/* DO NOT EDIT - Automatically generated by python */
		&sunwodasony_3900_110k_4400 {
			fcc = <3900>;
			default_rbatt_mohm = <100>;
			identify_type = "id_volt";
			id_identify_min = <2281>;
			id_identify_max = <2786>;
			id_voltage_min = <2426>;
			id_voltage_max = <2631>;
			vbat_max = <4400>;
			temp_para = 
						"-32767","0","-1","0","4100","0",
						"0","5","-1","390","4400","0",
						"5","10","-1","1170","4400","3",
						"10","45","-1","-1","4400","3",
						"45","50","-1","1365","4100","3",
						"50","32767","-1","0","4100","0";
			vbat_para = 
						"-32767","3400","-1","820","0",
						"3400","32767","-1","-1","0";
			segment_para = 
						"-32767","4150","3900","4208","50",
						"4150","4450","2730","4400","0";
			batt_brand = "sunwodasony";
			fcc_temp = <3857 3876 3892 3941 3918 3901>;
			fcc_sf_x = <0 100 200 300 400 500 600 700 800 1000 1500>;
			fcc_sf_y = <100 96 94 92 90 88 87 84 81 75 50>;
			fcc_sf_cols = <11>;
			pc_sf_rows = <1>;
			pc_sf_cols = <1>;
			pc_sf_row_entries = <0>;
			pc_sf_percent = <100>;
			pc_sf_sf = <100>;
			rbatt_sf_rows = <28>;
			rbatt_sf_cols = <6>;
			rbatt_sf_percent = <100 95 90 85 80 75 70 65 60 55 50 45 40 35 30 25 20 15 10 9 8 7 6 5 4 3 2 1>;
			rbatt_sf_sf = <
			               1354 673 331 126 100 90
			               1354 673 331 126 100 90
			               1345 688 342 129 101 90
			               1314 694 350 133 104 91
			               1320 688 354 138 107 92
			               1300 707 369 144 110 94
			               1268 675 359 152 115 97
			               1266 683 349 158 120 101
			               1269 685 340 147 120 103
			               1264 685 333 130 103 91
			               1284 695 336 127 100 89
			               1327 719 341 130 101 90
			               1373 758 351 134 104 92
			               1435 799 366 139 108 96
			               1514 850 398 140 110 93
			               1608 907 420 135 103 91
			               1749 992 453 136 104 94
			               1998 1164 505 136 105 94
			               3187 1631 656 140 106 95
			               3513 1576 556 143 106 95
			               4112 1573 534 142 106 96
			               5220 1792 594 144 108 97
			               6859 2243 686 146 108 96
			               9550 2825 803 145 107 94
			               16132 3694 925 149 108 96
			               29739 5496 1185 155 111 97
			               51777 10304 1614 219 117 101
			               75879 22013 2595 602 192 134
			              >;
			pc_temp_ocv_rows = <29>;
			pc_temp_ocv_cols = <6>;
			pc_temp_ocv_percent = <100 95 90 85 80 75 70 65 60 55 50 45 40 35 30 25 20 15 10 9 8 7 6 5 4 3 2 1>;
			pc_temp_ocv_ocv = <
			                   4354 4353 4350 4346 4337 4331
			                   4262 4274 4279 4282 4273 4268
			                   4191 4210 4217 4222 4214 4209
			                   4123 4150 4157 4164 4157 4153
			                   4073 4089 4100 4109 4103 4099
			                   4017 4041 4050 4057 4052 4049
			                   3957 3979 3996 4009 4006 4003
			                   3909 3932 3946 3963 3962 3960
			                   3870 3889 3902 3915 3917 3916
			                   3831 3850 3863 3872 3872 3869
			                   3801 3818 3832 3842 3841 3839
			                   3778 3793 3806 3818 3818 3815
			                   3756 3776 3786 3798 3799 3796
			                   3737 3759 3770 3782 3783 3780
			                   3721 3744 3759 3766 3766 3758
			                   3702 3726 3743 3746 3741 3728
			                   3684 3701 3721 3724 3720 3708
			                   3660 3669 3687 3694 3692 3679
			                   3624 3634 3644 3663 3660 3650
			                   3614 3626 3638 3659 3656 3645
			                   3600 3615 3630 3652 3650 3640
			                   3581 3601 3621 3644 3643 3634
			                   3558 3587 3611 3630 3631 3621
			                   3531 3568 3594 3600 3606 3592
			                   3498 3534 3561 3554 3564 3550
			                   3454 3480 3509 3494 3509 3497
			                   3395 3403 3436 3419 3439 3429
			                   3315 3310 3332 3335 3344 3336
			                   3200 3200 3200 3200 3200 3200
			                  >;
		};
