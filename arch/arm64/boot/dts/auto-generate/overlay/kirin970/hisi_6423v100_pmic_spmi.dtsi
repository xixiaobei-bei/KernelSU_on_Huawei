/*
 *  Copyright (C) 2012-2013 Linaro Ltd.
 *
 *  This program is free software; you can redistribute it and/or modify
 *  it under the terms of the GNU General Public License version 2 as
 *  publishhed by the Free Software Foundation.
 */

/ {
	spmi: spmi@FFF24000 {
		subpmic: subpmic@6 {
			compatible = "hisilicon-hisi-6423-pmic-spmi";
			slave_id = <6>;
			#interrupt-cells = <2>;
			interrupt-controller;
			hisilicon,hisi-subpmic-irq-addr = <0x0A>;/*hisi irq addr*/
			hisilicon,hisi-subpmic-irq-mask-addr = <0x0D>;/*hisi irq mask addr*/
			hisilicon,hisi-subpmic-irq-np-record = <0x80>;/*hisi irq np record*/
			bigfreq-limit-channel = "big-freq", "vote-src-2";
			gpufreq-limit-channel = "gpu-freq", "vote-src-2";
		 };/* end of subpmic */
	};/* end of spmi */
};
