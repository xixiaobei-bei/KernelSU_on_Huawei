/{
    hw_antenna_board_match:hw_antenna_board_match{
        compatible = "huawei,antenna_board_match";
        status = "disabled";
    };
    antenna_board_adc_match:antenna_board_adc_match{
        compatible = "huawei,antenna_board_adc_match";
        antenna_board_adc_channel = <12>;
        antenna_board_match_range = <825 975>;
        status = "disabled";
    };
};