/* DO NOT EDIT - Automatically generated by python */
		&desayatl_4900_39k_4400 {
			fcc = <4900>;
			default_rbatt_mohm = <100>;
			identify_type = "id_volt";
			id_identify_min = <1235>;
			id_identify_max = <1759>;
			id_voltage_min = <1420>;
			id_voltage_max = <1562>;
			vbat_max = <4400>;
			temp_para = 
						"-32767","0","-1","0","4100","0",
						"0","5","-1","490","4400","0",
						"5","10","-1","1470","4400","3",
						"10","45","-1","-1","4400","3",
						"45","50","-1","1715","4100","3",
						"50","32767","-1","0","4100","0";
			vbat_para = 
						"-32767","3400","-1","820","0",
						"3400","32767","-1","-1","0";
			segment_para = 
						"-32767","4150","4900","4208","50",
						"4150","4450","3430","4400","0";
			batt_brand = "desayatl";
			fcc_temp = <4959 4959 4983 4992 4975 4930>;
			fcc_sf_x = <0 100 200 300 400 500 600 700 800 1000 1500>;
			fcc_sf_y = <100 96 94 92 90 88 87 84 81 75 50>;
			fcc_sf_cols = <11>;
			pc_sf_rows = <1>;
			pc_sf_cols = <1>;
			pc_sf_row_entries = <0>;
			pc_sf_percent = <100>;
			pc_sf_sf = <100>;
			rbatt_sf_rows = <28>;
			rbatt_sf_cols = <6>;
			rbatt_sf_percent = <100 95 90 85 80 75 70 65 60 55 50 45 40 35 30 25 20 15 10 9 8 7 6 5 4 3 2 1>;
			rbatt_sf_sf = <
			               1476 1080 327 102 83 76
			               1474 1079 327 102 83 76
			               1349 1003 319 102 84 77
			               1258 940 314 102 84 77
			               1233 906 313 104 85 78
			               1168 880 326 106 87 80
			               1094 802 335 111 90 80
			               1097 786 309 117 92 83
			               1064 759 301 123 98 86
			               1090 738 280 110 92 80
			               1136 763 275 99 83 77
			               1167 794 276 99 83 78
			               1203 834 285 102 85 79
			               1239 881 310 104 88 81
			               1304 923 340 105 89 83
			               1368 989 376 103 84 78
			               1484 1055 420 102 84 78
			               1642 1136 478 105 84 79
			               2402 1261 438 103 86 80
			               2587 1365 463 105 86 81
			               2809 1490 508 105 87 82
			               3000 1632 561 107 88 82
			               3185 1786 632 108 88 82
			               3454 1969 682 107 87 80
			               3735 2140 705 108 87 80
			               4167 2379 817 109 87 81
			               4917 2743 975 114 89 83
			               6016 3310 1253 121 93 86
			              >;
			pc_temp_ocv_rows = <29>;
			pc_temp_ocv_cols = <6>;
			pc_temp_ocv_percent = <100 95 90 85 80 75 70 65 60 55 50 45 40 35 30 25 20 15 10 9 8 7 6 5 4 3 2 1>;
			pc_temp_ocv_ocv = <
			                   4389 4386 4384 4377 4373 4366
			                   4282 4291 4307 4312 4309 4303
			                   4208 4219 4243 4254 4251 4246
			                   4145 4157 4186 4196 4194 4189
			                   4101 4107 4132 4141 4138 4134
			                   4037 4059 4084 4087 4086 4082
			                   3961 3984 4029 4039 4037 4033
			                   3917 3939 3968 3990 3990 3989
			                   3872 3892 3924 3949 3950 3948
			                   3845 3848 3879 3897 3898 3895
			                   3825 3826 3844 3857 3859 3858
			                   3809 3811 3818 3831 3833 3832
			                   3796 3799 3799 3810 3812 3810
			                   3782 3788 3788 3793 3795 3793
			                   3768 3778 3779 3778 3777 3775
			                   3751 3765 3767 3762 3755 3743
			                   3733 3746 3748 3741 3733 3720
			                   3715 3718 3719 3715 3708 3695
			                   3692 3689 3690 3690 3683 3671
			                   3684 3684 3687 3688 3682 3669
			                   3678 3679 3683 3687 3680 3668
			                   3670 3674 3677 3684 3678 3665
			                   3655 3664 3668 3679 3672 3659
			                   3636 3647 3649 3664 3655 3638
			                   3601 3613 3611 3626 3619 3600
			                   3550 3561 3559 3573 3567 3548
			                   3483 3490 3487 3501 3498 3480
			                   3383 3388 3380 3396 3398 3381
			                   3200 3200 3200 3200 3200 3200
			                  >;
		};
