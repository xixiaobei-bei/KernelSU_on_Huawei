/*---------------------------------------------------------------------------
 * This file is autogenerated file using huawei LCD parser. Please do not edit it.
 * Update input XML file to add a new entry or update variable in this file
 * Parser location: vendor/huawei/chipset_common/devkit/lcdkit/tools 
 *---------------------------------------------------------------------------*/


/include/ "vce_auo_nt36682a_6p4_1080p_video.dtsi"
/include/ "vce_auo_otm1901a_5p2_1080p_video_default_1.dtsi"
/include/ "vce_auo_td4320_6p4_1080p_video.dtsi"
/include/ "vce_boe_nt36682a_6p4_1080p_video.dtsi"
/include/ "vce_boe_td4320_6p4_1080p_video.dtsi"
/include/ "vce_ctc_nt36682a_6p4_1080p_video.dtsi"
/include/ "vce_lg_td4320_6p4_1080p_video.dtsi"