/*---------------------------------------------------------------------------
 * This file is autogenerated file using huawei LCD parser. Please do not edit it.
 * Update input XML file to add a new entry or update variable in this file
 * Parser location: vendor/huawei/chipset_common/devkit/lcdkit/tools 
 *---------------------------------------------------------------------------*/


/include/ "alps_tugl_auo_otm1901a_5p2_1080p_video_default.dtsi"
/include/ "alps_tugl_auo_otm1901a_5p2_1080p_video_default_1.dtsi"
/include/ "alps_tugl_auo_otm1901a_5p2_1080p_video_default_2.dtsi"
/include/ "alps_tugl_jdi_2lane_nt36860c_5p88_1440p_cmd.dtsi"
/include/ "alps_tugl_jdi_2lane_nt36860c_cut2_5p88_1440p_cmd.dtsi"
/include/ "alps_tugl_jdi_nt36860_5p88_1440p_cmd.dtsi"
/include/ "alps_tugl_jdi_nt36860_temp_5p88_1440p_cmd.dtsi"
/include/ "alps_tugl_lgd_2lane_nt36870_5p88_1440p_cmd.dtsi"
/include/ "alps_tugl_lgd_2lane_nt36870_vn1_5p88_1440p_cmd.dtsi"
/include/ "alps_tugl_sharp_2lane_nt36870_5p88_1440p_cmd.dtsi"
/include/ "alps_tugl_sharp_2lane_nt36870_vn1_5p88_1440p_cmd.dtsi"
/include/ "alps_tugl_sharp_nt36870_5p88_1440p_cmd.dtsi"