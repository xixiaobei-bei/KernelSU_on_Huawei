/*---------------------------------------------------------------------------
 * This file is autogenerated file using huawei LCD parser. Please do not edit it.
 * Update input XML file to add a new entry or update variable in this file
 * Parser location: vendor/huawei/chipset_common/devkit/lcdkit/tools 
 *---------------------------------------------------------------------------*/


/include/ "cor_vn1_auo_otm1901a_5p2_1080p_video_default_1.dtsi"
/include/ "cor_vn1_boe_ft8719_6p3_1080p_video.dtsi"
/include/ "cor_vn1_boe_td4320_6p3_1080p_video.dtsi"
/include/ "cor_vn1_dpt_ft8719_6p3_1080p_video.dtsi"
/include/ "cor_vn1_dsbj_ft8719_6p3_1080p_video.dtsi"
/include/ "cor_vn1_tm_ft8719_6p3_1080p_video.dtsi"
/include/ "cor_vn1_tm_td4320_6p3_1080p_video.dtsi"