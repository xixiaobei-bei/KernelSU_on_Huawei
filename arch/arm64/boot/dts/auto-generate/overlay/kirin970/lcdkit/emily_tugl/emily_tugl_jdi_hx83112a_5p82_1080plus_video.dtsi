/* Copyright (c) 2013, The Linux Foundation. All rights reserved.
 *
 * This program is free software; you can redistribute it and/or modify
 * it under the terms of the GNU General Public License version 2 and
 * only version 2 as published by the Free Software Foundation.
 *
 * This program is distributed in the hope that it will be useful,
 * but WITHOUT ANY WARRANTY; without even the implied warranty of
 * MERCHANTABILITY or FITNESS FOR A PARTICULAR PURPOSE.  See the
 * GNU General Public License for more details.
 */

/*-------------------------------------------------------------------------
 * This file is autogenerated file using gcdb parser. Please do not edit it.
 * Update input XML file to add a new entry or update variable in this file
 * VERSION = 1.1
 *-----------------------------------------------------------------------*/
/ {
	dsi_emily_tugl_jdi_hx83112a_5p82_1080plus_video: lcdkit_emily_tugl_jdi_hx83112a_5p82_1080plus_video {
		compatible = "jdi_hx83112a_5p82_1080plus_video";
		hw,lcdkit-panel-name = "JDI_HX83112A 5.82' VIDEO TFT 1080 x 2244";
		hw,lcdkit-panel-type = <0x01>;
		hw,lcdkit-panel-xres = <1080>;
		hw,lcdkit-panel-yres = <2244>;
		hw,lcdkit-panel-width = <64>;
		hw,lcdkit-panel-height = <133>;
		hw,lcdkit-panel-on-command = <0x39 0x01 0x00 0x00 0x0a 0x00 0x04 0xB9 0x83 0x11 0x2A
			0x39 0x01 0x00 0x00 0x0a 0x00 0x03 0x51 0x0F 0xF0
			0x15 0x01 0x00 0x00 0x0a 0x00 0x02 0x53 0x24
			0x15 0x01 0x00 0x00 0x0a 0x00 0x02 0x55 0x10
			0x05 0x01 0x00 0x00 0x0a 0x00 0x02 0x11 0x00
			0x05 0x01 0x00 0x00 0x64 0x01 0x02 0x29 0x00>;
		hw,lcdkit-panel-on-command-state = "dsi_lp_mode";
		hw,lcdkit-panel-display-on-command = <0x05 0x01 0x00 0x00 0x78 0x00 0x02 0x29 0x00>;
		hw,lcdkit-panel-off-command = <0x05 0x01 0x00 0x00 0x1e 0x01 0x02 0x28 0x00
			0x05 0x01 0x00 0x00 0x28 0x01 0x02 0x10 0x00>;
		hw,lcdkit-panel-off-command-state = "dsi_lp_mode";
		hw,lcdkit-panel-backlight-command = <0x39 0x01 0x00 0x00 0x00 0x00 0x03 0x51 0x00 0x00>;
		hw,lcdkit-panel-backlight-command-state = "dsi_lp_mode";
		hw,lcdkit-panel-cabc-off-command = <0x15 0x01 0x00 0x00 0x0a 0x00 0x02 0x55 0x00>;
		hw,lcdkit-panel-cabc-off-command-state = "dsi_lp_mode";
		hw,lcdkit-panel-cabc-ui-command = <0x15 0x01 0x00 0x00 0x0a 0x00 0x02 0x55 0x01
			0x15 0x01 0x00 0x00 0x0a 0x00 0x02 0x53 0x24>;
		hw,lcdkit-panel-cabc-ui-command-state = "dsi_lp_mode";
		hw,lcdkit-panel-cabc-still-command = <0x15 0x01 0x00 0x00 0x0a 0x00 0x02 0x55 0x02
			0x15 0x01 0x00 0x00 0x0a 0x00 0x02 0x53 0x24>;
		hw,lcdkit-panel-cabc-still-command-state = "dsi_lp_mode";
		hw,lcdkit-panel-cabc-moving-command = <0x15 0x01 0x00 0x00 0x0a 0x00 0x02 0x55 0x03
			0x15 0x01 0x00 0x00 0x0a 0x00 0x02 0x53 0x2C>;
		hw,lcdkit-panel-cabc-moving-command-state = "dsi_lp_mode";
		hw,lcdkit-panel-cabc-support = <0>;
		hw,lcdkit-panel-rgbw-support = <0>;
		hw,lcdkit-panel-display-on-effect-command = <0x15 0x01 0x00 0x00 0x0a 0x00 0x02 0xFF 0x23
			0x15 0x01 0x00 0x00 0x0a 0x00 0x02 0xFB 0x01
			0x15 0x01 0x00 0x00 0x0a 0x00 0x02 0x00 0x02
			0x15 0x01 0x00 0x00 0x0a 0x00 0x02 0x01 0x84
			0x15 0x01 0x00 0x00 0x0a 0x00 0x02 0x05 0x24
			0x15 0x01 0x00 0x00 0x0a 0x00 0x02 0x19 0x00
			0x15 0x01 0x00 0x00 0x0a 0x00 0x02 0x1A 0x04
			0x15 0x01 0x00 0x00 0x0a 0x00 0x02 0x1B 0x08
			0x15 0x01 0x00 0x00 0x0a 0x00 0x02 0x1C 0x0C
			0x15 0x01 0x00 0x00 0x0a 0x00 0x02 0x1D 0x10
			0x15 0x01 0x00 0x00 0x0a 0x00 0x02 0x1E 0x14
			0x15 0x01 0x00 0x00 0x0a 0x00 0x02 0x1F 0x18
			0x15 0x01 0x00 0x00 0x0a 0x00 0x02 0x20 0x1C
			0x15 0x01 0x00 0x00 0x0a 0x00 0x02 0x21 0x20
			0x15 0x01 0x00 0x00 0x0a 0x00 0x02 0x22 0x24
			0x15 0x01 0x00 0x00 0x0a 0x00 0x02 0x23 0x28
			0x15 0x01 0x00 0x00 0x0a 0x00 0x02 0x24 0x2C
			0x15 0x01 0x00 0x00 0x0a 0x00 0x02 0x25 0x30
			0x15 0x01 0x00 0x00 0x0a 0x00 0x02 0x26 0x34
			0x15 0x01 0x00 0x00 0x0a 0x00 0x02 0x27 0x38
			0x15 0x01 0x00 0x00 0x0a 0x00 0x02 0x28 0x3C
			0x15 0x01 0x00 0x00 0x0a 0x00 0x02 0x29 0x24
			0x15 0x01 0x00 0x00 0x0a 0x00 0x02 0x2B 0x3D
			0x15 0x01 0x00 0x00 0x0a 0x00 0x02 0x30 0xFF
			0x15 0x01 0x00 0x00 0x0a 0x00 0x02 0x31 0xFD
			0x15 0x01 0x00 0x00 0x0a 0x00 0x02 0x32 0xFB
			0x15 0x01 0x00 0x00 0x0a 0x00 0x02 0x33 0xF9
			0x15 0x01 0x00 0x00 0x0a 0x00 0x02 0x34 0xF7
			0x15 0x01 0x00 0x00 0x0a 0x00 0x02 0x35 0xF5
			0x15 0x01 0x00 0x00 0x0a 0x00 0x02 0x36 0xF3
			0x15 0x01 0x00 0x00 0x0a 0x00 0x02 0x37 0xF1
			0x15 0x01 0x00 0x00 0x0a 0x00 0x02 0x38 0xEF
			0x15 0x01 0x00 0x00 0x0a 0x00 0x02 0x39 0xED
			0x15 0x01 0x00 0x00 0x0a 0x00 0x02 0x3A 0xEB
			0x15 0x01 0x00 0x00 0x0a 0x00 0x02 0x3B 0xE9
			0x15 0x01 0x00 0x00 0x0a 0x00 0x02 0x3D 0xE7
			0x15 0x01 0x00 0x00 0x0a 0x00 0x02 0x3F 0xE5
			0x15 0x01 0x00 0x00 0x0a 0x00 0x02 0x40 0xE3
			0x15 0x01 0x00 0x00 0x0a 0x00 0x02 0x41 0xE0
			0x15 0x01 0x00 0x00 0x0a 0x00 0x02 0x45 0xFF
			0x15 0x01 0x00 0x00 0x0a 0x00 0x02 0x46 0xFD
			0x15 0x01 0x00 0x00 0x0a 0x00 0x02 0x47 0xFB
			0x15 0x01 0x00 0x00 0x0a 0x00 0x02 0x48 0xF9
			0x15 0x01 0x00 0x00 0x0a 0x00 0x02 0x49 0xF7
			0x15 0x01 0x00 0x00 0x0a 0x00 0x02 0x4A 0xF5
			0x15 0x01 0x00 0x00 0x0a 0x00 0x02 0x4B 0xF3
			0x15 0x01 0x00 0x00 0x0a 0x00 0x02 0x4C 0xF1
			0x15 0x01 0x00 0x00 0x0a 0x00 0x02 0x4D 0xEF
			0x15 0x01 0x00 0x00 0x0a 0x00 0x02 0x4E 0xED
			0x15 0x01 0x00 0x00 0x0a 0x00 0x02 0x4F 0xEB
			0x15 0x01 0x00 0x00 0x0a 0x00 0x02 0x50 0xE9
			0x15 0x01 0x00 0x00 0x0a 0x00 0x02 0x51 0xE7
			0x15 0x01 0x00 0x00 0x0a 0x00 0x02 0x52 0xE5
			0x15 0x01 0x00 0x00 0x0a 0x00 0x02 0x53 0xE3
			0x15 0x01 0x00 0x00 0x0a 0x00 0x02 0x54 0xE0
			0x15 0x01 0x00 0x00 0x0a 0x00 0x02 0x58 0xFF
			0x15 0x01 0x00 0x00 0x0a 0x00 0x02 0x59 0xF8
			0x15 0x01 0x00 0x00 0x0a 0x00 0x02 0x5A 0xF1
			0x15 0x01 0x00 0x00 0x0a 0x00 0x02 0x5B 0xEA
			0x15 0x01 0x00 0x00 0x0a 0x00 0x02 0x5C 0xE3
			0x15 0x01 0x00 0x00 0x0a 0x00 0x02 0x5D 0xDC
			0x15 0x01 0x00 0x00 0x0a 0x00 0x02 0x5E 0xD5
			0x15 0x01 0x00 0x00 0x0a 0x00 0x02 0x5F 0xCE
			0x15 0x01 0x00 0x00 0x0a 0x00 0x02 0x60 0xC7
			0x15 0x01 0x00 0x00 0x0a 0x00 0x02 0x61 0xC0
			0x15 0x01 0x00 0x00 0x0a 0x00 0x02 0x62 0xB9
			0x15 0x01 0x00 0x00 0x0a 0x00 0x02 0x63 0xB2
			0x15 0x01 0x00 0x00 0x0a 0x00 0x02 0x64 0xAB
			0x15 0x01 0x00 0x00 0x0a 0x00 0x02 0x65 0xA4
			0x15 0x01 0x00 0x00 0x0a 0x00 0x02 0x66 0x9D
			0x15 0x01 0x00 0x00 0x0a 0x00 0x02 0x67 0x96
			0x15 0x01 0x00 0x00 0x0a 0x00 0x02 0xFF 0x10
			0x15 0x01 0x00 0x00 0x0a 0x00 0x02 0xFF 0x22
			0x15 0x01 0x00 0x00 0x0a 0x00 0x02 0xFB 0x01
			0x15 0x01 0x00 0x00 0x0a 0x00 0x02 0x00 0x40
			0x15 0x01 0x00 0x00 0x0a 0x00 0x02 0x01 0x54
			0x15 0x01 0x00 0x00 0x0a 0x00 0x02 0x02 0x5A
			0x15 0x01 0x00 0x00 0x0a 0x00 0x02 0x03 0x60
			0x15 0x01 0x00 0x00 0x0a 0x00 0x02 0x04 0x66
			0x15 0x01 0x00 0x00 0x0a 0x00 0x02 0x05 0x6A
			0x15 0x01 0x00 0x00 0x0a 0x00 0x02 0x06 0x6C
			0x15 0x01 0x00 0x00 0x0a 0x00 0x02 0x07 0x6C
			0x15 0x01 0x00 0x00 0x0a 0x00 0x02 0x08 0x68
			0x15 0x01 0x00 0x00 0x0a 0x00 0x02 0x09 0x62
			0x15 0x01 0x00 0x00 0x0a 0x00 0x02 0x0A 0x5B
			0x15 0x01 0x00 0x00 0x0a 0x00 0x02 0x0B 0x53
			0x15 0x01 0x00 0x00 0x0a 0x00 0x02 0x0C 0x4D
			0x15 0x01 0x00 0x00 0x0a 0x00 0x02 0x0D 0x43
			0x15 0x01 0x00 0x00 0x0a 0x00 0x02 0x0E 0x44
			0x15 0x01 0x00 0x00 0x0a 0x00 0x02 0x0F 0x41
			0x15 0x01 0x00 0x00 0x0a 0x00 0x02 0x10 0x40
			0x15 0x01 0x00 0x00 0x0a 0x00 0x02 0x11 0x50
			0x15 0x01 0x00 0x00 0x0a 0x00 0x02 0x12 0x60
			0x15 0x01 0x00 0x00 0x0a 0x00 0x02 0x13 0x70
			0x15 0x01 0x00 0x00 0x0a 0x00 0x02 0x14 0x58
			0x15 0x01 0x00 0x00 0x0a 0x00 0x02 0x15 0x68
			0x15 0x01 0x00 0x00 0x0a 0x00 0x02 0x16 0x78
			0x15 0x01 0x00 0x00 0x0a 0x00 0x02 0x17 0x00
			0x15 0x01 0x00 0x00 0x0a 0x00 0x02 0x18 0x40
			0x15 0x01 0x00 0x00 0x0a 0x00 0x02 0x19 0x40
			0x15 0x01 0x00 0x00 0x0a 0x00 0x02 0x1A 0x40
			0x15 0x01 0x00 0x00 0x0a 0x00 0x02 0x1B 0x40
			0x15 0x01 0x00 0x00 0x0a 0x00 0x02 0x1C 0x40
			0x15 0x01 0x00 0x00 0x0a 0x00 0x02 0x1D 0x40
			0x15 0x01 0x00 0x00 0x0a 0x00 0x02 0x1E 0x40
			0x15 0x01 0x00 0x00 0x0a 0x00 0x02 0x1F 0x40
			0x15 0x01 0x00 0x00 0x0a 0x00 0x02 0x20 0x40
			0x15 0x01 0x00 0x00 0x0a 0x00 0x02 0x21 0x45
			0x15 0x01 0x00 0x00 0x0a 0x00 0x02 0x22 0x49
			0x15 0x01 0x00 0x00 0x0a 0x00 0x02 0x23 0x4C
			0x15 0x01 0x00 0x00 0x0a 0x00 0x02 0x24 0x4B
			0x15 0x01 0x00 0x00 0x0a 0x00 0x02 0x25 0x48
			0x15 0x01 0x00 0x00 0x0a 0x00 0x02 0x26 0x44
			0x15 0x01 0x00 0x00 0x0a 0x00 0x02 0x27 0x41
			0x15 0x01 0x00 0x00 0x0a 0x00 0x02 0x28 0x40
			0x15 0x01 0x00 0x00 0x0a 0x00 0x02 0x2D 0x00
			0x15 0x01 0x00 0x00 0x0a 0x00 0x02 0x2F 0x40
			0x15 0x01 0x00 0x00 0x0a 0x00 0x02 0x30 0x40
			0x15 0x01 0x00 0x00 0x0a 0x00 0x02 0x31 0x3E
			0x15 0x01 0x00 0x00 0x0a 0x00 0x02 0x32 0x3E
			0x15 0x01 0x00 0x00 0x0a 0x00 0x02 0x33 0x3B
			0x15 0x01 0x00 0x00 0x0a 0x00 0x02 0x34 0x3A
			0x15 0x01 0x00 0x00 0x0a 0x00 0x02 0x35 0x3A
			0x15 0x01 0x00 0x00 0x0a 0x00 0x02 0x36 0x3A
			0x15 0x01 0x00 0x00 0x0a 0x00 0x02 0x37 0x3A
			0x15 0x01 0x00 0x00 0x0a 0x00 0x02 0x38 0x3B
			0x15 0x01 0x00 0x00 0x0a 0x00 0x02 0x39 0x3C
			0x15 0x01 0x00 0x00 0x0a 0x00 0x02 0x3A 0x3E
			0x15 0x01 0x00 0x00 0x0a 0x00 0x02 0x3B 0x3F
			0x15 0x01 0x00 0x00 0x0a 0x00 0x02 0x3D 0x40
			0x15 0x01 0x00 0x00 0x0a 0x00 0x02 0x3F 0x40
			0x15 0x01 0x00 0x00 0x0a 0x00 0x02 0x40 0x40
			0x15 0x01 0x00 0x00 0x0a 0x00 0x02 0x41 0x40
			0x15 0x01 0x00 0x00 0x0a 0x00 0x02 0x42 0x40
			0x15 0x01 0x00 0x00 0x0a 0x00 0x02 0x43 0x40
			0x15 0x01 0x00 0x00 0x0a 0x00 0x02 0x44 0x3E
			0x15 0x01 0x00 0x00 0x0a 0x00 0x02 0x45 0x3E
			0x15 0x01 0x00 0x00 0x0a 0x00 0x02 0x46 0x3B
			0x15 0x01 0x00 0x00 0x0a 0x00 0x02 0x47 0x3A
			0x15 0x01 0x00 0x00 0x0a 0x00 0x02 0x48 0x3A
			0x15 0x01 0x00 0x00 0x0a 0x00 0x02 0x49 0x3A
			0x15 0x01 0x00 0x00 0x0a 0x00 0x02 0x4A 0x3A
			0x15 0x01 0x00 0x00 0x0a 0x00 0x02 0x4B 0x3A
			0x15 0x01 0x00 0x00 0x0a 0x00 0x02 0x4C 0x3A
			0x15 0x01 0x00 0x00 0x0a 0x00 0x02 0x4D 0x3A
			0x15 0x01 0x00 0x00 0x0a 0x00 0x02 0x4E 0x3A
			0x15 0x01 0x00 0x00 0x0a 0x00 0x02 0x4F 0x3B
			0x15 0x01 0x00 0x00 0x0a 0x00 0x02 0x50 0x3D
			0x15 0x01 0x00 0x00 0x0a 0x00 0x02 0x51 0x3F
			0x15 0x01 0x00 0x00 0x0a 0x00 0x02 0x52 0x40
			0x15 0x01 0x00 0x00 0x0a 0x00 0x02 0x53 0x77
			0x15 0x01 0x00 0x00 0x0a 0x00 0x02 0x54 0x00
			0x15 0x01 0x00 0x00 0x0a 0x00 0x02 0x55 0x88
			0x15 0x01 0x00 0x00 0x0a 0x00 0x02 0x56 0x77
			0x15 0x01 0x00 0x00 0x0a 0x00 0x02 0x58 0xC0
			0x15 0x01 0x00 0x00 0x0a 0x00 0x02 0x59 0xC0
			0x15 0x01 0x00 0x00 0x0a 0x00 0x02 0x5A 0x40
			0x15 0x01 0x00 0x00 0x0a 0x00 0x02 0x5B 0x40
			0x15 0x01 0x00 0x00 0x0a 0x00 0x02 0x5C 0x40
			0x15 0x01 0x00 0x00 0x0a 0x00 0x02 0x5D 0x40
			0x15 0x01 0x00 0x00 0x0a 0x00 0x02 0x5E 0x40
			0x15 0x01 0x00 0x00 0x0a 0x00 0x02 0x5F 0x40
			0x15 0x01 0x00 0x00 0x0a 0x00 0x02 0x60 0x40
			0x15 0x01 0x00 0x00 0x0a 0x00 0x02 0x61 0x40
			0x15 0x01 0x00 0x00 0x0a 0x00 0x02 0x62 0x40
			0x15 0x01 0x00 0x00 0x0a 0x00 0x02 0x63 0x40
			0x15 0x01 0x00 0x00 0x0a 0x00 0x02 0x64 0x40
			0x15 0x01 0x00 0x00 0x0a 0x00 0x02 0x65 0x40
			0x15 0x01 0x00 0x00 0x0a 0x00 0x02 0x66 0x40
			0x15 0x01 0x00 0x00 0x0a 0x00 0x02 0x67 0x40
			0x15 0x01 0x00 0x00 0x0a 0x00 0x02 0x68 0x40
			0x15 0x01 0x00 0x00 0x0a 0x00 0x02 0x69 0x40
			0x15 0x01 0x00 0x00 0x0a 0x00 0x02 0x6A 0x40
			0x15 0x01 0x00 0x00 0x0a 0x00 0x02 0x6B 0x40
			0x15 0x01 0x00 0x00 0x0a 0x00 0x02 0x6C 0x40
			0x15 0x01 0x00 0x00 0x0a 0x00 0x02 0x6D 0x40
			0x15 0x01 0x00 0x00 0x0a 0x00 0x02 0x6E 0x40
			0x15 0x01 0x00 0x00 0x0a 0x00 0x02 0x6F 0x40
			0x15 0x01 0x00 0x00 0x0a 0x00 0x02 0x70 0x0C
			0x15 0x01 0x00 0x00 0x0a 0x00 0x02 0x71 0x00
			0x15 0x01 0x00 0x00 0x0a 0x00 0x02 0x72 0x00
			0x15 0x01 0x00 0x00 0x0a 0x00 0x02 0x73 0x00
			0x15 0x01 0x00 0x00 0x0a 0x00 0x02 0x74 0x03
			0x15 0x01 0x00 0x00 0x0a 0x00 0x02 0x75 0x0C
			0x15 0x01 0x00 0x00 0x0a 0x00 0x02 0x76 0x03
			0x15 0x01 0x00 0x00 0x0a 0x00 0x02 0x77 0x09
			0x15 0x01 0x00 0x00 0x0a 0x00 0x02 0x78 0x0F
			0x15 0x01 0x00 0x00 0x0a 0x00 0x02 0x79 0x68
			0x15 0x01 0x00 0x00 0x0a 0x00 0x02 0x7A 0x88
			0x15 0x01 0x00 0x00 0x0a 0x00 0x02 0x83 0x00
			0x15 0x01 0x00 0x00 0x0a 0x00 0x02 0x84 0x28
			0x15 0x01 0x00 0x00 0x0a 0x00 0x02 0x85 0x5F
			0x15 0x01 0x00 0x00 0x0a 0x00 0x02 0x86 0x50
			0x15 0x01 0x00 0x00 0x0a 0x00 0x02 0x87 0x22
			0x15 0x01 0x00 0x00 0x0a 0x00 0x02 0x88 0x40
			0x15 0x01 0x00 0x00 0x0a 0x00 0x02 0x89 0x4E
			0x15 0x01 0x00 0x00 0x0a 0x00 0x02 0x8A 0x4F
			0x15 0x01 0x00 0x00 0x0a 0x00 0x02 0x8B 0x50
			0x15 0x01 0x00 0x00 0x0a 0x00 0x02 0x8C 0x50
			0x15 0x01 0x00 0x00 0x0a 0x00 0x02 0x8D 0x40
			0x15 0x01 0x00 0x00 0x0a 0x00 0x02 0x8E 0x40
			0x15 0x01 0x00 0x00 0x0a 0x00 0x02 0x8F 0x00
			0x15 0x01 0x00 0x00 0x0a 0x00 0x02 0x90 0x1E
			0x15 0x01 0x00 0x00 0x0a 0x00 0x02 0x91 0x23
			0x15 0x01 0x00 0x00 0x0a 0x00 0x02 0x92 0x3A
			0x15 0x01 0x00 0x00 0x0a 0x00 0x02 0x93 0x40
			0x15 0x01 0x00 0x00 0x0a 0x00 0x02 0x94 0x40
			0x15 0x01 0x00 0x00 0x0a 0x00 0x02 0x95 0x40
			0x15 0x01 0x00 0x00 0x0a 0x00 0x02 0x96 0x49
			0x15 0x01 0x00 0x00 0x0a 0x00 0x02 0x97 0x49
			0x15 0x01 0x00 0x00 0x0a 0x00 0x02 0x98 0x43
			0x15 0x01 0x00 0x00 0x0a 0x00 0x02 0x99 0x43
			0x15 0x01 0x00 0x00 0x0a 0x00 0x02 0x9A 0x3C
			0x15 0x01 0x00 0x00 0x0a 0x00 0x02 0x9B 0x40
			0x15 0x01 0x00 0x00 0x0a 0x00 0x02 0x9C 0x40
			0x15 0x01 0x00 0x00 0x0a 0x00 0x02 0x9D 0x40
			0x15 0x01 0x00 0x00 0x0a 0x00 0x02 0x9E 0x4C
			0x15 0x01 0x00 0x00 0x0a 0x00 0x02 0x9F 0x4D
			0x15 0x01 0x00 0x00 0x0a 0x00 0x02 0xA0 0x4E
			0x15 0x01 0x00 0x00 0x0a 0x00 0x02 0xA2 0x20
			0x15 0x01 0x00 0x00 0x0a 0x00 0x02 0xB3 0x00
			0x15 0x01 0x00 0x00 0x0a 0x00 0x02 0xB7 0x00
			0x15 0x01 0x00 0x00 0x0a 0x00 0x02 0xB8 0x00
			0x15 0x01 0x00 0x00 0x0a 0x00 0x02 0xFF 0x10
			0x15 0x01 0x00 0x00 0x0a 0x00 0x02 0x53 0x24
			0x15 0x01 0x00 0x00 0x0a 0x00 0x02 0x55 0x81>;
		hw,lcdkit-panel-display-on-effect-support = <0>;
		hw,lcdkit-panel-ce-off-command = <>;
		hw,lcdkit-panel-ce-srgb-command = <>;
		hw,lcdkit-panel-ce-user-command = <>;
		hw,lcdkit-panel-ce-vivid-command = <>;
		hw,lcdkit-panel-ce-support = <0>;
		hw,lcdkit-panel-version-support = <0>;
		hw,lcdkit-panel-otp-support = <0>;
		hw,lcdkit-panel-inversion-support = <0>;
		hw,lcdkit-panel-scan-support = <0>;
		hw,lcdkit-panel-display-region-support = <0>;
		hw,lcdkit-panel-checksum-enter-command = <0x15 0x01 0x00 0x00 0x0a 0x00 0x02 0xFF 0xF0
				0x15 0x01 0x00 0x00 0x0a 0x00 0x02 0xEA 0x00
				0x15 0x01 0x00 0x00 0x0a 0x00 0x02 0x7B 0x00>;
		hw,lcdkit-panel-checksum-enable-command = <0x15 0x01 0x00 0x00 0x0a 0x00 0x02 0xFF 0xF0
					0x15 0x01 0x00 0x00 0x0a 0x00 0x02 0x92 0x01>;
		hw,lcdkit-panel-checksum-disable-command = <0x15 0x01 0x00 0x00 0x0a 0x00 0x02 0xFF 0xF0
					0x15 0x01 0x00 0x00 0x0a 0x00 0x02 0x92 0x00
					0x15 0x01 0x00 0x00 0x0a 0x00 0x02 0x7B 0x00
					0x15 0x01 0x00 0x00 0x0a 0x00 0x02 0xFF 0x10>;
		hw,lcdkit-panel-checksum-command = <0x06 0x01 0x00 0x00 0x14 0x00 0x01 0x73>;
		hw,lcdkit-panel-checksum-exit-command = <0x15 0x01 0x00 0x00 0x0a 0x00 0x02 0xFF 0x10
				0x15 0x01 0x00 0x00 0x0a 0x00 0x02 0xFB 0x01>;
		hw,lcdkit-panel-checksum-support = <0>;
		hw,lcdkit-panel-checksum-second-part-support = <0>;
		hw,lcdkit-panel-esd-reg-command = <0x06 0x01 0x00 0x00 0x0a 0x00 0x01 0x0a>;
		hw,lcdkit-panel-esd-reg-command-state = "dsi_lp_mode";
		hw,lcdkit-panel-esd-value = <0x9c>;
		hw,lcdkit-panel-esd-support = <0>;
		hw,lcdkit-panel-check-reg-command = <0x06 0x01 0x00 0x00 0x0a 0x00 0x01 0x0a>;
		hw,lcdkit-panel-check-reg-value = <0x9c>;
		hw,lcdkit-panel-check-reg-command-state = "dsi_lp_mode";
		hw,lcdkit-panel-check-reg-support = <0>;
		hw,lcdkit-panel-brightness-color-uniform-support = <0>;
		hw,lcdkit-panel-dynamic-gamma-support = <1>;
		hw,lcdkit-panel-mipi-detect-support = <0>;
		hw,lcdkit-panel-dynamic-sram-check-support = <0>;
		hw,lcdkit-panel-fps-to-thirty-command = <
				
				0x15 0x01 0x00 0x00 0x0a 0x00 0x02 0xff 0x25
				0x15 0x01 0x00 0x00 0x0a 0x00 0x02 0xcb 0x07
				0x15 0x01 0x00 0x00 0x0a 0x00 0x02 0xcc 0x8a
				0x15 0x01 0x00 0x00 0x0a 0x00 0x02 0xfb 0x01
				0x15 0x01 0x00 0x00 0x0a 0x00 0x02 0xff 0x24
				0x15 0x01 0x00 0x00 0x0a 0x00 0x02 0x80 0x06
				0x15 0x01 0x00 0x00 0x0a 0x00 0x02 0xfb 0x01
				0x15 0x01 0x00 0x00 0x0a 0x00 0x02 0xff 0x10
				0x15 0x01 0x00 0x00 0x0a 0x00 0x02 0x26 0x08
				0x15 0x01 0x00 0x00 0x0a 0x00 0x02 0xfb 0x01
				
				0x15 0x01 0x00 0x00 0x0a 0x00 0x02 0xff 0x10
				0x15 0x01 0x00 0x00 0x0a 0x00 0x02 0xb1 0x00
				0x15 0x01 0x00 0x00 0x0a 0x00 0x02 0xfb 0x01
				>;
		hw,lcdkit-panel-fps-to-thirty-command-state = "dsi_hs_mode";
		hw,lcdkit-panel-fps-to-sixty-command = <
				
				0x15 0x01 0x00 0x00 0x0a 0x00 0x02 0xff 0x25
				0x15 0x01 0x00 0x00 0x0a 0x00 0x02 0xcb 0x00
				0x15 0x01 0x00 0x00 0x0a 0x00 0x02 0xcc 0x04
				0x15 0x01 0x00 0x00 0x0a 0x00 0x02 0xfb 0x01
				0x15 0x01 0x00 0x00 0x0a 0x00 0x02 0xff 0x24
				0x15 0x01 0x00 0x00 0x0a 0x00 0x02 0x80 0x02
				0x15 0x01 0x00 0x00 0x0a 0x00 0x02 0xfb 0x01
				0x15 0x01 0x00 0x00 0x0a 0x00 0x02 0xff 0x10
				0x15 0x01 0x00 0x00 0x0a 0x00 0x02 0x26 0x01
				0x15 0x01 0x00 0x00 0x0a 0x00 0x02 0xfb 0x01
				
				0x15 0x01 0x00 0x00 0x0a 0x00 0x02 0xff 0x10
				0x15 0x01 0x00 0x00 0x0a 0x00 0x02 0xb1 0x00
				0x15 0x01 0x00 0x00 0x0a 0x00 0x02 0xfb 0x01
				>;
		hw,lcdkit-panel-fps-to-sixty-command-state = "dsi_hs_mode";
		hw,lcdkit-panel-dfr-enable-command = <
				
				0x15 0x01 0x00 0x00 0x0a 0x00 0x02 0xff 0x25
				0x15 0x01 0x00 0x00 0x0a 0x00 0x02 0xcb 0x00
				0x15 0x01 0x00 0x00 0x0a 0x00 0x02 0xcc 0x04
				0x15 0x01 0x00 0x00 0x0a 0x00 0x02 0xfb 0x01
				0x15 0x01 0x00 0x00 0x0a 0x00 0x02 0xff 0x24
				0x15 0x01 0x00 0x00 0x0a 0x00 0x02 0x80 0x02
				0x15 0x01 0x00 0x00 0x0a 0x00 0x02 0xfb 0x01
				0x15 0x01 0x00 0x00 0x0a 0x00 0x02 0xff 0x10
				0x15 0x01 0x00 0x00 0x0a 0x00 0x02 0x26 0x01
				0x15 0x01 0x00 0x00 0x0a 0x00 0x02 0xfb 0x01
				
				0x15 0x01 0x00 0x00 0x0a 0x00 0x02 0xff 0x10
				0x15 0x01 0x00 0x00 0x0a 0x00 0x02 0xb1 0x03
				0x15 0x01 0x00 0x00 0x0a 0x00 0x02 0xfb 0x01
				>;
		hw,lcdkit-panel-dfr-enable-command-state = "dsi_hs_mode";
		hw,lcdkit-panel-fps-updt-support = <0>;
		hw,lcdkit-panel-fps-func-switch = <0>;
		hw,lcdkit-panel-check-reg-on-support = <0>;
		hw,lcdkit-panel-fps-tscall-support = <0>;
		hw,lcdkit-panel-dis-on-cmds-delay-margin-support = <0>;
		hw,lcdkit-panel-snd-cmd-before-frame-support = <0>;
		hw,lcdkit-panel-ts-resume-ctrl-mode = <0>;
		hw,lcdkit-panel-dis-on-cmds-delay-margin-time = <0>;
		hw,lcdkit-panel-lptohs-mipi-check-support = <0>;
		hw,lcdkit-panel-acl-ctrl-support = <0>;
		hw,lcdkit-panel-hbm-ctrl-support = <0>;
		hw,lcdkit-panel-vr-support = <0>;
		hw,lcdkit-panel-current-detect-support = <0>;
		hw,lcdkit-panel-lv-detect-support = <0>;
		hw,lcdkit-host-eml-read-reg-flag = <1>;
		hw,lcdkit-reset-shutdown-later = <0>;
		hw,lcdkit-panel-pcd-errflag-check-support = <0>;
		hw,lcdkit-panel-pt-ulps-support = <0>;
		hw,lcdkit-panel-aod-support = <0>;
		hw,lcdkit-panel-orientation = <1>;
		hw,lcdkit-panel-bpp = <0>;
		hw,lcdkit-panel-bgrfmt = <0>;
		hw,lcdkit-panel-bl-type = <4>;
		hw,lcdkit-panel-blmin = <15>;
		hw,lcdkit-panel-blmax = <8820>;
		hw,lcdkit-mask-delay-time-before-fp = <16666>;
		hw,lcdkit-mask-delay-time-after-fp = <16666>;
		hw,lcdkit-panel-bl-def = <4000>;
		hw,lcdkit-panel-bl-maxnit = <750>;
		hw,lcdkit-panel-getblmaxnit-type = <0>;
		hw,lcdkit-panel-cmd-type = <8>;
		hw,lcdkit-panel-dsi1-snd-cmd-panel-support = <0>;
		hw,lcdkit-panel-ifbctype = <0>;
		hw,lcdkit-panel-ifbc-vesa3x-set = <0>;
		hw,lcdkit-panel-frc-enable = <0>;
		hw,lcdkit-panel-esd-skip-mipi-check = <1>;
		hw,lcdkit-panel-pxl-clk = <160>;
		hw,lcdkit-panel-pxl-clk-div = <1>;
		hw,lcdkit-panel-tp-resume-nosync = <1>;
		hw,lcdkit-panel-display-on-in-backlight = <0>;
		hw,lcdkit-panel-display-on-new-seq = <0>;
		hw,lcdkit-panel-dirt-updt-support = <0>;
		hw,lcdkit-is-hostprocessing = <1>;
		hw,lcdkit-host-info-all-in-ddic = <1>;
		hw,lcdkit-panel-dsi-upt-support = <0>;
		hw,mipiclk-updt-support-new = <0>;
		hw,lcdkit-panel-vsyn-ctr-type = <0>;
		hw,lcdkit-panel-bl-pwm-preci-no-convert = <0>;
		hw,lcdkit-panel-bl-pwm-preci-type = <2>;
		hw,lcdkit-panel-bl-ic-ctrl-type = <8>;
		hw,lcdkit-panel-fps-updt-only = <0>;
		hw,lcdkit-panel-step-support = <1>;
		hw,lcdkit-ldi-hsync-plr = <0>;
		hw,lcdkit-ldi-vsync-plr = <0>;
		hw,lcdkit-ldi-pixel-clk-plr = <0>;
		hw,lcdkit-ldi-data-en-plr = <0>;
		hw,lcdkit-ldi-dpi-a-overlap-size = <0>;
		hw,lcdkit-ldi-dpi-b-overlap-size = <0>;
		hw,lcdkit-sbl-stren-limit = <128>;
		hw,lcdkit-sbl-cal-a = <60>;
		hw,lcdkit-sbl-cal-b = <95>;
		hw,lcdkit-sbl-cal-c = <5>;
		hw,lcdkit-sbl-cal-d = <1>;
		hw,lcdkit-sbl-tf-ctl = <5>;
		hw,lcdkit-sbl-bl-min = <480>;
		hw,lcdkit-sbl-bl-max = <4096>;
		hw,lcdkit-sbl-bl-scale = <0xff>;
		hw,lcdkit-sbl-am-light-min = <14>;
		hw,lcdkit-sbl-filter-a = <1738>;
		hw,lcdkit-sbl-filter-b = <6>;
		hw,lcdkit-sbl-logo-left = <0>;
		hw,lcdkit-sbl-logo-top = <0>;
		hw,lcdkit-sbl-variance-intensity-space = <145>;
		hw,lcdkit-sbl-slope-max = <54>;
		hw,lcdkit-sbl-slope-min = <160>;
		hw,lcdkit-mipi-lane-nums = <3>;
		hw,lcdkit-mipi-color-mode = <5>;
		hw,lcdkit-mipi-vc = <0>;
		hw,lcdkit-mipi-dsi-bit-clk = <480>;
		hw,lcdkit-mipi-burst-mode = <2>;
		hw,lcdkit-mipi-max-esc-clk = <10>;
		hw,lcdkit-mipi-dsi-bit-clk-val-a = <480>;
		hw,lcdkit-mipi-dsi-bit-clk-val-b = <480>;
		hw,lcdkit-mipi-dsi-bit-clk-val-c = <0>;
		hw,lcdkit-mipi-dsi-bit-clk-val-d = <0>;
		hw,lcdkit-mipi-dsi-bit-clk-val-e = <0>;
		hw,lcdkit-mipi-dsi-bit-clk-upt = <480>;
		hw,lcdkit-mipi-rg-vcm-adjust = <0>;
		hw,lcdkit-mipi-non-continue-enable = <1>;
		hw,lcdkit-mipi-clk-post-adjust = <215>;
		hw,lcdkit-mipi-lp11_flag = <0>;
		hw,lcdkit-mipi-clk-pre-adjust = <0>;
		hw,lcdkit-mipi-clk-t-hs-prepare-adjust = <0>;
		hw,lcdkit-mipi-clk-t-lpx-adjust = <0>;
		hw,lcdkit-mipi-clk-t-hs-trail-adjust = <0>;
		hw,lcdkit-mipi-clk-t-hs-exit-adjust = <0>;
		hw,lcdkit-mipi-clk-t-hs-zero-adjust = <0>;
		hw,lcdkit-mipi-data-t-lpx-adjust = <0>;
		hw,lcdkit-mipi-phy-mode = <0>;
		hw,lcdkit-mipi-eotp-disable-flag = <0>;
		hw,lcdkit-blpwm-input-disable = <0>;
		hw,lcdkit-dirt-left-align = <0xffff>;
		hw,lcdkit-dirt-right-align = <0xffff>;
		hw,lcdkit-dirt-top-align = <8>;
		hw,lcdkit-dirt-bott-align = <0xffff>;
		hw,lcdkit-dirt-width-align = <0xffff>;
		hw,lcdkit-dirt-height-align = <8>;
		hw,lcdkit-dirt-width-min = <1080>;
		hw,lcdkit-dirt-height-min = <8>;
		hw,lcdkit-dirt-top-start = <0xffff>;
		hw,lcdkit-dirt-bott-start = <0xffff>;
		hw,lcdkit-bl-byte-order = <0>;
		hw,lcdkit-iovcc-before-vci-flag = <0>;
		hw,lcdkit-gpios = <&gpio4 2 0>,<&gpio6 3 0>,<&gpio1 4 0>,<&gpio26 2 0>,<&gpio24 4 0>,<&gpio4 3 0>;
		lcdio-vcc-supply = <&ldo4>;
		lcdanalog-vcc-supply = <&ldo17>;
		pinctrl-0 = <&gpio029_pmx_func &gpio029_cfg_func>;
		pinctrl-1 = <&gpio029_pmx_idle &gpio029_cfg_idle>;
		pinctrl-names = "default","idle";
		status = "disabled";
		hw,lcdkit-sbl-support = <0>;
		hw,lcdkit-gamma-support = <1>;
		hw,lcdkit-gmp-support = <1>;
		hw,lcdkit-color-temp-support = <1>;
		hw,lcdkit-color-temp-rectify-support = <1>;
		hw,lcdkit-comform-mode-support = <1>;
		hw,lcdkit-cinema-mode-support = <0>;
		hw,lcdkit-prefix-sharp-two-d-support = <1>;
		hw,lcdkit-xcc-support = <1>;
		hw,lcdkit-prefix-ce-support = <0>;
		hw,lcdkit-prefix-sharp-one-d-support = <0>;
		hw,lcdkit-acm-support = <0>;
		hw,lcdkit-smart-color-mode-support = <0>;
		hw,lcdkit-acm-ce-support = <0>;
		hw,lcdkit-acm-valid-num = <7>;
		hw,lcdkit-r_hh0 = <0x80>;
		hw,lcdkit-r_lh0 = <0x0>;
		hw,lcdkit-r_hh1 = <0xff>;
		hw,lcdkit-r_lh1 = <0x81>;
		hw,lcdkit-r_hh2 = <0x17f>;
		hw,lcdkit-r_lh2 = <0x100>;
		hw,lcdkit-r_hh3 = <0x1ff>;
		hw,lcdkit-r_lh3 = <0x180>;
		hw,lcdkit-r_hh4 = <0x281>;
		hw,lcdkit-r_lh4 = <0x200>;
		hw,lcdkit-r_hh5 = <0x2ff>;
		hw,lcdkit-r_lh5 = <0x282>;
		hw,lcdkit-r_hh6 = <0x380>;
		hw,lcdkit-r_lh6 = <0x300>;
		hw,lcdkit-r_video_hh0 = <0x7f>;
		hw,lcdkit-r_video_lh0 = <0x0>;
		hw,lcdkit-r_video_hh1 = <0x101>;
		hw,lcdkit-r_video_lh1 = <0x80>;
		hw,lcdkit-r_video_hh2 = <0x177>;
		hw,lcdkit-r_video_lh2 = <0x102>;
		hw,lcdkit-r_video_hh3 = <0x1ed>;
		hw,lcdkit-r_video_lh3 = <0x178>;
		hw,lcdkit-r_video_hh4 = <0x26f>;
		hw,lcdkit-r_video_lh4 = <0x1ee>;
		hw,lcdkit-r_video_hh5 = <0x2ff>;
		hw,lcdkit-r_video_lh5 = <0x270>;
		hw,lcdkit-r_video_hh6 = <0x37c>;
		hw,lcdkit-r_video_lh6 = <0x300>;
		hw,lcdkit-color-temp-rectify-r = <32768>;
		hw,lcdkit-color-temp-rectify-g = <32334>;
		hw,lcdkit-color-temp-rectify-b = <32384>;
		hw,lcdkit-hiace-support = <1>;
		hw,lcdkit-panel-effect-support = <0>;
		hw,lcdkit-arsr1p-sharpness-support = <1>;
		hw,lcdkit-iglobal-hist-black-pos = <16>;
		hw,lcdkit-iglobal-hist-white-pos = <240>;
		hw,lcdkit-iglobal-hist-black-weight = <51>;
		hw,lcdkit-iglobal-hist-white-weight = <51>;
		hw,lcdkit-iglobal-hist-zero-cut-ratio = <486>;
		hw,lcdkit-iglobal-hist-slope-cut-ratio = <410>;
		hw,lcdkit-imax-lcd-luminance = <500>;
		hw,lcdkit-imin-lcd-luminance = <3>;
		hw,lcdkit-cfg-name = "/product/etc/display/effect/algorithm/hdr_engine.xml";
		hw,lcdkit-effect-support-mode = <65537>;
		hw,lcdkit-bl-support-mode = <0>;
		hw,lcdkit-bl-enhance = <0>;
		hw,lcdkit-bl-normal = <0>;
		hw,lcdkit-delay-af-rst-off = <10>;
		hw,lcdkit-h-back-porch = <18>;
		hw,lcdkit-h-front-porch = <36>;
		hw,lcdkit-h-pulse-width = <18>;
		hw,lcdkit-v-back-porch = <36>;
		hw,lcdkit-v-pulse-width = <30>;
		hw,lcdkit-v-front-porch = <10>;
		hw,lcdkit-h-sync-skew = <0>;
		hw,lcdkit-non-check-ldi-porch = <0>;
		hw,lcdkit-dpi01-set-change = <0>;
		hw,lcdkit-lcd-type = <2>;
		hw,lcdkit-panel-pt-test-support = <1>;
		hw,lcdkit-mipi-clk-config-support = <0>;
		hw,lcdkit-panel-hkadc-support = <0>;
		hw,lcdkit-bias-power-ctrl-mode = <4>;
		hw,lcdkit-bl-power-ctrl-mode = <0>;
		hw,lcdkit-bl-gpio-ctrl-mode = <1>;
		hw,lcdkit-bl-gpio-suspend-disable = <0>;
		hw,lcdkit-iovcc-power-ctrl-mode = <1>;
		hw,lcdkit-vci-power-ctrl-mode = <0>;
		hw,lcdkit-id0-gpio = <131>;
		hw,lcdkit-id1-gpio = <132>;
		hw,lcdkit-reset-gpio = <29>;
		hw,lcdkit-te-gpio = <16>;
		hw,lcdkit-vsp-gpio = <12>;
		hw,lcdkit-vsn-gpio = <34>;
		hw,lcdkit-iovcc-gpio = <0>;
		hw,lcdkit-vci-gpio = <0>;
		hw,lcdkit-bl-gpio = <11>;
		hw,lcdkit-iovcc-on-is-need-reset = <0>;
		hw,lcdkit-vsn-on-is-need-reset = <1>;
		hw,lcdkit-reset-pull-high-flag = <0>;
		hw,lcdkit-lcdanalog-vcc = <3100000>;
		hw,lcdkit-lcdio-vcc = <1850000>;
		hw,lcdkit-lcd-bias = <5500000>;
		hw,lcdkit-lcd-vsp = <5500000>;
		hw,lcdkit-lcd-vsn = <5500000>;
		hw,lcdkit-lcd-rst-first-high = <5>;
		hw,lcdkit-lcd-rst-low = <2>;
		hw,lcdkit-lcd-rst-second-high = <10>;
		hw,lcdkit-delay-af-vci-on = <0>;
		hw,lcdkit-delay-af-iovcc-on = <5>;
		hw,lcdkit-delay-af-bias-on = <0>;
		hw,lcdkit-delay-af-vsp-on = <5>;
		hw,lcdkit-delay-af-vsn-on = <5>;
		hw,lcdkit-delay-af-lp11 = <3>;
		hw,lcdkit-delay-af-tp-reset = <15>;
		hw,lcdkit-tp-reset-before-lcd-reset = <0>;
		hw,lcdkit-delay-af-vsn-off = <5>;
		hw,lcdkit-delay-af-vsp-off = <5>;
		hw,lcdkit-delay-af-bias-off = <0>;
		hw,lcdkit-delay-af-vbat-off = <0>;
		hw,lcdkit-delay-af-iovcc-off = <5>;
		hw,lcdkit-delay-af-vci-off = <0>;
		hw_tps65132,lcdkit-bias-type = <0x06>;
		hw_tps65132,lcdkit-bias-vpos-reg = <0x00>;
		hw_tps65132,lcdkit-bias-vneg-reg = <0x01>;
		hw_tps65132,lcdkit-bias-vpos-val = <0x0f>;
		hw_tps65132,lcdkit-bias-vneg-val = <0x0f>;
		hw_tps65132,lcdkit-bias-vpos-mask = <0x1f>;
		hw_tps65132,lcdkit-bias-vneg-mask = <0x1f>;
		hw_tps65132,lcdkit-bias-state-reg = <0x03>;
		hw_tps65132,lcdkit-bias-state-val = <0x43>;
		hw_tps65132,lcdkit-bias-state-mask = <0x43>;
		hw_rt4801h,lcdkit-bias-type = <0x0c>;
		hw_rt4801h,lcdkit-bias-vpos-reg = <0x00>;
		hw_rt4801h,lcdkit-bias-vneg-reg = <0x01>;
		hw_rt4801h,lcdkit-bias-vpos-val = <0x0f>;
		hw_rt4801h,lcdkit-bias-vneg-val = <0x0f>;
		hw_rt4801h,lcdkit-bias-vpos-mask = <0x1f>;
		hw_rt4801h,lcdkit-bias-vneg-mask = <0x1f>;
		hw_rt4801h,lcdkit-bias-state-reg = <0x03>;
		hw_rt4801h,lcdkit-bias-state-val = <0x03>;
		hw_rt4801h,lcdkit-bias-state-mask = <0x43>;
		hw_lv52134a,lcdkit-bias-type = <0x04>;
		hw_lv52134a,lcdkit-bias-vpos-reg = <0x00>;
		hw_lv52134a,lcdkit-bias-vneg-reg = <0x01>;
		hw_lv52134a,lcdkit-bias-vpos-val = <0x0f>;
		hw_lv52134a,lcdkit-bias-vneg-val = <0x0f>;
		hw_lv52134a,lcdkit-bias-vpos-mask = <0x1f>;
		hw_lv52134a,lcdkit-bias-vneg-mask = <0x1f>;
		hw_lv52134a,lcdkit-bias-state-reg = <0x00>;
		hw_lv52134a,lcdkit-bias-state-val = <0x00>;
		hw_lv52134a,lcdkit-bias-state-mask = <0x00>;
		hw_lm36923,lcdkit-bl-ic-level = <2047>;
		hw_lm36923,lcdkit-bl-ic-ctrl-mode = <0>;
		hw_lm36923,lcdkit-bl-ic-type = <0>;
		hw_lm36923,lcdkit-bl-ic-before-init-delay = <0>;
		hw_lm36923,lcdkit-bl-ic-init-delay = <0>;
		hw_lm36923,lcdkit-bl-ic-ovp-check = <1>;
		hw_lm36923,lcdkit-bl-ic-fake-lcd-ovp-check = <0>;
		hw_lm36923,lcdkit-bl-ic-init-cmd = <0x02 0x11 0x85 0xff
                                     0x01 0x13 0x69 0xff
                                     0x01 0x10 0x0f 0x0f
                                     0x02 0x12 0xa3 0x1c
                                     0x01 0x15 0xdc 0xff
                                     0x01 0x16 0xbf 0xff
                                     0x01 0x1e 0x04 0x0f>;
		hw_lm36923,lcdkit-bl-ic-num-of-init-cmd = <0x07>;
		hw_lm36923,lcdkit-bl-ic-bl-lsb-reg-cmd = <0x03 0x18 0x02 0x07>;
		hw_lm36923,lcdkit-bl-ic-bl-msb-reg-cmd = <0x08 0x19 0x66 0xff>;
		hw_lm36923,lcdkit-bl-ic-bl-enable-cmd = <0x01 0x10 0x0f 0x0f>;
		hw_lm36923,lcdkit-bl-ic-bl-disable-cmd = <0x01 0x10 0x00 0x00>;
		hw_lm36923,lcdkit-bl-ic-disable-device-cmd = <0x01 0x10 0x00 0x00>;
		hw_lm36923,lcdkit-bl-ic-fault-flag-cmd = <0x01 0x1f 0x00 0xff>;
		hw_lm36923,lcdkit-bl-ic-bias-disable-cmd = <0x01 0x00 0x00 0x00>;
		hw_lm36923,lcdkit-bl-ic-bias-enable-cmd = <0x01 0x00 0x00 0x00>;
		hw_lm36923,lcdkit-bl-ic-led-open-short-test = <1>;
		hw_lm36923,lcdkit-bl-ic-num-of-led = <2>;
		hw_lm36923,lcdkit-bl-ic-brt-ctrl-cmd = <0x01 0x11 0x00 0xff>;
		hw_lm36923,lcdkit-bl-ic-fault-ctrl-cmd = <0x01 0x1e 0x00 0xff>;
		hw_lm36923,lcdkit-bl-ic-hidden-reg-surpport = <0>;
		hw_lm36923,lcdkit-bl-ic-sec-reg-enable-cmd = <0x00 0x00 0x00 0x00>;
		hw_lm36923,lcdkit-bl-ic-sec-reg-disable-cmd = <0x00 0x00 0x00 0x00>;
		hw_lm36923,lcdkit-bl-ic-hidden-reg-cmd = <0x00 0x00 0x00 0x00>;
		hw_lm36923,lcdkit-bl-ic-hidden-reg-val-mask = <0>;
		hw_lm36923,lcdkit-bl-ic-suspend-disbright-support = <0>;
		hw_lm36923,lcdkit-bl-ic-bl-wq-support = <0>;
		hw_lm36923,lcdkit-bl-ic-bl-enahnce-support = <0>;
		hw_lm36923,lcdkit-bl-ic-bl-lowpower-delay = <0>;
		hw_lm36923,lcdkit-bl-ic-bl-normal-level = <0>;
		hw_lm36923,lcdkit-bl-ic-bl-enhance-level = <0>;
		hw_lm36923,lcdkit-bl-ic-bl-enhance-hrdtimer-time = <0>;
		hw_lm36923,lcdkit-bl-ic-bl-normal-ovp-cmd = <0x00 0x00 0x00 0x00>;
		hw_lm36923,lcdkit-bl-ic-bl-normal-cur-ramp-cmd = <0x00 0x00 0x00 0x00>;
		hw_lm36923,lcdkit-bl-ic-bl-normal-boost-cur-cmd = <0x00 0x00 0x00 0x00>;
		hw_lm36923,lcdkit-bl-ic-bl-normal-sink-cmd = <0x00 0x00 0x00 0x00>;
		hw_lm36923,lcdkit-bl-ic-bl-enhance-ovp-cmd = <0x00 0x00 0x00 0x00>;
		hw_lm36923,lcdkit-bl-ic-bl-enhance-cur-ramp-cmd = <0x00 0x00 0x00 0x00>;
		hw_lm36923,lcdkit-bl-ic-bl-enhance-boost-cur-cmd = <0x00 0x00 0x00 0x00>;
		hw_lm36923,lcdkit-bl-ic-bl-enhance-sink-cmd = <0x00 0x00 0x00 0x00>;
		hw_mp3313,lcdkit-bl-ic-level = <2047>;
		hw_mp3313,lcdkit-bl-ic-ctrl-mode = <0>;
		hw_mp3313,lcdkit-bl-ic-type = <0>;
		hw_mp3313,lcdkit-bl-ic-before-init-delay = <0>;
		hw_mp3313,lcdkit-bl-ic-init-delay = <0>;
		hw_mp3313,lcdkit-bl-ic-ovp-check = <1>;
		hw_mp3313,lcdkit-bl-ic-fake-lcd-ovp-check = <0>;
		hw_mp3313,lcdkit-bl-ic-init-cmd = <0x01 0x11 0x82 0xff
                                     0x01 0x13 0x69 0xff
                                     0x02 0x12 0xa3 0x1c
                                     0x01 0x15 0xdc 0xff
                                     0x01 0x16 0xbf 0xff
                                     0x01 0x1e 0x4a 0xff
                                     0x01 0x10 0x0f 0x0f>;
		hw_mp3313,lcdkit-bl-ic-num-of-init-cmd = <0x07>;
		hw_mp3313,lcdkit-bl-ic-bl-lsb-reg-cmd = <0x03 0x18 0x02 0x07>;
		hw_mp3313,lcdkit-bl-ic-bl-msb-reg-cmd = <0x08 0x19 0x66 0xff>;
		hw_mp3313,lcdkit-bl-ic-bl-enable-cmd = <0x01 0x10 0x0f 0x0f>;
		hw_mp3313,lcdkit-bl-ic-bl-disable-cmd = <0x01 0x10 0x00 0xff>;
		hw_mp3313,lcdkit-bl-ic-disable-device-cmd = <0x01 0x10 0x00 0xff>;
		hw_mp3313,lcdkit-bl-ic-fault-flag-cmd = <0x01 0x1f 0x00 0xff>;
		hw_mp3313,lcdkit-bl-ic-bias-disable-cmd = <0x01 0x00 0x00 0x00>;
		hw_mp3313,lcdkit-bl-ic-bias-enable-cmd = <0x01 0x00 0x00 0x00>;
		hw_mp3313,lcdkit-bl-ic-led-open-short-test = <0>;
		hw_mp3313,lcdkit-bl-ic-num-of-led = <2>;
		hw_mp3313,lcdkit-bl-ic-brt-ctrl-cmd = <0x01 0x11 0x00 0xff>;
		hw_mp3313,lcdkit-bl-ic-fault-ctrl-cmd = <0x01 0x1e 0x00 0xff>;
		hw_mp3313,lcdkit-bl-ic-hidden-reg-surpport = <0>;
		hw_mp3313,lcdkit-bl-ic-sec-reg-enable-cmd = <0x00 0x00 0x00 0x00>;
		hw_mp3313,lcdkit-bl-ic-sec-reg-disable-cmd = <0x00 0x00 0x00 0x00>;
		hw_mp3313,lcdkit-bl-ic-hidden-reg-cmd = <0x00 0x00 0x00 0x00>;
		hw_mp3313,lcdkit-bl-ic-hidden-reg-val-mask = <0>;
		hw_mp3313,lcdkit-bl-ic-suspend-disbright-support = <0>;
		hw_mp3313,lcdkit-bl-ic-bl-wq-support = <0>;
		hw_mp3313,lcdkit-bl-ic-bl-enahnce-support = <0>;
		hw_mp3313,lcdkit-bl-ic-bl-lowpower-delay = <0>;
		hw_mp3313,lcdkit-bl-ic-bl-normal-level = <0>;
		hw_mp3313,lcdkit-bl-ic-bl-enhance-level = <0>;
		hw_mp3313,lcdkit-bl-ic-bl-enhance-hrdtimer-time = <0>;
		hw_mp3313,lcdkit-bl-ic-bl-normal-ovp-cmd = <0x00 0x00 0x00 0x00>;
		hw_mp3313,lcdkit-bl-ic-bl-normal-cur-ramp-cmd = <0x00 0x00 0x00 0x00>;
		hw_mp3313,lcdkit-bl-ic-bl-normal-boost-cur-cmd = <0x00 0x00 0x00 0x00>;
		hw_mp3313,lcdkit-bl-ic-bl-normal-sink-cmd = <0x00 0x00 0x00 0x00>;
		hw_mp3313,lcdkit-bl-ic-bl-enhance-ovp-cmd = <0x00 0x00 0x00 0x00>;
		hw_mp3313,lcdkit-bl-ic-bl-enhance-cur-ramp-cmd = <0x00 0x00 0x00 0x00>;
		hw_mp3313,lcdkit-bl-ic-bl-enhance-boost-cur-cmd = <0x00 0x00 0x00 0x00>;
		hw_mp3313,lcdkit-bl-ic-bl-enhance-sink-cmd = <0x00 0x00 0x00 0x00>;
    };
};