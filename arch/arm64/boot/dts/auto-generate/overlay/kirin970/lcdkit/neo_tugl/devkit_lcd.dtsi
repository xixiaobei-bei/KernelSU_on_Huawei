/*---------------------------------------------------------------------------
 * This file is autogenerated file using huawei LCD parser. Please do not edit it.
 * Update input XML file to add a new entry or update variable in this file
 * Parser location: vendor/huawei/chipset_common/devkit/lcdkit/tools 
 *---------------------------------------------------------------------------*/


/include/ "neo_tugl_auo_otm1901a_5p2_1080p_video_default.dtsi"
/include/ "neo_tugl_boe_sw43404_5p99_1440plus_cmd.dtsi"
/include/ "neo_tugl_lg_ea9151_5p99_1440plus_cmd.dtsi"