/*---------------------------------------------------------------------------
 * This file is autogenerated file using huawei LCD parser. Please do not edit it.
 * Update input XML file to add a new entry or update variable in this file
 * Parser location: vendor/huawei/chipset_common/devkit/lcdkit/tools 
 *---------------------------------------------------------------------------*/


/include/ "blanc_tugl_auo_otm1901a_5p2_1080p_video_default.dtsi"
/include/ "blanc_tugl_auo_otm1901a_5p2_1080p_video_default_1.dtsi"
/include/ "blanc_tugl_samsung_ea8074_6p01_1080plus_cmd.dtsi"
/include/ "blanc_tugl_samsung_v2_ea8074_6p01_1080plus_cmd.dtsi"
/include/ "blanc_tugl_samsung_v3_ea8074_6p01_1080plus_cmd.dtsi"
/include/ "blanc_tugl_tianma_rm69299_6p01_1080plus_cmd.dtsi"