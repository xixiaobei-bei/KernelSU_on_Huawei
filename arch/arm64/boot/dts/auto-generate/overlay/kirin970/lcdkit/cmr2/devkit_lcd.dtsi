/*---------------------------------------------------------------------------
 * This file is autogenerated file using huawei LCD parser. Please do not edit it.
 * Update input XML file to add a new entry or update variable in this file
 * Parser location: vendor/huawei/chipset_common/devkit/lcdkit/tools 
 *---------------------------------------------------------------------------*/


/include/ "cmr2_boedvt2_nt35523_10p7_1600p_video.dtsi"
/include/ "cmr2_inx_nt35523_10p7_1600p_video.dtsi"