/*---------------------------------------------------------------------------
 * This file is autogenerated file using huawei LCD parser. Please do not edit it.
 * Update input XML file to add a new entry or update variable in this file
 * Parser location: vendor/huawei/chipset_common/devkit/lcdkit/tools 
 *---------------------------------------------------------------------------*/


/include/ "cor_auo_otm1901a_5p2_1080p_video_default.dtsi"
/include/ "cor_boe_ft8719_6p3_1080p_video.dtsi"
/include/ "cor_boe_td4320_6p3_1080p_video.dtsi"
/include/ "cor_dpt_ft8719_6p3_1080p_video.dtsi"
/include/ "cor_dsbj_ft8719_6p3_1080p_video.dtsi"
/include/ "cor_tm_ft8719_6p3_1080p_video.dtsi"
/include/ "cor_tm_td4320_6p3_1080p_video.dtsi"