/* Copyright (c) 2013, The Linux Foundation. All rights reserved.
 *
 * This program is free software; you can redistribute it and/or modify
 * it under the terms of the GNU General Public License version 2 and
 * only version 2 as published by the Free Software Foundation.
 *
 * This program is distributed in the hope that it will be useful,
 * but WITHOUT ANY WARRANTY; without even the implied warranty of
 * MERCHANTABILITY or FITNESS FOR A PARTICULAR PURPOSE.  See the
 * GNU General Public License for more details.
 */

/*-------------------------------------------------------------------------
 * This file is autogenerated file using gcdb parser. Please do not edit it.
 * Update input XML file to add a new entry or update variable in this file
 * VERSION = 1.1
 *-----------------------------------------------------------------------*/
/ {
	dsi_alps_tugl_jdi_2lane_nt36860c_cut2_5p88_1440p_cmd: lcdkit_alps_tugl_jdi_2lane_nt36860c_cut2_5p88_1440p_cmd {
		compatible = "jdi_2lane_nt36860_cut2_5p88_1440P_cmd";
		hw,lcdkit-panel-name = "JDI_2LANE_NT36860 CUT2 5.88' CMD TFT 1440 x 2560";
		hw,lcdkit-panel-type = <0x01>;
		hw,lcdkit-panel-xres = <1440>;
		hw,lcdkit-panel-yres = <2560>;
		hw,lcdkit-panel-width = <73>;
		hw,lcdkit-panel-height = <130>;
		hw,lcdkit-panel-on-command = <0x15 0x01 0x00 0x00 0x0a 0x00 0x02 0xFF 0x20
			0x15 0x01 0x00 0x00 0x0a 0x00 0x02 0x0D 0x3F
			0x15 0x01 0x00 0x00 0x0a 0x00 0x02 0xFB 0x01
			0x15 0x01 0x00 0x00 0x0a 0x00 0x02 0x01 0x66
			0x15 0x01 0x00 0x00 0x0a 0x00 0x02 0xFF 0x10
			0x15 0x01 0x00 0x00 0x0a 0x00 0x02 0xFB 0x01
			0x39 0x01 0x00 0x00 0x0a 0x00 0x05 0x2A 0x00 0x00 0x05 0x9F
			0x39 0x01 0x00 0x00 0x0a 0x00 0x05 0x2B 0x00 0x00 0x09 0xFF
			0x39 0x01 0x00 0x00 0x0a 0x00 0x03 0x44 0x09 0xFC
			0x15 0x01 0x00 0x00 0x0a 0x00 0x02 0x35 0x00
			0x15 0x01 0x00 0x00 0x0a 0x00 0x02 0xC0 0x03
			0x15 0x01 0x00 0x00 0x0a 0x00 0x02 0xBA 0x01
			0x15 0x01 0x00 0x00 0x0a 0x00 0x02 0xBB 0x10
			0x15 0x01 0x00 0x00 0x0a 0x00 0x02 0xE5 0x01
			0x15 0x01 0x00 0x00 0x0a 0x00 0x02 0x50 0xFF
			0x39 0x01 0x00 0x00 0x0a 0x00 0x03 0x61 0x00 0x06
			0x15 0x01 0x00 0x00 0x0a 0x00 0x02 0x63 0x24
			0x15 0x01 0x00 0x00 0x0a 0x00 0x02 0x65 0x02
			0x15 0x01 0x00 0x00 0x0a 0x00 0x02 0x6A 0x00
			0x15 0x01 0x00 0x00 0x0a 0x00 0x02 0x6C 0xFF
			0x15 0x01 0x00 0x00 0x0a 0x00 0x02 0x6E 0x00
			0x39 0x01 0x00 0x00 0x0a 0x00 0x03 0x51 0x0F 0xFF
			0x15 0x01 0x00 0x00 0x0a 0x00 0x02 0x53 0x2C
			0x15 0x01 0x00 0x00 0x0a 0x00 0x02 0x55 0x00
			0x15 0x01 0x00 0x00 0x0a 0x00 0x02 0x5E 0x00
			0x15 0x01 0x00 0x00 0x0a 0x00 0x02 0xFF 0xF0
			0x15 0x01 0x00 0x00 0x0a 0x00 0x02 0xFB 0x01
			0x15 0x01 0x00 0x00 0x0a 0x00 0x02 0x7F 0x00
			0x15 0x01 0x00 0x00 0x0a 0x00 0x02 0xFF 0x10
			0x05 0x01 0x00 0x00 0x0a 0x01 0x02 0x11 0x00
			0x05 0x01 0x00 0x00 0x0a 0x00 0x02 0x29 0x00
			0x15 0x01 0x00 0x00 0x0a 0x00 0x02 0xFF 0x2A
			0x15 0x01 0x00 0x00 0x0a 0x00 0x02 0xFB 0x01
			0x15 0x01 0x00 0x00 0x0a 0x00 0x02 0x42 0x4D
			0x15 0x01 0x00 0x00 0x0a 0x00 0x02 0x28 0x21
			0x15 0x01 0x00 0x00 0x0a 0x00 0x02 0x10 0xFF
			0x15 0x01 0x00 0x00 0x0a 0x00 0x02 0x11 0xFF
			0x15 0x01 0x00 0x00 0x0a 0x00 0x02 0x12 0xFF
			0x15 0x01 0x00 0x00 0x0a 0x00 0x02 0x13 0xFF
			0x15 0x01 0x00 0x00 0x0a 0x00 0x02 0x14 0xFF
			0x15 0x01 0x00 0x00 0x0a 0x00 0x02 0xFF 0x23
			0x15 0x01 0x00 0x00 0x0a 0x00 0x02 0xFB 0x01
			0x15 0x01 0x00 0x00 0x0a 0x00 0x02 0x07 0x00
			0x15 0x01 0x00 0x00 0x0a 0x00 0x02 0x08 0x01
			0x15 0x01 0x00 0x00 0x0a 0x00 0x02 0x09 0x00
			0x15 0x01 0x00 0x00 0x0a 0x00 0x02 0xFF 0x26
			0x15 0x01 0x00 0x00 0x0a 0x00 0x02 0x7A 0x41
			0x15 0x01 0x00 0x00 0x0a 0x00 0x02 0xFF 0x27
			0x15 0x01 0x00 0x00 0x0a 0x00 0x02 0x31 0x36
			0x15 0x01 0x00 0x00 0x0a 0x00 0x02 0x8F 0x36
			0x15 0x01 0x00 0x00 0x0a 0x00 0x02 0xFF 0x28
			0x15 0x01 0x00 0x00 0x0a 0x00 0x02 0x31 0x36
			0x15 0x01 0x00 0x00 0x0a 0x00 0x02 0x8F 0x36
			0x15 0x01 0x00 0x00 0x0a 0x00 0x02 0xFF 0x25
			0x15 0x01 0x00 0x00 0x0a 0x00 0x02 0xFB 0x01
			0x15 0x01 0x00 0x00 0x0a 0x00 0x02 0xC9 0x00
			0x15 0x01 0x00 0x00 0x0a 0x00 0x02 0xCA 0x0A
			0x15 0x01 0x00 0x00 0x0a 0x00 0x02 0xCB 0x00
			0x15 0x01 0x00 0x00 0x0a 0x00 0x02 0xCC 0xAE
			0x15 0x01 0x00 0x00 0x0a 0x00 0x02 0xCD 0x00
			0x15 0x01 0x00 0x00 0x0a 0x00 0x02 0xD2 0x00
			0x15 0x01 0x00 0x00 0x0a 0x00 0x02 0xD3 0x0A
			0x15 0x01 0x00 0x00 0x0a 0x00 0x02 0xD4 0x0B
			0x15 0x01 0x00 0x00 0x0a 0x00 0x02 0xD5 0x70
			0x15 0x01 0x00 0x00 0x0a 0x00 0x02 0xDB 0x00
			0x15 0x01 0x00 0x00 0x0a 0x00 0x02 0xDC 0x0A
			0x15 0x01 0x00 0x00 0x0a 0x00 0x02 0xDD 0x00
			0x15 0x01 0x00 0x00 0x0a 0x00 0x02 0xDE 0xAE
			0x15 0x01 0x00 0x00 0x0a 0x00 0x02 0xFF 0x20
			0x15 0x01 0x00 0x00 0x0a 0x00 0x02 0xFB 0x01
			0x15 0x01 0x00 0x00 0x0a 0x00 0x02 0x2F 0x06
			0x15 0x01 0x00 0x00 0x0a 0x00 0x02 0xFF 0x24
			0x15 0x01 0x00 0x00 0x0a 0x00 0x02 0xFB 0x01
			0x15 0x01 0x00 0x00 0x0a 0x00 0x02 0x1C 0x28
			0x15 0x01 0x00 0x00 0x0a 0x00 0x02 0x1D 0x28
			0x15 0x01 0x00 0x00 0x0a 0x00 0x02 0x1F 0x28
			0x15 0x01 0x00 0x00 0x0a 0x00 0x02 0x20 0x28
			0x15 0x01 0x00 0x00 0x0a 0x00 0x02 0x33 0x43
			0x15 0x01 0x00 0x00 0x0a 0x00 0x02 0x38 0x43
			0x15 0x01 0x00 0x00 0x0a 0x00 0x02 0xB8 0x12
			0x15 0x01 0x00 0x00 0x0a 0x00 0x02 0xBC 0x12
			0x15 0x01 0x00 0x00 0x0a 0x00 0x02 0xFF 0x25
			0x15 0x01 0x00 0x00 0x0a 0x00 0x02 0xFB 0x01
			0x15 0x01 0x00 0x00 0x0a 0x00 0x02 0xC1 0x4F
			0x15 0x01 0x00 0x00 0x0a 0x00 0x02 0xC3 0x4F
			0x15 0x01 0x00 0x00 0x0a 0x00 0x02 0xC6 0x4F
			0x15 0x01 0x00 0x00 0x0a 0x00 0x02 0xC8 0x4F
			0x15 0x01 0x00 0x00 0x0a 0x00 0x02 0xCF 0x4F
			0x15 0x01 0x00 0x00 0x0a 0x00 0x02 0xD1 0x4F
			0x15 0x01 0x00 0x00 0x0a 0x00 0x02 0xD8 0x4F
			0x15 0x01 0x00 0x00 0x0a 0x00 0x02 0xDA 0x4F
			0x15 0x01 0x00 0x00 0x0a 0x00 0x02 0xFF 0x26
			0x15 0x01 0x00 0x00 0x0a 0x00 0x02 0xFB 0x01
			0x15 0x01 0x00 0x00 0x0a 0x00 0x02 0x06 0x70
			0x15 0x01 0x00 0x00 0x0a 0x00 0x02 0x14 0x64
			0x15 0x01 0x00 0x00 0x0a 0x00 0x02 0x15 0xF5
			0x15 0x01 0x00 0x00 0x0a 0x00 0x02 0xFF 0x27
			0x15 0x01 0x00 0x00 0x0a 0x00 0x02 0xFB 0x01
			0x15 0x01 0x00 0x00 0x0a 0x00 0x02 0x15 0xA7
			0x15 0x01 0x00 0x00 0x0a 0x00 0x02 0x23 0x4F
			0x15 0x01 0x00 0x00 0x0a 0x00 0x02 0x26 0xA7
			0x15 0x01 0x00 0x00 0x0a 0x00 0x02 0x3B 0xA7
			0x15 0x01 0x00 0x00 0x0a 0x00 0x02 0x3F 0xA7
			0x15 0x01 0x00 0x00 0x0a 0x00 0x02 0x75 0x93
			0x15 0x01 0x00 0x00 0x0a 0x00 0x02 0x83 0x4F
			0x15 0x01 0x00 0x00 0x0a 0x00 0x02 0x86 0x93
			0x15 0x01 0x00 0x00 0x0a 0x00 0x02 0x99 0x93
			0x15 0x01 0x00 0x00 0x0a 0x00 0x02 0x9B 0x93
			0x15 0x01 0x00 0x00 0x0a 0x00 0x02 0xFF 0x28
			0x15 0x01 0x00 0x00 0x0a 0x00 0x02 0xFB 0x01
			0x15 0x01 0x00 0x00 0x0a 0x00 0x02 0x15 0xA7
			0x15 0x01 0x00 0x00 0x0a 0x00 0x02 0x23 0x4F
			0x15 0x01 0x00 0x00 0x0a 0x00 0x02 0x26 0x5B
			0x15 0x01 0x00 0x00 0x0a 0x00 0x02 0x3B 0xA7
			0x15 0x01 0x00 0x00 0x0a 0x00 0x02 0x3F 0xA7
			0x15 0x01 0x00 0x00 0x0a 0x00 0x02 0x75 0x93
			0x15 0x01 0x00 0x00 0x0a 0x00 0x02 0x83 0x4F
			0x15 0x01 0x00 0x00 0x0a 0x00 0x02 0x86 0x93
			0x15 0x01 0x00 0x00 0x0a 0x00 0x02 0x99 0x00
			0x15 0x01 0x00 0x00 0x0a 0x00 0x02 0x9B 0x00
			0x15 0x01 0x00 0x00 0x0a 0x00 0x02 0xFF 0x27
			0x15 0x01 0x00 0x00 0x0a 0x00 0x02 0xFB 0x01
			0x15 0x01 0x00 0x00 0x0a 0x00 0x02 0x33 0x4F
			0x15 0x01 0x00 0x00 0x0a 0x00 0x02 0xFF 0xD0
			0x15 0x01 0x00 0x00 0x0a 0x00 0x02 0xFB 0x01
			0x15 0x01 0x00 0x00 0x0a 0x00 0x02 0x05 0x88
			0x15 0x01 0x00 0x00 0x0a 0x00 0x02 0xFF 0x10
			0x15 0x01 0x00 0x00 0x0a 0x00 0x02 0xFB 0x01>;
		hw,lcdkit-panel-on-command-state = "dsi_lp_mode";
		hw,lcdkit-panel-display-on-command = <0x05 0x01 0x00 0x00 0x78 0x00 0x02 0x29 0x00>;
		hw,lcdkit-panel-off-command = <0x05 0x01 0x00 0x00 0x14 0x01 0x02 0x28 0x00
			0x05 0x01 0x00 0x00 0x46 0x01 0x02 0x10 0x00>;
		hw,lcdkit-panel-off-command-state = "dsi_lp_mode";
		hw,lcdkit-panel-backlight-command = <0x15 0x01 0x00 0x00 0x00 0x00 0x02 0x51 0x00>;
		hw,lcdkit-panel-backlight-command-state = "dsi_lp_mode";
		hw,lcdkit-panel-cabc-off-command = <0x15 0x01 0x00 0x00 0x0a 0x00 0x02 0xFF 0x10
			0x15 0x01 0x00 0x00 0x0a 0x00 0x02 0x55 0x00>;
		hw,lcdkit-panel-cabc-off-command-state = "dsi_lp_mode";
		hw,lcdkit-panel-cabc-ui-command = <0x15 0x01 0x00 0x00 0x0a 0x00 0x02 0xFF 0x10
			0x15 0x01 0x00 0x00 0x0a 0x00 0x02 0x55 0x01>;
		hw,lcdkit-panel-cabc-ui-command-state = "dsi_lp_mode";
		hw,lcdkit-panel-cabc-still-command = <0x15 0x01 0x00 0x00 0x0a 0x00 0x02 0xFF 0x10
			0x15 0x01 0x00 0x00 0x0a 0x00 0x02 0x55 0x02>;
		hw,lcdkit-panel-cabc-still-command-state = "dsi_lp_mode";
		hw,lcdkit-panel-cabc-moving-command = <0x15 0x01 0x00 0x00 0x0a 0x00 0x02 0xFF 0x10
			0x15 0x01 0x00 0x00 0x0a 0x00 0x02 0x55 0x03>;
		hw,lcdkit-panel-cabc-moving-command-state = "dsi_lp_mode";
		hw,lcdkit-panel-cabc-support = <0>;
		hw,lcdkit-panel-cabc-switch-support = <1>;
		hw,lcdkit-panel-rgbw-set1-command = <0x15 0x01 0x00 0x00 0x0a 0x00 0x02 0x65 0x01>;
		hw,lcdkit-panel-rgbw-set1-command-state = "dsi_lp_mode";
		hw,lcdkit-panel-rgbw-set2-command = <0x15 0x01 0x00 0x00 0x0a 0x00 0x02 0x65 0x02>;
		hw,lcdkit-panel-rgbw-set2-command-state = "dsi_lp_mode";
		hw,lcdkit-panel-rgbw-set3-command = <0x15 0x01 0x00 0x00 0x0a 0x00 0x02 0x65 0x03>;
		hw,lcdkit-panel-rgbw-set3-command-state = "dsi_lp_mode";
		hw,lcdkit-panel-rgbw-set4-command = <0x15 0x01 0x00 0x00 0x0a 0x00 0x02 0x65 0x04>;
		hw,lcdkit-panel-rgbw-set4-command-state = "dsi_lp_mode";
		hw,lcdkit-panel-rgbw-backlight-command = <0x39 0x01 0x00 0x00 0x0a 0x00 0x03 0x61 0x00 0x00>;
		hw,lcdkit-panel-rgbw-backlight-command-state = "dsi_lp_mode";
		hw,lcdkit-panel-rgbw-pixelgainlimit-command = <0x15 0x01 0x00 0x00 0x0a 0x00 0x02 0x6A 0x00>;
		hw,lcdkit-panel-rgbw-pixelgainlimit-command-state = "dsi_lp_mode";
		hw,lcdkit-panel-rgbw-support = <1>;
		hw,lcdkit-panel-display-on-effect-command = <0x15 0x01 0x00 0x00 0x0a 0x00 0x02 0xFF 0x2A
					0x15 0x01 0x00 0x00 0x0a 0x00 0x02 0xFB 0x01
					0x15 0x01 0x00 0x00 0x0a 0x00 0x02 0x10 0x73
					0x15 0x01 0x00 0x00 0x0a 0x00 0x02 0x11 0x73
					0x15 0x01 0x00 0x00 0x0a 0x00 0x02 0x12 0x73
					0x15 0x01 0x00 0x00 0x0a 0x00 0x02 0x13 0x73
					0x15 0x01 0x00 0x00 0x0a 0x00 0x02 0x14 0x73
					0x15 0x01 0x00 0x00 0x0a 0x00 0x02 0xFF 0x10
					0x15 0x01 0x00 0x00 0x0a 0x00 0x02 0xFB 0x01>;
		hw,lcdkit-panel-display-on-effect-support = <1>;
		hw,lcdkit-panel-ce-off-command = <>;
		hw,lcdkit-panel-ce-srgb-command = <>;
		hw,lcdkit-panel-ce-user-command = <>;
		hw,lcdkit-panel-ce-vivid-command = <>;
		hw,lcdkit-panel-ce-support = <0>;
		hw,lcdkit-panel-version-support = <0>;
		hw,lcdkit-panel-otp-support = <1>;
		hw,lcdkit-panel-inversion-support = <0>;
		hw,lcdkit-panel-scan-support = <0>;
		hw,lcdkit-panel-display-region-command = <0x39 0x01 0x00 0x00 0x05 0x00 0x05 0x2A 0x00 0x00 0x05 0x9F
				0x39 0x01 0x00 0x00 0x05 0x00 0x05 0x2B 0x00 0x00 0x09 0xFF>;
		hw,lcdkit-panel-display-region-command-state = "dsi_lp_mode";
		hw,lcdkit-panel-display-region-support = <1>;
		hw,lcdkit-panel-checksum-enter-command = <0x15 0x01 0x00 0x00 0x0a 0x00 0x02 0xFF 0xF0
				0x15 0x01 0x00 0x00 0x0a 0x00 0x02 0xEA 0x00
				0x15 0x01 0x00 0x00 0x0a 0x00 0x02 0x7B 0x00>;
		hw,lcdkit-panel-checksum-enter-second-part-command = <0x15 0x01 0x00 0x00 0x0a 0x00 0x02 0xFF 0xF0
				0x15 0x01 0x00 0x00 0x0a 0x00 0x02 0xFB 0x01
				0x15 0x01 0x00 0x00 0x0a 0x00 0x02 0x7B 0x20>;
		hw,lcdkit-panel-checksum-enable-command = <0x15 0x01 0x00 0x00 0x0a 0x00 0x02 0xFF 0xF0
					0x15 0x01 0x00 0x00 0x0a 0x00 0x02 0x92 0x01>;
		hw,lcdkit-panel-checksum-disable-command = <0x15 0x01 0x00 0x00 0x0a 0x00 0x02 0xFF 0xF0
					0x15 0x01 0x00 0x00 0x0a 0x00 0x02 0x92 0x00
					0x15 0x01 0x00 0x00 0x0a 0x00 0x02 0x7B 0x00
					0x15 0x01 0x00 0x00 0x0a 0x00 0x02 0xFF 0x10>;
		hw,lcdkit-panel-checksum-command = <0x06 0x01 0x00 0x00 0x14 0x00 0x01 0x73>;
		hw,lcdkit-panel-checksum-exit-command = <0x15 0x01 0x00 0x00 0x0a 0x00 0x02 0xFF 0x10
				0x15 0x01 0x00 0x00 0x0a 0x00 0x02 0xFB 0x01>;
		hw,lcdkit-panel-checksum-value = <0x10 0x9a 0xad 0xe3 0x90 0xbe 0xe4 0xdc 0x80 0x41 0xd9 0x6d 0x1a 0x71 0xaa 0xb6 0xb0
                         0x10 0x3d 0xce 0x9b 0x6e 0x18 0x2 0x49 0x1a 0x86 0xb 0xd 0xac 0x68 0xef 0x5d 0x9c
                         0x10 0xcf 0xa9 0x96 0x27 0x72 0xc7 0x58 0xe7 0xa 0x0 0xd2 0x59 0x67 0x6e 0xc5 0x9e>;
		hw,lcdkit-panel-checksum-support = <1>;
		hw,lcdkit-panel-checksum-second-part-support = <1>;
		hw,lcdkit-panel-esd-reg-command = <0x06 0x01 0x00 0x00 0x0a 0x00 0x01 0x0a>;
		hw,lcdkit-panel-esd-reg-command-state = "dsi_lp_mode";
		hw,lcdkit-panel-esd-value = <0x9c>;
		hw,lcdkit-panel-esd-support = <1>;
		hw,lcdkit-panel-check-reg-command = <0x06 0x01 0x00 0x00 0x0a 0x00 0x01 0x0a>;
		hw,lcdkit-panel-check-reg-value = <0x9c>;
		hw,lcdkit-panel-check-reg-command-state = "dsi_lp_mode";
		hw,lcdkit-panel-check-reg-support = <1>;
		hw,lcdkit-panel-gamma-enter-command = <0x15 0x01 0x00 0x00 0x0a 0x00 0x02 0xFF 0x20
				0x15 0x01 0x00 0x00 0x0a 0x00 0x02 0xFB 0x01>;
		hw,lcdkit-panel-gamma-exit-command = <0x15 0x01 0x00 0x00 0x0a 0x00 0x02 0xFF 0x10
				0x15 0x01 0x00 0x00 0x0a 0x00 0x02 0xFB 0x01>;
		hw,lcdkit-panel-gamma-correct-reg = <0x96 0x97 0x98 0xB0 0xB1 0xB2 0xB3 0xB4 0xB5 0xB6 0xB7 0xB8 0xB9 0xBA 0xBB 0xBC 0xBD 0xBE 0xBF 0xB0 0xB1 0xB2 0xB3 0xB4 0xB5 0xB6 0xB7 0xB8 0xB9 0xBA 0xBB 0xC0 0xC1 0xC2 0xC3>;
		hw,lcdkit-panel-gamma-reg-len = <1 1 1 16 16 16 14 16 16 16 14 16 16 16 14 16 16 16 14 16 16 16 14 16 16 16 14 16 16 16 14 16 16 16 14>;
		hw,lcdkit-panel-brightness-color-uniform-support = <1>;
		hw,lcdkit-panel-dynamic-gamma-support = <1>;
		hw,lcdkit-panel-mipi-detect-support = <0>;
		hw,lcdkit-panel-dynamic-sram-check-support = <0>;
		hw,lcdkit-panel-fps-to-thirty-command = <0x15 0x01 0x00 0x00 0x0a 0x00 0x02 0xff 0x10
				0x15 0x01 0x00 0x00 0x0a 0x00 0x02 0xb1 0x80
				0x15 0x01 0x00 0x00 0x0a 0x00 0x02 0xfb 0x01
				>;
		hw,lcdkit-panel-fps-to-thirty-command-state = "dsi_hs_mode";
		hw,lcdkit-panel-fps-to-sixty-command = <0x15 0x01 0x00 0x00 0x0a 0x00 0x02 0xff 0x10
				0x15 0x01 0x00 0x00 0x0a 0x00 0x02 0xb1 0x00
				0x15 0x01 0x00 0x00 0x0a 0x00 0x02 0xfb 0x01
				>;
		hw,lcdkit-panel-fps-to-sixty-command-state = "dsi_hs_mode";
		hw,lcdkit-panel-dfr-enable-command = <0x15 0x01 0x00 0x00 0x0a 0x00 0x02 0xff 0x10
				0x15 0x01 0x00 0x00 0x0a 0x00 0x02 0xb1 0x03
				0x15 0x01 0x00 0x00 0x0a 0x00 0x02 0xfb 0x01
				>;
		hw,lcdkit-panel-dfr-enable-command-state = "dsi_hs_mode";
		hw,lcdkit-panel-fps-updt-support = <0>;
		hw,lcdkit-panel-fps-func-switch = <1>;
		hw,lcdkit-panel-check-reg-on-support = <0>;
		hw,lcdkit-panel-fps-tscall-support = <0>;
		hw,lcdkit-panel-dis-on-cmds-delay-margin-support = <1>;
		hw,lcdkit-panel-snd-cmd-before-frame-support = <0>;
		hw,lcdkit-panel-ts-resume-ctrl-mode = <0>;
		hw,lcdkit-panel-dis-on-cmds-delay-margin-time = <68>;
		hw,lcdkit-panel-lptohs-mipi-check-support = <0>;
		hw,lcdkit-panel-acl-ctrl-support = <0>;
		hw,lcdkit-panel-hbm-ctrl-support = <0>;
		hw,lcdkit-panel-vr-support = <0>;
		hw,lcdkit-panel-current-detect-enter-command = <0x15 0x01 0x00 0x00 0x0a 0x00 0x02 0xFF 0x2B
					0x15 0x01 0x00 0x00 0x0a 0x00 0x02 0xFB 0x01
					0x15 0x01 0x00 0x00 0x0a 0x00 0x02 0x61 0x07
					0x15 0x01 0x00 0x00 0x0a 0x00 0x02 0xFF 0xE0
					0x15 0x01 0x00 0x00 0x0a 0x00 0x02 0xFB 0x01
					0x15 0x01 0x00 0x00 0x0a 0x00 0x02 0x44 0xF7
					0x15 0x01 0x00 0x00 0x0a 0x00 0x02 0xFF 0x20
					0x15 0x01 0x00 0x00 0x14 0x01 0x02 0xFB 0x01>;
		hw,lcdkit-panel-current-detect-exit-command = <0x15 0x01 0x00 0x00 0x0a 0x00 0x02 0xFF 0x2B
					0x15 0x01 0x00 0x00 0x0a 0x00 0x02 0xFB 0x01
					0x15 0x01 0x00 0x00 0x0a 0x00 0x02 0x61 0x00
					0x15 0x01 0x00 0x00 0x0a 0x00 0x02 0xFF 0x10>;
		hw,lcdkit-panel-current-detect-command = <0x06 0x01 0x00 0x00 0x0a 0x00 0x01 0x51>;
		hw,lcdkit-panel-current-detect-support = <0>;
		hw,lcdkit-panel-current-mask =  <0x70 0x20 0x40>;
		hw,lcdkit-panel-lv-detect-enter-command = <0x15 0x01 0x00 0x00 0x0a 0x00 0x02 0xFF 0x20
				0x15 0x01 0x00 0x00 0x0a 0x00 0x02 0xFB 0x01
				0x15 0x01 0x00 0x00 0x14 0x01 0x02 0x5d 0x12>;
		hw,lcdkit-panel-lv-detect-exit-command = <0x15 0x01 0x00 0x00 0x0a 0x00 0x02 0x5d 0x00
				0x15 0x01 0x00 0x00 0x0a 0x00 0x02 0xFF 0x10>;
		hw,lcdkit-panel-lv-detect-command = <0x06 0x01 0x00 0x00 0x0a 0x00 0x01 0x52>;
		hw,lcdkit-panel-lv-detect-support = <1>;
		hw,lcdkit-host-2d-barcode-enter-command = <0x29 0x01 0x00 0x00 0x0a 0x00 0x02 0xFF 0x22
								0x29 0x01 0x00 0x00 0x0a 0x00 0x02 0xFB 0x01>;
		hw,lcdkit-host-2d-barcode-command = <0x14 0x01 0x00 0x00 0x0a 0x00 0x0A 0x2A 0x04 0x00 0x00 0x00 0x00 0x00 0x00 0x00 0x00>;
		hw,lcdkit-host-2d-barcode-exit-command = <0x29 0x01 0x00 0x00 0x0a 0x00 0x02 0xFF 0x10
								0x29 0x01 0x00 0x00 0x0a 0x00 0x02 0xFB 0x01>;
		hw,lcdkit-host-project-id-enter-command = <0x29 0x01 0x00 0x00 0x0a 0x00 0x02 0xFF 0x22
								0x29 0x01 0x00 0x00 0x0a 0x00 0x02 0xFB 0x01>;
		hw,lcdkit-host-project-id-command = <0x14 0x01 0x00 0x00 0x0a 0x00 0x0a 0x29 0x00 0x00 0x00 0x00 0x00 0x00 0x00 0x00 0x00>;
		hw,lcdkit-host-project-id-exit-command = <0x29 0x01 0x00 0x00 0x0a 0x00 0x02 0xFF 0x10
								0x29 0x01 0x00 0x00 0x0a 0x00 0x02 0xFB 0x01>;
		hw,lcdkit-color-coordinate-enter-command = <0x29 0x01 0x00 0x00 0x0a 0x00 0x02 0xFF 0x22
								0x29 0x01 0x00 0x00 0x0a 0x00 0x02 0xFB 0x01>;
		hw,lcdkit-color-coordinate-command = <0x14 0x01 0x00 0x00 0x0a 0x00 0x06 0xF7 0x00 0x00 0x00 0x00 0x00>;
		hw,lcdkit-color-coordinate-exit-command = <0x29 0x01 0x00 0x00 0x0a 0x00 0x02 0xFF 0x10
								0x29 0x01 0x00 0x00 0x0a 0x00 0x02 0xFB 0x01>;
		hw,lcdkit-panel-consistency-enter-command = <0x29 0x01 0x00 0x00 0x0a 0x00 0x02 0xFF 0x22
								0x29 0x01 0x00 0x00 0x0a 0x00 0x02 0xFB 0x01>;
		hw,lcdkit-panel-consistency-command = <0x14 0x01 0x00 0x00 0x0a 0x00 0x0A 0x2A 0x04 0x00 0x00 0x00 0x00 0x00 0x00 0x00 0x00>;
		hw,lcdkit-panel-consistency-exit-command = <0x29 0x01 0x00 0x00 0x0a 0x00 0x02 0xFF 0x10
								0x29 0x01 0x00 0x00 0x0a 0x00 0x02 0xFB 0x01>;
		hw,lcdkit-reset-shutdown-later = <1>;
		hw,lcdkit-panel-pcd-errflag-check-support = <0>;
		hw,lcdkit-panel-pt-ulps-support = <0>;
		hw,lcdkit-panel-aod-support = <0>;
		hw,lcdkit-panel-orientation = <1>;
		hw,lcdkit-panel-bpp = <0>;
		hw,lcdkit-panel-bgrfmt = <0>;
		hw,lcdkit-panel-bl-type = <4>;
		hw,lcdkit-panel-blmin = <15>;
		hw,lcdkit-panel-blmax = <8820>;
		hw,lcdkit-mask-delay-time-before-fp = <16666>;
		hw,lcdkit-mask-delay-time-after-fp = <16666>;
		hw,lcdkit-panel-bl-def = <4000>;
		hw,lcdkit-panel-bl-maxnit = <730>;
		hw,lcdkit-panel-getblmaxnit-type = <0>;
		hw,lcdkit-panel-cmd-type = <16>;
		hw,lcdkit-panel-ifbctype = <9>;
		hw,lcdkit-panel-ifbc-vesa3x-set = <0>;
		hw,lcdkit-panel-frc-enable = <0>;
		hw,lcdkit-panel-esd-skip-mipi-check = <1>;
		hw,lcdkit-panel-pxl-clk = <277>;
		hw,lcdkit-panel-pxl-clk-div = <3>;
		hw,lcdkit-panel-tp-resume-nosync = <0>;
		hw,lcdkit-panel-display-on-in-backlight = <0>;
		hw,lcdkit-panel-display-on-new-seq = <0>;
		hw,lcdkit-panel-dirt-updt-support = <1>;
		hw,lcdkit-is-hostprocessing = <1>;
		hw,lcdkit-host-info-all-in-ddic = <1>;
		hw,lcdkit-panel-dsi-upt-support = <1>;
		hw,mipiclk-updt-support-new = <0>;
		hw,lcdkit-panel-vsyn-ctr-type = <7>;
		hw,lcdkit-panel-bl-pwm-preci-no-convert = <0>;
		hw,lcdkit-panel-bl-pwm-preci-type = <2>;
		hw,lcdkit-panel-bl-ic-ctrl-type = <1>;
		hw,lcdkit-panel-fps-updt-only = <0>;
		hw,lcdkit-panel-step-support = <1>;
		hw,lcdkit-ldi-hsync-plr = <0>;
		hw,lcdkit-ldi-vsync-plr = <0>;
		hw,lcdkit-ldi-pixel-clk-plr = <0>;
		hw,lcdkit-ldi-data-en-plr = <0>;
		hw,lcdkit-ldi-dpi-a-overlap-size = <0>;
		hw,lcdkit-ldi-dpi-b-overlap-size = <0>;
		hw,lcdkit-sbl-stren-limit = <128>;
		hw,lcdkit-sbl-cal-a = <60>;
		hw,lcdkit-sbl-cal-b = <95>;
		hw,lcdkit-sbl-cal-c = <5>;
		hw,lcdkit-sbl-cal-d = <1>;
		hw,lcdkit-sbl-tf-ctl = <5>;
		hw,lcdkit-sbl-bl-min = <480>;
		hw,lcdkit-sbl-bl-max = <4096>;
		hw,lcdkit-sbl-bl-scale = <0xff>;
		hw,lcdkit-sbl-am-light-min = <14>;
		hw,lcdkit-sbl-filter-a = <1738>;
		hw,lcdkit-sbl-filter-b = <6>;
		hw,lcdkit-sbl-logo-left = <0>;
		hw,lcdkit-sbl-logo-top = <0>;
		hw,lcdkit-sbl-variance-intensity-space = <145>;
		hw,lcdkit-sbl-slope-max = <54>;
		hw,lcdkit-sbl-slope-min = <160>;
		hw,lcdkit-mipi-lane-nums = <1>;
		hw,lcdkit-mipi-color-mode = <5>;
		hw,lcdkit-mipi-vc = <0>;
		hw,lcdkit-mipi-dsi-bit-clk = <644>;
		hw,lcdkit-mipi-burst-mode = <2>;
		hw,lcdkit-mipi-max-esc-clk = <10>;
		hw,lcdkit-mipi-dsi-bit-clk-val-a = <644>;
		hw,lcdkit-mipi-dsi-bit-clk-val-b = <653>;
		hw,lcdkit-mipi-dsi-bit-clk-val-c = <0>;
		hw,lcdkit-mipi-dsi-bit-clk-val-d = <0>;
		hw,lcdkit-mipi-dsi-bit-clk-val-e = <0>;
		hw,lcdkit-mipi-dsi-bit-clk-upt = <644>;
		hw,lcdkit-mipi-rg-vcm-adjust = <0>;
		hw,lcdkit-mipi-non-continue-enable = <1>;
		hw,lcdkit-mipi-clk-post-adjust = <215>;
		hw,lcdkit-mipi-clk-pre-adjust = <0>;
		hw,lcdkit-mipi-clk-t-hs-prepare-adjust = <0>;
		hw,lcdkit-mipi-clk-t-lpx-adjust = <0>;
		hw,lcdkit-mipi-clk-t-hs-trail-adjust = <0>;
		hw,lcdkit-mipi-clk-t-hs-exit-adjust = <0>;
		hw,lcdkit-mipi-clk-t-hs-zero-adjust = <0>;
		hw,lcdkit-mipi-data-t-lpx-adjust = <0>;
		hw,lcdkit-mipi-phy-mode = <1>;
		hw,lcdkit-mipi-eotp-disable-flag = <0>;
		hw,lcdkit-blpwm-input-disable = <0>;
		hw,lcdkit-dirt-left-align = <0xffff>;
		hw,lcdkit-dirt-right-align = <0xffff>;
		hw,lcdkit-dirt-top-align = <8>;
		hw,lcdkit-dirt-bott-align = <0xffff>;
		hw,lcdkit-dirt-width-align = <0xffff>;
		hw,lcdkit-dirt-height-align = <8>;
		hw,lcdkit-dirt-width-min = <1440>;
		hw,lcdkit-dirt-height-min = <8>;
		hw,lcdkit-dirt-top-start = <0xffff>;
		hw,lcdkit-dirt-bott-start = <0xffff>;
		hw,lcdkit-bl-byte-order = <0>;
		hw,lcdkit-iovcc-before-vci-flag = <0>;
		hw,lcdkit-gpios = <&gpio4 2 0>,<&gpio6 3 0>,<&gpio1 4 0>,<&gpio26 2 0>,<&gpio24 4 0>,<&gpio4 3 0>;
		lcdio-vcc-supply = <&ldo4>;
		lcdanalog-vcc-supply = <&ldo17>;
		pinctrl-0 = <&gpio034_pmx_func &gpio034_cfg_func>;
		pinctrl-1 = <&gpio034_pmx_idle &gpio034_cfg_idle>;
		pinctrl-names = "default","idle";
		status = "disabled";
		hw,lcdkit-sbl-support = <0>;
		hw,lcdkit-gamma-support = <1>;
		hw,lcdkit-gmp-support = <1>;
		hw,lcdkit-color-temp-support = <1>;
		hw,lcdkit-color-temp-rectify-support = <0>;
		hw,lcdkit-comform-mode-support = <1>;
		hw,lcdkit-cinema-mode-support = <0>;
		hw,lcdkit-prefix-sharp-two-d-support = <1>;
		hw,lcdkit-xcc-support = <1>;
		hw,lcdkit-prefix-ce-support = <0>;
		hw,lcdkit-prefix-sharp-one-d-support = <0>;
		hw,lcdkit-acm-support = <1>;
		hw,lcdkit-smart-color-mode-support = <0>;
		hw,lcdkit-acm-ce-support = <0>;
		hw,lcdkit-acm-valid-num = <7>;
		hw,lcdkit-r_hh0 = <0x7f>;
		hw,lcdkit-r_lh0 = <0x0>;
		hw,lcdkit-r_hh1 = <0xff>;
		hw,lcdkit-r_lh1 = <0x80>;
		hw,lcdkit-r_hh2 = <0x17f>;
		hw,lcdkit-r_lh2 = <0x100>;
		hw,lcdkit-r_hh3 = <0x1ff>;
		hw,lcdkit-r_lh3 = <0x180>;
		hw,lcdkit-r_hh4 = <0x27f>;
		hw,lcdkit-r_lh4 = <0x200>;
		hw,lcdkit-r_hh5 = <0x2ff>;
		hw,lcdkit-r_lh5 = <0x280>;
		hw,lcdkit-r_hh6 = <0x37f>;
		hw,lcdkit-r_lh6 = <0x300>;
		hw,lcdkit-r_video_hh0 = <0x7f>;
		hw,lcdkit-r_video_lh0 = <0x0>;
		hw,lcdkit-r_video_hh1 = <0x101>;
		hw,lcdkit-r_video_lh1 = <0x80>;
		hw,lcdkit-r_video_hh2 = <0x177>;
		hw,lcdkit-r_video_lh2 = <0x102>;
		hw,lcdkit-r_video_hh3 = <0x1ed>;
		hw,lcdkit-r_video_lh3 = <0x178>;
		hw,lcdkit-r_video_hh4 = <0x26f>;
		hw,lcdkit-r_video_lh4 = <0x1ee>;
		hw,lcdkit-r_video_hh5 = <0x2ff>;
		hw,lcdkit-r_video_lh5 = <0x270>;
		hw,lcdkit-r_video_hh6 = <0x37c>;
		hw,lcdkit-r_video_lh6 = <0x300>;
		hw,lcdkit-color-temp-rectify-r = <32768>;
		hw,lcdkit-color-temp-rectify-g = <32768>;
		hw,lcdkit-color-temp-rectify-b = <32768>;
		hw,lcdkit-hiace-support = <1>;
		hw,lcdkit-panel-effect-support = <0>;
		hw,lcdkit-arsr1p-sharpness-support = <1>;
		hw,lcdkit-iglobal-hist-black-pos = <16>;
		hw,lcdkit-iglobal-hist-white-pos = <240>;
		hw,lcdkit-iglobal-hist-black-weight = <51>;
		hw,lcdkit-iglobal-hist-white-weight = <51>;
		hw,lcdkit-iglobal-hist-zero-cut-ratio = <486>;
		hw,lcdkit-iglobal-hist-slope-cut-ratio = <410>;
		hw,lcdkit-imax-lcd-luminance = <500>;
		hw,lcdkit-imin-lcd-luminance = <3>;
		hw,lcdkit-cfg-name = "/product/etc/display/effect/algorithm/hdr_engine.xml";
		hw,lcdkit-effect-support-mode = <65537>;
		hw,lcdkit-bl-support-mode = <0>;
		hw,lcdkit-bl-enhance = <0>;
		hw,lcdkit-bl-normal = <0>;
		hw,lcdkit-hisi-esd-support = <1>;
		hw,lcdkit-hisi-esd-reg-command = <0x14 0x01 0x00 0x00 0x0a 0x00 0x02 0xab 0x00>;
		hw,lcdkit-hisi-esd-value = <0x3e 0xf3>;
		hw,lcdkit-delay-af-rst-off = <5>;
		hw,lcdkit-h-back-porch = <10>;
		hw,lcdkit-h-front-porch = <32>;
		hw,lcdkit-h-pulse-width = <10>;
		hw,lcdkit-v-back-porch = <60>;
		hw,lcdkit-v-pulse-width = <30>;
		hw,lcdkit-v-front-porch = <14>;
		hw,lcdkit-h-sync-skew = <0>;
		hw,lcdkit-lcd-type = <1>;
		hw,lcdkit-panel-pt-test-support = <1>;
		hw,lcdkit-mipi-clk-config-support = <0>;
		hw,lcdkit-panel-hkadc-support = <0>;
		hw,lcdkit-bias-power-ctrl-mode = <4>;
		hw,lcdkit-iovcc-power-ctrl-mode = <1>;
		hw,lcdkit-vci-power-ctrl-mode = <1>;
		hw,lcdkit-id0-gpio = <131>;
		hw,lcdkit-id1-gpio = <132>;
		hw,lcdkit-reset-gpio = <29>;
		hw,lcdkit-te-gpio = <16>;
		hw,lcdkit-vsp-gpio = <12>;
		hw,lcdkit-vsn-gpio = <34>;
		hw,lcdkit-iovcc-gpio = <0>;
		hw,lcdkit-vci-gpio = <0>;
		hw,lcdkit-bl-gpio = <11>;
		hw,lcdkit-iovcc-on-is-need-reset = <0>;
		hw,lcdkit-vsn-on-is-need-reset = <1>;
		hw,lcdkit-reset-pull-high-flag = <0>;
		hw,lcdkit-lcdanalog-vcc = <3100000>;
		hw,lcdkit-lcdio-vcc = <1850000>;
		hw,lcdkit-lcd-bias = <5500000>;
		hw,lcdkit-lcd-vsp = <5500000>;
		hw,lcdkit-lcd-vsn = <5500000>;
		hw,lcdkit-lcd-rst-first-high = <1>;
		hw,lcdkit-lcd-rst-low = <1>;
		hw,lcdkit-lcd-rst-second-high = <15>;
		hw,lcdkit-delay-af-vci-on = <5>;
		hw,lcdkit-delay-af-iovcc-on = <5>;
		hw,lcdkit-delay-af-bias-on = <0>;
		hw,lcdkit-delay-af-vsp-on = <5>;
		hw,lcdkit-delay-af-vsn-on = <5>;
		hw,lcdkit-delay-af-lp11 = <10>;
		hw,lcdkit-delay-af-tp-reset = <15>;
		hw,lcdkit-tp-reset-before-lcd-reset = <0>;
		hw,lcdkit-delay-af-vsn-off = <5>;
		hw,lcdkit-delay-af-vsp-off = <5>;
		hw,lcdkit-delay-af-bias-off = <0>;
		hw,lcdkit-delay-af-vbat-off = <0>;
		hw,lcdkit-delay-af-iovcc-off = <10>;
		hw,lcdkit-delay-af-vci-off = <90>;
		hw_tps65132,lcdkit-bias-type = <0x06>;
		hw_tps65132,lcdkit-bias-vpos-reg = <0x00>;
		hw_tps65132,lcdkit-bias-vneg-reg = <0x01>;
		hw_tps65132,lcdkit-bias-vpos-val = <0x0f>;
		hw_tps65132,lcdkit-bias-vneg-val = <0x0f>;
		hw_tps65132,lcdkit-bias-vpos-mask = <0x1f>;
		hw_tps65132,lcdkit-bias-vneg-mask = <0x1f>;
		hw_tps65132,lcdkit-bias-state-reg = <0x03>;
		hw_tps65132,lcdkit-bias-state-val = <0x43>;
		hw_tps65132,lcdkit-bias-state-mask = <0x43>;
		hw_rt4801h,lcdkit-bias-type = <0x0c>;
		hw_rt4801h,lcdkit-bias-vpos-reg = <0x00>;
		hw_rt4801h,lcdkit-bias-vneg-reg = <0x01>;
		hw_rt4801h,lcdkit-bias-vpos-val = <0x0f>;
		hw_rt4801h,lcdkit-bias-vneg-val = <0x0f>;
		hw_rt4801h,lcdkit-bias-vpos-mask = <0x1f>;
		hw_rt4801h,lcdkit-bias-vneg-mask = <0x1f>;
		hw_rt4801h,lcdkit-bias-state-reg = <0x03>;
		hw_rt4801h,lcdkit-bias-state-val = <0x03>;
		hw_rt4801h,lcdkit-bias-state-mask = <0x43>;
		hw_lv52134a,lcdkit-bias-type = <0x04>;
		hw_lv52134a,lcdkit-bias-vpos-reg = <0x00>;
		hw_lv52134a,lcdkit-bias-vneg-reg = <0x01>;
		hw_lv52134a,lcdkit-bias-vpos-val = <0x0f>;
		hw_lv52134a,lcdkit-bias-vneg-val = <0x0f>;
		hw_lv52134a,lcdkit-bias-vpos-mask = <0x1f>;
		hw_lv52134a,lcdkit-bias-vneg-mask = <0x1f>;
		hw_lv52134a,lcdkit-bias-state-reg = <0x00>;
		hw_lv52134a,lcdkit-bias-state-val = <0x00>;
		hw_lv52134a,lcdkit-bias-state-mask = <0x00>;
    };
};