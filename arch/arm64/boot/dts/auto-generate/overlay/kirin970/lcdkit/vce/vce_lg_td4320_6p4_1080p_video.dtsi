/* Copyright (c) 2013, The Linux Foundation. All rights reserved.
 *
 * This program is free software; you can redistribute it and/or modify
 * it under the terms of the GNU General Public License version 2 and
 * only version 2 as published by the Free Software Foundation.
 *
 * This program is distributed in the hope that it will be useful,
 * but WITHOUT ANY WARRANTY; without even the implied warranty of
 * MERCHANTABILITY or FITNESS FOR A PARTICULAR PURPOSE.  See the
 * GNU General Public License for more details.
 */

/*-------------------------------------------------------------------------
 * This file is autogenerated file using gcdb parser. Please do not edit it.
 * Update input XML file to add a new entry or update variable in this file
 * VERSION = 1.1
 *-----------------------------------------------------------------------*/
/ {
	dsi_vce_lg_td4320_6p4_1080p_video: lcdkit_vce_lg_td4320_6p4_1080p_video {
		compatible = "lg_td4320_6p4_1080p_video";
		hw,lcdkit-panel-name = "LG_TD4320 6.4' VIDEO TFT 1080 x 2310";
		hw,lcdkit-panel-model = "VNCE_100 101 0 6.4' 1080 x 2310";
		hw,lcdkit-mipi-clk-config-high = <600>;
		hw,lcdkit-mipi-clk-config-low = <548>;
		hw,lcdkit-mipi-clk-config-normal = <548>;
		hw,lcdkit-panel-type = <0x01>;
		hw,lcdkit-panel-xres = <1080>;
		hw,lcdkit-panel-yres = <2310>;
		hw,lcdkit-panel-width = <69>;
		hw,lcdkit-panel-height = <147>;
		hw,lcdkit-panel-on-command = <0x05 0x01 0x00 0x00 0x50 0x01 0x02 0x11 0x00
			0x05 0x01 0x00 0x00 0x14 0x01 0x02 0x29 0x00>;
		hw,lcdkit-panel-on-command-state = "dsi_lp_mode";
		hw,lcdkit-panel-off-command = <0x1000005 0x01 0x00 0x00 0x14 0x01 0x02 0x28 0x00
			0x1000005 0x01 0x00 0x00 0x46 0x01 0x02 0x10 0x00>;
		hw,lcdkit-panel-off-command-state = "dsi_lp_mode";
		hw,lcdkit-panel-cabc-off-command = <0x15 0x01 0x00 0x00 0x0a 0x00 0x02 0x55 0x00>;
		hw,lcdkit-panel-cabc-off-command-state = "dsi_lp_mode";
		hw,lcdkit-panel-cabc-ui-command = <0x15 0x01 0x00 0x00 0x0a 0x00 0x02 0x55 0x01
			0x15 0x01 0x00 0x00 0x0a 0x00 0x02 0x53 0x24>;
		hw,lcdkit-panel-cabc-ui-command-state = "dsi_lp_mode";
		hw,lcdkit-panel-cabc-still-command = <0x15 0x01 0x00 0x00 0x0a 0x00 0x02 0x55 0x02
			0x15 0x01 0x00 0x00 0x0a 0x00 0x02 0x53 0x24>;
		hw,lcdkit-panel-cabc-still-command-state = "dsi_lp_mode";
		hw,lcdkit-panel-cabc-moving-command = <0x15 0x01 0x00 0x00 0x0a 0x00 0x02 0x55 0x03
			0x15 0x01 0x00 0x00 0x0a 0x00 0x02 0x53 0x2C>;
		hw,lcdkit-panel-cabc-moving-command-state = "dsi_lp_mode";
		hw,lcdkit-panel-cabc-support = <0>;
		hw,lcdkit-panel-cabc-switch-support = <1>;
		hw,lcdkit-panel-rgbw-support = <0>;
		hw,lcdkit-panel-display-on-effect-support = <0>;
		hw,lcdkit-panel-ce-support = <0>;
		hw,lcdkit-panel-version-support = <0>;
		hw,lcdkit-panel-otp-support = <0>;
		hw,lcdkit-panel-dot-inversion-command = <0x29 0x01 0x00 0x00 0x0a 0x00 0x02 0xb0 0x04
				0x29 0x01 0x00 0x00 0x12 0x00 0x09 0xc6 0x02 0x1a 0x08 0xfc 0xff 0xff 0xff 0x01
				0x29 0x01 0x00 0x00 0x0a 0x00 0x02 0xb0 0x03>;
		hw,lcdkit-panel-dot-inversion-command-state = "dsi_lp_mode";
		hw,lcdkit-panel-column-inversion-command = <0x29 0x01 0x00 0x00 0x0a 0x00 0x02 0xb0 0x04
				0x29 0x01 0x00 0x00 0x12 0x00 0x09 0xc6 0x02 0x1a 0x08 0xfc 0xff 0xff 0xff 0x00
				0x29 0x01 0x00 0x00 0x0a 0x00 0x02 0xb0 0x03>;
		hw,lcdkit-panel-column-inversion-command-state = "dsi_lp_mode";
		hw,lcdkit-panel-inversion-support = <1>;
		hw,lcdkit-panel-scan-support = <0>;
		hw,lcdkit-panel-display-region-support = <0>;
		hw,lcdkit-panel-checksum-support = <0>;
		hw,lcdkit-panel-esd-reg-command = <0x1000006 0x01 0x00 0x00 0x0a 0x00 0x01 0x0a>;
		hw,lcdkit-panel-esd-reg-command-state = "dsi_lp_mode";
		hw,lcdkit-panel-esd-value = <0x1c>;
		hw,lcdkit-panel-esd-support = <1>;
		hw,lcdkit-panel-check-reg-command = <0x06 0x01 0x00 0x00 0x0a 0x00 0x01 0x0a>;
		hw,lcdkit-panel-check-reg-value = <0x1c>;
		hw,lcdkit-panel-check-reg-command-state = "dsi_lp_mode";
		hw,lcdkit-panel-mipi-check-command = <0x1000006 0x01 0x00 0x00 0x0a 0x00 0x01 0x05>;
		hw,lcdkit-panel-mipi-check-value = <0x00>;
		hw,lcdkit-panel-mipi-check-command-state = "dsi_lp_mode";
		hw,lcdkit-panel-mipi-check-support = <1>;
		hw,lcdkit-panel-check-reg-support = <1>;
		hw,lcdkit-panel-check-on-value = <0x0a>;
		hw,lcdkit-panel-check-reg-expect-value = <0x1c>;
		hw,lcdkit-panel-check-reg-mask-value = <0xff>;
		hw,lcdkit-panel-bl-maxnit-command = <0x1000006 0x01 0x00 0x00 0x0a 0x00 0x01 0xdb>;
		hw,lcdkit-panel-bl-maxnit-command-state = <>;
		hw,lcdkit-panel-bl-befreadconfig = <>;
		hw,lcdkit-panel-bl-befreadconfig-state = <>;
		hw,lcdkit-panel-bl-aftreadconfig = <>;
		hw,lcdkit-panel-bl-aftreadconfig-state = <>;
		hw,lcdkit-panel-brightness-color-uniform-support = <0>;
		hw,lcdkit-panel-dynamic-gamma-support = <0>;
		hw,lcdkit-panel-mipi-detect-support = <1>;
		hw,lcdkit-panel-dynamic-sram-check-support = <0>;
		hw,lcdkit-panel-fps-updt-support = <0>;
		hw,lcdkit-panel-fps-func-switch = <0>;
		hw,lcdkit-panel-check-reg-on-support = <1>;
		hw,lcdkit-panel-fps-tscall-support = <0>;
		hw,lcdkit-panel-dis-on-cmds-delay-margin-support = <0>;
		hw,lcdkit-panel-snd-cmd-before-frame-support = <0>;
		hw,lcdkit-panel-ts-resume-ctrl-mode = <2>;
		hw,lcdkit-panel-dis-on-cmds-delay-margin-time = <0>;
		hw,lcdkit-panel-lptohs-mipi-check-support = <0>;
		hw,lcdkit-panel-acl-ctrl-support = <0>;
		hw,lcdkit-panel-hbm-ctrl-support = <0>;
		hw,lcdkit-panel-vr-support = <0>;
		hw,lcdkit-panel-current-detect-support = <0>;
		hw,lcdkit-panel-lv-detect-support = <0>;
		hw,lcdkit-host-eml-read-reg-flag = <3>;
		hw,lcdkit-reset-shutdown-later = <0>;
		hw,lcdkit-lcdph-delay-set-flag = <1>;
		hw,lcdkit-panel-pcd-errflag-check-support = <0>;
		hw,lcdkit-panel-pt-ulps-support = <1>;
		hw,lcdkit-panel-aod-support = <0>;
		hw,lcdkit-panel-orientation = <1>;
		hw,lcdkit-panel-bpp = <0>;
		hw,lcdkit-panel-bgrfmt = <0>;
		hw,lcdkit-panel-bl-type = <4>;
		hw,lcdkit-panel-blmin = <100>;
		hw,lcdkit-panel-blmax = <9260>;
		hw,lcdkit-mask-delay-time-before-fp = <16666>;
		hw,lcdkit-mask-delay-time-after-fp = <16666>;
		hw,lcdkit-panel-bl-def = <4000>;
		hw,lcdkit-panel-bl-maxnit = <450>;
		hw,lcdkit-panel-getblmaxnit-type = <1>;
		hw,lcdkit-panel-cmd-type = <8>;
		hw,lcdkit-panel-ifbctype = <0>;
		hw,lcdkit-panel-ifbc-vesa3x-set = <0>;
		hw,lcdkit-panel-frc-enable = <0>;
		hw,lcdkit-panel-esd-skip-mipi-check = <1>;
		hw,lcdkit-panel-pxl-clk = <185>;
		hw,lcdkit-panel-pxl-clk-div = <1>;
		hw,lcdkit-panel-tp-resume-nosync = <0>;
		hw,lcdkit-panel-display-on-in-backlight = <0>;
		hw,lcdkit-panel-display-on-new-seq = <0>;
		hw,lcdkit-panel-dirt-updt-support = <0>;
		hw,lcdkit-is-hostprocessing = <1>;
		hw,lcdkit-host-info-all-in-ddic = <1>;
		hw,lcdkit-panel-dsi-upt-support = <0>;
		hw,mipiclk-updt-support-new = <1>;
		hw,lcdkit-panel-vsyn-ctr-type = <0>;
		hw,lcdkit-panel-bl-pwm-preci-no-convert = <0>;
		hw,lcdkit-panel-bl-pwm-preci-type = <1>;
		hw,lcdkit-panel-bl-ic-ctrl-type = <8>;
		hw,lcdkit-panel-fps-updt-only = <0>;
		hw,lcdkit-panel-step-support = <1>;
		hw,lcdkit-ldi-hsync-plr = <0>;
		hw,lcdkit-ldi-vsync-plr = <0>;
		hw,lcdkit-ldi-pixel-clk-plr = <0>;
		hw,lcdkit-ldi-data-en-plr = <0>;
		hw,lcdkit-ldi-dpi-a-overlap-size = <0>;
		hw,lcdkit-ldi-dpi-b-overlap-size = <0>;
		hw,lcdkit-sbl-stren-limit = <128>;
		hw,lcdkit-sbl-cal-a = <60>;
		hw,lcdkit-sbl-cal-b = <95>;
		hw,lcdkit-sbl-cal-c = <5>;
		hw,lcdkit-sbl-cal-d = <1>;
		hw,lcdkit-sbl-tf-ctl = <5>;
		hw,lcdkit-sbl-bl-min = <480>;
		hw,lcdkit-sbl-bl-max = <4096>;
		hw,lcdkit-sbl-bl-scale = <0xff>;
		hw,lcdkit-sbl-am-light-min = <14>;
		hw,lcdkit-sbl-filter-a = <1738>;
		hw,lcdkit-sbl-filter-b = <6>;
		hw,lcdkit-sbl-logo-left = <0>;
		hw,lcdkit-sbl-logo-top = <0>;
		hw,lcdkit-sbl-variance-intensity-space = <145>;
		hw,lcdkit-sbl-slope-max = <54>;
		hw,lcdkit-sbl-slope-min = <160>;
		hw,lcdkit-mipi-lane-nums = <3>;
		hw,lcdkit-mipi-color-mode = <5>;
		hw,lcdkit-mipi-vc = <0>;
		hw,lcdkit-mipi-dsi-bit-clk = <548>;
		hw,lcdkit-mipi-burst-mode = <2>;
		hw,lcdkit-mipi-max-esc-clk = <10>;
		hw,lcdkit-mipi-dsi-bit-clk-val-a = <562>;
		hw,lcdkit-mipi-dsi-bit-clk-val-b = <552>;
		hw,lcdkit-mipi-dsi-bit-clk-val-c = <0>;
		hw,lcdkit-mipi-dsi-bit-clk-val-d = <0>;
		hw,lcdkit-mipi-dsi-bit-clk-val-e = <0>;
		hw,lcdkit-mipi-dsi-bit-clk-upt = <548>;
		hw,lcdkit-mipi-rg-vcm-adjust = <0>;
		hw,lcdkit-mipi-non-continue-enable = <0>;
		hw,lcdkit-mipi-clk-post-adjust = <215>;
		hw,lcdkit-mipi-lp11_flag = <1>;
		hw,lcdkit-mipi-clk-pre-adjust = <0>;
		hw,lcdkit-mipi-clk-t-hs-prepare-adjust = <0>;
		hw,lcdkit-mipi-clk-t-lpx-adjust = <0>;
		hw,lcdkit-mipi-clk-t-hs-trail-adjust = <0>;
		hw,lcdkit-mipi-clk-t-hs-exit-adjust = <0>;
		hw,lcdkit-mipi-clk-t-hs-zero-adjust = <0>;
		hw,lcdkit-mipi-data-t-lpx-adjust = <0>;
		hw,lcdkit-mipi-phy-mode = <0>;
		hw,lcdkit-mipi-eotp-disable-flag = <0>;
		hw,lcdkit-blpwm-input-disable = <1>;
		hw,lcdkit-dirt-left-align = <2>;
		hw,lcdkit-dirt-right-align = <2>;
		hw,lcdkit-dirt-top-align = <2>;
		hw,lcdkit-dirt-bott-align = <2>;
		hw,lcdkit-dirt-width-align = <2>;
		hw,lcdkit-dirt-height-align = <2>;
		hw,lcdkit-dirt-width-min = <2>;
		hw,lcdkit-dirt-height-min = <2>;
		hw,lcdkit-dirt-top-start = <0xffff>;
		hw,lcdkit-dirt-bott-start = <0xffff>;
		hw,lcdkit-bl-byte-order = <0>;
		hw,lcdkit-iovcc-before-vci-flag = <0>;
		hw,lcdkit-gpios = <&gpio4 2 0>,<&gpio6 3 0>,<&gpio1 4 0>,<&gpio26 2 0>,<&gpio24 4 0>,<&gpio4 3 0>;
		lcdio-vcc-supply = <&ldo4>;
		lcdanalog-vcc-supply = <&ldo17>;
		pinctrl-0 = <&gpio034_pmx_func &gpio034_cfg_func &gpio011_pmx_func &gpio011_cfg_func>;
		pinctrl-1 = <&gpio034_pmx_idle &gpio034_cfg_idle &gpio011_pmx_idle &gpio011_cfg_idle>;
		pinctrl-names = "default","idle";
		status = "disabled";
		hw,lcdkit-sbl-support = <0>;
		hw,lcdkit-gamma-support = <1>;
		hw,lcdkit-gmp-support = <1>;
		hw,lcdkit-color-temp-support = <1>;
		hw,lcdkit-color-temp-rectify-support = <0>;
		hw,lcdkit-comform-mode-support = <1>;
		hw,lcdkit-cinema-mode-support = <0>;
		hw,lcdkit-prefix-sharp-two-d-support = <1>;
		hw,lcdkit-xcc-support = <1>;
		hw,lcdkit-prefix-ce-support = <0>;
		hw,lcdkit-prefix-sharp-one-d-support = <0>;
		hw,lcdkit-acm-support = <0>;
		hw,lcdkit-smart-color-mode-support = <0>;
		hw,lcdkit-acm-ce-support = <0>;
		hw,lcdkit-acm-valid-num = <7>;
		hw,lcdkit-r_hh0 = <0x7f>;
		hw,lcdkit-r_lh0 = <0xe>;
		hw,lcdkit-r_hh1 = <0xbe>;
		hw,lcdkit-r_lh1 = <0x80>;
		hw,lcdkit-r_hh2 = <0xff>;
		hw,lcdkit-r_lh2 = <0xbf>;
		hw,lcdkit-r_hh3 = <0x1c0>;
		hw,lcdkit-r_lh3 = <0x100>;
		hw,lcdkit-r_hh4 = <0x27f>;
		hw,lcdkit-r_lh4 = <0x1c1>;
		hw,lcdkit-r_hh5 = <0x323>;
		hw,lcdkit-r_lh5 = <0x280>;
		hw,lcdkit-r_hh6 = <0x381>;
		hw,lcdkit-r_lh6 = <0x324>;
		hw,lcdkit-r_video_hh0 = <0x7f>;
		hw,lcdkit-r_video_lh0 = <0xe>;
		hw,lcdkit-r_video_hh1 = <0xbe>;
		hw,lcdkit-r_video_lh1 = <0x80>;
		hw,lcdkit-r_video_hh2 = <0xff>;
		hw,lcdkit-r_video_lh2 = <0xbf>;
		hw,lcdkit-r_video_hh3 = <0x1c0>;
		hw,lcdkit-r_video_lh3 = <0x100>;
		hw,lcdkit-r_video_hh4 = <0x27f>;
		hw,lcdkit-r_video_lh4 = <0x1c1>;
		hw,lcdkit-r_video_hh5 = <0x323>;
		hw,lcdkit-r_video_lh5 = <0x280>;
		hw,lcdkit-r_video_hh6 = <0x381>;
		hw,lcdkit-r_video_lh6 = <0x324>;
		hw,lcdkit-color-temp-rectify-r = <32768>;
		hw,lcdkit-color-temp-rectify-g = <32768>;
		hw,lcdkit-color-temp-rectify-b = <32768>;
		hw,lcdkit-hiace-support = <1>;
		hw,lcdkit-panel-effect-support = <0>;
		hw,lcdkit-arsr1p-sharpness-support = <1>;
		hw,lcdkit-iglobal-hist-black-pos = <16>;
		hw,lcdkit-iglobal-hist-white-pos = <240>;
		hw,lcdkit-iglobal-hist-black-weight = <51>;
		hw,lcdkit-iglobal-hist-white-weight = <51>;
		hw,lcdkit-iglobal-hist-zero-cut-ratio = <486>;
		hw,lcdkit-iglobal-hist-slope-cut-ratio = <410>;
		hw,lcdkit-imax-lcd-luminance = <500>;
		hw,lcdkit-imin-lcd-luminance = <3>;
		hw,lcdkit-cfg-name = "/product/etc/display/effect/algorithm/hdr_engine.xml";
		hw,lcdkit-effect-support-mode = <65537>;
		hw,lcdkit-bl-support-mode = <1>;
		hw,lcdkit-bl-enhance = <0>;
		hw,lcdkit-bl-normal = <0>;
		hw,lcdkit-delay-af-rst-off = <5>;
		hw,lcdkit-default-project-id = "VENC691000";
		hw,lcdkit-h-back-porch = <26>;
		hw,lcdkit-h-front-porch = <180>;
		hw,lcdkit-h-pulse-width = <6>;
		hw,lcdkit-v-back-porch = <60>;
		hw,lcdkit-v-pulse-width = <4>;
		hw,lcdkit-v-front-porch = <4>;
		hw,lcdkit-h-sync-skew = <0>;
		hw,lcdkit-non-check-ldi-porch = <1>;
		hw,lcdkit-lcd-type = <2>;
		hw,lcdkit-panel-pt-test-support = <1>;
		hw,lcdkit-mipi-clk-config-support = <1>;
		hw,lcdkit-panel-hkadc-support = <0>;
		hw,lcdkit-bias-power-ctrl-mode = <2>;
		hw,lcdkit-bl-gpio-ctrl-mode = <0>;
		hw,lcdkit-bl-gpio-suspend-disable = <0>;
		hw,lcdkit-iovcc-power-ctrl-mode = <1>;
		hw,lcdkit-vci-power-ctrl-mode = <0>;
		hw,lcdkit-id0-gpio = <131>;
		hw,lcdkit-id1-gpio = <132>;
		hw,lcdkit-reset-gpio = <29>;
		hw,lcdkit-te-gpio = <16>;
		hw,lcdkit-vsp-gpio = <12>;
		hw,lcdkit-vsn-gpio = <34>;
		hw,lcdkit-iovcc-gpio = <0>;
		hw,lcdkit-vci-gpio = <0>;
		hw,lcdkit-bl-gpio = <11>;
		hw,lcdkit-iovcc-on-is-need-reset = <0>;
		hw,lcdkit-vsn-on-is-need-reset = <1>;
		hw,lcdkit-reset-pull-high-flag = <1>;
		hw,lcdkit-lcdanalog-vcc = <3100000>;
		hw,lcdkit-lcdio-vcc = <1850000>;
		hw,lcdkit-lcd-bias = <5500000>;
		hw,lcdkit-lcd-vsp = <5500000>;
		hw,lcdkit-lcd-vsn = <5500000>;
		hw,lcdkit-lcd-rst-first-high = <0>;
		hw,lcdkit-lcd-rst-low = <0>;
		hw,lcdkit-lcd-rst-second-high = <22>;
		hw,lcdkit-delay-af-vci-on = <5>;
		hw,lcdkit-delay-af-iovcc-on = <4>;
		hw,lcdkit-delay-af-bias-on = <0>;
		hw,lcdkit-delay-af-vsp-on = <5>;
		hw,lcdkit-delay-af-vsn-on = <5>;
		hw,lcdkit-delay-af-lp11 = <10>;
		hw,lcdkit-delay-af-tp-reset = <0>;
		hw,lcdkit-delay-af-tp-after-resume = <10>;
		hw,lcdkit-tp-reset-before-lcd-reset = <0>;
		hw,lcdkit-tp-fw-early-lcd-init = <1>;
		hw,lcdkit-delay-af-vsn-off = <2>;
		hw,lcdkit-delay-af-vsp-off = <2>;
		hw,lcdkit-delay-af-bias-off = <0>;
		hw,lcdkit-delay-af-vbat-off = <0>;
		hw,lcdkit-delay-af-iovcc-off = <10>;
		hw,lcdkit-delay-af-vci-off = <10>;
		hw_lm36274,lcdkit-bl-ic-level = <2047>;
		hw_lm36274,lcdkit-bl-ic-ctrl-mode = <0>;
		hw_lm36274,lcdkit-bl-ic-type = <1>;
		hw_lm36274,lcdkit-bl-ic-before-init-delay = <0>;
		hw_lm36274,lcdkit-bl-ic-init-delay = <0>;
		hw_lm36274,lcdkit-bl-ic-ovp-check = <1>;
		hw_lm36274,lcdkit-bl-ic-fake-lcd-ovp-check = <1>;
		hw_lm36274,lcdkit-bl-ic-init-cmd = <0x01 0x02 0x40 0xff
                                     0x01 0x03 0x85 0xff
                                     0x01 0x06 0x00 0xff
                                     0x01 0x07 0x00 0xff
                                     0x01 0x09 0x99 0xff
                                     0x01 0x0a 0x11 0xff
                                     0x01 0x0b 0x00 0xff
                                     0x01 0x0c 0x24 0xff
                                     0x01 0x0d 0x20 0xff
                                     0x01 0x0e 0x20 0xff
                                     0x01 0x10 0x46 0xff
                                     0x01 0x11 0x35 0xff
                                     0x01 0x08 0x17 0xff>;
		hw_lm36274,lcdkit-bl-ic-num-of-init-cmd = <0x0D>;
		hw_lm36274,lcdkit-bl-ic-bl-lsb-reg-cmd = <0x03 0x04 0x00 0x07>;
		hw_lm36274,lcdkit-bl-ic-bl-msb-reg-cmd = <0x08 0x05 0x00 0xff>;
		hw_lm36274,lcdkit-bl-ic-bl-enable-cmd = <0x01 0x08 0x17 0xff>;
		hw_lm36274,lcdkit-bl-ic-bl-disable-cmd = <0x01 0x08 0x00 0xff>;
		hw_lm36274,lcdkit-bl-ic-disable-device-cmd = <0x01 0x08 0x80 0xff>;
		hw_lm36274,lcdkit-bl-ic-fault-flag-cmd = <0x00 0x0f 0x00 0xff>;
		hw_lm36274,lcdkit-bl-ic-bias-disable-cmd = <0x02 0x09 0x00 0xff>;
		hw_lm36274,lcdkit-bl-ic-bias-enable-cmd = <0x02 0x09 0x00 0xe0>;
		hw_lm36274,lcdkit-bl-ic-led-open-short-test = <0>;
		hw_lm36274,lcdkit-bl-ic-num-of-led = <0>;
		hw_lm36274,lcdkit-bl-ic-brt-ctrl-cmd = <0x00 0x00 0x00 0x00>;
		hw_lm36274,lcdkit-bl-ic-fault-ctrl-cmd = <0x00 0x00 0x00 0x00>;
		hw_lm36274,lcdkit-bl-ic-hidden-reg-surpport = <0>;
		hw_lm36274,lcdkit-bl-ic-sec-reg-enable-cmd = <0x01 0x50 0x08 0xff>;
		hw_lm36274,lcdkit-bl-ic-sec-reg-disable-cmd = <0x01 0x50 0x00 0xff>;
		hw_lm36274,lcdkit-bl-ic-hidden-reg-cmd = <0x00 0x6a 0x00 0xff>;
		hw_lm36274,lcdkit-bl-ic-hidden-reg-val-mask = <0x30>;
		hw_lm36274,lcdkit-bl-ic-suspend-disbright-support = <1>;
		hw_lm36274,lcdkit-bl-ic-bl-wq-support = <0>;
		hw_lm36274,lcdkit-bl-ic-bl-enahnce-support = <0>;
		hw_lm36274,lcdkit-bl-ic-bl-lowpower-delay = <6>;
		hw_lm36274,lcdkit-bl-ic-bl-normal-level = <1709>;
		hw_lm36274,lcdkit-bl-ic-bl-enhance-level = <1869>;
		hw_lm36274,lcdkit-bl-ic-bl-enhance-hrdtimer-time = <60>;
		hw_lm36274,lcdkit-bl-ic-bl-normal-ovp-cmd = <0x01 0x02 0x40 0xff>;
		hw_lm36274,lcdkit-bl-ic-bl-normal-cur-ramp-cmd = <0x01 0x03 0x85 0xff>;
		hw_lm36274,lcdkit-bl-ic-bl-normal-boost-cur-cmd = <0x01 0x11 0x35 0xff>;
		hw_lm36274,lcdkit-bl-ic-bl-normal-sink-cmd = <0x01 0x08 0x17 0xff>;
		hw_lm36274,lcdkit-bl-ic-bl-enhance-ovp-cmd = <0x01 0x02 0x60 0xff>;
		hw_lm36274,lcdkit-bl-ic-bl-enhance-cur-ramp-cmd = <0x01 0x03 0xad 0xff>;
		hw_lm36274,lcdkit-bl-ic-bl-enhance-boost-cur-cmd = <0x01 0x11 0x36 0xff>;
		hw_lm36274,lcdkit-bl-ic-bl-enhance-sink-cmd = <0x01 0x08 0x17 0xff>;
    };
};