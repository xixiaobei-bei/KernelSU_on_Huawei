
/**
 * Copyright (C) 2014 Hisilicon Ltd.
 *
 *  This program is free software; you can redistribute it and/or modify
 *  it under the terms of the GNU General Public License version 2 as
 *  publishhed by the Free Software Foundation.
 */

/include/ "kirin970_udp_cs_EVB2_overlay.dtsi"

/ {
	board_id = <6015>;
};

&rootparam {
    hisi,boardid = <6 0 1 5>;
    hisi,boardname = "kirin970_udp_cs_EVB2_PILOT";
};

