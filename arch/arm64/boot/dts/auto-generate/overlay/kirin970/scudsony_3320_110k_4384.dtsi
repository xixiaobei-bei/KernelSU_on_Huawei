/* DO NOT EDIT - Automatically generated by python */
		&scudsony_3320_110k_4384 {
			fcc = <3320>;
			default_rbatt_mohm = <100>;
			identify_type = "id_volt";
			id_identify_min = <2281>;
			id_identify_max = <2786>;
			id_voltage_min = <2426>;
			id_voltage_max = <2631>;
			vbat_max = <4384>;
			temp_para = 
						"-32767","0","-1","0","4100","0",
						"0","5","-1","332","4384","0",
						"5","10","-1","996","4384","3",
						"10","45","-1","-1","4384","3",
						"45","50","-1","1162","4100","3",
						"50","32767","-1","0","4100","0";
			vbat_para = 
						"-32767","3400","-1","820","0",
						"3400","32767","-1","-1","0";
			segment_para = 
						"-32767","4150","3320","4208","50",
						"4150","4450","2324","4384","0";
			batt_brand = "scudsony";
			fcc_temp = <3295 3227 3308 3340 3339 3319>;
			fcc_sf_x = <0 100 200 300 400 500 600 700 800 1000 1500>;
			fcc_sf_y = <100 96 94 92 90 88 87 84 81 75 50>;
			fcc_sf_cols = <11>;
			pc_sf_rows = <1>;
			pc_sf_cols = <1>;
			pc_sf_row_entries = <0>;
			pc_sf_percent = <100>;
			pc_sf_sf = <100>;
			rbatt_sf_rows = <28>;
			rbatt_sf_cols = <6>;
			rbatt_sf_percent = <100 95 90 85 80 75 70 65 60 55 50 45 40 35 30 25 20 15 10 9 8 7 6 5 4 3 2 1>;
			rbatt_sf_sf = <
			               1876 729 351 128 102 92
			               1876 729 351 128 102 92
			               1849 746 348 131 104 92
			               1808 750 359 134 106 94
			               1809 774 365 140 108 95
			               1737 781 384 146 112 97
			               1711 746 378 156 118 100
			               1697 749 367 164 127 104
			               1684 752 356 153 126 108
			               1699 754 348 131 105 94
			               1731 763 351 127 103 92
			               1781 785 354 130 104 92
			               1843 825 360 135 108 94
			               1916 877 374 141 111 97
			               2023 930 397 142 112 97
			               2143 1007 426 136 106 93
			               2306 1109 447 135 106 97
			               2566 1314 504 137 107 96
			               3397 1995 662 140 109 99
			               4292 2229 555 140 109 100
			               5471 2482 575 141 110 99
			               6313 2846 636 145 110 98
			               7447 3295 708 144 111 98
			               9171 3543 831 148 111 98
			               11965 4664 1066 148 109 99
			               19687 7942 1368 155 115 103
			               36204 17627 2359 186 130 128
			               61424 36944 5283 375 295 206
			              >;
			pc_temp_ocv_rows = <29>;
			pc_temp_ocv_cols = <6>;
			pc_temp_ocv_percent = <100 95 90 85 80 75 70 65 60 55 50 45 40 35 30 25 20 15 10 9 8 7 6 5 4 3 2 1>;
			pc_temp_ocv_ocv = <
			                   4355 4327 4351 4342 4338 4331
			                   4256 4254 4284 4277 4275 4269
			                   4181 4191 4220 4217 4215 4210
			                   4116 4130 4162 4159 4158 4153
			                   4068 4079 4104 4105 4104 4099
			                   4002 4028 4054 4054 4053 4049
			                   3946 3970 4000 4006 4006 4002
			                   3901 3924 3950 3962 3963 3960
			                   3857 3884 3905 3915 3917 3917
			                   3824 3847 3866 3871 3871 3870
			                   3798 3816 3836 3840 3841 3839
			                   3776 3794 3810 3817 3818 3815
			                   3756 3775 3788 3799 3799 3796
			                   3737 3761 3773 3784 3783 3780
			                   3722 3745 3761 3768 3766 3759
			                   3702 3730 3748 3749 3741 3728
			                   3681 3706 3725 3728 3720 3708
			                   3658 3672 3692 3699 3692 3680
			                   3618 3637 3647 3665 3661 3650
			                   3608 3629 3642 3661 3656 3645
			                   3595 3620 3635 3655 3651 3640
			                   3577 3609 3628 3648 3644 3633
			                   3553 3597 3616 3636 3632 3620
			                   3526 3578 3597 3613 3606 3592
			                   3493 3544 3567 3571 3563 3551
			                   3445 3488 3508 3516 3509 3499
			                   3386 3411 3434 3445 3440 3433
			                   3320 3318 3339 3353 3353 3347
			                   3200 3200 3200 3200 3200 3200
			                  >;
		};
