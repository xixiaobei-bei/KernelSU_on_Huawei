/*
 * Hisilicon Ltd. hi3xxxASIC SoC
 *
 * Copyright (C) 2013 Hisilicon Technologies CO., Ltd.
 *
 * This program is free software; you can redistribute it and/or modify
 * it under the terms of the GNU General Public License version 2 as
 * publishhed by the Free Software Foundation.
 */
/{
        hisi_secs: secs_power_ctrl {
		compatible = "hisilicon,secs_power_ctrl";
		secs-atfd-power-ctrl;
	};
};
