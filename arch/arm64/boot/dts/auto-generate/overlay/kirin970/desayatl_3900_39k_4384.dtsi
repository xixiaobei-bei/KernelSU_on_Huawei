/* DO NOT EDIT - Automatically generated by python */
		&desayatl_3900_39k_4384 {
			fcc = <3900>;
			default_rbatt_mohm = <100>;
			identify_type = "id_volt";
			id_identify_min = <1235>;
			id_identify_max = <1759>;
			id_voltage_min = <1420>;
			id_voltage_max = <1562>;
			vbat_max = <4384>;
			temp_para = 
						"-32767","0","-1","0","4100","0",
						"0","5","-1","390","4384","0",
						"5","10","-1","1170","4384","3",
						"10","45","-1","-1","4384","3",
						"45","50","-1","1365","4100","3",
						"50","32767","-1","0","4100","0";
			vbat_para = 
						"-32767","3400","-1","820","0",
						"3400","32767","-1","-1","0";
			segment_para = 
						"-32767","4150","3900","4208","50",
						"4150","4450","2730","4384","0";
			batt_brand = "desayatl";
			fcc_temp = <3870 3872 3882 3900 3895 3866>;
			fcc_sf_x = <0 100 200 300 400 500 600 700 800 1000 1500>;
			fcc_sf_y = <100 96 94 92 90 88 87 84 81 75 50>;
			fcc_sf_cols = <11>;
			pc_sf_rows = <1>;
			pc_sf_cols = <1>;
			pc_sf_row_entries = <0>;
			pc_sf_percent = <100>;
			pc_sf_sf = <100>;
			rbatt_sf_rows = <28>;
			rbatt_sf_cols = <6>;
			rbatt_sf_percent = <100 95 90 85 80 75 70 65 60 55 50 45 40 35 30 25 20 15 10 9 8 7 6 5 4 3 2 1>;
			rbatt_sf_sf = <
			               1741 1021 403 118 98 91
			               1741 1021 403 118 98 91
			               1607 998 403 119 99 91
			               1503 968 402 121 100 92
			               1466 955 400 125 103 93
			               1351 938 443 130 106 95
			               1291 854 406 138 111 98
			               1273 851 395 147 117 101
			               1256 833 374 151 127 108
			               1243 818 356 119 101 94
			               1260 830 354 116 98 92
			               1292 862 356 118 99 92
			               1329 903 373 122 103 95
			               1378 946 403 127 107 99
			               1439 1000 446 128 109 96
			               1509 1067 491 120 100 93
			               1601 1148 548 121 100 95
			               1723 1242 622 123 101 95
			               1908 1373 747 127 102 96
			               2142 1308 618 129 107 98
			               2608 1237 568 130 106 102
			               2879 1368 625 128 106 100
			               3136 1539 699 127 104 98
			               3382 1687 770 124 102 94
			               3639 1768 818 127 102 95
			               3920 1941 906 131 104 97
			               4288 2197 1034 139 108 97
			               4893 2614 1229 330 128 104
			              >;
			pc_temp_ocv_rows = <29>;
			pc_temp_ocv_cols = <6>;
			pc_temp_ocv_percent = <100 95 90 85 80 75 70 65 60 55 50 45 40 35 30 25 20 15 10 9 8 7 6 5 4 3 2 1>;
			pc_temp_ocv_ocv = <
			                   4356 4354 4352 4347 4341 4336
			                   4260 4270 4279 4287 4282 4278
			                   4191 4204 4219 4231 4226 4222
			                   4132 4147 4163 4176 4171 4167
			                   4091 4099 4111 4123 4118 4115
			                   4016 4046 4070 4073 4068 4065
			                   3958 3975 4003 4024 4021 4020
			                   3917 3933 3957 3979 3979 3978
			                   3880 3890 3912 3936 3938 3937
			                   3848 3852 3870 3883 3883 3884
			                   3826 3827 3838 3852 3852 3852
			                   3811 3811 3814 3828 3828 3828
			                   3798 3800 3798 3808 3808 3808
			                   3785 3791 3788 3791 3792 3791
			                   3773 3781 3780 3775 3775 3768
			                   3758 3769 3769 3756 3750 3740
			                   3742 3750 3751 3737 3730 3719
			                   3725 3723 3722 3709 3704 3691
			                   3704 3702 3696 3688 3681 3671
			                   3698 3697 3691 3687 3680 3668
			                   3690 3692 3686 3684 3678 3667
			                   3681 3686 3682 3681 3675 3663
			                   3668 3679 3675 3670 3668 3654
			                   3648 3663 3658 3642 3645 3630
			                   3616 3629 3624 3598 3605 3590
			                   3568 3579 3573 3539 3552 3539
			                   3499 3510 3503 3460 3482 3472
			                   3398 3408 3402 3346 3382 3375
			                   3200 3200 3200 3200 3200 3200
			                  >;
		};
