/**
 * Note: any file.dtsi or node in this file will be compile into all config.dts
 *so, if your node or file.dtsi will not use on some products, please don't put it here
 */
/include/ "kirin970_spmi.dtsi"
/include/ "kirin970_hwspinlock.dtsi"
/include/ "kirin970_pm_clk_monitor.dtsi"
/include/ "kirin970_ddr.dtsi"
/include/ "kirin970_bootdevice.dtsi"
/include/ "kirin970_mmc.dtsi"
/include/ "kirin970_ufs.dtsi"
/include/ "kirin970_ipc.dtsi"
/include/ "kirin970_ao_ipc.dtsi"
/include/ "kirin970_usb.dtsi"
/include/ "kirin970_ion.dtsi"
/include/ "kirin970_i2c.dtsi"
/include/ "kirin970_gpu.dtsi"
/include/ "kirin970_hw_vote.dtsi"
/include/ "kirin970_memory.dtsi"
/include/ "kirin970_efuse.dtsi"
/include/ "kirin970_earlymount.dtsi"
/include/ "kirin970_earlymount_huawei.dtsi"
/include/ "kirin970_qos.dtsi"
/include/ "kirin970_uart.dtsi"
/include/ "kirin970_spi.dtsi"
/include/ "kirin970_mntn.dtsi"
/include/ "kirin970_jtag.dtsi"
/include/ "hisi_6421v600_pmic_spmi.dtsi"
/include/ "hisi_6421v600_pmic_mntn_spmi.dtsi"
/include/ "hisi_6423v100_pmic_spmi.dtsi"
/include/ "kirin970_syscounter.dtsi"
/include/ "kirin970_contexthub.dtsi"
/include/ "kirin970_vdec.dtsi"
/include/ "kirin970_venc.dtsi"
/include/ "kirin970_pmu.dtsi"
/include/ "kirin970_camera3.dtsi"
/include/ "huawei-sensor.dtsi"
/include/ "kirin970_ddrflux.dtsi"
/include/ "kirin970_hisee.dtsi"
/include/ "fastboot_6421v600_mntn.dtsi"
/include/ "fastboot_pmic.dtsi"
/include/ "kirin970_pcie.dtsi"
/include/ "kirin970_bl31_kernel_share_mem.dtsi"
/include/ "kirin970_ivp.dtsi"
/include/ "kirin970_timekeeper.dtsi"
/include/ "kirin970_dmsspt.dtsi"
/include/ "kirin970_hhee.dtsi"
/include/ "kirin970_hkip_atkinfo.dtsi"
/include/ "kirin970_vowifi_proxy.dtsi"
/include/ "kirin970_pmu_dump.dtsi"
/include/ "kirin970_secs.dtsi"
/include/ "kirin970_subpmu.dtsi"
/include/ "kirin970_ads.dtsi"
