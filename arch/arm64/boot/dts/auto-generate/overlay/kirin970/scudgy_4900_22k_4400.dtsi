/* DO NOT EDIT - Automatically generated by python */
		&scudgy_4900_22k_4400 {
			fcc = <4900>;
			default_rbatt_mohm = <100>;
			identify_type = "id_volt";
			id_identify_min = <751>;
			id_identify_max = <1235>;
			id_voltage_min = <939>;
			id_voltage_max = <1059>;
			vbat_max = <4400>;
			temp_para = 
						"-32767","0","-1","0","4100","0",
						"0","5","-1","490","4400","0",
						"5","10","-1","1470","4400","3",
						"10","45","-1","-1","4400","3",
						"45","50","-1","1715","4100","3",
						"50","32767","-1","0","4100","0";
			vbat_para = 
						"-32767","3400","-1","820","0",
						"3400","32767","-1","-1","0";
			segment_para = 
						"-32767","4150","4900","4208","50",
						"4150","4450","3430","4400","0";
			batt_brand = "scudgy";
			fcc_temp = <4997 4994 5008 5009 4998 4953>;
			fcc_sf_x = <0 100 200 300 400 500 600 700 800 1000 1500>;
			fcc_sf_y = <100 96 94 92 90 88 87 84 81 75 50>;
			fcc_sf_cols = <11>;
			pc_sf_rows = <1>;
			pc_sf_cols = <1>;
			pc_sf_row_entries = <0>;
			pc_sf_percent = <100>;
			pc_sf_sf = <100>;
			rbatt_sf_rows = <28>;
			rbatt_sf_cols = <6>;
			rbatt_sf_percent = <100 95 90 85 80 75 70 65 60 55 50 45 40 35 30 25 20 15 10 9 8 7 6 5 4 3 2 1>;
			rbatt_sf_sf = <
			               1455 1070 400 105 83 77
			               1453 1068 400 105 83 77
			               1323 990 394 102 83 78
			               1233 919 382 102 83 78
			               1183 882 375 103 83 78
			               1073 832 389 105 85 79
			               1043 763 357 109 87 80
			               1021 735 344 116 91 83
			               1008 717 323 121 97 87
			               1020 710 307 105 88 81
			               1041 730 300 97 82 78
			               1069 761 306 97 82 78
			               1108 797 329 99 83 79
			               1159 845 361 101 85 81
			               1216 902 404 101 86 83
			               1280 960 458 100 82 78
			               1355 1016 526 101 82 78
			               1454 1085 617 105 84 79
			               2545 1337 593 102 83 81
			               2801 1492 653 104 84 81
			               3015 1669 719 105 86 82
			               3243 1821 808 106 86 84
			               3522 2061 913 107 89 85
			               3821 2270 985 108 84 81
			               4172 2511 1082 107 86 82
			               4647 2819 1206 111 87 82
			               5232 3306 1462 117 89 83
			               6170 3987 1917 137 95 88
			              >;
			pc_temp_ocv_rows = <29>;
			pc_temp_ocv_cols = <6>;
			pc_temp_ocv_percent = <100 95 90 85 80 75 70 65 60 55 50 45 40 35 30 25 20 15 10 9 8 7 6 5 4 3 2 1>;
			pc_temp_ocv_ocv = <
			                   4387 4383 4383 4375 4370 4363
			                   4266 4272 4292 4301 4297 4290
			                   4188 4198 4226 4239 4236 4230
			                   4125 4137 4167 4182 4179 4173
			                   4076 4087 4111 4126 4123 4118
			                   3992 4030 4065 4073 4071 4066
			                   3944 3963 4001 4024 4022 4018
			                   3898 3914 3952 3979 3978 3975
			                   3860 3871 3904 3935 3936 3934
			                   3836 3838 3862 3884 3886 3883
			                   3818 3819 3829 3848 3849 3847
			                   3803 3806 3807 3823 3824 3822
			                   3787 3793 3794 3804 3804 3802
			                   3773 3782 3784 3788 3788 3786
			                   3758 3769 3773 3773 3772 3768
			                   3743 3752 3759 3758 3750 3739
			                   3727 3732 3740 3739 3730 3717
			                   3710 3711 3714 3713 3705 3694
			                   3685 3688 3686 3688 3681 3669
			                   3680 3682 3681 3686 3680 3668
			                   3672 3678 3674 3685 3678 3667
			                   3661 3670 3666 3682 3676 3664
			                   3649 3662 3656 3677 3671 3659
			                   3631 3647 3638 3662 3655 3641
			                   3601 3617 3608 3625 3617 3603
			                   3562 3568 3559 3572 3565 3552
			                   3500 3499 3490 3500 3496 3484
			                   3399 3394 3383 3392 3395 3386
			                   3200 3200 3200 3200 3200 3200
			                  >;
		};
