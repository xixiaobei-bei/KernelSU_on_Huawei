/* DO NOT EDIT - Automatically generated by python */
		&desaygy_3320_22k_4400 {
			fcc = <3320>;
			default_rbatt_mohm = <100>;
			identify_type = "id_volt";
			id_identify_min = <751>;
			id_identify_max = <1235>;
			id_voltage_min = <939>;
			id_voltage_max = <1059>;
			vbat_max = <4400>;
			temp_para = 
						"-32767","0","-1","0","4100","0",
						"0","5","-1","332","4400","0",
						"5","10","-1","996","4400","3",
						"10","45","-1","-1","4400","3",
						"45","50","-1","1162","4100","3",
						"50","32767","-1","0","4100","0";
			vbat_para = 
						"-32767","3400","-1","820","0",
						"3400","32767","-1","-1","0";
			segment_para = 
						"-32767","4150","3320","4208","50",
						"4150","4450","2324","4400","0";
			batt_brand = "desaygy";
			fcc_temp = <3334 3357 3379 3379 3362 3344>;
			fcc_sf_x = <0 100 200 300 400 500 600 700 800 1000 1500>;
			fcc_sf_y = <100 96 94 92 90 88 87 84 81 75 50>;
			fcc_sf_cols = <11>;
			pc_sf_rows = <1>;
			pc_sf_cols = <1>;
			pc_sf_row_entries = <0>;
			pc_sf_percent = <100>;
			pc_sf_sf = <100>;
			rbatt_sf_rows = <28>;
			rbatt_sf_cols = <6>;
			rbatt_sf_percent = <100 95 90 85 80 75 70 65 60 55 50 45 40 35 30 25 20 15 10 9 8 7 6 5 4 3 2 1>;
			rbatt_sf_sf = <
			               2081 1208 547 140 113 104
			               2081 1208 547 140 113 104
			               1956 1178 540 139 113 104
			               1843 1148 525 140 114 105
			               1774 1113 524 142 114 106
			               1675 1119 543 147 116 107
			               1536 992 520 154 119 109
			               1527 977 484 169 126 112
			               1494 952 468 174 137 118
			               1481 946 442 145 123 110
			               1497 940 433 133 111 105
			               1526 967 435 134 111 105
			               1586 1023 454 136 112 106
			               1657 1095 488 141 118 109
			               1741 1188 540 142 119 114
			               1836 1296 610 138 111 105
			               1971 1434 700 137 112 105
			               2139 1590 828 142 113 106
			               2450 1434 714 149 122 114
			               2815 1564 791 149 120 117
			               3186 1785 902 151 121 117
			               3604 2018 1002 154 124 118
			               3984 2313 1139 155 127 119
			               4357 2570 1252 155 125 116
			               4818 2758 1255 162 123 116
			               5282 3059 1350 172 126 119
			               6002 3691 1717 221 137 125
			               7104 4407 2257 605 190 136
			              >;
			pc_temp_ocv_rows = <29>;
			pc_temp_ocv_cols = <6>;
			pc_temp_ocv_percent = <100 95 90 85 80 75 70 65 60 55 50 45 40 35 30 25 20 15 10 9 8 7 6 5 4 3 2 1>;
			pc_temp_ocv_ocv = <
			                   4369 4374 4382 4370 4364 4360
			                   4272 4285 4300 4303 4297 4293
			                   4202 4219 4238 4243 4237 4234
			                   4143 4162 4178 4185 4180 4176
			                   4094 4104 4125 4129 4124 4121
			                   4030 4063 4077 4076 4072 4069
			                   3952 3978 4014 4026 4023 4020
			                   3915 3935 3958 3979 3979 3977
			                   3874 3893 3915 3936 3937 3936
			                   3841 3858 3874 3885 3886 3884
			                   3818 3826 3839 3850 3849 3848
			                   3802 3807 3813 3825 3824 3823
			                   3788 3796 3797 3805 3805 3803
			                   3777 3785 3786 3789 3789 3786
			                   3765 3774 3776 3774 3773 3770
			                   3752 3760 3765 3758 3751 3740
			                   3737 3743 3748 3738 3731 3718
			                   3720 3721 3722 3712 3707 3695
			                   3696 3698 3695 3689 3682 3670
			                   3691 3692 3690 3688 3681 3669
			                   3684 3686 3686 3686 3679 3668
			                   3677 3678 3679 3682 3677 3666
			                   3663 3670 3672 3673 3671 3660
			                   3645 3657 3660 3645 3654 3640
			                   3620 3631 3632 3599 3614 3601
			                   3575 3580 3583 3537 3561 3549
			                   3515 3512 3514 3453 3488 3480
			                   3421 3408 3411 3332 3379 3380
			                   3200 3200 3200 3200 3200 3200
			                  >;
		};
