/* DO NOT EDIT - Automatically generated by python */
		&DESAYSONY_3240_110k_4400 {
			fcc = <3240>;
			default_rbatt_mohm = <100>;
			identify_type = "id_volt";
			id_identify_min = <2281>;
			id_identify_max = <2786>;
			id_voltage_min = <2426>;
			id_voltage_max = <2631>;
			vbat_max = <4400>;
			temp_para = 
						"-32767","0","-1","0","4100","0",
						"0","5","-1","324","4400","0",
						"5","10","-1","972","4400","3",
						"10","45","-1","-1","4400","3",
						"45","50","-1","1134","4100","3",
						"50","32767","-1","0","4100","0";
			vbat_para = 
						"-32767","3400","-1","820","0",
						"3400","32767","-1","-1","0";
			segment_para = 
						"-32767","4150","3240","4208","50",
						"4150","4450","2268","4400","0";
			batt_brand = "DESAYSONY";
			fcc_temp = <3297 3304 3321 3355 3344 3323>;
			fcc_sf_x = <0 100 200 300 400 500 600 700 800 1000 1500>;
			fcc_sf_y = <100 96 94 92 90 88 87 84 81 75 50>;
			fcc_sf_cols = <11>;
			pc_sf_rows = <1>;
			pc_sf_cols = <1>;
			pc_sf_row_entries = <0>;
			pc_sf_percent = <100>;
			pc_sf_sf = <100>;
			rbatt_sf_rows = <28>;
			rbatt_sf_cols = <6>;
			rbatt_sf_percent = <100 95 90 85 80 75 70 65 60 55 50 45 40 35 30 25 20 15 10 9 8 7 6 5 4 3 2 1>;
			rbatt_sf_sf = <
			               1446 647 377 144 116 106
			               1446 647 377 144 116 106
			               1477 655 385 147 117 106
			               1444 664 391 151 119 107
			               1481 655 405 155 122 108
			               1474 680 412 162 126 110
			               1439 667 417 172 130 113
			               1447 650 400 181 138 118
			               1454 662 394 176 141 121
			               1469 663 393 155 126 110
			               1504 669 395 148 118 106
			               1563 677 400 150 118 106
			               1629 699 410 155 121 108
			               1703 737 431 160 126 111
			               1794 784 460 162 126 111
			               1919 838 490 160 121 107
			               2130 911 526 161 122 109
			               2556 1073 598 163 123 110
			               4562 1289 605 160 124 110
			               5275 1394 633 163 125 112
			               6150 1552 679 168 126 112
			               7305 1776 750 173 128 115
			               8982 2130 839 176 128 115
			               11699 2640 963 173 128 111
			               18394 3465 1145 190 130 114
			               33059 5287 1452 257 165 134
			               51703 10612 2058 393 207 158
			               82827 23649 3139 497 207 188
			              >;
			pc_temp_ocv_rows = <29>;
			pc_temp_ocv_cols = <6>;
			pc_temp_ocv_percent = <100 95 90 85 80 75 70 65 60 55 50 45 40 35 30 25 20 15 10 9 8 7 6 5 4 3 2 1>;
			pc_temp_ocv_ocv = <
			                   4386 4385 4382 4374 4368 4361
			                   4293 4308 4309 4306 4301 4295
			                   4227 4244 4247 4245 4241 4235
			                   4152 4183 4185 4186 4182 4177
			                   4103 4119 4128 4128 4126 4120
			                   4045 4068 4071 4074 4072 4067
			                   3979 4010 4018 4024 4023 4019
			                   3927 3954 3962 3977 3977 3974
			                   3882 3911 3916 3929 3932 3930
			                   3843 3872 3876 3883 3885 3882
			                   3812 3838 3843 3849 3850 3847
			                   3788 3808 3815 3824 3824 3822
			                   3766 3785 3792 3803 3804 3802
			                   3747 3767 3776 3786 3787 3784
			                   3728 3751 3762 3768 3768 3762
			                   3708 3734 3746 3749 3744 3732
			                   3687 3710 3723 3727 3722 3709
			                   3661 3678 3688 3698 3694 3682
			                   3619 3644 3650 3667 3664 3652
			                   3606 3635 3644 3662 3659 3648
			                   3591 3625 3637 3656 3654 3643
			                   3573 3613 3629 3648 3647 3637
			                   3553 3599 3618 3637 3636 3626
			                   3530 3581 3601 3611 3612 3599
			                   3503 3550 3571 3567 3571 3557
			                   3473 3502 3521 3513 3519 3506
			                   3418 3434 3455 3450 3453 3440
			                   3303 3337 3358 3361 3359 3348
			                   3200 3200 3200 3200 3200 3200
			                  >;
		};
