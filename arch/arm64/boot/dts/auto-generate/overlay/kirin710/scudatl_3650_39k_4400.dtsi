/* DO NOT EDIT - Automatically generated by python */
		&scudatl_3650_39k_4400 {
			fcc = <3650>;
			default_rbatt_mohm = <100>;
			identify_type = "id_volt";
			id_identify_min = <1235>;
			id_identify_max = <1759>;
			id_voltage_min = <1420>;
			id_voltage_max = <1562>;
			vbat_max = <4400>;
			temp_para = 
						"-32767","0","-1","0","4100","0",
						"0","5","-1","365","4400","0",
						"5","10","-1","1095","4400","3",
						"10","45","-1","-1","4400","3",
						"45","50","-1","1277","4100","3",
						"50","32767","-1","0","4100","0";
			vbat_para = 
						"-32767","3400","-1","820","0",
						"3400","32767","-1","-1","0";
			segment_para = 
						"-32767","4150","3650","4208","50",
						"4150","4450","2555","4400","0";
			batt_brand = "scudatl";
			fcc_temp = <3592 3590 3595 3613 3608 3523>;
			fcc_sf_x = <0 100 200 300 400 500 600 700 800 1000 1500>;
			fcc_sf_y = <100 96 94 92 90 88 87 84 81 75 50>;
			fcc_sf_cols = <11>;
			pc_sf_rows = <1>;
			pc_sf_cols = <1>;
			pc_sf_row_entries = <0>;
			pc_sf_percent = <100>;
			pc_sf_sf = <100>;
			rbatt_sf_rows = <28>;
			rbatt_sf_cols = <6>;
			rbatt_sf_percent = <100 95 90 85 80 75 70 65 60 55 50 45 40 35 30 25 20 15 10 9 8 7 6 5 4 3 2 1>;
			rbatt_sf_sf = <
			               1851 1188 470 128 103 94
			               1851 1188 470 128 103 94
			               1706 1145 468 131 104 95
			               1587 1088 473 134 106 97
			               1526 1074 475 139 110 99
			               1395 1032 513 147 115 102
			               1351 928 473 154 119 105
			               1328 912 455 166 128 112
			               1302 900 430 152 131 107
			               1304 891 416 126 106 97
			               1327 902 409 123 102 96
			               1368 932 417 128 105 98
			               1419 973 444 131 110 102
			               1474 1020 484 138 116 106
			               1539 1078 533 137 112 102
			               1618 1148 594 131 106 98
			               1712 1225 664 131 107 98
			               1837 1317 758 134 108 98
			               2030 1453 927 140 111 101
			               2073 1483 965 141 112 102
			               2508 1409 782 141 113 103
			               2989 1417 732 140 113 103
			               3319 1609 837 137 113 102
			               3656 1819 936 138 107 100
			               3990 2034 1053 136 109 100
			               4422 2237 1222 141 111 115
			               5035 2600 1471 152 115 154
			               6020 3277 1881 304 124 106
			              >;
			pc_temp_ocv_rows = <29>;
			pc_temp_ocv_cols = <6>;
			pc_temp_ocv_percent = <100 95 90 85 80 75 70 65 60 55 50 45 40 35 30 25 20 15 10 9 8 7 6 5 4 3 2 1>;
			pc_temp_ocv_ocv = <
			                   4352 4350 4349 4342 4337 4313
			                   4257 4265 4274 4280 4277 4256
			                   4190 4199 4212 4223 4220 4201
			                   4131 4139 4158 4168 4165 4147
			                   4083 4096 4105 4115 4112 4096
			                   4004 4043 4061 4067 4062 4048
			                   3954 3969 3995 4016 4014 4004
			                   3913 3925 3948 3974 3974 3963
			                   3873 3886 3902 3924 3928 3916
			                   3844 3850 3864 3877 3878 3873
			                   3822 3825 3833 3847 3848 3844
			                   3806 3809 3810 3824 3824 3822
			                   3794 3797 3796 3804 3805 3803
			                   3781 3787 3786 3788 3790 3786
			                   3768 3778 3777 3773 3771 3763
			                   3755 3766 3766 3756 3749 3737
			                   3740 3748 3748 3737 3731 3716
			                   3724 3724 3721 3710 3705 3691
			                   3701 3703 3697 3690 3685 3670
			                   3696 3699 3693 3687 3681 3666
			                   3690 3694 3687 3685 3680 3661
			                   3682 3687 3681 3682 3677 3657
			                   3670 3679 3675 3674 3671 3649
			                   3652 3663 3660 3650 3652 3630
			                   3620 3634 3628 3607 3613 3591
			                   3571 3585 3579 3552 3561 3541
			                   3501 3514 3511 3475 3492 3476
			                   3392 3410 3411 3362 3389 3377
			                   3200 3200 3200 3200 3200 3200
			                  >;
		};
