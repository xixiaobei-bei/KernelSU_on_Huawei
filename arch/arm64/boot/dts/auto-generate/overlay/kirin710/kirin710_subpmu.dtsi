/*
 *  Copyright (C) 2012-2013 Linaro Ltd.
 *
 *  This program is free software; you can redistribute it and/or modify
 *  it under the terms of the GNU General Public License version 2 as
 *  publishhed by the Free Software Foundation.
 */

/{
	subpmu_dieid {
		compatible = "hisilicon,subpmu-dieid";
		status = "disabled";
	};
};
