/* DO NOT EDIT - Automatically generated by python */
		&scudmurata_3320_110k_4400 {
			fcc = <3320>;
			default_rbatt_mohm = <100>;
			identify_type = "id_volt";
			id_identify_min = <2281>;
			id_identify_max = <2786>;
			id_voltage_min = <2426>;
			id_voltage_max = <2631>;
			vbat_max = <4400>;
			temp_para = 
						"-32767","0","-1","0","4100","0",
						"0","5","-1","332","4400","0",
						"5","10","-1","996","4400","3",
						"10","45","-1","-1","4400","3",
						"45","50","-1","1162","4100","3",
						"50","32767","-1","0","4100","0";
			vbat_para = 
						"-32767","3400","-1","820","0",
						"3400","32767","-1","-1","0";
			segment_para = 
						"-32767","4150","3320","4208","50",
						"4150","4450","2324","4400","0";
			batt_brand = "scudmurata";
			fcc_temp = <3360 3369 3385 3423 3405 3384>;
			fcc_sf_x = <0 100 200 300 400 500 600 700 800 1000 1500>;
			fcc_sf_y = <100 96 94 92 90 88 87 84 81 75 50>;
			fcc_sf_cols = <11>;
			pc_sf_rows = <1>;
			pc_sf_cols = <1>;
			pc_sf_row_entries = <0>;
			pc_sf_percent = <100>;
			pc_sf_sf = <100>;
			rbatt_sf_rows = <28>;
			rbatt_sf_cols = <6>;
			rbatt_sf_percent = <100 95 90 85 80 75 70 65 60 55 50 45 40 35 30 25 20 15 10 9 8 7 6 5 4 3 2 1>;
			rbatt_sf_sf = <
			               1662 773 381 147 117 105
			               1662 773 381 147 117 105
			               1652 791 390 150 118 106
			               1615 789 401 155 120 107
			               1571 785 409 161 124 108
			               1558 779 416 168 128 111
			               1531 770 415 179 133 113
			               1538 766 396 185 142 118
			               1544 769 381 178 143 121
			               1552 774 382 154 124 108
			               1561 782 387 148 117 105
			               1600 797 393 150 118 106
			               1658 830 398 154 120 107
			               1733 873 411 160 125 110
			               1822 911 435 162 125 112
			               1937 1014 465 158 119 106
			               2096 1124 500 157 119 107
			               2350 1316 543 158 121 109
			               3374 1352 505 159 126 112
			               3939 1471 524 166 128 117
			               4528 1634 554 166 129 114
			               5289 1881 590 176 130 115
			               6315 2202 681 176 128 118
			               8022 2627 778 175 131 114
			               10253 3132 902 177 131 117
			               13287 4109 1047 187 135 121
			               22728 4241 1506 204 141 125
			               39526 6921 2046 241 174 141
			              >;
			pc_temp_ocv_rows = <29>;
			pc_temp_ocv_cols = <6>;
			pc_temp_ocv_percent = <100 95 90 85 80 75 70 65 60 55 50 45 40 35 30 25 20 15 10 9 8 7 6 5 4 3 2 1>;
			pc_temp_ocv_ocv = <
			                   4371 4369 4367 4366 4358 4353
			                   4284 4290 4296 4299 4292 4286
			                   4213 4228 4235 4238 4232 4226
			                   4149 4166 4175 4179 4173 4169
			                   4081 4106 4118 4123 4117 4113
			                   4026 4046 4062 4069 4065 4061
			                   3971 3993 4009 4020 4017 4013
			                   3926 3945 3956 3973 3972 3970
			                   3884 3901 3909 3926 3927 3926
			                   3847 3864 3872 3880 3881 3879
			                   3813 3832 3841 3848 3847 3845
			                   3789 3804 3815 3823 3823 3820
			                   3769 3783 3793 3803 3803 3801
			                   3751 3768 3777 3786 3787 3784
			                   3732 3752 3764 3770 3768 3762
			                   3714 3737 3750 3751 3744 3732
			                   3695 3715 3731 3729 3723 3710
			                   3671 3683 3696 3700 3695 3683
			                   3635 3648 3657 3670 3666 3654
			                   3627 3639 3651 3665 3661 3650
			                   3614 3629 3644 3659 3656 3645
			                   3597 3618 3635 3651 3648 3638
			                   3567 3606 3624 3637 3636 3625
			                   3545 3588 3606 3608 3608 3597
			                   3513 3555 3572 3563 3565 3555
			                   3469 3502 3513 3504 3510 3502
			                   3395 3429 3436 3431 3439 3433
			                   3312 3328 3337 3339 3341 3340
			                   3200 3200 3200 3200 3200 3200
			                  >;
		};
