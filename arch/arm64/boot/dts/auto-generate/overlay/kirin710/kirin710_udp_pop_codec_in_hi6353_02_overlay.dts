/**
 * Copyright (C) 2014 Hisilicon Ltd.
 *
 *  This program is free software; you can redistribute it and/or modify
 *  it under the terms of the GNU General Public License version 2 as
 *  publishhed by the Free Software Foundation.
 */

/dts-v1/;
/plugin/;
/include/ "kirin710_udp_default_overlay.dtsi"
/include/ "kirin710_udp_pop_codec_in_hi6353_02_pin.dtsi"
/include/ "kirin710_udp_pop_codec_in_hi6353_02_modem_pin.dtsi"

/ {
    board_id = <7002>;
};

	&rootparam{
		hisi,boardid = <7 0 0 2>;
		hisi,boardname = "kirin710_udp_pop_codec_in_hi6353_02";
		hisi,product_id = <0x38F5FC02>;
	};
