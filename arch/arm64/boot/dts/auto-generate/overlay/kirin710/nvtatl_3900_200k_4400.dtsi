/* DO NOT EDIT - Automatically generated by python */
		&nvtatl_3900_200k_4400 {
			fcc = <3900>;
			default_rbatt_mohm = <100>;
			identify_type = "id_volt";
			id_identify_min = <2786>;
			id_identify_max = <3312>;
			id_voltage_min = <2941>;
			id_voltage_max = <3167>;
			vbat_max = <4400>;
			temp_para = 
						"-32767","0","-1","0","4100","0",
						"0","5","-1","390","4400","0",
						"5","10","-1","1170","4400","3",
						"10","45","-1","-1","4400","3",
						"45","50","-1","1365","4100","3",
						"50","32767","-1","0","4100","0";
			vbat_para = 
						"-32767","3400","-1","820","0",
						"3400","32767","-1","-1","0";
			segment_para = 
						"-32767","4150","3900","4208","50",
						"4150","4450","2730","4400","0";
			batt_brand = "nvtatl";
			fcc_temp = <3870 3872 3882 3900 3895 3866>;
			fcc_sf_x = <0 100 200 300 400 500 600 700 800 1000 1500>;
			fcc_sf_y = <100 96 94 92 90 88 87 84 81 75 50>;
			fcc_sf_cols = <11>;
			pc_sf_rows = <1>;
			pc_sf_cols = <1>;
			pc_sf_row_entries = <0>;
			pc_sf_percent = <100>;
			pc_sf_sf = <100>;
			rbatt_sf_rows = <28>;
			rbatt_sf_cols = <6>;
			rbatt_sf_percent = <100 95 90 85 80 75 70 65 60 55 50 45 40 35 30 25 20 15 10 9 8 7 6 5 4 3 2 1>;
			rbatt_sf_sf = <
			               1771 1051 433 148 128 121
			               1771 1051 433 148 128 121
			               1637 1028 433 149 129 121
			               1533 998 432 151 130 122
			               1496 985 430 155 133 123
			               1381 968 473 160 136 125
			               1321 884 436 168 141 128
			               1303 881 425 177 147 131
			               1286 863 404 181 157 138
			               1273 848 386 149 131 124
			               1290 860 384 146 128 122
			               1322 892 386 148 129 122
			               1359 933 403 152 133 125
			               1408 976 433 157 137 129
			               1469 1030 476 158 139 126
			               1539 1097 521 150 130 123
			               1631 1178 578 151 130 125
			               1753 1272 652 153 131 125
			               1938 1403 777 157 132 126
			               2172 1338 648 159 137 128
			               2638 1267 598 160 136 132
			               2909 1398 655 158 136 130
			               3166 1569 729 157 134 128
			               3412 1717 800 154 132 124
			               3669 1798 848 157 132 125
			               3950 1971 936 161 134 127
			               4318 2227 1064 169 138 127
			               4923 2644 1259 360 158 134
			              >;
			pc_temp_ocv_rows = <29>;
			pc_temp_ocv_cols = <6>;
			pc_temp_ocv_percent = <100 95 90 85 80 75 70 65 60 55 50 45 40 35 30 25 20 15 10 9 8 7 6 5 4 3 2 1>;
			pc_temp_ocv_ocv = <
			                   4356 4354 4352 4347 4341 4336
			                   4260 4270 4279 4287 4282 4278
			                   4191 4204 4219 4231 4226 4222
			                   4132 4147 4163 4176 4171 4167
			                   4091 4099 4111 4123 4118 4115
			                   4016 4046 4070 4073 4068 4065
			                   3958 3975 4003 4024 4021 4020
			                   3917 3933 3957 3979 3979 3978
			                   3880 3890 3912 3936 3938 3937
			                   3848 3852 3870 3883 3883 3884
			                   3826 3827 3838 3852 3852 3852
			                   3811 3811 3814 3828 3828 3828
			                   3798 3800 3798 3808 3808 3808
			                   3785 3791 3788 3791 3792 3791
			                   3773 3781 3780 3775 3775 3768
			                   3758 3769 3769 3756 3750 3740
			                   3742 3750 3751 3737 3730 3719
			                   3725 3723 3722 3709 3704 3691
			                   3704 3702 3696 3688 3681 3671
			                   3698 3697 3691 3687 3680 3668
			                   3690 3692 3686 3684 3678 3667
			                   3681 3686 3682 3681 3675 3663
			                   3668 3679 3675 3670 3668 3654
			                   3648 3663 3658 3642 3645 3630
			                   3616 3629 3624 3598 3605 3590
			                   3568 3579 3573 3539 3552 3539
			                   3499 3510 3503 3460 3482 3472
			                   3398 3408 3402 3346 3382 3375
			                   3200 3200 3200 3200 3200 3200
			                  >;
		};
