/* DO NOT EDIT - Automatically generated by python */
		&desayatl_3900_22k_4400 {
			fcc = <3900>;
			default_rbatt_mohm = <100>;
			identify_type = "id_volt";
			id_identify_min = <751>;
			id_identify_max = <1235>;
			id_voltage_min = <939>;
			id_voltage_max = <1059>;
			vbat_max = <4400>;
			temp_para = 
						"-32767","0","-1","0","4100","0",
						"0","5","-1","390","4400","0",
						"5","10","-1","1170","4400","3",
						"10","45","-1","-1","4400","3",
						"45","50","-1","1365","4100","3",
						"50","32767","-1","0","4100","0";
			vbat_para = 
						"-32767","3400","-1","820","0",
						"3400","32767","-1","-1","0";
			segment_para = 
						"-32767","4150","3900","4208","50",
						"4150","4450","2730","4400","0";
			batt_brand = "desayatl";
			fcc_temp = <3870 3872 3882 3900 3895 3866>;
			fcc_sf_x = <0 100 200 300 400 500 600 700 800 1000 1500>;
			fcc_sf_y = <100 96 94 92 90 88 87 84 81 75 50>;
			fcc_sf_cols = <11>;
			pc_sf_rows = <1>;
			pc_sf_cols = <1>;
			pc_sf_row_entries = <0>;
			pc_sf_percent = <100>;
			pc_sf_sf = <100>;
			rbatt_sf_rows = <28>;
			rbatt_sf_cols = <6>;
			rbatt_sf_percent = <100 95 90 85 80 75 70 65 60 55 50 45 40 35 30 25 20 15 10 9 8 7 6 5 4 3 2 1>;
			rbatt_sf_sf = <
			               1774 1054 436 151 131 124
			               1774 1054 436 151 131 124
			               1640 1031 436 152 132 124
			               1536 1001 435 154 133 125
			               1499 988 433 158 136 126
			               1384 971 476 163 139 128
			               1324 887 439 171 144 131
			               1306 884 428 180 150 134
			               1289 866 407 184 160 141
			               1276 851 389 152 134 127
			               1293 863 387 149 131 125
			               1325 895 389 151 132 125
			               1362 936 406 155 136 128
			               1411 979 436 160 140 132
			               1472 1033 479 161 142 129
			               1542 1100 524 153 133 126
			               1634 1181 581 154 133 128
			               1756 1275 655 156 134 128
			               1941 1406 780 160 135 129
			               2175 1341 651 162 140 131
			               2641 1270 601 163 139 135
			               2912 1401 658 161 139 133
			               3169 1572 732 160 137 131
			               3415 1720 803 157 135 127
			               3672 1801 851 160 135 128
			               3953 1974 939 164 137 130
			               4321 2230 1067 172 141 130
			               4926 2647 1262 363 161 137
			              >;
			pc_temp_ocv_rows = <29>;
			pc_temp_ocv_cols = <6>;
			pc_temp_ocv_percent = <100 95 90 85 80 75 70 65 60 55 50 45 40 35 30 25 20 15 10 9 8 7 6 5 4 3 2 1>;
			pc_temp_ocv_ocv = <
			                   4356 4354 4352 4347 4341 4336
			                   4260 4270 4279 4287 4282 4278
			                   4191 4204 4219 4231 4226 4222
			                   4132 4147 4163 4176 4171 4167
			                   4091 4099 4111 4123 4118 4115
			                   4016 4046 4070 4073 4068 4065
			                   3958 3975 4003 4024 4021 4020
			                   3917 3933 3957 3979 3979 3978
			                   3880 3890 3912 3936 3938 3937
			                   3848 3852 3870 3883 3883 3884
			                   3826 3827 3838 3852 3852 3852
			                   3811 3811 3814 3828 3828 3828
			                   3798 3800 3798 3808 3808 3808
			                   3785 3791 3788 3791 3792 3791
			                   3773 3781 3780 3775 3775 3768
			                   3758 3769 3769 3756 3750 3740
			                   3742 3750 3751 3737 3730 3719
			                   3725 3723 3722 3709 3704 3691
			                   3704 3702 3696 3688 3681 3671
			                   3698 3697 3691 3687 3680 3668
			                   3690 3692 3686 3684 3678 3667
			                   3681 3686 3682 3681 3675 3663
			                   3668 3679 3675 3670 3668 3654
			                   3648 3663 3658 3642 3645 3630
			                   3616 3629 3624 3598 3605 3590
			                   3568 3579 3573 3539 3552 3539
			                   3499 3510 3503 3460 3482 3472
			                   3398 3408 3402 3346 3382 3375
			                   3200 3200 3200 3200 3200 3200
			                  >;
		};
