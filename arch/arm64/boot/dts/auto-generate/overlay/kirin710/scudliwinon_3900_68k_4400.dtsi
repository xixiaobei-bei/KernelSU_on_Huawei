/* DO NOT EDIT - Automatically generated by python */
		&scudliwinon_3900_68k_4400 {
			fcc = <3900>;
			default_rbatt_mohm = <100>;
			identify_type = "id_volt";
			id_identify_min = <1759>;
			id_identify_max = <2281>;
			id_voltage_min = <1956>;
			id_voltage_max = <2135>;
			vbat_max = <4400>;
			temp_para = 
						"-32767","0","-1","0","4100","0",
						"0","5","-1","390","4400","0",
						"5","10","-1","1170","4400","3",
						"10","45","-1","-1","4400","3",
						"45","50","-1","1365","4100","3",
						"50","32767","-1","0","4100","0";
			vbat_para = 
						"-32767","3400","-1","820","0",
						"3400","32767","-1","-1","0";
			segment_para = 
						"-32767","4150","3900","4208","50",
						"4150","4450","2730","4400","0";
			batt_brand = "scudliwinon";
			fcc_temp = <4002 4017 4004 4021 4007 3970>;
			fcc_sf_x = <0 100 200 300 400 500 600 700 800 1000 1500>;
			fcc_sf_y = <100 96 94 92 90 88 87 84 81 75 50>;
			fcc_sf_cols = <11>;
			pc_sf_rows = <1>;
			pc_sf_cols = <1>;
			pc_sf_row_entries = <0>;
			pc_sf_percent = <100>;
			pc_sf_sf = <100>;
			rbatt_sf_rows = <28>;
			rbatt_sf_cols = <6>;
			rbatt_sf_percent = <100 95 90 85 80 75 70 65 60 55 50 45 40 35 30 25 20 15 10 9 8 7 6 5 4 3 2 1>;
			rbatt_sf_sf = <
			               1903 1402 835 150 106 89
			               1897 1401 834 150 106 89
			               1679 1338 809 146 105 90
			               1675 1250 766 144 104 91
			               1369 1185 747 143 105 92
			               1285 1132 769 152 108 94
			               1483 1027 688 160 115 95
			               1468 1023 647 156 117 99
			               1454 1019 449 169 124 102
			               1493 976 658 150 118 99
			               1554 977 640 133 102 92
			               1546 1016 654 132 103 92
			               1601 1082 687 135 105 93
			               1680 1097 751 141 109 96
			               1744 1140 874 142 110 98
			               1832 1215 976 138 104 91
			               1936 1409 1099 140 105 93
			               2101 1530 1215 150 106 93
			               3897 1916 1090 159 114 104
			               4197 2281 1175 158 116 106
			               4458 2213 1269 165 120 109
			               4742 2510 1898 174 124 114
			               5070 2745 1728 175 125 106
			               6696 3003 1727 165 122 106
			               5885 3515 1824 181 134 117
			               6155 3227 2245 212 143 133
			               6752 3486 2374 257 167 138
			               7812 3503 2473 382 222 159
			              >;
			pc_temp_ocv_rows = <29>;
			pc_temp_ocv_cols = <6>;
			pc_temp_ocv_percent = <100 95 90 85 80 75 70 65 60 55 50 45 40 35 30 25 20 15 10 9 8 7 6 5 4 3 2 1>;
			pc_temp_ocv_ocv = <
			                   4402 4401 4395 4391 4384 4379
			                   4286 4299 4306 4330 4323 4317
			                   4210 4226 4238 4269 4263 4257
			                   4142 4165 4175 4211 4204 4199
			                   4101 4110 4115 4154 4147 4143
			                   4022 4063 4073 4100 4093 4088
			                   3953 3974 4000 4052 4044 4038
			                   3906 3934 3967 3988 3992 3992
			                   3869 3890 3922 3951 3950 3948
			                   3844 3852 3867 3900 3900 3897
			                   3825 3827 3830 3860 3858 3857
			                   3811 3812 3811 3832 3831 3830
			                   3796 3801 3799 3811 3810 3809
			                   3781 3790 3790 3794 3793 3791
			                   3766 3778 3781 3778 3775 3770
			                   3749 3764 3766 3760 3753 3741
			                   3730 3743 3746 3740 3732 3719
			                   3713 3718 3719 3712 3705 3693
			                   3692 3693 3691 3690 3682 3670
			                   3685 3687 3687 3688 3681 3669
			                   3677 3684 3682 3686 3679 3667
			                   3667 3678 3676 3684 3677 3665
			                   3655 3669 3667 3677 3671 3659
			                   3633 3650 3653 3654 3652 3637
			                   3603 3614 3620 3612 3612 3597
			                   3555 3562 3566 3556 3558 3546
			                   3485 3486 3496 3479 3486 3477
			                   3386 3380 3389 3363 3382 3377
			                   3200 3200 3200 3200 3200 3200
			                  >;
		};
