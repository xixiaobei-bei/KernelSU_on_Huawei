/*---------------------------------------------------------------------------
 * This file is autogenerated file using huawei LCD parser. Please do not edit it.
 * Update input XML file to add a new entry or update variable in this file
 * Parser location: vendor/huawei/chipset_common/devkit/lcdkit/tools 
 *---------------------------------------------------------------------------*/


/include/ "dup_auo_otm1901a_5p2_1080p_video_default_1.dtsi"
/include/ "dup_mutto_ltps_ili7807_6p26_720p_video.dtsi"
/include/ "dup_ofilm_hsd_hx8394f_6p26_720p_video.dtsi"
/include/ "dup_ofilm_inx_hx8399c_6p26_720p_video.dtsi"
/include/ "dup_txd_inx_ili9881c_6p26_720p_video.dtsi"