/* Copyright (c) 2013, The Linux Foundation. All rights reserved.
 *
 * This program is free software; you can redistribute it and/or modify
 * it under the terms of the GNU General Public License version 2 and
 * only version 2 as published by the Free Software Foundation.
 *
 * This program is distributed in the hope that it will be useful,
 * but WITHOUT ANY WARRANTY; without even the implied warranty of
 * MERCHANTABILITY or FITNESS FOR A PARTICULAR PURPOSE.  See the
 * GNU General Public License for more details.
 */

/*-------------------------------------------------------------------------
 * This file is autogenerated file using gcdb parser. Please do not edit it.
 * Update input XML file to add a new entry or update variable in this file
 * VERSION = 1.1
 *-----------------------------------------------------------------------*/
&huawei_lcd_config {
	dsi_jdn2_inx_nt51021_8p0_1200p_video: lcdkit_jdn2_inx_nt51021_8p0_1200p_video {
		compatible = "inx_nt51021_8p0_1200p_video";
		hw,lcdkit-panel-name = "INX_NT51021 8P0 VIDEO TFT 1200 x 1920";
		hw,lcdkit-panel-type = <0x1>;
		hw,lcdkit-panel-xres = <1200>;
		hw,lcdkit-panel-yres = <1920>;
		hw,lcdkit-panel-width = <108>;
		hw,lcdkit-panel-height = <173>;
		hw,lcdkit-panel-on-command = <0x15 0x01 0x00 0x00 0x06 0x00 0x02 0x8F 0xA5
				0x15 0x01 0x00 0x00 0x18 0x00 0x02 0x01 0x00
				0x15 0x01 0x00 0x00 0x00 0x00 0x02 0x8F 0xA5
				0x15 0x01 0x00 0x00 0x00 0x00 0x02 0x83 0xBB
				0x15 0x01 0x00 0x00 0x00 0x00 0x02 0x84 0x22
				0x15 0x01 0x00 0x00 0x00 0x00 0x02 0xA1 0xFF
				0x15 0x01 0x00 0x00 0x00 0x00 0x02 0xA2 0xF9
				0x15 0x01 0x00 0x00 0x00 0x00 0x02 0xA3 0xF2
				0x15 0x01 0x00 0x00 0x00 0x00 0x02 0xA4 0xED
				0x15 0x01 0x00 0x00 0x00 0x00 0x02 0xA5 0xE8
				0x15 0x01 0x00 0x00 0x00 0x00 0x02 0xA6 0xE1
				0x15 0x01 0x00 0x00 0x00 0x00 0x02 0xA7 0xDE
				0x15 0x01 0x00 0x00 0x00 0x00 0x02 0xA8 0xDA
				0x15 0x01 0x00 0x00 0x00 0x00 0x02 0xA9 0xD3
				0x15 0x01 0x00 0x00 0x00 0x00 0x02 0xAA 0xCF
				0x15 0x01 0x00 0x00 0x00 0x00 0x02 0xB4 0x20
				0x15 0x01 0x00 0x00 0x00 0x00 0x02 0xB5 0x32
				0x15 0x01 0x00 0x00 0x00 0x00 0x02 0xB6 0x29
				0x15 0x01 0x00 0x00 0x00 0x00 0x02 0xAD 0x06
				0x15 0x01 0x00 0x00 0x00 0x00 0x02 0x9A 0x10
				0x15 0x01 0x00 0x00 0x00 0x00 0x02 0x94 0xB8
				0x15 0x01 0x00 0x00 0x00 0x00 0x02 0x95 0x00
				0x15 0x01 0x00 0x00 0x00 0x00 0x02 0x9A 0x10
				0x15 0x01 0x00 0x00 0x00 0x00 0x02 0x96 0x00
				0x15 0x01 0x00 0x00 0x00 0x00 0x02 0x90 0x00
				0x15 0x01 0x00 0x00 0x00 0x00 0x02 0x83 0xAA
				0x15 0x01 0x00 0x00 0x00 0x00 0x02 0x84 0x11
				0x15 0x01 0x00 0x00 0x00 0x00 0x02 0xA9 0x4B
				0x15 0x01 0x00 0x00 0x00 0x00 0x02 0x83 0x00
				0x15 0x01 0x00 0x00 0x00 0x00 0x02 0x84 0x00
				0x15 0x01 0x00 0x00 0x00 0x00 0x02 0x8C 0x04
				0x15 0x01 0x00 0x00 0x00 0x00 0x02 0xFD 0x53
				0x15 0x01 0x00 0x00 0x00 0x00 0x02 0xFA 0x0E
				0x15 0x01 0x00 0x00 0x00 0x00 0x02 0x83 0xAA
				0x15 0x01 0x00 0x00 0x00 0x00 0x02 0x84 0x11
				0x15 0x01 0x00 0x00 0x00 0x00 0x02 0xC0 0x00
				0x15 0x01 0x00 0x00 0x00 0x00 0x02 0xC1 0x01
				0x15 0x01 0x00 0x00 0x00 0x00 0x02 0xC2 0x0B
				0x15 0x01 0x00 0x00 0x00 0x00 0x02 0xC3 0x17
				0x15 0x01 0x00 0x00 0x00 0x00 0x02 0xC4 0x22
				0x15 0x01 0x00 0x00 0x00 0x00 0x02 0xC5 0x2A
				0x15 0x01 0x00 0x00 0x00 0x00 0x02 0xC6 0x32
				0x15 0x01 0x00 0x00 0x00 0x00 0x02 0xC7 0x38
				0x15 0x01 0x00 0x00 0x00 0x00 0x02 0xC8 0x3E
				0x15 0x01 0x00 0x00 0x00 0x00 0x02 0xC9 0x8D
				0x15 0x01 0x00 0x00 0x00 0x00 0x02 0xCA 0x8D
				0x15 0x01 0x00 0x00 0x00 0x00 0x02 0xCB 0xA0
				0x15 0x01 0x00 0x00 0x00 0x00 0x02 0xCC 0xAF
				0x15 0x01 0x00 0x00 0x00 0x00 0x02 0xCD 0xB3
				0x15 0x01 0x00 0x00 0x00 0x00 0x02 0xCE 0xAC
				0x15 0x01 0x00 0x00 0x00 0x00 0x02 0xCF 0xAF
				0x15 0x01 0x00 0x00 0x00 0x00 0x02 0xD0 0xAD
				0x15 0x01 0x00 0x00 0x00 0x00 0x02 0xD1 0xB1
				0x15 0x01 0x00 0x00 0x00 0x00 0x02 0xD2 0xBB
				0x15 0x01 0x00 0x00 0x00 0x00 0x02 0xD3 0xCF
				0x15 0x01 0x00 0x00 0x00 0x00 0x02 0xD4 0xCF
				0x15 0x01 0x00 0x00 0x00 0x00 0x02 0xD5 0x6B
				0x15 0x01 0x00 0x00 0x00 0x00 0x02 0xD6 0x70
				0x15 0x01 0x00 0x00 0x00 0x00 0x02 0xD7 0x73
				0x15 0x01 0x00 0x00 0x00 0x00 0x02 0xD8 0x7C
				0x15 0x01 0x00 0x00 0x00 0x00 0x02 0xD9 0x80
				0x15 0x01 0x00 0x00 0x00 0x00 0x02 0xDA 0x89
				0x15 0x01 0x00 0x00 0x00 0x00 0x02 0xDB 0x95
				0x15 0x01 0x00 0x00 0x00 0x00 0x02 0xDC 0xB3
				0x15 0x01 0x00 0x00 0x00 0x00 0x02 0xDD 0xB4
				0x15 0x01 0x00 0x00 0x00 0x00 0x02 0xDE 0x00
				0x15 0x01 0x00 0x00 0x00 0x00 0x02 0xDF 0x20
				0x15 0x01 0x00 0x00 0x00 0x00 0x02 0xE0 0x39
				0x15 0x01 0x00 0x00 0x00 0x00 0x02 0xE1 0x3A
				0x15 0x01 0x00 0x00 0x00 0x00 0x02 0xE2 0x44
				0x15 0x01 0x00 0x00 0x00 0x00 0x02 0xE3 0x4E
				0x15 0x01 0x00 0x00 0x00 0x00 0x02 0xE4 0x5B
				0x15 0x01 0x00 0x00 0x00 0x00 0x02 0xE5 0x65
				0x15 0x01 0x00 0x00 0x00 0x00 0x02 0xE6 0x6B
				0x15 0x01 0x00 0x00 0x00 0x00 0x02 0xE7 0x71
				0x15 0x01 0x00 0x00 0x00 0x00 0x02 0xE8 0x77
				0x15 0x01 0x00 0x00 0x00 0x00 0x02 0xE9 0xD7
				0x15 0x01 0x00 0x00 0x00 0x00 0x02 0xEA 0xD4
				0x15 0x01 0x00 0x00 0x00 0x00 0x02 0xEB 0xEB
				0x15 0x01 0x00 0x00 0x00 0x00 0x02 0xEC 0xFC
				0x15 0x01 0x00 0x00 0x00 0x00 0x02 0xED 0xFF
				0x15 0x01 0x00 0x00 0x00 0x00 0x02 0xEE 0xF9
				0x15 0x01 0x00 0x00 0x00 0x00 0x02 0xEF 0xFB
				0x15 0x01 0x00 0x00 0x00 0x00 0x02 0xF0 0xF9
				0x15 0x01 0x00 0x00 0x00 0x00 0x02 0xF1 0xFD
				0x15 0x01 0x00 0x00 0x00 0x00 0x02 0xF2 0x06
				0x15 0x01 0x00 0x00 0x00 0x00 0x02 0xF3 0x1C
				0x15 0x01 0x00 0x00 0x00 0x00 0x02 0xF4 0x1B
				0x15 0x01 0x00 0x00 0x00 0x00 0x02 0xF5 0x91
				0x15 0x01 0x00 0x00 0x00 0x00 0x02 0xF6 0x96
				0x15 0x01 0x00 0x00 0x00 0x00 0x02 0xF7 0x99
				0x15 0x01 0x00 0x00 0x00 0x00 0x02 0xF8 0xA2
				0x15 0x01 0x00 0x00 0x00 0x00 0x02 0xF9 0xA7
				0x15 0x01 0x00 0x00 0x00 0x00 0x02 0xFA 0xAD
				0x15 0x01 0x00 0x00 0x00 0x00 0x02 0xFB 0xB1
				0x15 0x01 0x00 0x00 0x00 0x00 0x02 0xFC 0xB3
				0x15 0x01 0x00 0x00 0x00 0x00 0x02 0xFD 0xB4
				0x15 0x01 0x00 0x00 0x00 0x00 0x02 0xFE 0x00
				0x15 0x01 0x00 0x00 0x00 0x00 0x02 0xFF 0x2E
				0x15 0x01 0x00 0x00 0x00 0x00 0x02 0x83 0xBB
				0x15 0x01 0x00 0x00 0x00 0x00 0x02 0x84 0x22
				0x15 0x01 0x00 0x00 0x00 0x00 0x02 0xC0 0x00
				0x15 0x01 0x00 0x00 0x00 0x00 0x02 0xC1 0x01
				0x15 0x01 0x00 0x00 0x00 0x00 0x02 0xC2 0x0B
				0x15 0x01 0x00 0x00 0x00 0x00 0x02 0xC3 0x17
				0x15 0x01 0x00 0x00 0x00 0x00 0x02 0xC4 0x22
				0x15 0x01 0x00 0x00 0x00 0x00 0x02 0xC5 0x2A
				0x15 0x01 0x00 0x00 0x00 0x00 0x02 0xC6 0x32
				0x15 0x01 0x00 0x00 0x00 0x00 0x02 0xC7 0x38
				0x15 0x01 0x00 0x00 0x00 0x00 0x02 0xC8 0x3E
				0x15 0x01 0x00 0x00 0x00 0x00 0x02 0xC9 0x8D
				0x15 0x01 0x00 0x00 0x00 0x00 0x02 0xCA 0x90
				0x15 0x01 0x00 0x00 0x00 0x00 0x02 0xCB 0xA3
				0x15 0x01 0x00 0x00 0x00 0x00 0x02 0xCC 0xB2
				0x15 0x01 0x00 0x00 0x00 0x00 0x02 0xCD 0xB6
				0x15 0x01 0x00 0x00 0x00 0x00 0x02 0xCE 0xB2
				0x15 0x01 0x00 0x00 0x00 0x00 0x02 0xCF 0xB5
				0x15 0x01 0x00 0x00 0x00 0x00 0x02 0xD0 0xB3
				0x15 0x01 0x00 0x00 0x00 0x00 0x02 0xD1 0xBF
				0x15 0x01 0x00 0x00 0x00 0x00 0x02 0xD2 0xCE
				0x15 0x01 0x00 0x00 0x00 0x00 0x02 0xD3 0xE7
				0x15 0x01 0x00 0x00 0x00 0x00 0x02 0xD4 0xEC
				0x15 0x01 0x00 0x00 0x00 0x00 0x02 0xD5 0x7C
				0x15 0x01 0x00 0x00 0x00 0x00 0x02 0xD6 0x82
				0x15 0x01 0x00 0x00 0x00 0x00 0x02 0xD7 0x88
				0x15 0x01 0x00 0x00 0x00 0x00 0x02 0xD8 0x90
				0x15 0x01 0x00 0x00 0x00 0x00 0x02 0xD9 0x98
				0x15 0x01 0x00 0x00 0x00 0x00 0x02 0xDA 0x9F
				0x15 0x01 0x00 0x00 0x00 0x00 0x02 0xDB 0xAA
				0x15 0x01 0x00 0x00 0x00 0x00 0x02 0xDC 0xC7
				0x15 0x01 0x00 0x00 0x00 0x00 0x02 0xDD 0xCA
				0x15 0x01 0x00 0x00 0x00 0x00 0x02 0xDE 0x00
				0x15 0x01 0x00 0x00 0x00 0x00 0x02 0xDF 0x20
				0x15 0x01 0x00 0x00 0x00 0x00 0x02 0xE0 0x39
				0x15 0x01 0x00 0x00 0x00 0x00 0x02 0xE1 0x3A
				0x15 0x01 0x00 0x00 0x00 0x00 0x02 0xE2 0x44
				0x15 0x01 0x00 0x00 0x00 0x00 0x02 0xE3 0x4E
				0x15 0x01 0x00 0x00 0x00 0x00 0x02 0xE4 0x5B
				0x15 0x01 0x00 0x00 0x00 0x00 0x02 0xE5 0x65
				0x15 0x01 0x00 0x00 0x00 0x00 0x02 0xE6 0x6B
				0x15 0x01 0x00 0x00 0x00 0x00 0x02 0xE7 0x71
				0x15 0x01 0x00 0x00 0x00 0x00 0x02 0xE8 0x77
				0x15 0x01 0x00 0x00 0x00 0x00 0x02 0xE9 0xD7
				0x15 0x01 0x00 0x00 0x00 0x00 0x02 0xEA 0xD7
				0x15 0x01 0x00 0x00 0x00 0x00 0x02 0xEB 0xEE
				0x15 0x01 0x00 0x00 0x00 0x00 0x02 0xEC 0xFF
				0x15 0x01 0x00 0x00 0x00 0x00 0x02 0xED 0x02
				0x15 0x01 0x00 0x00 0x00 0x00 0x02 0xEE 0xFF
				0x15 0x01 0x00 0x00 0x00 0x00 0x02 0xEF 0x01
				0x15 0x01 0x00 0x00 0x00 0x00 0x02 0xF0 0xFF
				0x15 0x01 0x00 0x00 0x00 0x00 0x02 0xF1 0x0B
				0x15 0x01 0x00 0x00 0x00 0x00 0x02 0xF2 0x19
				0x15 0x01 0x00 0x00 0x00 0x00 0x02 0xF3 0x34
				0x15 0x01 0x00 0x00 0x00 0x00 0x02 0xF4 0x38
				0x15 0x01 0x00 0x00 0x00 0x00 0x02 0xF5 0xA2
				0x15 0x01 0x00 0x00 0x00 0x00 0x02 0xF6 0xA8
				0x15 0x01 0x00 0x00 0x00 0x00 0x02 0xF7 0xAE
				0x15 0x01 0x00 0x00 0x00 0x00 0x02 0xF8 0xB6
				0x15 0x01 0x00 0x00 0x00 0x00 0x02 0xF9 0xBF
				0x15 0x01 0x00 0x00 0x00 0x00 0x02 0xFA 0xC4
				0x15 0x01 0x00 0x00 0x00 0x00 0x02 0xFB 0xC7
				0x15 0x01 0x00 0x00 0x00 0x00 0x02 0xFC 0xC7
				0x15 0x01 0x00 0x00 0x00 0x00 0x02 0xFD 0xCA
				0x15 0x01 0x00 0x00 0x00 0x00 0x02 0xFE 0x50
				0x15 0x01 0x00 0x00 0x00 0x00 0x02 0xFF 0x2F
				0x15 0x01 0x00 0x00 0x00 0x00 0x02 0x83 0xCC
				0x15 0x01 0x00 0x00 0x00 0x00 0x02 0x84 0x33
				0x15 0x01 0x00 0x00 0x00 0x00 0x02 0xC0 0x00
				0x15 0x01 0x00 0x00 0x00 0x00 0x02 0xC1 0x01
				0x15 0x01 0x00 0x00 0x00 0x00 0x02 0xC2 0x0B
				0x15 0x01 0x00 0x00 0x00 0x00 0x02 0xC3 0x17
				0x15 0x01 0x00 0x00 0x00 0x00 0x02 0xC4 0x22
				0x15 0x01 0x00 0x00 0x00 0x00 0x02 0xC5 0x2A
				0x15 0x01 0x00 0x00 0x00 0x00 0x02 0xC6 0x32
				0x15 0x01 0x00 0x00 0x00 0x00 0x02 0xC7 0x38
				0x15 0x01 0x00 0x00 0x00 0x00 0x02 0xC8 0x3E
				0x15 0x01 0x00 0x00 0x00 0x00 0x02 0xC9 0x8D
				0x15 0x01 0x00 0x00 0x00 0x00 0x02 0xCA 0x90
				0x15 0x01 0x00 0x00 0x00 0x00 0x02 0xCB 0xA5
				0x15 0x01 0x00 0x00 0x00 0x00 0x02 0xCC 0xB4
				0x15 0x01 0x00 0x00 0x00 0x00 0x02 0xCD 0xBB
				0x15 0x01 0x00 0x00 0x00 0x00 0x02 0xCE 0xB8
				0x15 0x01 0x00 0x00 0x00 0x00 0x02 0xCF 0xBB
				0x15 0x01 0x00 0x00 0x00 0x00 0x02 0xD0 0xBD
				0x15 0x01 0x00 0x00 0x00 0x00 0x02 0xD1 0xCC
				0x15 0x01 0x00 0x00 0x00 0x00 0x02 0xD2 0xDF
				0x15 0x01 0x00 0x00 0x00 0x00 0x02 0xD3 0xFE
				0x15 0x01 0x00 0x00 0x00 0x00 0x02 0xD4 0x08
				0x15 0x01 0x00 0x00 0x00 0x00 0x02 0xD5 0x90
				0x15 0x01 0x00 0x00 0x00 0x00 0x02 0xD6 0x97
				0x15 0x01 0x00 0x00 0x00 0x00 0x02 0xD7 0x9E
				0x15 0x01 0x00 0x00 0x00 0x00 0x02 0xD8 0xA8
				0x15 0x01 0x00 0x00 0x00 0x00 0x02 0xD9 0xB1
				0x15 0x01 0x00 0x00 0x00 0x00 0x02 0xDA 0xBC
				0x15 0x01 0x00 0x00 0x00 0x00 0x02 0xDB 0xD8
				0x15 0x01 0x00 0x00 0x00 0x00 0x02 0xDC 0xEF
				0x15 0x01 0x00 0x00 0x00 0x00 0x02 0xDD 0xFF
				0x15 0x01 0x00 0x00 0x00 0x00 0x02 0xDE 0x00
				0x15 0x01 0x00 0x00 0x00 0x00 0x02 0xDF 0x28
				0x15 0x01 0x00 0x00 0x00 0x00 0x02 0xE0 0x39
				0x15 0x01 0x00 0x00 0x00 0x00 0x02 0xE1 0x3A
				0x15 0x01 0x00 0x00 0x00 0x00 0x02 0xE2 0x44
				0x15 0x01 0x00 0x00 0x00 0x00 0x02 0xE3 0x4E
				0x15 0x01 0x00 0x00 0x00 0x00 0x02 0xE4 0x5B
				0x15 0x01 0x00 0x00 0x00 0x00 0x02 0xE5 0x65
				0x15 0x01 0x00 0x00 0x00 0x00 0x02 0xE6 0x6B
				0x15 0x01 0x00 0x00 0x00 0x00 0x02 0xE7 0x71
				0x15 0x01 0x00 0x00 0x00 0x00 0x02 0xE8 0x77
				0x15 0x01 0x00 0x00 0x00 0x00 0x02 0xE9 0xD7
				0x15 0x01 0x00 0x00 0x00 0x00 0x02 0xEA 0xD7
				0x15 0x01 0x00 0x00 0x00 0x00 0x02 0xEB 0xF0
				0x15 0x01 0x00 0x00 0x00 0x00 0x02 0xEC 0x02
				0x15 0x01 0x00 0x00 0x00 0x00 0x02 0xED 0x07
				0x15 0x01 0x00 0x00 0x00 0x00 0x02 0xEE 0x05
				0x15 0x01 0x00 0x00 0x00 0x00 0x02 0xEF 0x07
				0x15 0x01 0x00 0x00 0x00 0x00 0x02 0xF0 0x09
				0x15 0x01 0x00 0x00 0x00 0x00 0x02 0xF1 0x18
				0x15 0x01 0x00 0x00 0x00 0x00 0x02 0xF2 0x2A
				0x15 0x01 0x00 0x00 0x00 0x00 0x02 0xF3 0x4B
				0x15 0x01 0x00 0x00 0x00 0x00 0x02 0xF4 0x54
				0x15 0x01 0x00 0x00 0x00 0x00 0x02 0xF5 0xB6
				0x15 0x01 0x00 0x00 0x00 0x00 0x02 0xF6 0xBD
				0x15 0x01 0x00 0x00 0x00 0x00 0x02 0xF7 0xC4
				0x15 0x01 0x00 0x00 0x00 0x00 0x02 0xF8 0xCE
				0x15 0x01 0x00 0x00 0x00 0x00 0x02 0xF9 0xD8
				0x15 0x01 0x00 0x00 0x00 0x00 0x02 0xFA 0xE1
				0x15 0x01 0x00 0x00 0x00 0x00 0x02 0xFB 0xED
				0x15 0x01 0x00 0x00 0x00 0x00 0x02 0xFC 0xEF
				0x15 0x01 0x00 0x00 0x00 0x00 0x02 0xFD 0xFF
				0x15 0x01 0x00 0x00 0x00 0x00 0x02 0xFE 0xF8
				0x15 0x01 0x00 0x00 0x00 0x00 0x02 0xFF 0x2F
				0x15 0x01 0x00 0x00 0x00 0x00 0x02 0x83 0x00
				0x15 0x01 0x00 0x00 0x00 0x00 0x02 0x84 0x00
				0x05 0x01 0x00 0x00 0x05 0x00 0x02 0x11 0x00>;
		hw,lcdkit-panel-on-command-state = "dsi_lp_mode";
		hw,lcdkit-panel-off-command = <0x15 0x01 0x00 0x00 0x05 0x00 0x02 0x10 0x00>;
		hw,lcdkit-panel-off-command-state = "dsi_hs_mode";
		hw,lcdkit-panel-backlight-command = <0x23 0x01 0x00 0x00 0x00 0x00 0x02 0x9F 0x00>;
		hw,lcdkit-panel-backlight-command-state = "dsi_lp_mode";
		hw,lcdkit-panel-cabc-off-command = <0x23 0x01 0x00 0x00 0x00 0x00 0x02 0x83 0xBB
				0x23 0x01 0x00 0x00 0x00 0x00 0x02 0x84 0x22
				0x23 0x01 0x00 0x00 0x00 0x00 0x02 0x90 0xC0>;
		hw,lcdkit-panel-cabc-off-command-state = "dsi_hs_mode";
		hw,lcdkit-panel-cabc-ui-command = <0x23 0x01 0x00 0x00 0x00 0x00 0x02 0x83 0xBB
				0x23 0x01 0x00 0x00 0x00 0x00 0x02 0x84 0x22
				0x23 0x01 0x00 0x00 0x00 0x00 0x02 0xA1 0xFF
				0x23 0x01 0x00 0x00 0x00 0x00 0x02 0xA2 0xF9
				0x23 0x01 0x00 0x00 0x00 0x00 0x02 0xA3 0xF2
				0x23 0x01 0x00 0x00 0x00 0x00 0x02 0xA4 0xED
				0x23 0x01 0x00 0x00 0x00 0x00 0x02 0xA5 0xE8
				0x23 0x01 0x00 0x00 0x00 0x00 0x02 0xA6 0xE1
				0x23 0x01 0x00 0x00 0x00 0x00 0x02 0xA7 0xDE
				0x23 0x01 0x00 0x00 0x00 0x00 0x02 0xA8 0xDA
				0x23 0x01 0x00 0x00 0x00 0x00 0x02 0xA9 0xD3
				0x23 0x01 0x00 0x00 0x00 0x00 0x02 0xAA 0xCF
				0x23 0x01 0x00 0x00 0x00 0x00 0x02 0xB4 0x20
				0x23 0x01 0x00 0x00 0x00 0x00 0x02 0xB5 0x32
				0x23 0x01 0x00 0x00 0x00 0x00 0x02 0xB6 0x29
				0x23 0x01 0x00 0x00 0x00 0x00 0x02 0xAD 0x06
				0x23 0x01 0x00 0x00 0x00 0x00 0x02 0x9A 0x10
				0x23 0x01 0x00 0x00 0x00 0x00 0x02 0x94 0xB8
				0x23 0x01 0x00 0x00 0x00 0x00 0x02 0x95 0x00
				0x23 0x01 0x00 0x00 0x00 0x00 0x02 0x9A 0x10
				0x23 0x01 0x00 0x00 0x00 0x00 0x02 0x96 0x00
				0x23 0x01 0x00 0x00 0x00 0x00 0x02 0x90 0x00>;
		hw,lcdkit-panel-cabc-ui-command-state = "dsi_hs_mode";
		hw,lcdkit-panel-cabc-still-command = <0x23 0x01 0x00 0x00 0x00 0x00 0x02 0x83 0xBB
				0x23 0x01 0x00 0x00 0x00 0x00 0x02 0x84 0x22
				0x23 0x01 0x00 0x00 0x00 0x00 0x02 0xA1 0xFF
				0x23 0x01 0x00 0x00 0x00 0x00 0x02 0xA2 0xFE
				0x23 0x01 0x00 0x00 0x00 0x00 0x02 0xA3 0xFA
				0x23 0x01 0x00 0x00 0x00 0x00 0x02 0xA4 0xF7
				0x23 0x01 0x00 0x00 0x00 0x00 0x02 0xA5 0xF3
				0x23 0x01 0x00 0x00 0x00 0x00 0x02 0xA6 0xF1
				0x23 0x01 0x00 0x00 0x00 0x00 0x02 0xA7 0xEE
				0x23 0x01 0x00 0x00 0x00 0x00 0x02 0xA8 0xEC
				0x23 0x01 0x00 0x00 0x00 0x00 0x02 0xA9 0xEB
				0x23 0x01 0x00 0x00 0x00 0x00 0x02 0xAA 0xE6
				0x23 0x01 0x00 0x00 0x00 0x00 0x02 0xB4 0x0D
				0x23 0x01 0x00 0x00 0x00 0x00 0x02 0xB5 0x1A
				0x23 0x01 0x00 0x00 0x00 0x00 0x02 0xB6 0x16
				0x23 0x01 0x00 0x00 0x00 0x00 0x02 0x9A 0x10
				0x23 0x01 0x00 0x00 0x00 0x00 0x02 0x9B 0x00
				0x23 0x01 0x00 0x00 0x00 0x00 0x02 0x99 0x00
				0x23 0x01 0x00 0x00 0x00 0x00 0x02 0x96 0x00
				0x23 0x01 0x00 0x00 0x00 0x00 0x02 0xAF 0x12
				0x23 0x01 0x00 0x00 0x00 0x00 0x02 0xB0 0x36
				0x23 0x01 0x00 0x00 0x00 0x00 0x02 0xB1 0x56
				0x23 0x01 0x00 0x00 0x00 0x00 0x02 0xB2 0x67
				0x23 0x01 0x00 0x00 0x00 0x00 0x02 0xB3 0x6A
				0x23 0x01 0x00 0x00 0x00 0x00 0x02 0x96 0x00
				0x23 0x01 0x00 0x00 0x00 0x00 0x02 0x90 0x40>;
		hw,lcdkit-panel-cabc-still-command-state = "dsi_hs_mode";
		hw,lcdkit-panel-cabc-moving-command = <0x23 0x01 0x00 0x00 0x00 0x00 0x02 0x83 0xBB
				0x23 0x01 0x00 0x00 0x00 0x00 0x02 0x84 0x22
				0x23 0x01 0x00 0x00 0x00 0x00 0x02 0xA1 0xFF
				0x23 0x01 0x00 0x00 0x00 0x00 0x02 0xA2 0xF9
				0x23 0x01 0x00 0x00 0x00 0x00 0x02 0xA3 0xF2
				0x23 0x01 0x00 0x00 0x00 0x00 0x02 0xA4 0xED
				0x23 0x01 0x00 0x00 0x00 0x00 0x02 0xA5 0xE8
				0x23 0x01 0x00 0x00 0x00 0x00 0x02 0xA6 0xE1
				0x23 0x01 0x00 0x00 0x00 0x00 0x02 0xA7 0xDE
				0x23 0x01 0x00 0x00 0x00 0x00 0x02 0xA8 0xDA
				0x23 0x01 0x00 0x00 0x00 0x00 0x02 0xA9 0xD3
				0x23 0x01 0x00 0x00 0x00 0x00 0x02 0xAA 0xCF
				0x23 0x01 0x00 0x00 0x00 0x00 0x02 0xB4 0x20
				0x23 0x01 0x00 0x00 0x00 0x00 0x02 0xB5 0x32
				0x23 0x01 0x00 0x00 0x00 0x00 0x02 0xB6 0x29
				0x23 0x01 0x00 0x00 0x00 0x00 0x02 0xAD 0x06
				0x23 0x01 0x00 0x00 0x00 0x00 0x02 0x9A 0x10
				0x23 0x01 0x00 0x00 0x00 0x00 0x02 0x94 0xB8
				0x23 0x01 0x00 0x00 0x00 0x00 0x02 0x95 0x00
				0x23 0x01 0x00 0x00 0x00 0x00 0x02 0x9A 0x10
				0x23 0x01 0x00 0x00 0x00 0x00 0x02 0x96 0x00
				0x23 0x01 0x00 0x00 0x00 0x00 0x02 0x90 0x00>;
		hw,lcdkit-panel-cabc-moving-command-state = "dsi_hs_mode";
		hw,lcdkit-panel-cabc-support = <1>;
		hw,lcdkit-panel-se-support = <0>;
		hw,lcdkit-panel-btb-support = <0>;
		hw,lcdkit-panel-ce-support = <0>;
		hw,lcdkit-panel-inversion-support = <0>;
		hw,lcdkit-panel-scan-support = <0>;
		hw,lcdkit-panel-display-region-command = <>;
		hw,lcdkit-panel-display-region-command-state = "dsi_lp_mode";
		hw,lcdkit-panel-display-region-support = <0>;
		hw,lcdkit-panel-checksum-support = <0>;
		hw,lcdkit-panel-esd-support = <0>;
		hw,lcdkit-panel-mipi-check-support = <0>;
		hw,lcdkit-panel-check-reg-support = <0>;
		hw,lcdkit-panel-brightness-color-uniform-support = <0>;
		hw,lcdkit-panel-dynamic-gamma-support = <0>;
		hw,lcdkit-panel-mipi-detect-command = <>;
		hw,lcdkit-panel-mipi-detect-value = <>;
		hw,lcdkit-panel-mipi-detect-mask = <>;
		hw,lcdkit-panel-mipi-detect-command-state = "dsi_lp_mode";
		hw,lcdkit-panel-mipi-detect-support = <0>;
		hw,lcdkit-panel-dynamic-sram-check-support = <0>;
		hw,lcdkit-panel-fps-updt-support = <0>;
		hw,lcdkit-panel-dis-on-cmds-delay-margin-support = <1>;
		hw,lcdkit-panel-ts-resume-ctrl-mode = <0>;
		hw,lcdkit-panel-dis-on-cmds-delay-margin-time = <100>;
		hw,lcdkit-panel-lptohs-mipi-check-support = <0>;
		hw,lcdkit-panel-acl-ctrl-support = <0>;
		hw,lcdkit-panel-hbm-ctrl-support = <0>;
		hw,lcdkit-panel-vr-support = <0>;
		hw,lcdkit-panel-current-detect-support = <0>;
		hw,lcdkit-panel-lv-detect-support = <0>;
		hw,lcdkit-panel-orientation = <1>;
		hw,lcdkit-panel-bpp = <0>;
		hw,lcdkit-panel-bgrfmt = <0>;
		hw,lcdkit-panel-bl-type = <4>;
		hw,lcdkit-panel-blmin = <75>;
		hw,lcdkit-panel-blmax = <8130>;
		hw,lcdkit-panel-idle2-lcd-reset-low = <0>;
		hw,lcdkit-panel-bl-def = <4000>;
		hw,lcdkit-panel-bl-maxnit = <530>;
		hw,lcdkit-panel-bl-v200 = <0>;
		hw,lcdkit-panel-bl-otm = <0>;
		hw,lcdkit-panel-getblmaxnit-type = <0>;
		hw,lcdkit-panel-cmd-type = <8>;
		hw,lcdkit-panel-ifbctype = <0>;
		hw,lcdkit-panel-frc-enable = <0>;
		hw,lcdkit-panel-esd-skip-mipi-check = <1>;
		hw,lcdkit-panel-pxl-clk = <160>;
		hw,lcdkit-panel-pxl-clk-div = <1>;
		hw,lcdkit-panel-tp-resume-nosync = <0>;
		hw,lcdkit-panel-dirt-updt-support = <0>;
		hw,lcdkit-is-hostprocessing = <0>;
		hw,lcdkit-host-info-all-in-ddic = <0>;
		hw,lcdkit-panel-dsi-upt-support = <0>;
		hw,lcdkit-panel-vsyn-ctr-type = <0>;
		hw,lcdkit-panel-bl-pwm-preci-no-convert = <0>;
		hw,lcdkit-panel-bl-pwm-preci-type = <2>;
		hw,lcdkit-panel-bl-ic-ctrl-type = <8>;
		hw,lcdkit-panel-bl-pwm-out-div-value = <0>;
		hw,lcdkit-panel-step-support = <1>;
		hw,lcdkit-panel-xcc-set-in-isr-support = <1>;
		hw,lcdkit-ldi-hsync-plr = <0>;
		hw,lcdkit-ldi-vsync-plr = <0>;
		hw,lcdkit-ldi-pixel-clk-plr = <0>;
		hw,lcdkit-ldi-data-en-plr = <0>;
		hw,lcdkit-ldi-dpi-a-overlap-size = <0>;
		hw,lcdkit-ldi-dpi-b-overlap-size = <0>;
		hw,lcdkit-sbl-stren-limit = <128>;
		hw,lcdkit-sbl-cal-a = <60>;
		hw,lcdkit-sbl-cal-b = <95>;
		hw,lcdkit-sbl-cal-c = <5>;
		hw,lcdkit-sbl-cal-d = <1>;
		hw,lcdkit-sbl-tf-ctl = <5>;
		hw,lcdkit-sbl-bl-min = <480>;
		hw,lcdkit-sbl-bl-max = <4096>;
		hw,lcdkit-sbl-bl-scale = <0xff>;
		hw,lcdkit-sbl-am-light-min = <14>;
		hw,lcdkit-sbl-filter-a = <1738>;
		hw,lcdkit-sbl-filter-b = <6>;
		hw,lcdkit-sbl-logo-left = <0>;
		hw,lcdkit-sbl-logo-top = <0>;
		hw,lcdkit-sbl-variance-intensity-space = <145>;
		hw,lcdkit-sbl-slope-max = <54>;
		hw,lcdkit-sbl-slope-min = <160>;
		hw,lcdkit-mipi-lane-nums = <3>;
		hw,lcdkit-mipi-color-mode = <5>;
		hw,lcdkit-mipi-vc = <0>;
		hw,lcdkit-mipi-dsi-bit-clk = <480>;
		hw,lcdkit-mipi-burst-mode = <2>;
		hw,lcdkit-mipi-max-esc-clk = <10>;
		hw,lcdkit-mipi-dsi-bit-clk-val-a = <0>;
		hw,lcdkit-mipi-dsi-bit-clk-val-b = <0>;
		hw,lcdkit-mipi-dsi-bit-clk-val-c = <0>;
		hw,lcdkit-mipi-dsi-bit-clk-val-d = <0>;
		hw,lcdkit-mipi-dsi-bit-clk-val-e = <0>;
		hw,lcdkit-mipi-dsi-bit-clk-upt = <480>;
		hw,lcdkit-mipi-rg-vcm-adjust = <5>;
		hw,lcdkit-mipi-rg-lptx-adjust = <0>;
		hw,lcdkit-mipi-rg-sri-adjust = <0>;
		hw,lcdkit-mipi-rg-vcm-clk-adjust = <0>;
		hw,lcdkit-mipi-rg-vcm-data-adjust = <0>;
		hw,lcdkit-mipi-non-continue-enable = <0>;
		hw,lcdkit-mipi-clk-post-adjust = <30>;
		hw,lcdkit-mipi-lp11_flag = <0>;
		hw,lcdkit-mipi-phy_update = <0>;
		hw,lcdkit-mipi-clk-pre-adjust = <0>;
		hw,lcdkit-mipi-clk-t-hs-prepare-adjust = <0>;
		hw,lcdkit-mipi-clk-t-lpx-adjust = <0>;
		hw,lcdkit-mipi-clk-t-hs-trail-adjust = <0>;
		hw,lcdkit-mipi-clk-t-hs-exit-adjust = <0>;
		hw,lcdkit-mipi-clk-t-hs-zero-adjust = <0>;
		hw,lcdkit-mipi-data-t-hs-trail-adjust = <0>;
		hw,lcdkit-mipi-phy-mode = <0>;
		hw,lcdkit-mipi-txoff-rxulps-enable = <0>;
		hw,lcdkit-dirt-left-align = <2>;
		hw,lcdkit-dirt-right-align = <2>;
		hw,lcdkit-dirt-top-align = <2>;
		hw,lcdkit-dirt-bott-align = <2>;
		hw,lcdkit-dirt-width-align = <2>;
		hw,lcdkit-dirt-height-align = <2>;
		hw,lcdkit-dirt-width-min = <2>;
		hw,lcdkit-dirt-height-min = <2>;
		hw,lcdkit-dirt-top-start = <0xffff>;
		hw,lcdkit-dirt-bott-start = <0xffff>;
		hw,lcdkit-gpios = <&gpio4 4 0>,<&gpio4 5 0>,<&gpio26 1 0>,<&gpio4 3 0>;
		lcdio-vcc-supply = <&ldo31>;
		lcdanalog-vcc-supply = <&ldo17>;
		pinctrl-0 = <&gpio036_pmx_func &gpio037_pmx_func &gpio209_pmx_func &gpio035_pmx_func &gpio036_cfg_func &gpio037_cfg_func &gpio209_cfg_func &gpio035_cfg_func>;
		pinctrl-1 = <&gpio036_pmx_idle &gpio037_pmx_idle &gpio209_pmx_idle &gpio035_pmx_idle &gpio036_cfg_idle &gpio037_cfg_idle &gpio209_cfg_idle &gpio035_cfg_idle>;
		pinctrl-names = "default","idle";
		status = "disabled";
		hw,lcdkit-sbl-support = <1>;
		hw,lcdkit-gamma-support = <1>;
		hw,lcdkit-gmp-support = <0>;
		hw,lcdkit-color-temp-support = <1>;
		hw,lcdkit-color-temp-rectify-support = <0>;
		hw,lcdkit-comform-mode-support = <1>;
		hw,lcdkit-cinema-mode-support = <0>;
		hw,lcdkit-prefix-sharp-two-d-support = <0>;
		hw,lcdkit-xcc-support = <1>;
		hw,lcdkit-prefix-ce-support = <0>;
		hw,lcdkit-prefix-sharp-one-d-support = <0>;
		hw,lcdkit-acm-support = <0>;
		hw,lcdkit-smart-color-mode-support = <0>;
		hw,lcdkit-acm-ce-support = <0>;
		hw,lcdkit-acm-valid-num = <7>;
		hw,lcdkit-r_hh0 = <0x7f>;
		hw,lcdkit-r_lh0 = <0x3ff>;
		hw,lcdkit-r_hh1 = <0xc2>;
		hw,lcdkit-r_lh1 = <0x80>;
		hw,lcdkit-r_hh2 = <0x1c0>;
		hw,lcdkit-r_lh2 = <0xc3>;
		hw,lcdkit-r_hh3 = <0x1fe>;
		hw,lcdkit-r_lh3 = <0x1c1>;
		hw,lcdkit-r_hh4 = <0x2fd>;
		hw,lcdkit-r_lh4 = <0x1ff>;
		hw,lcdkit-r_hh5 = <0x33f>;
		hw,lcdkit-r_lh5 = <0x2fe>;
		hw,lcdkit-r_hh6 = <0x37f>;
		hw,lcdkit-r_lh6 = <0x340>;
		hw,lcdkit-r_video_hh0 = <0x7f>;
		hw,lcdkit-r_video_lh0 = <0xe>;
		hw,lcdkit-r_video_hh1 = <0xbe>;
		hw,lcdkit-r_video_lh1 = <0x80>;
		hw,lcdkit-r_video_hh2 = <0xff>;
		hw,lcdkit-r_video_lh2 = <0xbf>;
		hw,lcdkit-r_video_hh3 = <0x1c0>;
		hw,lcdkit-r_video_lh3 = <0x100>;
		hw,lcdkit-r_video_hh4 = <0x27f>;
		hw,lcdkit-r_video_lh4 = <0x1c1>;
		hw,lcdkit-r_video_hh5 = <0x323>;
		hw,lcdkit-r_video_lh5 = <0x280>;
		hw,lcdkit-r_video_hh6 = <0x381>;
		hw,lcdkit-r_video_lh6 = <0x324>;
		hw,lcdkit-color-temp-rectify-r = <32768>;
		hw,lcdkit-color-temp-rectify-g = <32768>;
		hw,lcdkit-color-temp-rectify-b = <32768>;
		hw,lcdkit-hiace-support = <0>;
		hw,lcdkit-panel-effect-support = <0>;
		hw,lcdkit-arsr1p-sharpness-support = <0>;
		hw,lcdkit-iglobal-hist-black-pos = <16>;
		hw,lcdkit-iglobal-hist-white-pos = <240>;
		hw,lcdkit-iglobal-hist-black-weight = <51>;
		hw,lcdkit-iglobal-hist-white-weight = <51>;
		hw,lcdkit-iglobal-hist-zero-cut-ratio = <486>;
		hw,lcdkit-iglobal-hist-slope-cut-ratio = <410>;
		hw,lcdkit-imax-lcd-luminance = <500>;
		hw,lcdkit-imin-lcd-luminance = <3>;
		hw,lcdkit-cfg-name = "/product/etc/display/effect/algorithm/hdr_engine.xml";
		hw,lcdkit-effect-support-mode = <65537>;
		hw,lcdkit-bl-support-mode = <0>;
		hw,lcdkit-bl-enhance = <0>;
		hw,lcdkit-bl-normal = <0>;
		hw,lcdkit-delay-af-rst-off = <5>;
		hw,lcdkit-h-back-porch = <36>;
		hw,lcdkit-h-front-porch = <62>;
		hw,lcdkit-h-pulse-width = <2>;
		hw,lcdkit-v-back-porch = <24>;
		hw,lcdkit-v-pulse-width = <22>;
		hw,lcdkit-v-front-porch = <104>;
		hw,lcdkit-h-sync-skew = <0>;
		hw,lcdkit-lcd-type = <1>;
		hw,lcdkit-panel-pt-test-support = <0>;
		hw,lcdkit-mipi-clk-config-support = <0>;
		hw,lcdkit-panel-hkadc-support = <0>;
		hw,lcdkit-bias-power-ctrl-mode = <16>;
		hw,lcdkit-bl-power-ctrl-mode = <0>;
		hw,lcdkit-bl-gpio-ctrl-mode = <1>;
		hw,lcdkit-bl-gpio-suspend-disable = <0>;
		hw,lcdkit-iovcc-power-ctrl-mode = <1>;
		hw,lcdkit-vci-power-ctrl-mode = <16>;
		hw,lcdkit-vbat-power-ctrl-mode = <2>;
		hw,lcdkit-id0-gpio = <36>;
		hw,lcdkit-id1-gpio = <37>;
		hw,lcdkit-reset-gpio = <0>;
		hw,lcdkit-te-gpio = <15>;
		hw,lcdkit-vsp-gpio = <35>;
		hw,lcdkit-vsn-gpio = <45>;
		hw,lcdkit-iovcc-gpio = <0>;
		hw,lcdkit-vci-gpio = <0>;
		hw,lcdkit-bl-gpio = <209>;
		hw,lcdkit-vbat-gpio = <35>;
		hw,lcdkit-iovcc-on-is-need-reset = <0>;
		hw,lcdkit-vsn-on-is-need-reset = <0>;
		hw,lcdkit-lcdanalog-vcc = <3100000>;
		hw,lcdkit-lcdio-vcc = <3100000>;
		hw,lcdkit-lcd-bias = <5500000>;
		hw,lcdkit-lcd-vsp = <5500000>;
		hw,lcdkit-lcd-vsn = <5500000>;
		hw,lcdkit-lcd-rst-first-high = <0>;
		hw,lcdkit-lcd-rst-low = <0>;
		hw,lcdkit-lcd-rst-second-high = <0>;
		hw,lcdkit-delay-af-vci-on = <0>;
		hw,lcdkit-delay-af-iovcc-on = <0>;
		hw,lcdkit-delay-af-vbat-on = <31>;
		hw,lcdkit-delay-af-bias-on = <0>;
		hw,lcdkit-delay-af-vsp-on = <5>;
		hw,lcdkit-delay-af-vsn-on = <5>;
		hw,lcdkit-delay-af-lp11 = <5>;
		hw,lcdkit-delay-af-tp-reset = <0>;
		hw,lcdkit-tp-reset-before-lcd-reset = <0>;
		hw,lcdkit-delay-af-vsn-off = <5>;
		hw,lcdkit-delay-af-vsp-off = <5>;
		hw,lcdkit-delay-af-bias-off = <0>;
		hw,lcdkit-delay-af-vbat-off = <0>;
		hw,lcdkit-delay-af-iovcc-off = <500>;
		hw,lcdkit-delay-af-vci-off = <0>;
		hw,lcdkit-ulps-flag = <0>;
		hw_lm36923,lcdkit-bl-ic-level = <2047>;
		hw_lm36923,lcdkit-bl-ic-ctrl-mode = <0>;
		hw_lm36923,lcdkit-bl-ic-type = <0>;
		hw_lm36923,lcdkit-bl-ic-before-init-delay = <0>;
		hw_lm36923,lcdkit-bl-ic-init-delay = <0>;
		hw_lm36923,lcdkit-bl-ic-ovp-check = <1>;
		hw_lm36923,lcdkit-bl-ic-fake-lcd-ovp-check = <0>;
		hw_lm36923,lcdkit-bl-ic-init-cmd = <0x02 0x11 0x85 0xff
						0x01 0x13 0x7a 0xff
						0x01 0x10 0x0f 0x0f
						0x02 0x12 0xa3 0xff
						0x01 0x15 0x00 0xff
						0x01 0x16 0x00 0xff
						0x01 0x1e 0x04 0x0f>;
		hw_lm36923,lcdkit-bl-ic-num-of-init-cmd = <0x07>;
		hw_lm36923,lcdkit-bl-ic-bl-lsb-reg-cmd = <0x03 0x18 0x02 0x07>;
		hw_lm36923,lcdkit-bl-ic-bl-msb-reg-cmd = <0x08 0x19 0x66 0xff>;
		hw_lm36923,lcdkit-bl-ic-bl-enable-cmd = <0x01 0x10 0x0f 0x0f>;
		hw_lm36923,lcdkit-bl-ic-bl-disable-cmd = <0x01 0x10 0x00 0x00>;
		hw_lm36923,lcdkit-bl-ic-disable-device-cmd = <0x01 0x10 0x00 0x00>;
		hw_lm36923,lcdkit-bl-ic-fault-flag-cmd = <0x01 0x1f 0x00 0xff>;
		hw_lm36923,lcdkit-bl-ic-bias-disable-cmd = <0x01 0x00 0x00 0x00>;
		hw_lm36923,lcdkit-bl-ic-pull-down-vsp-cmd = <0x00 0x00 0x00 0x00>;
		hw_lm36923,lcdkit-bl-ic-pull-down-vsn-cmd = <0x00 0x00 0x00 0x00>;
		hw_lm36923,lcdkit-bl-ic-sec-enable-cmd = <0x00 0x00 0x00 0x00>;
		hw_lm36923,lcdkit-bl-ic-pull-down-boost-cmd = <0x00 0x00 0x00 0x00>;
		hw_lm36923,lcdkit-bl-ic-bias-enable-cmd = <0x01 0x00 0x00 0x00>;
		hw_lm36923,lcdkit-bl-ic-led-open-short-test = <1>;
		hw_lm36923,lcdkit-bl-ic-num-of-led = <3>;
		hw_lm36923,lcdkit-bl-ic-brt-ctrl-cmd = <0x01 0x11 0x00 0xff>;
		hw_lm36923,lcdkit-bl-ic-fault-ctrl-cmd = <0x01 0x1e 0x00 0xff>;
		hw_lm36923,lcdkit-bl-ic-hidden-reg-surpport = <0>;
		hw_lm36923,lcdkit-bl-ic-sec-reg-enable-cmd = <0x00 0x00 0x00 0x00>;
		hw_lm36923,lcdkit-bl-ic-sec-reg-disable-cmd = <0x00 0x00 0x00 0x00>;
		hw_lm36923,lcdkit-bl-ic-hidden-reg-cmd = <0x00 0x00 0x00 0x00>;
		hw_lm36923,lcdkit-bl-ic-hidden-reg-val-mask = <0>;
		hw_lm36923,lcdkit-bl-ic-suspend-disbright-support = <0>;
		hw_lm36923,lcdkit-bl-ic-bl-wq-support = <0>;
		hw_lm36923,lcdkit-bl-ic-bl-enahnce-support = <0>;
		hw_lm36923,lcdkit-bl-ic-pull-down-boost-support = <0>;
		hw_lm36923,lcdkit-bl-ic-pull-down-boost-delay = <0>;
		hw_lm36923,lcdkit-bl-ic-bl-lowpower-delay = <0>;
		hw_lm36923,lcdkit-bl-ic-bl-normal-level = <0>;
		hw_lm36923,lcdkit-bl-ic-bl-enhance-level = <0>;
		hw_lm36923,lcdkit-bl-ic-bl-enhance-hrdtimer-time = <0>;
		hw_lm36923,lcdkit-bl-ic-bl-normal-ovp-cmd = <0x00 0x00 0x00 0x00>;
		hw_lm36923,lcdkit-bl-ic-bl-normal-cur-ramp-cmd = <0x00 0x00 0x00 0x00>;
		hw_lm36923,lcdkit-bl-ic-bl-normal-boost-cur-cmd = <0x00 0x00 0x00 0x00>;
		hw_lm36923,lcdkit-bl-ic-bl-normal-sink-cmd = <0x00 0x00 0x00 0x00>;
		hw_lm36923,lcdkit-bl-ic-bl-enhance-ovp-cmd = <0x00 0x00 0x00 0x00>;
		hw_lm36923,lcdkit-bl-ic-bl-enhance-cur-ramp-cmd = <0x00 0x00 0x00 0x00>;
		hw_lm36923,lcdkit-bl-ic-bl-enhance-boost-cur-cmd = <0x00 0x00 0x00 0x00>;
		hw_lm36923,lcdkit-bl-ic-bl-enhance-sink-cmd = <0x00 0x00 0x00 0x00>;
		hw_lm36923,lcdkit-bl-ovp-bit = <0>;
		hw_lm36923,lcdkit-bl-ocp-bit = <0>;
		hw_lm36923,lcdkit-bl-tsd-bit = <0>;
		hw_mp3313,lcdkit-bl-ic-level = <2047>;
		hw_mp3313,lcdkit-bl-ic-ctrl-mode = <0>;
		hw_mp3313,lcdkit-bl-ic-type = <0>;
		hw_mp3313,lcdkit-bl-ic-before-init-delay = <0>;
		hw_mp3313,lcdkit-bl-ic-init-delay = <0>;
		hw_mp3313,lcdkit-bl-ic-ovp-check = <1>;
		hw_mp3313,lcdkit-bl-ic-fake-lcd-ovp-check = <0>;
		hw_mp3313,lcdkit-bl-ic-init-cmd = <0x01 0x11 0x82 0xff
						0x01 0x13 0x7a 0xff
						0x01 0x15 0x00 0xff
						0x01 0x16 0x00 0xff
						0x01 0x1e 0x4a 0xff
						0x01 0x10 0x0F 0x0f>;
		hw_mp3313,lcdkit-bl-ic-num-of-init-cmd = <0x06>;
		hw_mp3313,lcdkit-bl-ic-bl-lsb-reg-cmd = <0x03 0x18 0x02 0x07>;
		hw_mp3313,lcdkit-bl-ic-bl-msb-reg-cmd = <0x08 0x19 0x66 0xff>;
		hw_mp3313,lcdkit-bl-ic-bl-enable-cmd = <0x01 0x10 0x0f 0x0f>;
		hw_mp3313,lcdkit-bl-ic-bl-disable-cmd = <0x01 0x10 0x00 0xff>;
		hw_mp3313,lcdkit-bl-ic-disable-device-cmd = <0x01 0x10 0x00 0xff>;
		hw_mp3313,lcdkit-bl-ic-fault-flag-cmd = <0x01 0x1f 0x00 0xff>;
		hw_mp3313,lcdkit-bl-ic-bias-disable-cmd = <0x01 0x00 0x00 0x00>;
		hw_mp3313,lcdkit-bl-ic-pull-down-vsp-cmd = <0x00 0x00 0x00 0x00>;
		hw_mp3313,lcdkit-bl-ic-pull-down-vsn-cmd = <0x00 0x00 0x00 0x00>;
		hw_mp3313,lcdkit-bl-ic-sec-enable-cmd = <0x00 0x00 0x00 0x00>;
		hw_mp3313,lcdkit-bl-ic-pull-down-boost-cmd = <0x00 0x00 0x00 0x00>;
		hw_mp3313,lcdkit-bl-ic-bias-enable-cmd = <0x01 0x00 0x00 0x00>;
		hw_mp3313,lcdkit-bl-ic-led-open-short-test = <0>;
		hw_mp3313,lcdkit-bl-ic-num-of-led = <3>;
		hw_mp3313,lcdkit-bl-ic-brt-ctrl-cmd = <0x01 0x11 0x00 0xff>;
		hw_mp3313,lcdkit-bl-ic-fault-ctrl-cmd = <0x01 0x1e 0x00 0xff>;
		hw_mp3313,lcdkit-bl-ic-hidden-reg-surpport = <0>;
		hw_mp3313,lcdkit-bl-ic-sec-reg-enable-cmd = <0x00 0x00 0x00 0x00>;
		hw_mp3313,lcdkit-bl-ic-sec-reg-disable-cmd = <0x00 0x00 0x00 0x00>;
		hw_mp3313,lcdkit-bl-ic-hidden-reg-cmd = <0x00 0x00 0x00 0x00>;
		hw_mp3313,lcdkit-bl-ic-hidden-reg-val-mask = <0>;
		hw_mp3313,lcdkit-bl-ic-suspend-disbright-support = <0>;
		hw_mp3313,lcdkit-bl-ic-bl-wq-support = <0>;
		hw_mp3313,lcdkit-bl-ic-bl-enahnce-support = <0>;
		hw_mp3313,lcdkit-bl-ic-pull-down-boost-support = <0>;
		hw_mp3313,lcdkit-bl-ic-pull-down-boost-delay = <0>;
		hw_mp3313,lcdkit-bl-ic-bl-lowpower-delay = <0>;
		hw_mp3313,lcdkit-bl-ic-bl-normal-level = <0>;
		hw_mp3313,lcdkit-bl-ic-bl-enhance-level = <0>;
		hw_mp3313,lcdkit-bl-ic-bl-enhance-hrdtimer-time = <0>;
		hw_mp3313,lcdkit-bl-ic-bl-normal-ovp-cmd = <0x00 0x00 0x00 0x00>;
		hw_mp3313,lcdkit-bl-ic-bl-normal-cur-ramp-cmd = <0x00 0x00 0x00 0x00>;
		hw_mp3313,lcdkit-bl-ic-bl-normal-boost-cur-cmd = <0x00 0x00 0x00 0x00>;
		hw_mp3313,lcdkit-bl-ic-bl-normal-sink-cmd = <0x00 0x00 0x00 0x00>;
		hw_mp3313,lcdkit-bl-ic-bl-enhance-ovp-cmd = <0x00 0x00 0x00 0x00>;
		hw_mp3313,lcdkit-bl-ic-bl-enhance-cur-ramp-cmd = <0x00 0x00 0x00 0x00>;
		hw_mp3313,lcdkit-bl-ic-bl-enhance-boost-cur-cmd = <0x00 0x00 0x00 0x00>;
		hw_mp3313,lcdkit-bl-ic-bl-enhance-sink-cmd = <0x00 0x00 0x00 0x00>;
		hw_mp3313,lcdkit-bl-ovp-bit = <0>;
		hw_mp3313,lcdkit-bl-ocp-bit = <0>;
		hw_mp3313,lcdkit-bl-tsd-bit = <0>;
    };
};