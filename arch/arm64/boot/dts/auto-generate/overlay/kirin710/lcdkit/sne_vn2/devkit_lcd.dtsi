/*---------------------------------------------------------------------------
 * This file is autogenerated file using huawei LCD parser. Please do not edit it.
 * Update input XML file to add a new entry or update variable in this file
 * Parser location: vendor/huawei/chipset_common/devkit/lcdkit/tools 
 *---------------------------------------------------------------------------*/


/include/ "sne_vn2_auo_otm1901a_5p2_1080p_video_default_1.dtsi"
/include/ "sne_vn2_boe_ft8719_6p3_1080p_video.dtsi"
/include/ "sne_vn2_boe_td4320_6p3_1080p_video.dtsi"
/include/ "sne_vn2_dpt_ft8719_6p3_1080p_video.dtsi"
/include/ "sne_vn2_dsbj_ft8719_6p3_1080p_video.dtsi"
/include/ "sne_vn2_tm_ft8719_6p3_1080p_video.dtsi"
/include/ "sne_vn2_tm_td4320_6p3_1080p_video.dtsi"
/include/ "sne_vn2_tm_td4330_6p3_1080p_video.dtsi"