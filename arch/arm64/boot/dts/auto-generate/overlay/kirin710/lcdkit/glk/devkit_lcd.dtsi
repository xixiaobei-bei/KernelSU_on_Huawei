/*---------------------------------------------------------------------------
 * This file is autogenerated file using huawei LCD parser. Please do not edit it.
 * Update input XML file to add a new entry or update variable in this file
 * Parser location: vendor/huawei/chipset_common/devkit/lcdkit/tools 
 *---------------------------------------------------------------------------*/


/include/ "glk_auo_otm1901a_5p2_1080p_video_default_1.dtsi"
/include/ "glk_auo_td4320_6p4_1080p_video.dtsi"
/include/ "glk_boe_nt36682a_6p4_1080p_video.dtsi"
/include/ "glk_boe_td4320_6p4_1080p_video.dtsi"
/include/ "glk_ctc_nt36682a_6p4_1080p_video.dtsi"
/include/ "glk_tm_nt36682a_6p4_1080p_video.dtsi"
/include/ "glk_tm_td4320_6p4_1080p_video.dtsi"