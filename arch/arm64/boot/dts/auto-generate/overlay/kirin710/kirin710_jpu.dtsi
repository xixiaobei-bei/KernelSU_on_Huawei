/*
 * Hisilicon Ltd. hi3xxxASIC SoC
 *
 * Copyright (C) 2013 Hisilicon Technologies CO., Ltd.
 *
 * This program is free software; you can redistribute it and/or modify
 * it under the terms of the GNU General Public License version 2 as
 * publishhed by the Free Software Foundation.
 */
/ {
	jpu@E8401000 {
		compatible = "hisilicon,hisijpu";
		fpga_flag = <1>;
		// JPU decoder Base; TOP base; CVDR base; smmu base;  media1 crg;PERI_CRG,PMCTRL,SCtrl
		reg = <0x0 0xE8301000 0x0 0x1000>, <0x0 0xE8304000 0x0 0x1000>, <0x0 0xE8302000 0x0 0x1000>, <0x0 0xE8320000 0x0 0x20000>, <0x0 0xE87FF000 0x0 0x1000>, <0x0 0xFFF35000 0x0 0x1000>, <0x0 0xFFF31000 0x0 0x1000>,<0x0 0xFFF0A000 0x0 0x1000>;
		// JPU irq
		interrupts = <0 302 4>, <0 301 4>, <0 306 4>;
		interrupt-names = "JPU_ERR", "JPU_DONE", "JPU_OTHER";
		jpu-regulator-supply = <&ispsubsys>;
		//isp_axim_clk same to aclk_isp, isp_apbm_clk same to clk_ispa7cfg,  jpg_func_clk
		clocks = <&aclk_gate_isp>, <&clk_gate_ispcpu>, <&clk_gate_ispfunc>;
		clock-names = "aclk_isp", "clk_ispcpu", "clk_ispfunc";
		status = "ok";
	};
};

