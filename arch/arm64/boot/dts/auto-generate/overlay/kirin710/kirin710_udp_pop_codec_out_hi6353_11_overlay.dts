/**
 * Copyright (C) 2014 Hisilicon Ltd.
 *
 *  This program is free software; you can redistribute it and/or modify
 *  it under the terms of the GNU General Public License version 2 as
 *  publishhed by the Free Software Foundation.
 */

/dts-v1/;
/plugin/;
/include/ "kirin710_udp_pop_codec_out_default_10_overlay.dtsi"
/include/ "kirin710_udp_pop_codec_out_hi6353_11_pin.dtsi"
/include/ "kirin710_udp_pop_codec_out_hi6353_11_modem_pin.dtsi"

/ {
    board_id = <7011>;
};

	&rootparam{
		hisi,boardid = <7 0 1 1>;
		hisi,boardname = "kirin710_udp_pop_codec_out_hi6353_11";
		hisi,product_id = <0x38F5FC01>;
	};
