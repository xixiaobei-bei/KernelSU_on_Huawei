/* DO NOT EDIT - Automatically generated by python */
		&SCUDATL_3650_68k_4400 {
			fcc = <3650>;
			default_rbatt_mohm = <100>;
			identify_type = "id_volt";
			id_identify_min = <1759>;
			id_identify_max = <2281>;
			id_voltage_min = <1956>;
			id_voltage_max = <2135>;
			vbat_max = <4400>;
			temp_para = 
						"-32767","0","-1","0","4100","0",
						"0","5","-1","365","4400","0",
						"5","10","-1","1095","4400","3",
						"10","45","-1","-1","4400","3",
						"45","50","-1","1277","4100","3",
						"50","32767","-1","0","4100","0";
			vbat_para = 
						"-32767","3400","-1","820","0",
						"3400","32767","-1","-1","0";
			segment_para = 
						"-32767","4150","3650","4208","50",
						"4150","4450","2555","4400","0";
			batt_brand = "SCUDATL";
			fcc_temp = <3731 3716 3716 3754 3729 3697>;
			fcc_sf_x = <0 100 200 300 400 500 600 700 800 1000 1500>;
			fcc_sf_y = <100 96 94 92 90 88 87 84 81 75 50>;
			fcc_sf_cols = <11>;
			pc_sf_rows = <1>;
			pc_sf_cols = <1>;
			pc_sf_row_entries = <0>;
			pc_sf_percent = <100>;
			pc_sf_sf = <100>;
			rbatt_sf_rows = <28>;
			rbatt_sf_cols = <6>;
			rbatt_sf_percent = <100 95 90 85 80 75 70 65 60 55 50 45 40 35 30 25 20 15 10 9 8 7 6 5 4 3 2 1>;
			rbatt_sf_sf = <
			               1895 1146 535 161 143 137
			               1893 1146 535 161 143 137
			               1775 1140 538 163 143 137
			               1674 1112 526 166 145 138
			               1593 1083 528 171 149 140
			               1556 1085 545 177 153 143
			               1414 1013 544 187 158 146
			               1390 951 516 198 164 151
			               1383 950 490 203 172 156
			               1373 937 464 169 154 144
			               1385 937 459 158 143 139
			               1420 968 468 161 144 140
			               1467 1017 483 167 149 143
			               1520 1080 526 173 155 148
			               1581 1157 577 175 155 150
			               1654 1246 639 169 146 141
			               1749 1341 712 166 144 141
			               1881 1446 809 167 145 140
			               2560 1341 694 166 147 142
			               2823 1513 745 167 147 143
			               3067 1674 818 172 149 146
			               3338 1864 900 175 151 146
			               3634 2066 1007 173 151 148
			               3900 2292 1124 172 150 143
			               4259 2494 1233 177 148 145
			               4752 2752 1413 186 153 147
			               5624 3208 1750 220 161 149
			               7307 4059 2335 457 182 155
			              >;
			pc_temp_ocv_rows = <29>;
			pc_temp_ocv_cols = <6>;
			pc_temp_ocv_percent = <100 95 90 85 80 75 70 65 60 55 50 45 40 35 30 25 20 15 10 9 8 7 6 5 4 3 2 1>;
			pc_temp_ocv_ocv = <
			                   4387 4383 4383 4381 4377 4373
			                   4290 4298 4306 4312 4307 4302
			                   4221 4232 4244 4252 4247 4242
			                   4162 4173 4184 4194 4189 4185
			                   4106 4118 4130 4138 4133 4129
			                   4058 4073 4081 4084 4080 4076
			                   3972 4003 4024 4035 4031 4028
			                   3926 3941 3968 3986 3985 3983
			                   3888 3903 3922 3943 3943 3942
			                   3851 3864 3877 3889 3891 3889
			                   3824 3830 3843 3853 3854 3853
			                   3807 3809 3817 3828 3829 3828
			                   3793 3797 3797 3808 3809 3807
			                   3779 3786 3787 3791 3792 3790
			                   3765 3776 3778 3776 3775 3772
			                   3750 3765 3767 3759 3753 3742
			                   3734 3747 3750 3739 3733 3720
			                   3718 3722 3722 3712 3708 3696
			                   3696 3694 3692 3690 3683 3672
			                   3691 3690 3688 3688 3682 3670
			                   3685 3686 3685 3687 3681 3669
			                   3677 3682 3681 3683 3678 3667
			                   3666 3675 3676 3675 3673 3662
			                   3644 3662 3663 3650 3658 3644
			                   3609 3633 3630 3606 3621 3607
			                   3554 3582 3577 3546 3569 3556
			                   3475 3510 3502 3463 3498 3489
			                   3347 3400 3388 3339 3394 3388
			                   3200 3200 3200 3200 3200 3200
			                  >;
		};
