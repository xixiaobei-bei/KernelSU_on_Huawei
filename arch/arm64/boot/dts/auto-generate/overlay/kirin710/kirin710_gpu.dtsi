/{
    gpu: mali@E82C0000 {
        compatible = "arm,malit6xx", "arm,mali-midgard";
        #cooling-cells = <3>; /* min followed by max */
        gpu_outstanding = <0x0>;
        reg = <0x0 0xE82C0000 0x0 0x4000>;
        interrupts = <0 258 4 0 259 4 0 260 4>;
        interrupt-names = "JOB", "MMU", "GPU";
        clocks = <&clk_g3d>;
        gpu-supply = <&g3d>;
        operating-points = <
        /* <frequency> <voltage>*/
        413000	800000
        490000	800000
        567000	800000
        644000	900000
        682000	900000
        749000	900000
        826000	1000000
        903000	1000000
        999000	1100000
        >;
        system-coherency=<0>;
        fhss = <
        /* <DeviceID> <CaseID>*/
        4	644000
        5	749000
        >;
    };
};
