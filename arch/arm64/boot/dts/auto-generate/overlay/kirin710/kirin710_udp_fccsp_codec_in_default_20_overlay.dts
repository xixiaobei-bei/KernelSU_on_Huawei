/**
 * Copyright (C) 2014 Hisilicon Ltd.
 *
 *  This program is free software; you can redistribute it and/or modify
 *  it under the terms of the GNU General Public License version 2 as
 *  publishhed by the Free Software Foundation.
 */

/dts-v1/;
/plugin/;
/include/ "kirin710_udp_default_overlay.dtsi"
/include/ "kirin710_udp_fccsp_codec_in_default_20_pin.dtsi"
/include/ "kirin710_udp_fccsp_codec_in_default_20_modem_pin.dtsi"

/ {
    board_id = <7020>;
};

	&rootparam{
		hisi,boardid = <7 0 2 0>;
		hisi,boardname = "kirin710_udp_fccsp_codec_in_default_20";
	};
