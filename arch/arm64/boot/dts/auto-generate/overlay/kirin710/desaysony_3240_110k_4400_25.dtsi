/* DO NOT EDIT - Automatically generated by python */
		&desaysony_3240_110k_4400_25 {
			fcc = <3240>;
			default_rbatt_mohm = <100>;
			identify_type = "id_volt";
			id_identify_min = <2281>;
			id_identify_max = <2786>;
			id_voltage_min = <2426>;
			id_voltage_max = <2631>;
			vbat_max = <4400>;
			temp_para = 
						"-32767","0","-1","0","4100","0",
						"0","5","-1","324","4400","0",
						"5","10","-1","972","4400","3",
						"10","45","-1","-1","4400","3",
						"45","50","-1","1134","4100","3",
						"50","32767","-1","0","4100","0";
			vbat_para = 
						"-32767","3400","-1","820","0",
						"3400","32767","-1","-1","0";
			segment_para = 
						"-32767","4150","3240","4208","50",
						"4150","4450","2268","4400","0";
			batt_brand = "desaysony";
			fcc_temp = <3253 3251 3265 3293 3281 3259>;
			fcc_sf_x = <0 100 200 300 400 500 600 700 800 1000 1500>;
			fcc_sf_y = <100 96 94 92 90 88 87 84 81 75 50>;
			fcc_sf_cols = <11>;
			pc_sf_rows = <1>;
			pc_sf_cols = <1>;
			pc_sf_row_entries = <0>;
			pc_sf_percent = <100>;
			pc_sf_sf = <100>;
			rbatt_sf_rows = <28>;
			rbatt_sf_cols = <6>;
			rbatt_sf_percent = <100 95 90 85 80 75 70 65 60 55 50 45 40 35 30 25 20 15 10 9 8 7 6 5 4 3 2 1>;
			rbatt_sf_sf = <
			               1446 647 377 144 116 106
			               1455 650 380 145 116 106
			               1468 658 387 148 118 106
			               1453 661 395 152 120 107
			               1481 663 407 157 123 108
			               1466 677 415 165 127 111
			               1440 662 413 174 132 114
			               1448 653 399 182 141 120
			               1456 662 393 171 137 118
			               1473 664 393 152 123 109
			               1512 670 395 148 118 106
			               1571 680 400 151 119 107
			               1636 704 412 156 122 109
			               1712 742 434 161 127 112
			               1802 790 463 161 125 110
			               1931 843 492 160 121 107
			               2146 918 529 162 122 109
			               2585 1087 603 164 123 110
			               4654 1303 608 160 124 111
			               5376 1415 638 164 125 112
			               6264 1575 686 169 126 112
			               7448 1809 759 173 127 115
			               9160 2173 850 176 129 115
			               11982 2688 978 173 128 111
			               19093 3535 1165 194 130 116
			               33721 5410 1482 265 167 135
			               52220 10865 2089 396 209 159
			               83153 23924 3180 498 207 190
			              >;
			pc_temp_ocv_rows = <29>;
			pc_temp_ocv_cols = <6>;
			pc_temp_ocv_percent = <100 95 90 85 80 75 70 65 60 55 50 45 40 35 30 25 20 15 10 9 8 7 6 5 4 3 2 1>;
			pc_temp_ocv_ocv = <
			                   4361 4360 4357 4349 4343 4336
			                   4276 4288 4289 4284 4280 4273
			                   4209 4226 4228 4225 4221 4215
			                   4141 4165 4168 4168 4164 4158
			                   4090 4106 4112 4112 4109 4104
			                   4031 4053 4058 4060 4058 4053
			                   3969 3996 4004 4012 4011 4007
			                   3919 3944 3951 3966 3967 3964
			                   3876 3903 3907 3918 3920 3918
			                   3838 3866 3870 3875 3877 3874
			                   3809 3833 3838 3844 3845 3842
			                   3786 3804 3811 3820 3821 3818
			                   3764 3782 3790 3801 3802 3799
			                   3745 3766 3774 3784 3785 3782
			                   3726 3750 3761 3767 3765 3758
			                   3707 3732 3744 3747 3742 3730
			                   3685 3708 3721 3726 3721 3708
			                   3660 3676 3686 3695 3692 3680
			                   3617 3643 3649 3666 3663 3652
			                   3604 3634 3643 3661 3659 3647
			                   3590 3623 3636 3655 3653 3642
			                   3571 3611 3628 3647 3646 3636
			                   3551 3598 3617 3635 3634 3623
			                   3528 3579 3599 3607 3608 3595
			                   3502 3548 3568 3563 3567 3554
			                   3472 3499 3517 3510 3516 3503
			                   3416 3431 3451 3447 3451 3437
			                   3302 3336 3356 3358 3358 3345
			                   3200 3200 3200 3200 3200 3200
			                  >;
		};
