/* DO NOT EDIT - Automatically generated by python */
		&scudatl_3240_39k_4400_25 {
			fcc = <3240>;
			default_rbatt_mohm = <100>;
			identify_type = "id_volt";
			id_identify_min = <1235>;
			id_identify_max = <1759>;
			id_voltage_min = <1420>;
			id_voltage_max = <1562>;
			vbat_max = <4400>;
			temp_para = 
						"-32767","0","-1","0","4100","0",
						"0","5","-1","324","4400","0",
						"5","10","-1","972","4400","3",
						"10","45","-1","-1","4400","3",
						"45","50","-1","1134","4100","3",
						"50","32767","-1","0","4100","0";
			vbat_para = 
						"-32767","3400","-1","820","0",
						"3400","32767","-1","-1","0";
			segment_para = 
						"-32767","4150","3240","4208","50",
						"4150","4450","2268","4400","0";
			batt_brand = "scudatl";
			fcc_temp = <3188 3183 3175 3183 3174 3147>;
			fcc_sf_x = <0 100 200 300 400 500 600 700 800 1000 1500>;
			fcc_sf_y = <100 96 94 92 90 88 87 84 81 75 50>;
			fcc_sf_cols = <11>;
			pc_sf_rows = <1>;
			pc_sf_cols = <1>;
			pc_sf_row_entries = <0>;
			pc_sf_percent = <100>;
			pc_sf_sf = <100>;
			rbatt_sf_rows = <28>;
			rbatt_sf_cols = <6>;
			rbatt_sf_percent = <100 95 90 85 80 75 70 65 60 55 50 45 40 35 30 25 20 15 10 9 8 7 6 5 4 3 2 1>;
			rbatt_sf_sf = <
			               2024 918 425 130 106 96
			               1988 912 422 130 106 96
			               1848 894 412 131 107 97
			               1726 875 406 133 109 98
			               1692 863 410 137 111 99
			               1619 876 419 143 115 101
			               1509 828 429 152 120 104
			               1494 787 397 164 128 109
			               1476 790 377 163 130 112
			               1472 778 364 133 111 99
			               1498 780 360 127 106 97
			               1545 798 362 129 107 98
			               1600 837 368 134 110 100
			               1664 889 386 138 115 103
			               1739 953 412 138 116 102
			               1831 1030 444 133 107 98
			               1957 1125 481 132 107 98
			               2149 1273 538 135 108 99
			               2562 1442 610 138 111 99
			               3270 1292 500 138 112 104
			               3773 1443 526 137 110 104
			               4272 1632 559 138 112 104
			               4823 1850 617 142 113 102
			               5462 2118 706 141 110 100
			               6341 2496 756 142 111 100
			               7412 2936 841 146 112 102
			               9085 3755 1062 153 116 102
			               14332 5755 1629 204 124 105
			              >;
			pc_temp_ocv_rows = <29>;
			pc_temp_ocv_cols = <6>;
			pc_temp_ocv_percent = <100 95 90 85 80 75 70 65 60 55 50 45 40 35 30 25 20 15 10 9 8 7 6 5 4 3 2 1>;
			pc_temp_ocv_ocv = <
			                   4363 4362 4359 4351 4346 4339
			                   4280 4293 4295 4294 4289 4283
			                   4214 4232 4236 4237 4233 4227
			                   4152 4174 4180 4181 4177 4171
			                   4108 4119 4127 4126 4123 4118
			                   4049 4072 4077 4075 4072 4067
			                   3971 4006 4023 4027 4025 4021
			                   3927 3948 3964 3980 3980 3977
			                   3886 3909 3919 3935 3935 3933
			                   3851 3871 3880 3884 3885 3883
			                   3828 3839 3848 3852 3853 3852
			                   3811 3816 3822 3828 3828 3827
			                   3797 3800 3802 3808 3808 3806
			                   3784 3788 3788 3791 3791 3789
			                   3771 3778 3779 3775 3773 3768
			                   3755 3765 3768 3757 3750 3738
			                   3738 3747 3750 3738 3729 3717
			                   3721 3720 3721 3711 3704 3690
			                   3697 3697 3693 3687 3681 3670
			                   3688 3690 3689 3686 3679 3667
			                   3679 3684 3686 3684 3677 3666
			                   3668 3677 3681 3680 3674 3662
			                   3652 3664 3671 3672 3666 3653
			                   3627 3643 3653 3649 3645 3629
			                   3591 3613 3621 3607 3606 3589
			                   3538 3563 3567 3553 3554 3538
			                   3470 3490 3495 3479 3486 3471
			                   3372 3385 3391 3375 3387 3373
			                   3200 3200 3200 3200 3200 3200
			                  >;
		};
