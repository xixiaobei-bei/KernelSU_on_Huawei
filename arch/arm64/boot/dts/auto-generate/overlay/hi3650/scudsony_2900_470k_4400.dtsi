/* DO NOT EDIT - Automatically generated by python */
/ {
		scudsony_2900_470k_4400:scudsony_2900_470k_4400 {
			fcc = <2900>;
			default_rbatt_mohm = <100>;
			id_identify_min = <3312>;
			id_identify_max = <3767>;
			id_voltage_min = <3457>;
			id_voltage_max = <3696>;
			vbat_max = <4400>;
			temp_para = 
						"-32767","0","-1","0","4100","0",
						"0","5","-1","290","4400","0",
						"5","10","-1","870","4400","3",
						"10","45","-1","-1","4400","3",
						"45","50","-1","1015","4100","3",
						"50","32767","-1","0","4100","0";
			vbat_para = 
						"-32767","3400","-1","820","0",
						"3400","32767","-1","-1","0";
			segment_para = 
						"-32767","4150","2900","4208","50",
						"4150","4450","2030","4400","0";
			batt_brand = "scudsony";
			fcc_temp = <2976 2965 2976 3008 3000 2987>;
			fcc_sf_x = <0 100 200 300 400 500>;
			fcc_sf_y = <100 96 94 92 90 88>;
			fcc_sf_cols = <6>;
			pc_sf_rows = <1>;
			pc_sf_cols = <1>;
			pc_sf_row_entries = <0>;
			pc_sf_percent = <100>;
			pc_sf_sf = <100>;
			rbatt_sf_rows = <28>;
			rbatt_sf_cols = <6>;
			rbatt_sf_percent = <100 95 90 85 80 75 70 65 60 55 50 45 40 35 30 25 20 15 10 9 8 7 6 5 4 3 2 1>;
			rbatt_sf_sf = <
			               1911 969 513 181 124 104
			               1910 970 513 181 124 104
			               1889 989 530 184 126 105
			               1854 1000 542 189 127 106
			               1824 1005 555 194 129 107
			               1776 999 567 202 133 109
			               1753 971 568 212 139 112
			               1735 957 558 223 146 116
			               1741 953 531 214 146 118
			               1766 963 519 186 130 108
			               1818 985 522 178 123 106
			               1886 1043 539 180 124 106
			               1968 1116 573 185 127 107
			               2078 1209 622 191 131 110
			               2226 1327 689 194 130 110
			               2419 1490 777 194 126 107
			               2715 1727 902 202 127 109
			               3403 2078 1119 218 130 110
			               7399 3182 1280 206 131 109
			               8488 3542 1444 213 131 110
			               9874 4083 1642 220 134 112
			               11680 4732 1891 228 135 114
			               15629 5609 2258 238 136 115
			               27963 6837 2708 252 135 112
			               59796 8715 3374 257 139 115
			               119542 13030 4367 285 146 116
			               215155 31595 6404 336 154 122
			               168344 74543 12244 439 171 126
			              >;
			pc_temp_ocv_rows = <29>;
			pc_temp_ocv_cols = <6>;
			pc_temp_ocv_percent = <100 95 90 85 80 75 70 65 60 55 50 45 40 35 30 25 20 15 10 9 8 7 6 5 4 3 2 1>;
			pc_temp_ocv_ocv = <
			                   4382 4380 4377 4368 4363 4359
			                   4277 4289 4295 4299 4297 4294
			                   4198 4219 4230 4239 4238 4235
			                   4129 4157 4170 4180 4180 4178
			                   4066 4098 4112 4124 4125 4123
			                   4004 4042 4058 4071 4072 4071
			                   3952 3982 4006 4022 4024 4022
			                   3905 3931 3956 3976 3979 3978
			                   3867 3887 3906 3928 3932 3933
			                   3836 3850 3864 3880 3885 3885
			                   3812 3820 3831 3847 3851 3851
			                   3790 3800 3806 3822 3826 3826
			                   3769 3783 3789 3801 3806 3805
			                   3749 3768 3774 3784 3788 3788
			                   3731 3750 3759 3767 3768 3764
			                   3711 3730 3742 3747 3744 3734
			                   3688 3705 3716 3724 3721 3711
			                   3663 3672 3681 3693 3694 3685
			                   3622 3632 3636 3663 3665 3656
			                   3610 3620 3628 3659 3661 3653
			                   3598 3610 3619 3653 3656 3648
			                   3581 3599 3609 3645 3649 3641
			                   3560 3587 3598 3634 3638 3629
			                   3532 3570 3582 3614 3613 3603
			                   3494 3544 3554 3575 3572 3562
			                   3427 3500 3505 3521 3518 3509
			                   3335 3427 3437 3451 3448 3442
			                   3262 3326 3339 3353 3351 3347
			                   3200 3200 3200 3200 3200 3200
			                  >;
		};
};
