/* DO NOT EDIT - Automatically generated by python */
/ {
		scudatl_3300_68k_4400:scudatl_3300_68k_4400 {
			fcc = <3300>;
			default_rbatt_mohm = <100>;
			id_identify_min = <1759>;
			id_identify_max = <2281>;
			id_voltage_min = <1956>;
			id_voltage_max = <2135>;
			vbat_max = <4400>;
			temp_para = 
						"-32767","0","-1","0","4100","0",
						"0","5","-1","330","4400","0",
						"5","10","-1","990","4400","3",
						"10","45","-1","-1","4400","3",
						"45","50","-1","1155","4100","3",
						"50","32767","-1","0","4100","0";
			vbat_para = 
						"-32767","3400","-1","820","0",
						"3400","32767","-1","-1","0";
			segment_para = 
						"-32767","4150","3300","4208","50",
						"4150","4450","2310","4400","0";
			batt_brand = "scudatl";
			fcc_temp = <3451 3449 3447 3463 3452 3428>;
			fcc_sf_x = <0 100 200 300 400 500>;
			fcc_sf_y = <100 96 94 92 90 88>;
			fcc_sf_cols = <6>;
			pc_sf_rows = <1>;
			pc_sf_cols = <1>;
			pc_sf_row_entries = <0>;
			pc_sf_percent = <100>;
			pc_sf_sf = <100>;
			rbatt_sf_rows = <28>;
			rbatt_sf_cols = <6>;
			rbatt_sf_percent = <100 95 90 85 80 75 70 65 60 55 50 45 40 35 30 25 20 15 10 9 8 7 6 5 4 3 2 1>;
			rbatt_sf_sf = <
			               1837 899 421 141 117 106
			               1836 899 421 141 117 106
			               1732 905 422 142 117 107
			               1633 902 420 145 119 108
			               1576 891 429 149 122 110
			               1542 937 451 155 125 112
			               1338 836 476 167 131 115
			               1330 778 415 182 138 119
			               1321 783 397 187 152 129
			               1314 771 378 150 128 113
			               1321 775 376 138 116 107
			               1360 819 373 139 116 109
			               1417 884 379 142 120 111
			               1475 957 407 145 124 114
			               1558 1047 443 145 125 116
			               1638 1162 497 143 116 107
			               1727 1296 561 139 115 106
			               1844 1449 643 142 116 107
			               1896 1384 621 140 115 109
			               1913 1384 549 139 115 108
			               1964 1553 582 141 117 110
			               2033 1759 632 142 117 110
			               2144 1990 704 143 119 111
			               2279 2269 786 143 119 108
			               2550 2560 879 143 118 109
			               2952 2955 1019 148 119 111
			               3550 3514 1279 164 124 112
			               4438 4492 1787 236 139 130
			              >;
			pc_temp_ocv_rows = <29>;
			pc_temp_ocv_cols = <6>;
			pc_temp_ocv_percent = <100 95 90 85 80 75 70 65 60 55 50 45 40 35 30 25 20 15 10 9 8 7 6 5 4 3 2 1>;
			pc_temp_ocv_ocv = <
			                   4385 4382 4379 4372 4367 4360
			                   4288 4302 4308 4312 4308 4302
			                   4217 4240 4249 4253 4249 4245
			                   4157 4182 4191 4195 4192 4187
			                   4108 4124 4137 4139 4136 4132
			                   4066 4085 4088 4085 4082 4079
			                   3965 4004 4033 4036 4034 4030
			                   3923 3938 3962 3986 3986 3985
			                   3887 3901 3919 3942 3944 3943
			                   3854 3861 3877 3889 3890 3888
			                   3826 3828 3844 3853 3854 3854
			                   3808 3809 3817 3828 3829 3828
			                   3794 3797 3797 3808 3809 3808
			                   3779 3787 3786 3791 3792 3791
			                   3767 3775 3776 3776 3776 3773
			                   3751 3763 3766 3762 3755 3743
			                   3736 3745 3750 3742 3734 3721
			                   3721 3720 3723 3715 3708 3695
			                   3701 3696 3693 3692 3684 3672
			                   3696 3691 3690 3690 3683 3671
			                   3690 3686 3687 3689 3682 3670
			                   3684 3682 3683 3686 3680 3668
			                   3673 3675 3678 3683 3676 3664
			                   3657 3661 3665 3670 3662 3647
			                   3628 3632 3634 3634 3626 3609
			                   3582 3586 3583 3582 3576 3559
			                   3515 3517 3513 3513 3508 3492
			                   3414 3416 3414 3414 3409 3392
			                   3200 3200 3200 3200 3200 3200
			                  >;
			vol_dec1=  <16>;
			pc_temp_ocv_ocv1 = <
			                   4369 4366 4363 4356 4351 4344
			                   4276 4290 4295 4297 4293 4287
			                   4208 4229 4237 4240 4235 4230
			                   4150 4173 4181 4183 4179 4174
			                   4103 4119 4129 4127 4124 4120
			                   4053 4073 4079 4076 4073 4069
			                   3960 3994 4022 4027 4024 4021
			                   3919 3933 3956 3979 3979 3978
			                   3884 3896 3913 3933 3935 3934
			                   3851 3858 3873 3883 3884 3883
			                   3825 3826 3841 3850 3850 3850
			                   3807 3808 3815 3825 3826 3826
			                   3793 3796 3796 3806 3807 3806
			                   3779 3786 3786 3790 3791 3789
			                   3766 3775 3775 3775 3774 3770
			                   3750 3763 3766 3761 3753 3742
			                   3735 3744 3749 3741 3732 3720
			                   3720 3719 3722 3714 3707 3694
			                   3701 3695 3693 3691 3684 3672
			                   3696 3690 3689 3690 3683 3671
			                   3690 3686 3687 3688 3682 3670
			                   3683 3682 3683 3686 3679 3668
			                   3673 3674 3677 3682 3675 3662
			                   3657 3661 3664 3668 3660 3645
			                   3627 3631 3633 3632 3624 3607
			                   3581 3584 3581 3579 3573 3556
			                   3514 3515 3511 3510 3506 3489
			                   3413 3415 3413 3412 3408 3390
			                   3200 3200 3200 3200 3200 3200
			                  >;
			vol_dec2=  <48>;
			pc_temp_ocv_ocv2 = <
			                   4337 4334 4331 4324 4319 4312
			                   4254 4266 4270 4268 4262 4257
			                   4190 4209 4214 4212 4207 4202
			                   4137 4153 4160 4157 4153 4148
			                   4093 4107 4111 4105 4101 4097
			                   4027 4049 4061 4056 4052 4049
			                   3950 3975 3998 4008 4006 4004
			                   3912 3924 3943 3964 3965 3963
			                   3877 3886 3902 3916 3917 3915
			                   3846 3850 3865 3873 3873 3872
			                   3822 3822 3835 3843 3843 3843
			                   3805 3806 3811 3821 3821 3821
			                   3791 3795 3794 3802 3804 3802
			                   3777 3785 3784 3787 3788 3786
			                   3764 3773 3774 3773 3770 3765
			                   3749 3761 3764 3758 3751 3739
			                   3734 3742 3747 3738 3730 3717
			                   3720 3718 3719 3712 3705 3693
			                   3700 3694 3692 3691 3683 3672
			                   3695 3690 3689 3689 3683 3671
			                   3689 3685 3686 3688 3681 3669
			                   3682 3681 3682 3685 3679 3667
			                   3672 3673 3676 3681 3674 3660
			                   3655 3659 3662 3664 3656 3640
			                   3625 3628 3629 3626 3619 3601
			                   3578 3581 3577 3574 3568 3551
			                   3511 3512 3507 3505 3502 3484
			                   3410 3411 3409 3408 3404 3387
			                   3200 3200 3200 3200 3200 3200
			                  >;
			vol_dec3=  <192>;
			pc_temp_ocv_ocv3 = <
			                   4193 4190 4187 4180 4175 4168
			                   4162 4167 4154 4139 4131 4124
			                   4119 4119 4116 4093 4086 4080
			                   4083 4082 4073 4052 4045 4039
			                   4005 4011 4021 4009 4004 4001
			                   3945 3949 3961 3970 3968 3966
			                   3910 3913 3923 3930 3929 3926
			                   3878 3879 3887 3887 3885 3883
			                   3849 3846 3856 3856 3855 3854
			                   3825 3822 3831 3834 3834 3833
			                   3808 3807 3810 3815 3816 3815
			                   3796 3797 3795 3801 3801 3799
			                   3783 3787 3785 3787 3788 3785
			                   3771 3777 3777 3775 3773 3768
			                   3757 3767 3769 3763 3755 3743
			                   3743 3753 3757 3747 3738 3725
			                   3730 3732 3736 3726 3718 3705
			                   3716 3711 3710 3701 3693 3683
			                   3696 3690 3689 3689 3682 3671
			                   3691 3686 3686 3688 3681 3669
			                   3685 3682 3683 3686 3679 3667
			                   3677 3676 3678 3682 3675 3661
			                   3665 3666 3668 3671 3662 3647
			                   3645 3646 3647 3643 3634 3617
			                   3613 3613 3609 3602 3595 3577
			                   3565 3563 3557 3550 3546 3528
			                   3498 3496 3489 3484 3482 3462
			                   3399 3397 3392 3390 3387 3368
			                   3200 3200 3200 3200 3200 3200
			                  >;
		};
};
