/* DO NOT EDIT - Automatically generated by python */
/ {
		scudsdi_4000_470k_4400:scudsdi_4000_470k_4400 {
			fcc = <4000>;
			default_rbatt_mohm = <100>;
			id_identify_min = <3312>;
			id_identify_max = <3767>;
			id_voltage_min = <3457>;
			id_voltage_max = <3696>;
			vbat_max = <4400>;
			temp_para = 
						"-32767","0","-1","0","4100","0",
						"0","5","-1","400","4400","0",
						"5","10","-1","1200","4400","3",
						"10","45","-1","-1","4400","3",
						"45","50","-1","1400","4100","3",
						"50","32767","-1","0","4100","0";
			vbat_para = 
						"-32767","3400","-1","820","0",
						"3400","32767","-1","-1","0";
			segment_para = 
						"-32767","4150","4000","4208","50",
						"4150","4450","2800","4400","0";
			batt_brand = "scudsdi";
			fcc_temp = <4015 4012 4013 4041 4022 3992>;
			fcc_sf_x = <0 100 200 300 400 500>;
			fcc_sf_y = <100 96 94 92 90 88>;
			fcc_sf_cols = <6>;
			pc_sf_rows = <1>;
			pc_sf_cols = <1>;
			pc_sf_row_entries = <0>;
			pc_sf_percent = <100>;
			pc_sf_sf = <100>;
			rbatt_sf_rows = <28>;
			rbatt_sf_cols = <6>;
			rbatt_sf_percent = <100 95 90 85 80 75 70 65 60 55 50 45 40 35 30 25 20 15 10 9 8 7 6 5 4 3 2 1>;
			rbatt_sf_sf = <
			               1644 928 429 124 94 86
			               1641 928 429 124 94 86
			               1543 924 431 127 96 87
			               1460 916 434 130 98 88
			               1384 890 442 135 101 89
			               1331 898 466 144 106 91
			               1162 808 470 158 114 94
			               1162 729 390 163 116 98
			               1153 723 388 168 124 103
			               1151 710 373 134 113 99
			               1197 704 363 121 95 87
			               1259 748 361 122 97 88
			               1329 812 368 126 100 90
			               1404 889 402 130 104 94
			               1485 966 456 132 105 93
			               1575 1044 521 130 99 88
			               1684 1133 582 128 98 89
			               1816 1251 656 126 98 88
			               2448 1115 539 120 100 89
			               2557 1194 555 122 97 90
			               2705 1239 599 126 99 92
			               2872 1372 662 127 100 93
			               2991 1456 720 128 101 93
			               3193 1555 800 125 99 90
			               3364 1632 827 124 98 89
			               3593 1734 836 130 100 91
			               3842 1890 901 135 102 90
			               4291 2162 1017 152 108 92
			              >;
			pc_temp_ocv_rows = <29>;
			pc_temp_ocv_cols = <6>;
			pc_temp_ocv_percent = <100 95 90 85 80 75 70 65 60 55 50 45 40 35 30 25 20 15 10 9 8 7 6 5 4 3 2 1>;
			pc_temp_ocv_ocv = <
			                   4392 4388 4385 4374 4366 4359
			                   4284 4293 4305 4309 4306 4300
			                   4214 4226 4242 4250 4248 4243
			                   4158 4170 4187 4194 4191 4187
			                   4103 4113 4133 4139 4136 4132
			                   4051 4072 4085 4088 4084 4080
			                   3953 3998 4029 4042 4038 4031
			                   3913 3930 3949 3977 3981 3986
			                   3873 3892 3910 3942 3946 3944
			                   3835 3857 3874 3892 3897 3896
			                   3815 3823 3842 3855 3856 3855
			                   3801 3806 3816 3829 3829 3829
			                   3786 3793 3795 3808 3808 3807
			                   3769 3780 3783 3790 3791 3790
			                   3753 3764 3772 3776 3774 3769
			                   3738 3746 3759 3761 3755 3743
			                   3725 3730 3740 3742 3734 3721
			                   3707 3715 3715 3710 3704 3692
			                   3689 3698 3695 3689 3682 3669
			                   3680 3694 3691 3687 3680 3668
			                   3671 3688 3688 3686 3679 3667
			                   3662 3684 3684 3684 3677 3665
			                   3647 3676 3676 3679 3673 3660
			                   3629 3662 3663 3666 3661 3644
			                   3601 3636 3637 3630 3630 3609
			                   3562 3592 3594 3576 3579 3558
			                   3500 3525 3531 3501 3510 3488
			                   3401 3423 3432 3391 3408 3386
			                   3200 3200 3200 3200 3200 3200
			                  >;
			vol_dec1=  <16>;
			pc_temp_ocv_ocv1 = <
			                   4376 4372 4369 4358 4350 4343
			                   4274 4282 4293 4295 4291 4285
			                   4207 4218 4232 4238 4234 4229
			                   4151 4162 4178 4182 4178 4174
			                   4098 4108 4126 4128 4125 4120
			                   4039 4063 4078 4081 4076 4070
			                   3949 3989 4017 4028 4026 4022
			                   3909 3925 3944 3973 3976 3979
			                   3869 3889 3905 3934 3938 3936
			                   3834 3853 3870 3886 3890 3889
			                   3814 3822 3839 3851 3852 3851
			                   3800 3805 3814 3826 3827 3826
			                   3785 3792 3794 3806 3806 3805
			                   3768 3779 3782 3789 3789 3788
			                   3752 3763 3772 3775 3772 3767
			                   3737 3745 3759 3760 3753 3741
			                   3725 3729 3739 3741 3733 3719
			                   3707 3715 3715 3709 3703 3690
			                   3688 3698 3695 3688 3681 3669
			                   3680 3694 3690 3687 3680 3668
			                   3671 3687 3687 3686 3679 3667
			                   3662 3684 3684 3684 3677 3664
			                   3647 3676 3675 3679 3673 3659
			                   3628 3661 3662 3665 3660 3642
			                   3600 3634 3636 3628 3628 3607
			                   3560 3590 3593 3573 3577 3555
			                   3499 3523 3529 3499 3507 3486
			                   3400 3422 3431 3389 3406 3385
			                   3200 3200 3200 3200 3200 3200
			                  >;
			vol_dec2=  <48>;
			pc_temp_ocv_ocv2 = <
			                   4344 4340 4337 4326 4318 4311
			                   4254 4261 4269 4268 4262 4255
			                   4192 4201 4212 4213 4207 4201
			                   4137 4145 4159 4159 4154 4148
			                   4089 4099 4111 4107 4102 4097
			                   4014 4045 4064 4067 4059 4049
			                   3941 3971 3991 4002 4002 4005
			                   3902 3917 3933 3964 3965 3965
			                   3861 3882 3897 3918 3922 3920
			                   3830 3846 3863 3875 3876 3875
			                   3812 3818 3834 3844 3844 3844
			                   3798 3803 3809 3821 3821 3820
			                   3783 3791 3792 3802 3802 3801
			                   3767 3777 3781 3786 3786 3785
			                   3750 3761 3770 3773 3769 3762
			                   3737 3744 3757 3758 3751 3738
			                   3724 3728 3737 3739 3731 3717
			                   3706 3714 3713 3706 3700 3687
			                   3687 3697 3694 3688 3681 3669
			                   3679 3693 3690 3687 3680 3668
			                   3670 3687 3687 3686 3679 3666
			                   3660 3683 3682 3683 3676 3664
			                   3645 3674 3674 3678 3672 3658
			                   3626 3659 3660 3662 3656 3639
			                   3598 3632 3633 3623 3623 3602
			                   3558 3587 3589 3569 3572 3551
			                   3496 3521 3526 3495 3503 3482
			                   3398 3419 3428 3385 3403 3381
			                   3200 3200 3200 3200 3200 3200
			                  >;
			vol_dec3=  <192>;
			pc_temp_ocv_ocv3 = <
			                   4200 4196 4193 4182 4174 4167
			                   4171 4175 4173 4149 4135 4125
			                   4124 4122 4127 4104 4090 4081
			                   4082 4088 4084 4069 4055 4040
			                   4005 4027 4038 4014 4003 4002
			                   3940 3959 3957 3971 3970 3967
			                   3904 3914 3922 3938 3935 3929
			                   3866 3882 3890 3896 3894 3890
			                   3834 3848 3859 3862 3858 3856
			                   3816 3821 3834 3837 3835 3833
			                   3802 3806 3811 3818 3816 3814
			                   3789 3794 3794 3801 3800 3798
			                   3774 3783 3783 3787 3787 3784
			                   3759 3769 3774 3775 3772 3765
			                   3744 3753 3764 3763 3756 3743
			                   3732 3737 3750 3748 3739 3724
			                   3721 3723 3728 3726 3718 3704
			                   3701 3712 3707 3695 3687 3674
			                   3681 3694 3690 3687 3680 3667
			                   3673 3688 3687 3686 3678 3666
			                   3665 3685 3684 3683 3676 3664
			                   3653 3679 3677 3679 3672 3659
			                   3638 3668 3668 3668 3662 3644
			                   3618 3650 3649 3641 3640 3617
			                   3588 3619 3618 3599 3601 3577
			                   3547 3573 3574 3544 3550 3527
			                   3485 3508 3511 3471 3483 3462
			                   3390 3408 3416 3366 3388 3368
			                   3200 3200 3200 3200 3200 3200
			                  >;
		};
};
