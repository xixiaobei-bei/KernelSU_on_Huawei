/* DO NOT EDIT - Automatically generated by python */
/ {
		sunwodalg_4000_22k_4400:sunwodalg_4000_22k_4400 {
			fcc = <4000>;
			default_rbatt_mohm = <100>;
			id_identify_min = <751>;
			id_identify_max = <1235>;
			id_voltage_min = <949>;
			id_voltage_max = <1051>;
			vbat_max = <4400>;
			temp_para = 
						"-32767","0","-1","0","4100","0",
						"0","5","-1","400","4400","0",
						"5","10","-1","1200","4400","3",
						"10","45","-1","-1","4400","3",
						"45","50","-1","1400","4100","3",
						"50","32767","-1","0","4100","0";
			vbat_para = 
						"-32767","3400","-1","820","0",
						"3400","32767","-1","-1","0";
			segment_para = 
						"-32767","4150","4000","4208","50",
						"4150","4450","2800","4400","0";
			batt_brand = "sunwodalg";
			fcc_temp = <3977 3978 3978 4003 3989 3959>;
			fcc_sf_x = <0 100 200 300 400 500>;
			fcc_sf_y = <100 96 94 92 90 88>;
			fcc_sf_cols = <6>;
			pc_sf_rows = <1>;
			pc_sf_cols = <1>;
			pc_sf_row_entries = <0>;
			pc_sf_percent = <100>;
			pc_sf_sf = <100>;
			rbatt_sf_rows = <28>;
			rbatt_sf_cols = <6>;
			rbatt_sf_percent = <100 95 90 85 80 75 70 65 60 55 50 45 40 35 30 25 20 15 10 9 8 7 6 5 4 3 2 1>;
			rbatt_sf_sf = <
			               1705 952 411 101 75 65
			               1703 952 411 101 75 65
			               1585 932 416 103 77 66
			               1496 920 413 105 78 67
			               1460 907 423 110 81 69
			               1447 942 449 118 85 70
			               1283 860 478 131 92 74
			               1284 773 385 134 96 77
			               1278 779 378 135 102 83
			               1285 769 367 111 88 74
			               1307 773 364 101 76 66
			               1357 800 365 102 78 68
			               1417 850 372 104 81 71
			               1488 908 395 109 84 74
			               1575 982 432 110 83 73
			               1686 1070 477 107 78 67
			               1830 1181 535 103 76 66
			               1993 1338 630 103 76 66
			               2843 1255 545 104 79 68
			               3065 1339 578 104 79 68
			               3262 1455 623 104 79 68
			               3463 1567 679 105 79 67
			               3633 1682 734 105 79 68
			               3867 1797 785 106 78 68
			               4078 1890 822 113 81 69
			               4349 2026 866 130 84 71
			               4666 2194 925 264 93 76
			               5105 2454 1067 279 155 94
			              >;
			pc_temp_ocv_rows = <29>;
			pc_temp_ocv_cols = <6>;
			pc_temp_ocv_percent = <100 95 90 85 80 75 70 65 60 55 50 45 40 35 30 25 20 15 10 9 8 7 6 5 4 3 2 1>;
			pc_temp_ocv_ocv = <
			                   4394 4391 4389 4378 4371 4364
			                   4292 4301 4309 4320 4315 4308
			                   4221 4231 4248 4262 4257 4252
			                   4158 4173 4190 4206 4201 4196
			                   4108 4117 4137 4152 4146 4142
			                   4064 4080 4089 4101 4094 4089
			                   3963 4005 4036 4057 4048 4040
			                   3922 3931 3952 3988 3991 3995
			                   3883 3896 3913 3946 3952 3951
			                   3851 3861 3876 3898 3900 3900
			                   3826 3832 3845 3861 3861 3861
			                   3810 3812 3819 3834 3834 3833
			                   3793 3798 3799 3812 3812 3812
			                   3776 3784 3784 3794 3794 3793
			                   3757 3769 3770 3778 3775 3771
			                   3740 3753 3754 3760 3754 3744
			                   3722 3735 3735 3737 3731 3719
			                   3702 3717 3716 3706 3700 3689
			                   3678 3696 3695 3688 3680 3669
			                   3671 3688 3690 3687 3679 3668
			                   3663 3680 3683 3685 3678 3667
			                   3654 3671 3673 3681 3674 3663
			                   3640 3659 3658 3668 3666 3653
			                   3622 3643 3637 3637 3641 3628
			                   3593 3615 3605 3591 3600 3587
			                   3553 3573 3562 3533 3546 3535
			                   3491 3507 3498 3462 3475 3466
			                   3395 3405 3400 3355 3376 3366
			                   3200 3200 3200 3200 3200 3200
			                  >;
			vol_dec1=  <16>;
			pc_temp_ocv_ocv1 = <
			                   4378 4375 4373 4362 4355 4348
			                   4281 4289 4297 4305 4299 4293
			                   4212 4222 4237 4248 4243 4238
			                   4152 4164 4180 4193 4188 4183
			                   4104 4113 4129 4140 4134 4129
			                   4052 4070 4082 4093 4085 4078
			                   3959 3995 4023 4042 4035 4031
			                   3918 3928 3947 3981 3985 3986
			                   3880 3893 3908 3938 3943 3942
			                   3849 3858 3872 3892 3893 3893
			                   3825 3830 3842 3857 3857 3856
			                   3809 3811 3817 3831 3831 3831
			                   3792 3797 3798 3810 3810 3809
			                   3775 3783 3783 3792 3792 3791
			                   3757 3768 3770 3777 3773 3768
			                   3739 3752 3753 3759 3753 3742
			                   3722 3735 3734 3735 3729 3718
			                   3701 3716 3715 3704 3699 3688
			                   3678 3696 3695 3688 3680 3669
			                   3671 3687 3689 3687 3679 3668
			                   3663 3680 3682 3685 3677 3667
			                   3653 3671 3672 3680 3674 3663
			                   3639 3659 3657 3666 3665 3652
			                   3621 3642 3635 3635 3639 3625
			                   3592 3614 3604 3589 3597 3585
			                   3551 3571 3560 3530 3544 3533
			                   3491 3505 3496 3461 3473 3463
			                   3394 3404 3399 3354 3374 3365
			                   3200 3200 3200 3200 3200 3200
			                  >;
			vol_dec2=  <48>;
			pc_temp_ocv_ocv2 = <
			                   4346 4343 4341 4330 4323 4316
			                   4260 4266 4273 4275 4269 4262
			                   4194 4203 4215 4220 4214 4208
			                   4138 4147 4162 4168 4161 4156
			                   4095 4104 4114 4117 4110 4105
			                   4026 4050 4067 4077 4066 4057
			                   3950 3975 3997 4012 4012 4012
			                   3910 3919 3936 3967 3971 3970
			                   3874 3885 3899 3921 3925 3923
			                   3845 3852 3865 3880 3880 3880
			                   3822 3826 3836 3849 3849 3848
			                   3807 3809 3813 3825 3826 3825
			                   3790 3795 3795 3806 3806 3805
			                   3773 3781 3782 3789 3788 3787
			                   3755 3766 3768 3774 3770 3764
			                   3738 3751 3751 3757 3750 3738
			                   3721 3734 3733 3732 3726 3714
			                   3700 3716 3714 3702 3696 3685
			                   3677 3694 3694 3688 3680 3669
			                   3669 3686 3688 3686 3679 3668
			                   3662 3678 3681 3684 3677 3666
			                   3652 3669 3670 3679 3673 3662
			                   3637 3657 3655 3663 3661 3649
			                   3619 3640 3633 3630 3633 3620
			                   3590 3611 3601 3583 3591 3579
			                   3549 3568 3557 3525 3538 3528
			                   3488 3502 3493 3457 3468 3459
			                   3393 3402 3396 3350 3370 3361
			                   3200 3200 3200 3200 3200 3200
			                  >;
			vol_dec3=  <192>;
			pc_temp_ocv_ocv3 = <
			                   4202 4199 4197 4186 4179 4172
			                   4168 4172 4170 4145 4134 4124
			                   4124 4121 4128 4102 4091 4082
			                   4087 4091 4088 4069 4054 4042
			                   4010 4028 4039 4009 4005 4004
			                   3947 3957 3961 3968 3972 3968
			                   3910 3914 3924 3930 3931 3927
			                   3876 3882 3891 3892 3891 3888
			                   3848 3852 3861 3862 3860 3858
			                   3826 3828 3836 3838 3837 3835
			                   3811 3811 3814 3819 3819 3816
			                   3796 3799 3797 3803 3802 3801
			                   3780 3787 3785 3789 3787 3785
			                   3764 3773 3773 3775 3771 3765
			                   3747 3759 3759 3761 3754 3742
			                   3733 3744 3743 3742 3735 3723
			                   3714 3727 3726 3716 3710 3698
			                   3696 3712 3709 3692 3685 3675
			                   3671 3688 3688 3686 3678 3667
			                   3664 3680 3682 3683 3676 3665
			                   3657 3672 3673 3678 3672 3660
			                   3646 3664 3661 3665 3663 3649
			                   3630 3650 3643 3638 3641 3626
			                   3610 3630 3619 3600 3606 3593
			                   3580 3599 3586 3554 3564 3553
			                   3538 3554 3541 3498 3513 3501
			                   3477 3489 3477 3436 3447 3435
			                   3385 3392 3383 3335 3353 3345
			                   3200 3200 3200 3200 3200 3200
			                  >;
		};
};
