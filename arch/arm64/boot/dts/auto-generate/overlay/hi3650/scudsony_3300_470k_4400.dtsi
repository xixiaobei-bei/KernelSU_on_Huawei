/* DO NOT EDIT - Automatically generated by python */
/ {
		scudsony_3300_470k_4400:scudsony_3300_470k_4400 {
			fcc = <3300>;
			default_rbatt_mohm = <100>;
			id_identify_min = <3312>;
			id_identify_max = <3767>;
			id_voltage_min = <3457>;
			id_voltage_max = <3696>;
			vbat_max = <4400>;
			temp_para = 
						"-32767","0","-1","0","4100","0",
						"0","5","-1","330","4400","0",
						"5","10","-1","990","4400","3",
						"10","45","-1","-1","4400","3",
						"45","50","-1","1155","4100","3",
						"50","32767","-1","0","4100","0";
			vbat_para = 
						"-32767","3400","-1","820","0",
						"3400","32767","-1","-1","0";
			segment_para = 
						"-32767","4150","3300","4208","50",
						"4150","4450","2310","4400","0";
			batt_brand = "scudsony";
			fcc_temp = <3380 3381 3385 3414 3400 3377>;
			fcc_sf_x = <0 100 200 300 400 500>;
			fcc_sf_y = <100 96 94 92 90 88>;
			fcc_sf_cols = <6>;
			pc_sf_rows = <1>;
			pc_sf_cols = <1>;
			pc_sf_row_entries = <0>;
			pc_sf_percent = <100>;
			pc_sf_sf = <100>;
			rbatt_sf_rows = <28>;
			rbatt_sf_cols = <6>;
			rbatt_sf_percent = <100 95 90 85 80 75 70 65 60 55 50 45 40 35 30 25 20 15 10 9 8 7 6 5 4 3 2 1>;
			rbatt_sf_sf = <
			               1526 675 357 149 121 109
			               1526 676 357 149 121 109
			               1558 704 371 154 122 110
			               1541 724 380 158 125 111
			               1513 737 395 164 129 114
			               1496 772 415 172 134 116
			               1371 738 438 182 140 120
			               1359 686 418 198 148 125
			               1356 688 381 205 158 132
			               1362 689 362 173 146 124
			               1381 704 364 152 123 110
			               1425 739 372 154 126 113
			               1491 788 386 160 132 117
			               1568 852 408 165 137 121
			               1678 935 436 169 137 122
			               1793 1048 481 169 131 114
			               1950 1193 525 163 128 115
			               2218 1429 576 170 126 114
			               2453 1472 530 159 127 117
			               2520 1616 543 162 128 118
			               2595 1806 575 162 129 118
			               2779 2028 612 166 130 118
			               3015 2292 666 169 131 117
			               3308 2677 723 169 130 117
			               4053 3121 812 168 128 115
			               4971 3785 914 174 130 117
			               6470 4731 1114 209 145 120
			               8918 6469 1503 352 152 194
			              >;
			pc_temp_ocv_rows = <29>;
			pc_temp_ocv_cols = <6>;
			pc_temp_ocv_percent = <100 95 90 85 80 75 70 65 60 55 50 45 40 35 30 25 20 15 10 9 8 7 6 5 4 3 2 1>;
			pc_temp_ocv_ocv = <
			                   4387 4385 4382 4375 4370 4363
			                   4302 4313 4318 4316 4313 4308
			                   4230 4252 4260 4260 4258 4253
			                   4166 4194 4202 4204 4202 4198
			                   4109 4136 4147 4148 4147 4144
			                   4062 4088 4095 4096 4095 4092
			                   3983 4027 4046 4047 4047 4044
			                   3934 3959 3988 4003 4003 4000
			                   3894 3913 3931 3957 3959 3958
			                   3860 3872 3886 3903 3909 3907
			                   3831 3838 3852 3862 3865 3865
			                   3808 3814 3824 3835 3839 3839
			                   3788 3796 3802 3813 3817 3817
			                   3768 3782 3785 3795 3798 3797
			                   3750 3768 3772 3778 3779 3776
			                   3727 3752 3760 3761 3758 3746
			                   3703 3726 3738 3737 3732 3720
			                   3681 3685 3697 3704 3699 3689
			                   3654 3648 3662 3677 3672 3662
			                   3647 3642 3658 3675 3671 3660
			                   3640 3637 3654 3672 3668 3658
			                   3633 3632 3649 3668 3665 3654
			                   3625 3622 3642 3662 3659 3648
			                   3613 3610 3630 3650 3647 3632
			                   3589 3586 3605 3616 3615 3596
			                   3539 3539 3553 3561 3561 3542
			                   3468 3467 3481 3486 3489 3469
			                   3370 3374 3387 3386 3384 3369
			                   3200 3200 3200 3200 3200 3200
			                  >;
			vol_dec1=  <16>;
			pc_temp_ocv_ocv1 = <
			                   4371 4369 4366 4359 4354 4347
			                   4289 4300 4304 4302 4298 4293
			                   4219 4240 4247 4246 4244 4238
			                   4157 4183 4190 4191 4189 4184
			                   4102 4128 4137 4137 4135 4132
			                   4050 4078 4086 4086 4085 4081
			                   3976 4016 4036 4039 4038 4035
			                   3929 3952 3979 3995 3995 3992
			                   3890 3907 3924 3947 3950 3949
			                   3857 3868 3881 3896 3901 3900
			                   3829 3835 3849 3858 3861 3862
			                   3806 3812 3821 3832 3836 3836
			                   3787 3795 3800 3811 3815 3814
			                   3767 3781 3784 3793 3796 3796
			                   3749 3767 3771 3777 3778 3773
			                   3726 3751 3759 3760 3756 3745
			                   3702 3724 3736 3735 3731 3719
			                   3680 3684 3695 3703 3697 3687
			                   3653 3647 3661 3677 3672 3662
			                   3646 3642 3658 3674 3670 3660
			                   3640 3637 3654 3671 3668 3657
			                   3633 3631 3649 3667 3664 3654
			                   3624 3622 3641 3661 3659 3648
			                   3613 3609 3629 3649 3645 3631
			                   3587 3584 3602 3614 3612 3593
			                   3537 3537 3550 3558 3559 3539
			                   3467 3465 3479 3484 3487 3467
			                   3368 3372 3385 3384 3382 3367
			                   3200 3200 3200 3200 3200 3200
			                  >;
			vol_dec2=  <48>;
			pc_temp_ocv_ocv2 = <
			                   4339 4337 4334 4327 4322 4315
			                   4264 4274 4277 4273 4268 4262
			                   4198 4217 4221 4218 4215 4210
			                   4138 4160 4167 4165 4162 4158
			                   4089 4111 4116 4114 4111 4108
			                   4027 4058 4068 4066 4064 4060
			                   3963 3993 4016 4022 4020 4017
			                   3919 3938 3960 3980 3980 3977
			                   3882 3896 3910 3928 3933 3931
			                   3851 3859 3872 3882 3886 3886
			                   3824 3830 3841 3851 3853 3854
			                   3803 3808 3816 3827 3830 3830
			                   3783 3793 3797 3807 3810 3810
			                   3765 3779 3781 3790 3793 3792
			                   3746 3765 3770 3775 3774 3768
			                   3723 3749 3758 3757 3753 3741
			                   3701 3720 3733 3732 3728 3715
			                   3679 3681 3691 3700 3693 3684
			                   3652 3646 3660 3676 3672 3661
			                   3645 3641 3657 3674 3670 3659
			                   3638 3636 3653 3671 3667 3657
			                   3632 3630 3647 3667 3663 3653
			                   3623 3620 3640 3660 3657 3646
			                   3611 3607 3626 3645 3642 3627
			                   3584 3581 3598 3609 3607 3588
			                   3533 3533 3546 3553 3553 3534
			                   3463 3462 3475 3479 3482 3462
			                   3366 3370 3382 3380 3379 3364
			                   3200 3200 3200 3200 3200 3200
			                  >;
			vol_dec3=  <192>;
			pc_temp_ocv_ocv3 = <
			                   4195 4193 4190 4183 4178 4171
			                   4158 4156 4155 4142 4134 4128
			                   4107 4117 4112 4098 4091 4086
			                   4068 4072 4070 4057 4051 4046
			                   3995 4017 4025 4019 4014 4009
			                   3948 3958 3975 3983 3979 3975
			                   3910 3918 3928 3939 3939 3935
			                   3878 3882 3889 3896 3897 3895
			                   3849 3851 3859 3863 3864 3863
			                   3825 3826 3834 3840 3841 3841
			                   3805 3808 3812 3820 3823 3822
			                   3788 3794 3796 3804 3807 3806
			                   3770 3781 3783 3789 3792 3790
			                   3755 3769 3772 3776 3775 3769
			                   3734 3757 3762 3762 3757 3745
			                   3713 3738 3747 3742 3736 3724
			                   3693 3705 3716 3717 3712 3699
			                   3673 3668 3675 3686 3677 3670
			                   3646 3641 3656 3673 3669 3658
			                   3640 3636 3652 3670 3666 3656
			                   3634 3631 3648 3667 3663 3652
			                   3627 3623 3642 3661 3658 3647
			                   3618 3613 3631 3650 3646 3632
			                   3601 3595 3612 3623 3622 3601
			                   3569 3562 3575 3581 3581 3559
			                   3517 3512 3522 3525 3528 3506
			                   3449 3445 3455 3456 3460 3438
			                   3355 3356 3364 3362 3362 3347
			                   3200 3200 3200 3200 3200 3200
			                  >;
		};
};
