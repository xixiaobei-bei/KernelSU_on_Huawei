/* DO NOT EDIT - Automatically generated by python */
/ {
		sunwodalg_3300_200k_4350:sunwodalg_3300_200k_4350 {
			fcc = <3300>;
			default_rbatt_mohm = <100>;
			id_identify_min = <2786>;
			id_identify_max = <3312>;
			id_voltage_min = <2941>;
			id_voltage_max = <3167>;
			vbat_max = <4350>;
			temp_para = 
						"-32767","0","-1","0","4100","0",
						"0","5","-1","330","4350","0",
						"5","10","-1","990","4350","3",
						"10","45","-1","-1","4350","3",
						"45","50","-1","1155","4100","3",
						"50","32767","-1","0","4100","0";
			vbat_para = 
						"-32767","3400","-1","820","0",
						"3400","32767","-1","-1","0";
			segment_para = 
						"-32767","4150","3300","4208","50",
						"4150","4450","2310","4350","0";
			batt_brand = "sunwodalg";
			fcc_temp = <3278 3283 3278 3286 3282 3267>;
			fcc_sf_x = <0 100 200 300 400 500>;
			fcc_sf_y = <100 96 94 92 90 88>;
			fcc_sf_cols = <6>;
			pc_sf_rows = <1>;
			pc_sf_cols = <1>;
			pc_sf_row_entries = <0>;
			pc_sf_percent = <100>;
			pc_sf_sf = <100>;
			rbatt_sf_rows = <28>;
			rbatt_sf_cols = <6>;
			rbatt_sf_percent = <100 95 90 85 80 75 70 65 60 55 50 45 40 35 30 25 20 15 10 9 8 7 6 5 4 3 2 1>;
			rbatt_sf_sf = <
			               2382 1425 636 133 94 81
			               2381 1425 636 133 94 81
			               2245 1409 647 135 95 82
			               2163 1367 658 138 97 83
			               2121 1401 685 142 99 85
			               1886 1278 705 154 104 86
			               1863 1203 602 155 106 89
			               1852 1201 599 172 115 94
			               1845 1187 577 169 124 100
			               1863 1183 558 133 97 84
			               1908 1204 554 129 94 82
			               1967 1258 563 132 96 83
			               2040 1321 597 137 100 86
			               2128 1410 645 142 105 89
			               2230 1517 709 142 104 86
			               2349 1637 792 136 95 82
			               2478 1765 885 136 95 81
			               2635 1907 1046 139 95 82
			               4412 2048 938 141 98 82
			               4810 2255 984 136 98 83
			               5180 2470 1034 141 97 82
			               5510 2691 1162 143 97 85
			               5924 2893 1251 145 97 83
			               6301 3177 1336 144 97 84
			               6689 3377 1437 147 100 83
			               7167 3723 1628 157 100 86
			               7865 4163 1823 164 104 87
			               9172 4982 2291 233 137 116
			              >;
			pc_temp_ocv_rows = <29>;
			pc_temp_ocv_cols = <6>;
			pc_temp_ocv_percent = <100 95 90 85 80 75 70 65 60 55 50 45 40 35 30 25 20 15 10 9 8 7 6 5 4 3 2 1>;
			pc_temp_ocv_ocv = <
			                   4334 4333 4331 4325 4320 4313
			                   4234 4244 4252 4260 4259 4254
			                   4164 4179 4190 4204 4203 4199
			                   4112 4118 4136 4150 4149 4146
			                   4071 4084 4090 4099 4098 4094
			                   3969 4006 4040 4057 4050 4046
			                   3924 3944 3966 3995 4003 4001
			                   3884 3906 3929 3963 3964 3961
			                   3847 3867 3889 3919 3922 3921
			                   3820 3832 3852 3871 3871 3870
			                   3801 3807 3822 3841 3842 3841
			                   3786 3792 3799 3819 3820 3819
			                   3775 3779 3786 3801 3802 3800
			                   3763 3769 3776 3786 3786 3784
			                   3751 3759 3767 3772 3769 3764
			                   3739 3746 3756 3756 3748 3736
			                   3723 3731 3735 3737 3727 3715
			                   3700 3715 3715 3711 3702 3690
			                   3671 3694 3696 3688 3680 3669
			                   3660 3687 3692 3686 3679 3668
			                   3647 3679 3686 3685 3677 3666
			                   3630 3668 3682 3682 3675 3663
			                   3613 3652 3673 3675 3668 3655
			                   3589 3632 3655 3657 3649 3632
			                   3557 3599 3622 3621 3611 3594
			                   3514 3553 3575 3570 3561 3543
			                   3459 3488 3506 3502 3494 3474
			                   3381 3396 3406 3405 3396 3376
			                   3200 3200 3200 3200 3200 3200
			                  >;
			vol_dec1=  <16>;
			pc_temp_ocv_ocv1 = <
			                   4318 4317 4315 4309 4304 4297
			                   4223 4233 4240 4247 4245 4240
			                   4156 4169 4180 4192 4190 4186
			                   4107 4113 4128 4139 4138 4134
			                   4058 4072 4082 4091 4088 4083
			                   3963 3997 4029 4045 4041 4037
			                   3919 3939 3961 3990 3995 3993
			                   3880 3901 3924 3956 3957 3954
			                   3845 3863 3884 3911 3914 3912
			                   3818 3830 3848 3866 3867 3866
			                   3800 3806 3819 3838 3839 3838
			                   3786 3791 3798 3817 3818 3816
			                   3774 3779 3785 3799 3800 3798
			                   3762 3769 3776 3785 3785 3782
			                   3750 3758 3767 3771 3767 3762
			                   3738 3746 3755 3755 3746 3735
			                   3722 3731 3734 3736 3726 3713
			                   3700 3715 3714 3710 3701 3689
			                   3670 3694 3696 3688 3680 3669
			                   3659 3687 3691 3686 3679 3668
			                   3646 3678 3686 3684 3677 3666
			                   3629 3667 3682 3681 3674 3663
			                   3612 3651 3672 3675 3667 3654
			                   3588 3631 3653 3656 3646 3629
			                   3555 3597 3620 3618 3609 3591
			                   3512 3551 3573 3568 3559 3540
			                   3458 3487 3504 3500 3492 3472
			                   3380 3395 3404 3403 3394 3374
			                   3200 3200 3200 3200 3200 3200
			                  >;
			vol_dec2=  <48>;
			pc_temp_ocv_ocv2 = <
			                   4286 4285 4283 4277 4272 4265
			                   4202 4210 4216 4221 4217 4211
			                   4141 4149 4160 4168 4165 4159
			                   4097 4104 4112 4117 4115 4110
			                   4031 4050 4066 4074 4068 4062
			                   3952 3980 4005 4021 4021 4018
			                   3910 3930 3950 3979 3981 3978
			                   3872 3892 3913 3942 3943 3940
			                   3839 3855 3875 3896 3897 3895
			                   3815 3825 3842 3858 3858 3857
			                   3798 3803 3814 3833 3833 3832
			                   3784 3789 3796 3813 3813 3812
			                   3773 3777 3784 3796 3797 3795
			                   3761 3767 3774 3782 3782 3779
			                   3749 3757 3766 3768 3764 3757
			                   3737 3744 3753 3753 3744 3732
			                   3721 3730 3733 3733 3723 3711
			                   3698 3714 3713 3707 3699 3687
			                   3668 3693 3695 3688 3680 3669
			                   3657 3685 3690 3686 3679 3667
			                   3644 3677 3685 3684 3677 3665
			                   3627 3665 3680 3681 3674 3661
			                   3609 3650 3670 3673 3665 3651
			                   3585 3628 3650 3652 3642 3625
			                   3553 3594 3617 3614 3604 3586
			                   3510 3548 3569 3563 3554 3535
			                   3456 3484 3499 3496 3487 3467
			                   3378 3394 3401 3400 3391 3370
			                   3200 3200 3200 3200 3200 3200
			                  >;
			vol_dec3=  <192>;
			pc_temp_ocv_ocv3 = <
			                   4142 4141 4139 4133 4128 4121
			                   4117 4116 4116 4105 4097 4088
			                   4085 4088 4080 4071 4057 4047
			                   4004 4018 4033 4022 4017 4010
			                   3945 3960 3968 3983 3982 3976
			                   3906 3921 3935 3953 3949 3942
			                   3871 3886 3900 3915 3910 3905
			                   3840 3852 3866 3872 3870 3866
			                   3817 3824 3838 3847 3844 3841
			                   3800 3804 3813 3826 3825 3822
			                   3787 3791 3796 3810 3809 3806
			                   3777 3780 3785 3796 3795 3792
			                   3766 3771 3776 3783 3782 3778
			                   3755 3761 3769 3771 3767 3760
			                   3745 3751 3760 3757 3748 3736
			                   3732 3738 3743 3743 3732 3719
			                   3715 3725 3725 3722 3712 3698
			                   3692 3709 3709 3698 3689 3678
			                   3660 3687 3691 3686 3678 3667
			                   3649 3679 3686 3684 3677 3665
			                   3634 3670 3682 3681 3674 3661
			                   3619 3656 3675 3675 3666 3652
			                   3600 3641 3661 3661 3650 3632
			                   3574 3615 3636 3632 3620 3601
			                   3541 3581 3601 3592 3582 3561
			                   3499 3535 3551 3543 3533 3511
			                   3446 3471 3482 3478 3467 3446
			                   3369 3384 3389 3386 3376 3354
			                   3200 3200 3200 3200 3200 3200
			                  >;
		};
};
