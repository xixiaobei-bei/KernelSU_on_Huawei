/* DO NOT EDIT - Automatically generated by python */
/ {
		desayatl_3300_39k_4400:desayatl_3300_39k_4400 {
			fcc = <3300>;
			default_rbatt_mohm = <100>;
			id_identify_min = <1235>;
			id_identify_max = <1759>;
			id_voltage_min = <1420>;
			id_voltage_max = <1562>;
			vbat_max = <4400>;
			temp_para = 
						"-32767","0","-1","0","4100","0",
						"0","5","-1","330","4400","0",
						"5","10","-1","990","4400","3",
						"10","45","-1","-1","4400","3",
						"45","50","-1","1155","4100","3",
						"50","32767","-1","0","4100","0";
			vbat_para = 
						"-32767","3400","-1","820","0",
						"3400","32767","-1","-1","0";
			segment_para = 
						"-32767","4150","3300","4208","50",
						"4150","4450","2310","4400","0";
			batt_brand = "desayatl";
			fcc_temp = <3359 3356 3359 3379 3368 3346>;
			fcc_sf_x = <0 100 200 300 400 500>;
			fcc_sf_y = <100 96 94 92 90 88>;
			fcc_sf_cols = <6>;
			pc_sf_rows = <1>;
			pc_sf_cols = <1>;
			pc_sf_row_entries = <0>;
			pc_sf_percent = <100>;
			pc_sf_sf = <100>;
			rbatt_sf_rows = <28>;
			rbatt_sf_cols = <6>;
			rbatt_sf_percent = <100 95 90 85 80 75 70 65 60 55 50 45 40 35 30 25 20 15 10 9 8 7 6 5 4 3 2 1>;
			rbatt_sf_sf = <
			               2374 1329 574 159 119 105
			               2371 1329 574 159 119 105
			               2190 1314 578 161 120 105
			               2042 1279 576 165 121 106
			               1965 1242 577 170 124 108
			               1887 1256 598 178 127 110
			               1723 1125 583 191 133 113
			               1735 1108 534 201 141 117
			               1714 1102 530 202 150 124
			               1697 1087 517 162 126 109
			               1730 1085 515 154 118 105
			               1777 1121 512 155 118 106
			               1826 1182 520 159 121 109
			               1899 1250 556 162 125 112
			               1982 1332 599 161 125 113
			               2088 1431 655 158 115 104
			               2216 1557 728 158 115 104
			               2392 1709 827 161 118 104
			               3414 1621 753 155 118 108
			               3694 1757 776 157 119 107
			               4001 1891 827 158 119 108
			               4382 2060 903 159 121 110
			               4811 2283 991 162 121 108
			               5281 2561 1078 159 118 106
			               5889 2858 1185 165 121 106
			               6702 3273 1360 170 123 111
			               7772 3942 1684 194 132 112
			               9740 5090 2302 355 154 118
			              >;
			pc_temp_ocv_rows = <29>;
			pc_temp_ocv_cols = <6>;
			pc_temp_ocv_percent = <100 95 90 85 80 75 70 65 60 55 50 45 40 35 30 25 20 15 10 9 8 7 6 5 4 3 2 1>;
			pc_temp_ocv_ocv = <
			                   4382 4378 4376 4368 4362 4355
			                   4280 4291 4298 4301 4297 4292
			                   4210 4227 4238 4242 4238 4233
			                   4147 4168 4179 4184 4181 4176
			                   4098 4110 4124 4128 4125 4122
			                   4041 4066 4076 4076 4073 4070
			                   3952 3981 4012 4026 4024 4022
			                   3917 3935 3951 3978 3979 3978
			                   3878 3898 3913 3934 3937 3937
			                   3839 3859 3874 3882 3885 3883
			                   3817 3825 3842 3849 3851 3850
			                   3801 3805 3814 3824 3826 3825
			                   3786 3791 3793 3805 3806 3805
			                   3773 3779 3782 3788 3789 3788
			                   3759 3767 3772 3772 3773 3770
			                   3744 3751 3760 3757 3751 3740
			                   3728 3734 3742 3738 3730 3718
			                   3708 3716 3718 3713 3706 3695
			                   3682 3697 3694 3690 3682 3672
			                   3674 3692 3690 3688 3681 3671
			                   3663 3685 3686 3686 3680 3669
			                   3651 3676 3683 3683 3677 3666
			                   3638 3664 3676 3676 3672 3660
			                   3618 3647 3662 3655 3655 3640
			                   3589 3617 3630 3614 3617 3602
			                   3549 3570 3578 3558 3565 3551
			                   3487 3501 3506 3483 3497 3484
			                   3391 3398 3399 3377 3396 3385
			                   3200 3200 3200 3200 3200 3200
			                  >;
			vol_dec1=  <16>;
			pc_temp_ocv_ocv1 = <
			                   4366 4362 4360 4352 4346 4339
			                   4269 4280 4286 4288 4284 4278
			                   4201 4217 4227 4229 4226 4221
			                   4141 4158 4170 4173 4169 4165
			                   4092 4104 4117 4118 4115 4111
			                   4031 4054 4066 4067 4063 4061
			                   3948 3975 4003 4018 4016 4014
			                   3913 3930 3945 3971 3973 3971
			                   3874 3893 3908 3926 3929 3928
			                   3837 3856 3870 3878 3880 3879
			                   3816 3823 3839 3846 3847 3847
			                   3799 3803 3812 3822 3824 3823
			                   3785 3790 3792 3803 3804 3803
			                   3772 3778 3781 3787 3788 3787
			                   3758 3766 3771 3771 3772 3768
			                   3744 3751 3759 3756 3750 3738
			                   3727 3734 3741 3737 3729 3717
			                   3707 3716 3717 3711 3705 3694
			                   3682 3696 3694 3689 3682 3672
			                   3673 3691 3690 3688 3681 3670
			                   3663 3684 3686 3686 3679 3669
			                   3651 3675 3683 3683 3677 3666
			                   3637 3664 3676 3676 3671 3659
			                   3617 3646 3661 3654 3652 3639
			                   3588 3616 3628 3611 3615 3600
			                   3548 3568 3577 3555 3563 3549
			                   3486 3500 3504 3481 3495 3483
			                   3390 3397 3398 3376 3395 3383
			                   3200 3200 3200 3200 3200 3200
			                  >;
			vol_dec2=  <48>;
			pc_temp_ocv_ocv2 = <
			                   4334 4330 4328 4320 4314 4307
			                   4248 4258 4263 4261 4256 4250
			                   4183 4197 4205 4205 4200 4195
			                   4128 4140 4150 4150 4146 4141
			                   4079 4092 4101 4098 4094 4090
			                   4008 4029 4046 4049 4046 4043
			                   3941 3963 3984 4001 4000 3998
			                   3905 3921 3935 3958 3960 3958
			                   3866 3885 3898 3911 3912 3911
			                   3833 3848 3863 3869 3870 3869
			                   3813 3819 3833 3840 3841 3840
			                   3797 3801 3808 3818 3819 3818
			                   3783 3788 3790 3800 3801 3800
			                   3770 3777 3780 3784 3786 3784
			                   3757 3764 3770 3769 3768 3763
			                   3743 3749 3757 3754 3747 3736
			                   3726 3732 3739 3735 3727 3715
			                   3706 3715 3715 3709 3703 3691
			                   3680 3695 3693 3689 3682 3671
			                   3671 3690 3689 3688 3681 3670
			                   3661 3683 3686 3686 3679 3668
			                   3649 3674 3682 3682 3676 3665
			                   3635 3662 3675 3674 3669 3657
			                   3614 3644 3658 3649 3648 3634
			                   3586 3613 3624 3607 3610 3595
			                   3545 3565 3573 3551 3559 3544
			                   3484 3496 3501 3477 3491 3478
			                   3389 3394 3395 3373 3392 3380
			                   3200 3200 3200 3200 3200 3200
			                  >;
			vol_dec3=  <192>;
			pc_temp_ocv_ocv3 = <
			                   4190 4186 4184 4176 4170 4163
			                   4156 4162 4155 4141 4133 4127
			                   4114 4110 4114 4098 4090 4083
			                   4067 4074 4069 4054 4047 4042
			                   3995 3998 4013 4011 4007 4003
			                   3938 3950 3957 3972 3970 3966
			                   3905 3914 3923 3934 3933 3930
			                   3870 3880 3889 3888 3888 3885
			                   3837 3847 3858 3857 3857 3855
			                   3817 3820 3831 3834 3834 3833
			                   3801 3803 3809 3816 3816 3815
			                   3788 3791 3792 3800 3800 3799
			                   3776 3780 3782 3786 3787 3785
			                   3763 3770 3773 3773 3772 3768
			                   3751 3757 3763 3760 3753 3742
			                   3737 3742 3751 3745 3736 3724
			                   3721 3726 3730 3725 3718 3705
			                   3700 3710 3709 3699 3692 3682
			                   3675 3691 3689 3687 3680 3670
			                   3665 3684 3686 3686 3679 3668
			                   3655 3677 3683 3683 3676 3665
			                   3643 3667 3678 3677 3671 3659
			                   3627 3654 3667 3660 3657 3643
			                   3604 3632 3644 3627 3628 3612
			                   3575 3599 3606 3583 3588 3572
			                   3534 3550 3553 3527 3537 3523
			                   3473 3483 3483 3455 3472 3457
			                   3380 3383 3383 3358 3376 3362
			                   3200 3200 3200 3200 3200 3200
			                  >;
		};
};
