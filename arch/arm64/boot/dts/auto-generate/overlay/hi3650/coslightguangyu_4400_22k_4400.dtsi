/* DO NOT EDIT - Automatically generated by python */
/ {
		coslightguangyu_4400_22k_4400:coslightguangyu_4400_22k_4400 {
			fcc = <4400>;
			default_rbatt_mohm = <100>;
			id_identify_min = <751>;
			id_identify_max = <1235>;
			id_voltage_min = <949>;
			id_voltage_max = <1051>;
			vbat_max = <4400>;
			temp_para = 
						"-32767","0","-1","0","4100","0",
						"0","5","-1","440","4400","0",
						"5","10","-1","1320","4400","3",
						"10","45","-1","-1","4400","3",
						"45","50","-1","1540","4100","3",
						"50","32767","-1","0","4100","0";
			vbat_para = 
						"-32767","3400","-1","820","0",
						"3400","32767","-1","-1","0";
			segment_para = 
						"-32767","4150","4400","4208","50",
						"4150","4450","3080","4400","0";
			batt_brand = "coslightguangyu";
			fcc_temp = <4531 4529 4529 4549 4533 4502>;
			fcc_sf_x = <0 100 200 300 400 500>;
			fcc_sf_y = <100 96 94 92 90 88>;
			fcc_sf_cols = <6>;
			pc_sf_rows = <1>;
			pc_sf_cols = <1>;
			pc_sf_row_entries = <0>;
			pc_sf_percent = <100>;
			pc_sf_sf = <100>;
			rbatt_sf_rows = <28>;
			rbatt_sf_cols = <6>;
			rbatt_sf_percent = <100 95 90 85 80 75 70 65 60 55 50 45 40 35 30 25 20 15 10 9 8 7 6 5 4 3 2 1>;
			rbatt_sf_sf = <
			               1746 1107 497 127 101 94
			               1743 1106 496 127 101 94
			               1630 1076 493 127 102 94
			               1516 1042 487 128 103 95
			               1463 1015 486 132 104 95
			               1355 988 503 137 107 97
			               1304 889 459 146 110 98
			               1284 882 436 156 117 101
			               1272 868 432 155 124 106
			               1289 860 426 131 114 105
			               1317 886 426 123 101 95
			               1350 927 437 123 101 94
			               1389 973 468 126 102 95
			               1442 1023 512 128 106 98
			               1506 1084 565 129 106 97
			               1584 1160 629 128 101 93
			               1687 1259 712 129 102 94
			               1826 1379 828 132 103 95
			               3080 1624 797 126 103 93
			               3301 1804 886 128 102 96
			               3642 1985 995 130 103 98
			               3878 2205 1128 133 105 100
			               4197 2428 1310 135 106 103
			               4591 2699 1518 135 105 98
			               5165 3028 1720 133 103 94
			               5933 3561 2029 140 105 98
			               7149 4350 2603 151 107 100
			               10565 5848 3595 198 118 103
			              >;
			pc_temp_ocv_rows = <29>;
			pc_temp_ocv_cols = <6>;
			pc_temp_ocv_percent = <100 95 90 85 80 75 70 65 60 55 50 45 40 35 30 25 20 15 10 9 8 7 6 5 4 3 2 1>;
			pc_temp_ocv_ocv = <
			                   4385 4382 4380 4372 4364 4356
			                   4270 4279 4288 4300 4294 4288
			                   4199 4209 4224 4240 4234 4228
			                   4129 4150 4165 4182 4176 4171
			                   4077 4095 4110 4126 4121 4116
			                   3998 4039 4062 4073 4068 4064
			                   3941 3958 3991 4023 4019 4016
			                   3898 3917 3938 3976 3975 3973
			                   3858 3876 3898 3931 3933 3931
			                   3833 3839 3861 3881 3885 3885
			                   3813 3816 3828 3847 3847 3846
			                   3797 3801 3805 3822 3823 3821
			                   3782 3787 3790 3803 3803 3802
			                   3767 3774 3779 3787 3788 3786
			                   3753 3759 3768 3773 3772 3767
			                   3739 3743 3755 3759 3753 3741
			                   3722 3728 3736 3741 3734 3720
			                   3700 3712 3711 3713 3707 3694
			                   3667 3689 3686 3690 3683 3671
			                   3653 3682 3681 3688 3682 3670
			                   3646 3675 3677 3687 3681 3668
			                   3632 3667 3671 3684 3679 3666
			                   3615 3653 3664 3679 3674 3661
			                   3591 3632 3650 3661 3662 3645
			                   3559 3599 3620 3622 3624 3609
			                   3517 3554 3571 3566 3572 3558
			                   3462 3491 3502 3488 3501 3491
			                   3376 3391 3397 3371 3395 3392
			                   3200 3200 3200 3200 3200 3200
			                  >;
			vol_dec1=  <16>;
			pc_temp_ocv_ocv1 = <
			                   4369 4366 4364 4356 4348 4340
			                   4261 4269 4278 4287 4281 4275
			                   4190 4201 4215 4228 4222 4216
			                   4124 4142 4157 4171 4165 4160
			                   4068 4089 4104 4117 4111 4106
			                   3991 4029 4052 4065 4060 4055
			                   3937 3953 3984 4016 4012 4009
			                   3895 3913 3933 3970 3969 3966
			                   3856 3872 3894 3924 3926 3925
			                   3831 3837 3858 3877 3879 3880
			                   3812 3815 3826 3844 3844 3843
			                   3796 3800 3803 3820 3821 3819
			                   3781 3786 3789 3801 3802 3800
			                   3767 3773 3778 3786 3787 3784
			                   3753 3758 3768 3772 3771 3765
			                   3738 3742 3754 3758 3752 3740
			                   3721 3727 3735 3740 3733 3719
			                   3699 3712 3710 3712 3706 3693
			                   3666 3688 3685 3689 3683 3671
			                   3653 3682 3681 3688 3682 3670
			                   3646 3674 3676 3686 3681 3668
			                   3632 3666 3671 3684 3678 3666
			                   3614 3652 3664 3678 3674 3661
			                   3590 3631 3649 3659 3660 3644
			                   3558 3598 3619 3620 3622 3607
			                   3516 3553 3569 3564 3570 3556
			                   3460 3489 3501 3486 3499 3489
			                   3375 3389 3395 3370 3393 3391
			                   3200 3200 3200 3200 3200 3200
			                  >;
			vol_dec2=  <48>;
			pc_temp_ocv_ocv2 = <
			                   4337 4334 4332 4324 4316 4308
			                   4242 4248 4257 4262 4255 4248
			                   4172 4184 4197 4205 4198 4192
			                   4112 4128 4140 4150 4144 4138
			                   4050 4077 4092 4098 4091 4086
			                   3979 4008 4033 4048 4043 4038
			                   3929 3944 3970 4000 3998 3994
			                   3886 3904 3924 3958 3957 3954
			                   3851 3865 3886 3909 3912 3912
			                   3828 3833 3851 3867 3869 3869
			                   3810 3813 3821 3838 3838 3837
			                   3794 3798 3801 3816 3816 3815
			                   3779 3785 3788 3798 3799 3797
			                   3765 3771 3777 3783 3785 3782
			                   3752 3756 3766 3771 3768 3761
			                   3737 3741 3753 3756 3750 3737
			                   3720 3726 3734 3738 3731 3717
			                   3698 3711 3709 3710 3704 3690
			                   3664 3687 3684 3689 3683 3670
			                   3651 3681 3680 3688 3682 3669
			                   3645 3674 3675 3686 3680 3668
			                   3630 3665 3670 3683 3678 3666
			                   3613 3651 3662 3677 3672 3660
			                   3588 3629 3647 3656 3656 3640
			                   3556 3595 3615 3615 3617 3603
			                   3514 3551 3566 3559 3565 3552
			                   3458 3487 3497 3483 3495 3486
			                   3373 3387 3392 3367 3390 3388
			                   3200 3200 3200 3200 3200 3200
			                  >;
			vol_dec3=  <192>;
			pc_temp_ocv_ocv3 = <
			                   4193 4190 4188 4180 4172 4164
			                   4150 4159 4167 4146 4138 4131
			                   4106 4112 4116 4105 4096 4089
			                   4043 4067 4076 4060 4052 4045
			                   3978 3996 4012 4017 4011 4005
			                   3931 3942 3959 3977 3973 3969
			                   3891 3905 3920 3939 3937 3933
			                   3856 3868 3885 3892 3894 3893
			                   3833 3836 3852 3859 3857 3856
			                   3815 3816 3825 3835 3834 3832
			                   3800 3802 3804 3815 3815 3813
			                   3785 3789 3791 3800 3799 3797
			                   3772 3777 3781 3786 3787 3784
			                   3759 3764 3772 3774 3773 3767
			                   3747 3749 3760 3762 3756 3745
			                   3732 3735 3747 3747 3740 3726
			                   3715 3722 3726 3729 3722 3709
			                   3694 3707 3702 3699 3693 3680
			                   3655 3683 3681 3688 3682 3669
			                   3648 3676 3677 3686 3680 3668
			                   3638 3669 3672 3684 3678 3666
			                   3623 3658 3666 3679 3675 3662
			                   3604 3642 3656 3667 3665 3650
			                   3578 3618 3635 3638 3637 3623
			                   3546 3583 3600 3596 3597 3583
			                   3504 3538 3550 3540 3544 3534
			                   3449 3473 3482 3465 3475 3469
			                   3365 3376 3380 3352 3373 3375
			                   3200 3200 3200 3200 3200 3200
			                  >;
		};
};
