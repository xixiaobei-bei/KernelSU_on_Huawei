/* DO NOT EDIT - Automatically generated by python */
/ {
		desayatl_3300_39k_4350:desayatl_3300_39k_4350 {
			fcc = <3300>;
			default_rbatt_mohm = <100>;
			id_identify_min = <1235>;
			id_identify_max = <1759>;
			id_voltage_min = <1420>;
			id_voltage_max = <1562>;
			vbat_max = <4350>;
			temp_para = 
						"-32767","0","-1","0","4100","0",
						"0","5","-1","330","4350","0",
						"5","10","-1","990","4350","3",
						"10","45","-1","-1","4350","3",
						"45","50","-1","1155","4100","3",
						"50","32767","-1","0","4100","0";
			vbat_para = 
						"-32767","3400","-1","820","0",
						"3400","32767","-1","-1","0";
			segment_para = 
						"-32767","4150","3300","4208","50",
						"4150","4450","2310","4350","0";
			batt_brand = "desayatl";
			fcc_temp = <3244 3252 3251 3269 3265 3242>;
			fcc_sf_x = <0 100 200 300 400 500>;
			fcc_sf_y = <100 96 94 92 90 88>;
			fcc_sf_cols = <6>;
			pc_sf_rows = <1>;
			pc_sf_cols = <1>;
			pc_sf_row_entries = <0>;
			pc_sf_percent = <100>;
			pc_sf_sf = <100>;
			rbatt_sf_rows = <28>;
			rbatt_sf_cols = <6>;
			rbatt_sf_percent = <100 95 90 85 80 75 70 65 60 55 50 45 40 35 30 25 20 15 10 9 8 7 6 5 4 3 2 1>;
			rbatt_sf_sf = <
			               2336 1266 538 146 117 106
			               2335 1266 538 146 117 106
			               2147 1261 546 149 118 107
			               2016 1228 557 154 121 109
			               1967 1248 562 158 124 111
			               1736 1199 612 167 130 113
			               1691 1079 543 175 134 117
			               1687 1079 515 188 143 123
			               1670 1063 494 168 137 119
			               1671 1057 481 146 117 108
			               1705 1071 480 145 118 107
			               1750 1121 484 148 121 110
			               1804 1169 506 154 125 113
			               1871 1235 538 159 130 117
			               1957 1310 577 159 126 111
			               2065 1402 628 151 119 109
			               2193 1515 682 150 118 108
			               2367 1657 778 150 119 108
			               3021 1611 764 151 121 111
			               3503 1595 700 152 121 112
			               3826 1741 731 154 121 111
			               4182 1910 788 155 124 112
			               4588 2105 855 157 122 109
			               5042 2321 905 151 120 109
			               5527 2560 967 154 121 110
			               6131 2888 1084 158 125 112
			               6973 3400 1267 169 130 115
			               8797 4279 1710 234 173 145
			              >;
			pc_temp_ocv_rows = <29>;
			pc_temp_ocv_cols = <6>;
			pc_temp_ocv_percent = <100 95 90 85 80 75 70 65 60 55 50 45 40 35 30 25 20 15 10 9 8 7 6 5 4 3 2 1>;
			pc_temp_ocv_ocv = <
			                   4333 4332 4329 4323 4318 4312
			                   4242 4255 4261 4262 4260 4255
			                   4177 4194 4203 4207 4204 4200
			                   4123 4135 4150 4153 4151 4147
			                   4087 4096 4099 4101 4099 4095
			                   3991 4039 4057 4054 4051 4047
			                   3939 3960 3985 4004 4004 4003
			                   3903 3922 3939 3963 3964 3962
			                   3866 3882 3899 3912 3914 3912
			                   3835 3847 3862 3870 3871 3870
			                   3815 3819 3833 3842 3843 3843
			                   3799 3804 3809 3820 3821 3821
			                   3787 3791 3794 3803 3803 3802
			                   3775 3781 3783 3787 3787 3786
			                   3762 3769 3773 3772 3768 3762
			                   3750 3755 3762 3754 3746 3736
			                   3735 3736 3741 3736 3727 3716
			                   3715 3719 3716 3710 3702 3690
			                   3686 3700 3696 3689 3682 3671
			                   3679 3694 3693 3688 3680 3670
			                   3668 3688 3689 3686 3679 3668
			                   3654 3682 3686 3683 3676 3665
			                   3638 3670 3678 3677 3668 3657
			                   3616 3650 3659 3656 3645 3634
			                   3582 3616 3624 3616 3606 3595
			                   3535 3566 3573 3563 3554 3545
			                   3470 3496 3503 3494 3486 3479
			                   3374 3397 3404 3396 3388 3383
			                   3200 3200 3200 3200 3200 3200
			                  >;
			vol_dec1=  <16>;
			pc_temp_ocv_ocv1 = <
			                   4317 4316 4313 4307 4302 4296
			                   4231 4243 4248 4249 4246 4240
			                   4168 4183 4191 4194 4191 4187
			                   4118 4128 4139 4141 4139 4134
			                   4074 4087 4091 4091 4088 4084
			                   3984 4026 4044 4044 4041 4038
			                   3935 3954 3978 3996 3996 3995
			                   3899 3916 3933 3954 3955 3953
			                   3863 3878 3893 3905 3906 3905
			                   3833 3844 3858 3866 3866 3866
			                   3814 3818 3830 3839 3840 3840
			                   3798 3803 3807 3818 3819 3818
			                   3786 3791 3793 3801 3802 3800
			                   3774 3780 3782 3786 3786 3784
			                   3762 3768 3773 3770 3766 3760
			                   3749 3754 3761 3753 3745 3734
			                   3734 3736 3740 3734 3726 3714
			                   3714 3718 3715 3709 3701 3689
			                   3686 3699 3696 3689 3682 3671
			                   3678 3693 3692 3688 3680 3669
			                   3667 3688 3689 3686 3678 3667
			                   3654 3681 3686 3683 3675 3664
			                   3637 3669 3677 3676 3668 3655
			                   3614 3649 3658 3654 3643 3632
			                   3581 3614 3622 3614 3603 3592
			                   3534 3564 3571 3561 3551 3542
			                   3468 3495 3501 3492 3484 3477
			                   3373 3396 3402 3394 3386 3382
			                   3200 3200 3200 3200 3200 3200
			                  >;
			vol_dec2=  <48>;
			pc_temp_ocv_ocv2 = <
			                   4285 4284 4281 4275 4270 4264
			                   4209 4219 4222 4221 4216 4211
			                   4151 4161 4169 4168 4164 4159
			                   4108 4115 4119 4118 4114 4110
			                   4046 4069 4076 4071 4068 4062
			                   3970 4001 4019 4024 4022 4019
			                   3926 3943 3963 3982 3982 3979
			                   3890 3906 3920 3936 3937 3935
			                   3856 3869 3883 3891 3892 3891
			                   3829 3837 3851 3858 3858 3858
			                   3811 3815 3824 3833 3834 3833
			                   3796 3801 3804 3814 3814 3814
			                   3784 3789 3791 3798 3798 3797
			                   3773 3779 3781 3783 3782 3779
			                   3760 3767 3771 3768 3763 3756
			                   3748 3752 3759 3751 3743 3732
			                   3733 3734 3737 3732 3723 3711
			                   3712 3717 3714 3707 3699 3687
			                   3685 3698 3695 3688 3681 3670
			                   3676 3692 3692 3687 3680 3669
			                   3665 3687 3689 3685 3678 3667
			                   3652 3679 3685 3682 3674 3663
			                   3635 3668 3676 3673 3666 3652
			                   3611 3646 3655 3649 3639 3626
			                   3578 3610 3618 3608 3598 3587
			                   3530 3560 3567 3556 3547 3537
			                   3465 3491 3497 3487 3479 3472
			                   3371 3394 3399 3389 3383 3378
			                   3200 3200 3200 3200 3200 3200
			                  >;
			vol_dec3=  <192>;
			pc_temp_ocv_ocv3 = <
			                   4141 4140 4137 4131 4126 4120
			                   4123 4121 4110 4100 4093 4085
			                   4093 4083 4078 4061 4054 4045
			                   4011 4030 4030 4019 4013 4008
			                   3955 3960 3974 3983 3979 3974
			                   3918 3927 3935 3944 3941 3936
			                   3885 3892 3900 3903 3901 3897
			                   3854 3860 3868 3869 3867 3865
			                   3830 3833 3842 3845 3844 3843
			                   3813 3814 3819 3826 3825 3824
			                   3799 3801 3803 3810 3810 3808
			                   3788 3790 3791 3796 3796 3794
			                   3777 3781 3782 3783 3782 3778
			                   3766 3771 3774 3770 3765 3757
			                   3755 3759 3765 3755 3747 3736
			                   3742 3743 3748 3740 3731 3719
			                   3727 3728 3727 3720 3711 3698
			                   3706 3712 3708 3697 3690 3679
			                   3678 3693 3692 3687 3679 3668
			                   3668 3688 3689 3685 3677 3666
			                   3657 3682 3685 3682 3674 3663
			                   3643 3672 3679 3676 3667 3653
			                   3625 3657 3664 3657 3645 3633
			                   3600 3632 3637 3625 3613 3602
			                   3564 3594 3599 3583 3572 3563
			                   3516 3543 3548 3531 3521 3514
			                   3452 3476 3479 3464 3456 3450
			                   3361 3383 3387 3368 3364 3360
			                   3200 3200 3200 3200 3200 3200
			                  >;
		};
};
