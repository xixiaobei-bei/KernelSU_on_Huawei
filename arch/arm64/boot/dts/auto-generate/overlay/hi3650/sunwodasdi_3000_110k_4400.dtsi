/* DO NOT EDIT - Automatically generated by python */
/ {
		sunwodasdi_3000_110k_4400:sunwodasdi_3000_110k_4400 {
			fcc = <3000>;
			default_rbatt_mohm = <100>;
			id_identify_min = <2281>;
			id_identify_max = <2786>;
			id_voltage_min = <2426>;
			id_voltage_max = <2631>;
			vbat_max = <4400>;
			temp_para = 
						"-32767","0","-1","0","4100","0",
						"0","5","-1","300","4400","0",
						"5","10","-1","900","4400","3",
						"10","45","-1","-1","4400","3",
						"45","50","-1","1050","4100","3",
						"50","32767","-1","0","4100","0";
			vbat_para = 
						"-32767","3400","-1","820","0",
						"3400","32767","-1","-1","0";
			segment_para = 
						"-32767","4150","3000","4208","50",
						"4150","4450","2100","4400","0";
			batt_brand = "sunwodasdi";
			fcc_temp = <3004 2999 2994 3030 3017 2989>;
			fcc_sf_x = <0 100 200 300 400 500>;
			fcc_sf_y = <100 96 94 92 90 88>;
			fcc_sf_cols = <6>;
			pc_sf_rows = <1>;
			pc_sf_cols = <1>;
			pc_sf_row_entries = <0>;
			pc_sf_percent = <100>;
			pc_sf_sf = <100>;
			rbatt_sf_rows = <28>;
			rbatt_sf_cols = <6>;
			rbatt_sf_percent = <100 95 90 85 80 75 70 65 60 55 50 45 40 35 30 25 20 15 10 9 8 7 6 5 4 3 2 1>;
			rbatt_sf_sf = <
			               2069 1471 886 156 119 107
			               2068 1471 886 156 119 107
			               1868 1360 873 160 122 109
			               1728 1249 857 163 125 110
			               1712 1177 819 171 130 113
			               1675 1179 854 178 135 117
			               1423 997 725 198 147 121
			               1414 903 668 196 150 126
			               1408 901 635 217 159 134
			               1427 894 590 169 145 123
			               1509 878 576 150 120 108
			               1599 952 575 153 122 110
			               1691 1046 646 157 128 115
			               1779 1154 738 164 135 120
			               1858 1254 852 167 135 121
			               1968 1323 956 163 125 112
			               2149 1386 1025 156 122 109
			               2462 1520 1108 157 124 110
			               3023 1746 1168 160 126 110
			               3423 1644 850 157 126 114
			               3656 1601 864 155 126 115
			               3888 1710 943 158 126 113
			               4078 1852 1033 159 127 114
			               4275 1929 1123 158 123 109
			               4529 2018 1179 159 124 111
			               4712 2146 1186 163 125 115
			               4981 2256 1261 169 131 114
			               5421 2538 1389 272 136 118
			              >;
			pc_temp_ocv_rows = <29>;
			pc_temp_ocv_cols = <6>;
			pc_temp_ocv_percent = <100 95 90 85 80 75 70 65 60 55 50 45 40 35 30 25 20 15 10 9 8 7 6 5 4 3 2 1>;
			pc_temp_ocv_ocv = <
			                   4383 4378 4374 4369 4362 4354
			                   4271 4281 4286 4305 4301 4296
			                   4200 4217 4221 4248 4244 4239
			                   4139 4161 4166 4193 4189 4184
			                   4103 4111 4110 4139 4135 4131
			                   4062 4079 4078 4088 4083 4080
			                   3951 3992 4002 4048 4041 4033
			                   3905 3927 3948 3978 3984 3989
			                   3864 3890 3907 3949 3950 3949
			                   3832 3858 3869 3895 3900 3898
			                   3816 3821 3837 3857 3858 3857
			                   3803 3806 3807 3831 3831 3831
			                   3787 3796 3794 3810 3810 3810
			                   3767 3784 3785 3793 3793 3792
			                   3744 3767 3774 3778 3776 3774
			                   3726 3741 3760 3762 3755 3744
			                   3711 3718 3734 3741 3733 3721
			                   3698 3708 3713 3712 3705 3692
			                   3681 3700 3697 3688 3680 3669
			                   3675 3698 3695 3687 3679 3668
			                   3666 3694 3689 3685 3677 3666
			                   3657 3686 3685 3682 3675 3664
			                   3643 3677 3680 3677 3671 3660
			                   3625 3660 3670 3659 3659 3646
			                   3602 3634 3647 3620 3623 3608
			                   3564 3594 3605 3563 3571 3557
			                   3508 3530 3539 3482 3500 3486
			                   3417 3432 3437 3359 3394 3383
			                   3200 3200 3200 3200 3200 3200
			                  >;
			vol_dec1=  <16>;
			pc_temp_ocv_ocv1 = <
			                   4367 4362 4358 4353 4346 4338
			                   4262 4271 4275 4291 4287 4281
			                   4192 4209 4212 4236 4231 4226
			                   4134 4154 4157 4182 4177 4172
			                   4099 4107 4105 4129 4124 4120
			                   4050 4068 4067 4081 4075 4070
			                   3946 3985 3995 4035 4030 4024
			                   3901 3923 3944 3974 3978 3982
			                   3861 3887 3902 3941 3942 3941
			                   3831 3854 3865 3890 3894 3892
			                   3815 3820 3834 3854 3854 3854
			                   3802 3805 3806 3829 3829 3828
			                   3786 3795 3793 3808 3809 3808
			                   3766 3783 3784 3791 3792 3790
			                   3744 3766 3774 3777 3774 3772
			                   3725 3740 3759 3761 3753 3743
			                   3710 3718 3733 3739 3731 3719
			                   3698 3707 3712 3711 3704 3691
			                   3680 3700 3697 3688 3680 3668
			                   3674 3698 3694 3686 3679 3667
			                   3665 3693 3689 3685 3677 3666
			                   3656 3685 3685 3682 3675 3664
			                   3643 3676 3680 3676 3671 3659
			                   3624 3659 3669 3657 3658 3643
			                   3601 3633 3646 3617 3621 3605
			                   3563 3593 3603 3560 3569 3554
			                   3507 3529 3537 3480 3497 3484
			                   3416 3431 3435 3357 3393 3381
			                   3200 3200 3200 3200 3200 3200
			                  >;
			vol_dec2=  <48>;
			pc_temp_ocv_ocv2 = <
			                   4335 4330 4326 4321 4314 4306
			                   4242 4251 4253 4264 4258 4251
			                   4176 4192 4194 4211 4205 4198
			                   4126 4140 4140 4159 4153 4147
			                   4090 4099 4096 4108 4102 4097
			                   4026 4047 4047 4067 4059 4051
			                   3937 3970 3981 4009 4008 4007
			                   3893 3915 3934 3966 3967 3968
			                   3855 3881 3894 3924 3926 3924
			                   3828 3848 3859 3879 3881 3879
			                   3813 3818 3829 3847 3847 3846
			                   3800 3804 3804 3824 3824 3823
			                   3783 3793 3792 3805 3805 3804
			                   3763 3781 3783 3789 3789 3787
			                   3742 3763 3772 3774 3771 3767
			                   3724 3738 3756 3758 3751 3739
			                   3709 3717 3732 3736 3728 3716
			                   3697 3707 3711 3708 3702 3689
			                   3679 3699 3697 3687 3679 3668
			                   3673 3697 3693 3686 3678 3667
			                   3664 3692 3688 3684 3677 3665
			                   3655 3684 3685 3681 3674 3663
			                   3641 3675 3679 3675 3669 3656
			                   3623 3657 3667 3653 3653 3638
			                   3599 3631 3643 3612 3616 3600
			                   3562 3590 3600 3555 3563 3548
			                   3505 3527 3534 3475 3492 3478
			                   3414 3428 3433 3353 3388 3376
			                   3200 3200 3200 3200 3200 3200
			                  >;
			vol_dec3=  <192>;
			pc_temp_ocv_ocv3 = <
			                   4191 4186 4182 4177 4170 4162
			                   4154 4164 4162 4147 4135 4123
			                   4119 4122 4112 4104 4090 4081
			                   4086 4090 4083 4068 4055 4041
			                   4020 4028 4021 4020 4009 4004
			                   3937 3961 3968 3972 3972 3969
			                   3897 3913 3927 3945 3939 3932
			                   3860 3881 3891 3898 3897 3891
			                   3832 3851 3859 3864 3861 3857
			                   3817 3820 3831 3840 3838 3836
			                   3805 3806 3805 3820 3819 3817
			                   3790 3797 3794 3804 3803 3801
			                   3773 3786 3786 3790 3789 3786
			                   3753 3772 3777 3777 3774 3769
			                   3735 3752 3765 3764 3756 3744
			                   3719 3729 3746 3747 3738 3725
			                   3706 3714 3724 3724 3716 3702
			                   3694 3705 3707 3698 3691 3680
			                   3675 3698 3694 3686 3678 3667
			                   3668 3695 3689 3684 3676 3665
			                   3659 3687 3686 3681 3674 3663
			                   3651 3680 3682 3676 3671 3658
			                   3634 3670 3674 3663 3660 3646
			                   3617 3648 3660 3633 3631 3615
			                   3593 3622 3631 3589 3591 3574
			                   3553 3578 3585 3532 3537 3522
			                   3496 3515 3519 3453 3467 3453
			                   3407 3419 3420 3335 3365 3354
			                   3200 3200 3200 3200 3200 3200
			                  >;
		};
};
