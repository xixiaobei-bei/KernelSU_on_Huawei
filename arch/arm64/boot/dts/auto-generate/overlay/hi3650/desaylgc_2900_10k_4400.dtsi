/* DO NOT EDIT - Automatically generated by python */
/ {
		desaylgc_2900_10k_4400:desaylgc_2900_10k_4400 {
			fcc = <2900>;
			default_rbatt_mohm = <100>;
			id_identify_min = <0>;
			id_identify_max = <751>;
			id_voltage_min = <496>;
			id_voltage_max = <553>;
			vbat_max = <4400>;
			temp_para = 
						"-32767","0","-1","0","4100","0",
						"0","5","-1","290","4400","0",
						"5","10","-1","870","4400","3",
						"10","45","-1","-1","4400","3",
						"45","50","-1","1015","4100","3",
						"50","32767","-1","0","4100","0";
			vbat_para = 
						"-32767","3400","-1","820","0",
						"3400","32767","-1","-1","0";
			segment_para = 
						"-32767","4150","2900","4208","50",
						"4150","4450","2030","4400","0";
			batt_brand = "desaylgc";
			fcc_temp = <3101 3075 3069 3108 3073 3060>;
			fcc_sf_x = <0 100 200 300 400 500>;
			fcc_sf_y = <100 96 94 92 90 88>;
			fcc_sf_cols = <6>;
			pc_sf_rows = <1>;
			pc_sf_cols = <1>;
			pc_sf_row_entries = <0>;
			pc_sf_percent = <100>;
			pc_sf_sf = <100>;
			rbatt_sf_rows = <28>;
			rbatt_sf_cols = <6>;
			rbatt_sf_percent = <100 95 90 85 80 75 70 65 60 55 50 45 40 35 30 25 20 15 10 9 8 7 6 5 4 3 2 1>;
			rbatt_sf_sf = <
			               2395 1512 687 133 90 72
			               2389 1511 687 133 90 72
			               2218 1462 688 133 91 73
			               2082 1406 685 137 93 74
			               1999 1375 674 142 95 76
			               1907 1359 752 151 99 78
			               1768 1165 659 166 106 81
			               1762 1137 610 175 114 86
			               1759 1135 606 181 123 92
			               1752 1126 594 144 112 89
			               1773 1137 586 125 90 74
			               1828 1171 589 125 90 75
			               1918 1245 627 129 94 77
			               2033 1339 692 133 99 80
			               2175 1455 782 133 98 80
			               2333 1588 896 129 90 72
			               2495 1724 1036 130 89 72
			               2678 1870 1222 134 90 72
			               4863 2180 1032 131 90 75
			               5151 2399 1135 132 89 76
			               5511 2633 1234 139 91 76
			               5874 2839 1389 139 92 74
			               6195 3104 1525 143 91 75
			               6563 3363 1715 143 92 74
			               6964 3598 1872 155 96 78
			               7466 3898 2033 185 102 79
			               8114 4390 2303 383 113 80
			               9008 5286 2888 954 305 143
			              >;
			pc_temp_ocv_rows = <29>;
			pc_temp_ocv_cols = <6>;
			pc_temp_ocv_percent = <100 95 90 85 80 75 70 65 60 55 50 45 40 35 30 25 20 15 10 9 8 7 6 5 4 3 2 1>;
			pc_temp_ocv_ocv = <
			                   4392 4378 4373 4374 4360 4356
			                   4284 4282 4288 4308 4295 4292
			                   4207 4211 4223 4249 4236 4234
			                   4141 4150 4166 4191 4180 4178
			                   4085 4098 4107 4137 4125 4123
			                   4022 4051 4068 4085 4073 4071
			                   3946 3961 3992 4038 4025 4023
			                   3907 3917 3938 3980 3981 3979
			                   3870 3881 3898 3941 3938 3937
			                   3835 3847 3861 3890 3890 3891
			                   3808 3821 3830 3852 3850 3850
			                   3789 3801 3806 3826 3825 3825
			                   3774 3789 3793 3806 3805 3804
			                   3761 3776 3784 3789 3789 3787
			                   3749 3762 3775 3775 3773 3768
			                   3738 3747 3762 3760 3754 3742
			                   3724 3730 3742 3741 3733 3720
			                   3708 3712 3717 3709 3705 3694
			                   3681 3693 3692 3689 3682 3671
			                   3672 3687 3688 3688 3681 3670
			                   3663 3682 3682 3686 3680 3668
			                   3654 3675 3676 3683 3677 3666
			                   3639 3666 3665 3675 3671 3660
			                   3618 3650 3649 3647 3653 3640
			                   3588 3619 3622 3600 3615 3601
			                   3545 3570 3579 3539 3563 3550
			                   3487 3502 3514 3465 3492 3479
			                   3393 3413 3423 3373 3395 3378
			                   3200 3200 3200 3200 3200 3200
			                  >;
			vol_dec1=  <16>;
			pc_temp_ocv_ocv1 = <
			                   4376 4362 4357 4358 4344 4340
			                   4273 4271 4277 4295 4281 4278
			                   4198 4202 4214 4237 4224 4221
			                   4134 4143 4156 4180 4168 4166
			                   4079 4092 4102 4126 4115 4112
			                   4013 4039 4057 4077 4064 4062
			                   3942 3956 3985 4026 4017 4015
			                   3903 3913 3933 3975 3974 3972
			                   3866 3877 3894 3934 3931 3930
			                   3832 3845 3858 3884 3884 3885
			                   3806 3819 3827 3849 3847 3847
			                   3788 3800 3804 3824 3823 3822
			                   3774 3788 3792 3804 3804 3803
			                   3760 3775 3783 3788 3788 3786
			                   3748 3761 3774 3774 3771 3766
			                   3737 3746 3761 3759 3752 3741
			                   3724 3729 3741 3740 3732 3719
			                   3707 3712 3716 3708 3704 3692
			                   3681 3692 3692 3689 3682 3671
			                   3672 3687 3688 3688 3681 3670
			                   3663 3682 3682 3686 3679 3668
			                   3654 3674 3675 3682 3677 3666
			                   3638 3665 3664 3673 3671 3659
			                   3617 3649 3648 3644 3651 3638
			                   3586 3618 3621 3597 3613 3598
			                   3544 3569 3577 3536 3561 3547
			                   3486 3500 3513 3463 3490 3477
			                   3392 3412 3422 3372 3393 3376
			                   3200 3200 3200 3200 3200 3200
			                  >;
			vol_dec2=  <48>;
			pc_temp_ocv_ocv2 = <
			                   4344 4330 4325 4326 4312 4308
			                   4251 4248 4253 4267 4254 4250
			                   4181 4184 4195 4211 4198 4196
			                   4121 4127 4137 4158 4145 4142
			                   4065 4082 4092 4105 4093 4091
			                   3994 4015 4035 4063 4046 4043
			                   3934 3945 3970 4004 4001 3999
			                   3896 3905 3923 3965 3961 3959
			                   3860 3870 3885 3917 3916 3916
			                   3827 3839 3851 3873 3872 3872
			                   3803 3815 3822 3842 3840 3840
			                   3786 3798 3802 3819 3818 3818
			                   3772 3786 3791 3801 3800 3799
			                   3759 3773 3782 3786 3785 3783
			                   3747 3760 3773 3772 3769 3762
			                   3737 3745 3760 3757 3750 3738
			                   3723 3728 3739 3737 3730 3717
			                   3707 3711 3715 3705 3701 3690
			                   3680 3691 3691 3689 3682 3671
			                   3670 3686 3687 3687 3681 3669
			                   3662 3681 3681 3685 3679 3668
			                   3652 3673 3674 3681 3676 3665
			                   3636 3664 3663 3669 3669 3656
			                   3615 3647 3646 3639 3647 3633
			                   3584 3616 3618 3591 3609 3594
			                   3542 3566 3574 3531 3556 3542
			                   3484 3498 3510 3460 3486 3472
			                   3390 3410 3420 3368 3391 3372
			                   3200 3200 3200 3200 3200 3200
			                  >;
			vol_dec3=  <192>;
			pc_temp_ocv_ocv3 = <
			                   4200 4186 4181 4182 4168 4164
			                   4158 4155 4159 4149 4133 4129
			                   4109 4107 4107 4105 4090 4086
			                   4057 4071 4076 4066 4048 4044
			                   3988 3993 4007 4018 4008 4005
			                   3933 3938 3954 3974 3972 3968
			                   3898 3903 3915 3941 3935 3932
			                   3864 3870 3881 3895 3894 3892
			                   3833 3842 3850 3860 3856 3856
			                   3808 3819 3824 3836 3833 3833
			                   3791 3802 3804 3816 3815 3814
			                   3777 3790 3793 3800 3800 3798
			                   3765 3778 3785 3787 3787 3784
			                   3753 3767 3777 3775 3772 3766
			                   3743 3753 3767 3762 3756 3744
			                   3733 3739 3754 3747 3738 3725
			                   3719 3722 3731 3725 3720 3707
			                   3703 3708 3709 3694 3689 3678
			                   3673 3687 3687 3687 3681 3669
			                   3665 3683 3682 3685 3679 3668
			                   3658 3676 3677 3681 3677 3665
			                   3645 3668 3668 3674 3671 3659
			                   3629 3659 3657 3651 3657 3642
			                   3606 3639 3637 3614 3627 3611
			                   3575 3604 3606 3566 3587 3571
			                   3532 3553 3560 3508 3536 3519
			                   3475 3486 3496 3441 3467 3450
			                   3382 3403 3410 3354 3378 3354
			                   3200 3200 3200 3200 3200 3200
			                  >;
		};
};
