/* DO NOT EDIT - Automatically generated by python */
/ {
		sunwodasdi_3400_10k_4400:sunwodasdi_3400_10k_4400 {
			fcc = <3400>;
			default_rbatt_mohm = <100>;
			id_identify_min = <0>;
			id_identify_max = <751>;
			id_voltage_min = <496>;
			id_voltage_max = <553>;
			vbat_max = <4400>;
			temp_para = 
						"-32767","0","-1","0","4100","0",
						"0","5","-1","340","4400","0",
						"5","10","-1","1020","4400","3",
						"10","45","-1","-1","4400","3",
						"45","50","-1","1190","4100","3",
						"50","32767","-1","0","4100","0";
			vbat_para = 
						"-32767","3400","-1","820","0",
						"3400","32767","-1","-1","0";
			segment_para = 
						"-32767","4150","3400","4208","50",
						"4150","4450","2380","4400","0";
			batt_brand = "sunwodasdi";
			fcc_temp = <3485 3483 3480 3493 3480 3459>;
			fcc_sf_x = <0 100 200 300 400 500>;
			fcc_sf_y = <100 96 94 92 90 88>;
			fcc_sf_cols = <6>;
			pc_sf_rows = <1>;
			pc_sf_cols = <1>;
			pc_sf_row_entries = <0>;
			pc_sf_percent = <100>;
			pc_sf_sf = <100>;
			rbatt_sf_rows = <28>;
			rbatt_sf_cols = <6>;
			rbatt_sf_percent = <100 95 90 85 80 75 70 65 60 55 50 45 40 35 30 25 20 15 10 9 8 7 6 5 4 3 2 1>;
			rbatt_sf_sf = <
			               2002 1250 638 155 108 95
			               1998 1249 638 155 108 95
			               1864 1223 638 155 108 95
			               1757 1182 627 157 109 95
			               1689 1141 638 161 111 97
			               1628 1144 676 170 115 98
			               1421 993 643 189 125 100
			               1415 915 549 188 125 105
			               1402 916 537 199 136 110
			               1411 900 513 162 128 110
			               1479 901 500 145 106 96
			               1546 977 498 145 106 95
			               1615 1054 540 149 109 97
			               1689 1138 616 151 114 100
			               1775 1219 703 154 115 101
			               1881 1295 790 152 109 95
			               2010 1382 877 151 107 96
			               2172 1513 988 154 107 96
			               3212 1492 849 145 109 97
			               3384 1601 896 148 109 99
			               3606 1725 969 150 110 100
			               3787 1872 1097 152 111 101
			               3954 2018 1202 155 114 103
			               4175 2115 1275 156 112 99
			               4464 2258 1320 158 110 98
			               4784 2424 1381 166 110 98
			               5078 2659 1524 229 120 100
			               5676 3145 1810 519 201 132
			              >;
			pc_temp_ocv_rows = <29>;
			pc_temp_ocv_cols = <6>;
			pc_temp_ocv_percent = <100 95 90 85 80 75 70 65 60 55 50 45 40 35 30 25 20 15 10 9 8 7 6 5 4 3 2 1>;
			pc_temp_ocv_ocv = <
			                   4400 4397 4394 4382 4375 4368
			                   4284 4296 4305 4316 4313 4309
			                   4210 4226 4242 4257 4255 4251
			                   4153 4167 4183 4200 4197 4194
			                   4105 4113 4131 4146 4142 4139
			                   4055 4074 4087 4094 4090 4086
			                   3952 3989 4025 4049 4044 4037
			                   3911 3926 3948 3980 3986 3993
			                   3870 3891 3908 3945 3951 3950
			                   3835 3854 3870 3896 3903 3902
			                   3818 3822 3838 3858 3860 3860
			                   3801 3808 3810 3831 3832 3832
			                   3784 3794 3794 3809 3811 3810
			                   3766 3779 3783 3791 3793 3792
			                   3750 3763 3772 3776 3776 3772
			                   3737 3745 3758 3760 3755 3744
			                   3724 3729 3739 3741 3734 3721
			                   3708 3717 3718 3711 3705 3694
			                   3686 3702 3697 3688 3681 3669
			                   3677 3697 3692 3687 3680 3668
			                   3669 3691 3686 3685 3678 3667
			                   3658 3686 3682 3683 3676 3665
			                   3641 3678 3675 3679 3672 3661
			                   3620 3661 3660 3664 3661 3648
			                   3593 3633 3635 3626 3628 3611
			                   3558 3589 3594 3570 3576 3560
			                   3503 3525 3532 3496 3506 3490
			                   3420 3439 3437 3400 3406 3388
			                   3200 3200 3200 3200 3200 3200
			                  >;
			vol_dec1=  <16>;
			pc_temp_ocv_ocv1 = <
			                   4384 4381 4378 4366 4359 4352
			                   4274 4285 4294 4302 4299 4294
			                   4203 4218 4232 4244 4241 4237
			                   4147 4159 4175 4189 4185 4182
			                   4101 4109 4125 4135 4131 4128
			                   4043 4063 4080 4087 4081 4076
			                   3948 3981 4014 4036 4032 4029
			                   3907 3923 3943 3975 3981 3985
			                   3866 3888 3904 3938 3943 3942
			                   3834 3851 3867 3891 3896 3896
			                   3817 3821 3835 3854 3856 3856
			                   3800 3807 3808 3828 3830 3829
			                   3783 3793 3793 3807 3809 3808
			                   3765 3778 3782 3790 3792 3790
			                   3750 3762 3771 3775 3774 3769
			                   3736 3745 3757 3759 3754 3743
			                   3723 3729 3738 3740 3733 3720
			                   3708 3716 3717 3710 3703 3693
			                   3685 3702 3696 3688 3681 3669
			                   3676 3696 3691 3687 3679 3668
			                   3668 3691 3686 3685 3678 3667
			                   3658 3686 3682 3683 3676 3664
			                   3641 3678 3674 3678 3672 3660
			                   3619 3660 3659 3663 3659 3646
			                   3592 3632 3634 3624 3625 3609
			                   3558 3587 3593 3567 3574 3558
			                   3502 3524 3530 3494 3504 3488
			                   3419 3437 3437 3398 3405 3386
			                   3200 3200 3200 3200 3200 3200
			                  >;
			vol_dec2=  <48>;
			pc_temp_ocv_ocv2 = <
			                   4352 4349 4346 4334 4327 4320
			                   4255 4264 4273 4275 4270 4265
			                   4189 4201 4213 4220 4215 4210
			                   4136 4144 4159 4166 4161 4157
			                   4092 4101 4113 4114 4109 4105
			                   4020 4043 4063 4073 4064 4056
			                   3940 3966 3993 4009 4009 4012
			                   3900 3916 3934 3966 3970 3971
			                   3860 3881 3895 3923 3928 3927
			                   3831 3844 3861 3879 3882 3882
			                   3815 3818 3829 3847 3849 3848
			                   3798 3805 3805 3823 3824 3824
			                   3781 3791 3791 3804 3805 3804
			                   3763 3776 3781 3787 3789 3787
			                   3749 3760 3770 3773 3771 3765
			                   3735 3743 3755 3757 3751 3740
			                   3723 3728 3736 3738 3730 3717
			                   3707 3716 3716 3707 3701 3690
			                   3684 3701 3695 3688 3680 3669
			                   3675 3695 3690 3687 3679 3668
			                   3668 3690 3685 3685 3678 3666
			                   3656 3685 3681 3682 3676 3664
			                   3639 3677 3673 3677 3671 3658
			                   3617 3658 3658 3659 3657 3641
			                   3591 3630 3631 3619 3621 3604
			                   3556 3585 3590 3563 3569 3552
			                   3500 3522 3528 3491 3500 3483
			                   3417 3435 3435 3395 3402 3382
			                   3200 3200 3200 3200 3200 3200
			                  >;
			vol_dec3=  <192>;
			pc_temp_ocv_ocv3 = <
			                   4208 4205 4202 4190 4183 4176
			                   4171 4176 4180 4156 4145 4137
			                   4130 4127 4133 4112 4099 4092
			                   4089 4094 4096 4076 4062 4051
			                   4019 4029 4044 4023 4012 4012
			                   3943 3960 3971 3975 3975 3976
			                   3905 3915 3927 3943 3942 3938
			                   3867 3883 3892 3901 3901 3899
			                   3836 3849 3861 3865 3863 3862
			                   3820 3821 3832 3840 3839 3837
			                   3804 3809 3808 3821 3820 3818
			                   3788 3796 3794 3803 3803 3801
			                   3772 3783 3785 3788 3789 3787
			                   3756 3768 3775 3775 3774 3768
			                   3744 3753 3764 3763 3757 3745
			                   3731 3737 3748 3747 3739 3725
			                   3720 3724 3730 3727 3719 3706
			                   3703 3714 3711 3695 3687 3677
			                   3678 3697 3691 3686 3679 3667
			                   3670 3692 3686 3685 3678 3666
			                   3663 3687 3682 3682 3676 3664
			                   3649 3682 3678 3678 3672 3660
			                   3631 3670 3666 3667 3662 3649
			                   3609 3649 3649 3638 3637 3619
			                   3583 3618 3619 3594 3597 3579
			                   3547 3573 3576 3539 3546 3528
			                   3491 3511 3514 3471 3478 3459
			                   3409 3424 3421 3376 3383 3363
			                   3200 3200 3200 3200 3200 3200
			                  >;
		};
};
