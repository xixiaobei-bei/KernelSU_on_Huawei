/* DO NOT EDIT - Automatically generated by python */
/ {
		desaylgc_2900_200k_4400:desaylgc_2900_200k_4400 {
			fcc = <2900>;
			default_rbatt_mohm = <100>;
			id_identify_min = <2786>;
			id_identify_max = <3312>;
			id_voltage_min = <2941>;
			id_voltage_max = <3167>;
			vbat_max = <4400>;
			temp_para = 
						"-32767","0","-1","0","4100","0",
						"0","5","-1","290","4400","0",
						"5","10","-1","870","4400","3",
						"10","45","-1","-1","4400","3",
						"45","50","-1","1015","4100","3",
						"50","32767","-1","0","4100","0";
			vbat_para = 
						"-32767","3400","-1","820","0",
						"3400","32767","-1","-1","0";
			segment_para = 
						"-32767","4150","2900","4208","50",
						"4150","4450","2030","4400","0";
			batt_brand = "desaylgc";
			fcc_temp = <2918 2922 2919 2940 2926 2906>;
			fcc_sf_x = <0 100 200 300 400 500>;
			fcc_sf_y = <100 96 94 92 90 88>;
			fcc_sf_cols = <6>;
			pc_sf_rows = <1>;
			pc_sf_cols = <1>;
			pc_sf_row_entries = <0>;
			pc_sf_percent = <100>;
			pc_sf_sf = <100>;
			rbatt_sf_rows = <28>;
			rbatt_sf_cols = <6>;
			rbatt_sf_percent = <100 95 90 85 80 75 70 65 60 55 50 45 40 35 30 25 20 15 10 9 8 7 6 5 4 3 2 1>;
			rbatt_sf_sf = <
			               2210 1081 483 124 90 77
			               2208 1081 483 124 90 77
			               2071 1076 490 126 92 78
			               1969 1078 492 130 96 80
			               1957 1064 505 136 100 82
			               1903 1145 537 147 104 86
			               1712 1010 570 165 111 90
			               1704 952 454 174 119 93
			               1678 946 438 188 132 102
			               1675 929 408 131 107 87
			               1713 921 405 122 92 80
			               1765 960 402 126 95 82
			               1834 1013 406 132 100 86
			               1918 1088 424 138 106 90
			               2020 1183 463 141 107 89
			               2144 1288 512 137 97 83
			               2296 1429 557 127 93 81
			               2496 1620 622 128 93 80
			               3811 1588 579 135 100 83
			               4225 1714 591 137 98 83
			               4507 1863 621 134 97 82
			               4893 2056 705 133 99 82
			               5170 2248 772 132 96 82
			               5547 2432 833 133 95 82
			               5894 2517 890 147 100 86
			               6328 2762 949 171 104 86
			               6782 3094 995 313 111 87
			               7716 3649 1160 857 206 109
			              >;
			pc_temp_ocv_rows = <29>;
			pc_temp_ocv_cols = <6>;
			pc_temp_ocv_percent = <100 95 90 85 80 75 70 65 60 55 50 45 40 35 30 25 20 15 10 9 8 7 6 5 4 3 2 1>;
			pc_temp_ocv_ocv = <
			                   4386 4384 4380 4373 4366 4360
			                   4294 4305 4309 4316 4311 4305
			                   4221 4237 4248 4259 4254 4249
			                   4157 4180 4191 4202 4198 4193
			                   4113 4121 4138 4148 4144 4139
			                   4056 4086 4093 4097 4091 4087
			                   3960 3997 4041 4053 4043 4039
			                   3918 3937 3958 3989 3995 3994
			                   3877 3898 3919 3951 3953 3952
			                   3845 3862 3877 3894 3898 3897
			                   3827 3829 3846 3859 3860 3860
			                   3812 3811 3820 3833 3834 3834
			                   3798 3799 3800 3811 3812 3812
			                   3784 3787 3787 3794 3794 3793
			                   3770 3775 3778 3778 3777 3772
			                   3754 3757 3765 3762 3755 3744
			                   3737 3737 3741 3736 3730 3719
			                   3717 3717 3712 3705 3700 3686
			                   3690 3696 3697 3688 3680 3668
			                   3682 3689 3693 3686 3679 3667
			                   3671 3682 3687 3684 3677 3665
			                   3661 3674 3680 3679 3674 3662
			                   3643 3663 3666 3665 3665 3651
			                   3621 3646 3644 3631 3640 3624
			                   3586 3613 3610 3583 3599 3584
			                   3539 3565 3565 3522 3545 3531
			                   3468 3495 3499 3446 3474 3460
			                   3372 3394 3396 3357 3374 3360
			                   3200 3200 3200 3200 3200 3200
			                  >;
			vol_dec1=  <16>;
			pc_temp_ocv_ocv1 = <
			                   4370 4368 4364 4357 4350 4344
			                   4282 4292 4296 4301 4295 4289
			                   4211 4227 4236 4244 4239 4234
			                   4151 4170 4181 4189 4185 4180
			                   4105 4116 4130 4136 4131 4127
			                   4043 4073 4084 4088 4081 4077
			                   3955 3989 4027 4040 4033 4029
			                   3914 3932 3953 3983 3987 3986
			                   3874 3894 3913 3941 3943 3942
			                   3844 3858 3873 3888 3891 3891
			                   3825 3827 3843 3855 3856 3856
			                   3811 3810 3818 3830 3831 3831
			                   3797 3798 3799 3809 3810 3809
			                   3783 3787 3786 3792 3792 3791
			                   3769 3774 3777 3777 3775 3769
			                   3754 3756 3764 3760 3754 3742
			                   3736 3736 3740 3734 3729 3717
			                   3716 3717 3712 3704 3699 3685
			                   3689 3695 3696 3687 3680 3668
			                   3682 3689 3692 3686 3678 3666
			                   3670 3681 3686 3683 3677 3665
			                   3660 3673 3679 3679 3673 3661
			                   3642 3662 3665 3664 3663 3650
			                   3619 3644 3642 3628 3638 3622
			                   3585 3612 3609 3581 3596 3581
			                   3537 3563 3563 3519 3543 3529
			                   3467 3494 3497 3444 3471 3458
			                   3371 3393 3395 3355 3372 3359
			                   3200 3200 3200 3200 3200 3200
			                  >;
			vol_dec2=  <48>;
			pc_temp_ocv_ocv2 = <
			                   4338 4336 4332 4325 4318 4312
			                   4258 4266 4270 4270 4264 4258
			                   4191 4206 4213 4216 4210 4205
			                   4138 4149 4160 4163 4158 4153
			                   4090 4106 4113 4112 4107 4103
			                   4016 4045 4068 4071 4060 4055
			                   3945 3971 4000 4013 4013 4011
			                   3904 3922 3941 3970 3972 3971
			                   3867 3885 3901 3920 3923 3922
			                   3840 3850 3865 3877 3879 3879
			                   3823 3823 3837 3848 3848 3848
			                   3808 3808 3813 3824 3825 3825
			                   3795 3796 3796 3805 3806 3805
			                   3782 3785 3785 3789 3789 3787
			                   3767 3771 3776 3775 3771 3764
			                   3752 3754 3761 3757 3750 3739
			                   3735 3735 3737 3731 3725 3713
			                   3715 3716 3711 3702 3696 3683
			                   3688 3694 3695 3687 3679 3667
			                   3680 3687 3691 3685 3678 3666
			                   3669 3680 3685 3683 3676 3664
			                   3658 3672 3677 3677 3672 3660
			                   3640 3660 3662 3660 3660 3648
			                   3616 3641 3638 3623 3632 3617
			                   3582 3608 3605 3574 3590 3576
			                   3534 3560 3559 3514 3537 3524
			                   3464 3490 3493 3439 3467 3454
			                   3369 3391 3392 3352 3369 3355
			                   3200 3200 3200 3200 3200 3200
			                  >;
			vol_dec3=  <192>;
			pc_temp_ocv_ocv3 = <
			                   4194 4192 4188 4181 4174 4168
			                   4158 4162 4154 4137 4129 4122
			                   4119 4116 4118 4095 4086 4080
			                   4071 4082 4077 4062 4047 4040
			                   3990 4002 4026 4005 4006 4003
			                   3937 3947 3957 3971 3971 3968
			                   3899 3910 3923 3929 3929 3927
			                   3866 3877 3887 3887 3888 3887
			                   3841 3846 3858 3858 3858 3857
			                   3824 3823 3833 3836 3836 3835
			                   3811 3809 3813 3817 3818 3817
			                   3799 3798 3797 3802 3802 3801
			                   3787 3788 3786 3788 3787 3785
			                   3774 3777 3778 3776 3772 3765
			                   3760 3762 3769 3761 3754 3743
			                   3745 3745 3750 3742 3735 3723
			                   3729 3728 3724 3713 3708 3695
			                   3709 3710 3706 3693 3687 3675
			                   3682 3688 3691 3685 3677 3665
			                   3672 3681 3686 3682 3676 3663
			                   3663 3674 3679 3676 3672 3660
			                   3648 3665 3667 3662 3661 3648
			                   3630 3653 3649 3630 3639 3623
			                   3604 3628 3622 3591 3606 3589
			                   3568 3592 3588 3543 3565 3548
			                   3518 3543 3541 3484 3513 3496
			                   3450 3474 3474 3417 3445 3430
			                   3359 3380 3378 3334 3353 3341
			                   3200 3200 3200 3200 3200 3200
			                  >;
		};
};
