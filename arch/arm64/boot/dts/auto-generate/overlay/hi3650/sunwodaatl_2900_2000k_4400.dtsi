/* DO NOT EDIT - Automatically generated by python */
/ {
		sunwodaatl_2900_2000k_4400:sunwodaatl_2900_2000k_4400 {
			fcc = <2900>;
			default_rbatt_mohm = <100>;
			id_identify_min = <3767>;
			id_identify_max = <4095>;
			id_voltage_min = <3838>;
			id_voltage_max = <4082>;
			vbat_max = <4400>;
			temp_para = 
						"-32767","0","-1","0","4100","0",
						"0","5","-1","290","4400","0",
						"5","10","-1","870","4400","3",
						"10","45","-1","-1","4400","3",
						"45","50","-1","1015","4100","3",
						"50","32767","-1","0","4100","0";
			vbat_para = 
						"-32767","3400","-1","820","0",
						"3400","32767","-1","-1","0";
			segment_para = 
						"-32767","4150","2900","4208","50",
						"4150","4450","2030","4400","0";
			batt_brand = "sunwodaatl";
			fcc_temp = <3050 3054 3049 3104 3055 3035>;
			fcc_sf_x = <0 100 200 300 400 500>;
			fcc_sf_y = <100 96 94 92 90 88>;
			fcc_sf_cols = <6>;
			pc_sf_rows = <1>;
			pc_sf_cols = <1>;
			pc_sf_row_entries = <0>;
			pc_sf_percent = <100>;
			pc_sf_sf = <100>;
			rbatt_sf_rows = <28>;
			rbatt_sf_cols = <6>;
			rbatt_sf_percent = <100 95 90 85 80 75 70 65 60 55 50 45 40 35 30 25 20 15 10 9 8 7 6 5 4 3 2 1>;
			rbatt_sf_sf = <
			               1816 1087 492 145 111 99
			               1816 1087 492 145 111 99
			               1772 1093 490 144 112 100
			               1707 1095 492 147 114 101
			               1665 1090 494 152 117 104
			               1633 1125 539 161 123 106
			               1468 985 526 174 129 110
			               1483 968 461 188 138 115
			               1469 970 451 188 148 122
			               1448 959 436 154 130 116
			               1484 967 435 138 111 101
			               1541 1031 435 138 112 101
			               1602 1110 454 142 116 104
			               1681 1203 495 147 121 109
			               1772 1317 552 149 123 111
			               1887 1458 603 147 115 101
			               2034 1609 661 146 113 101
			               2241 1765 782 149 114 101
			               3387 1882 747 143 113 104
			               3743 2109 792 144 116 104
			               4091 2393 863 147 116 106
			               4516 2702 950 148 119 108
			               5022 3063 1065 149 118 106
			               5589 3492 1230 150 115 104
			               6219 3994 1378 152 114 104
			               7217 4701 1609 161 119 105
			               8637 5897 2082 181 127 106
			               12029 7845 2971 343 233 116
			              >;
			pc_temp_ocv_rows = <29>;
			pc_temp_ocv_cols = <6>;
			pc_temp_ocv_percent = <100 95 90 85 80 75 70 65 60 55 50 45 40 35 30 25 20 15 10 9 8 7 6 5 4 3 2 1>;
			pc_temp_ocv_ocv = <
			                   4378 4375 4371 4381 4361 4355
			                   4283 4290 4293 4312 4293 4288
			                   4217 4225 4232 4251 4234 4229
			                   4155 4166 4175 4193 4176 4171
			                   4100 4108 4120 4136 4120 4116
			                   4045 4062 4075 4082 4068 4064
			                   3954 3975 4013 4032 4019 4017
			                   3917 3927 3949 3982 3975 3974
			                   3880 3890 3910 3937 3934 3933
			                   3841 3852 3870 3887 3885 3885
			                   3819 3820 3838 3851 3847 3847
			                   3803 3804 3812 3825 3823 3822
			                   3788 3793 3794 3805 3804 3802
			                   3775 3781 3783 3788 3788 3786
			                   3761 3768 3774 3775 3773 3770
			                   3748 3754 3763 3761 3754 3743
			                   3735 3735 3747 3743 3734 3721
			                   3720 3715 3721 3715 3708 3697
			                   3699 3694 3692 3691 3684 3673
			                   3693 3688 3688 3689 3683 3672
			                   3684 3683 3685 3687 3681 3670
			                   3675 3678 3681 3685 3679 3668
			                   3664 3671 3675 3679 3675 3663
			                   3648 3658 3663 3660 3661 3646
			                   3616 3629 3634 3619 3625 3610
			                   3571 3579 3580 3562 3572 3560
			                   3503 3510 3507 3483 3502 3491
			                   3399 3405 3400 3367 3402 3391
			                   3200 3200 3200 3200 3200 3200
			                  >;
			vol_dec1=  <16>;
			pc_temp_ocv_ocv1 = <
			                   4362 4359 4355 4365 4345 4339
			                   4272 4278 4281 4298 4280 4274
			                   4207 4215 4221 4239 4221 4216
			                   4147 4157 4165 4181 4164 4160
			                   4093 4102 4113 4125 4110 4107
			                   4033 4049 4066 4073 4059 4056
			                   3950 3968 4003 4023 4012 4010
			                   3913 3922 3944 3976 3969 3967
			                   3875 3885 3904 3930 3926 3926
			                   3839 3848 3866 3882 3879 3879
			                   3817 3819 3835 3848 3844 3843
			                   3802 3803 3810 3823 3821 3820
			                   3788 3792 3793 3803 3802 3801
			                   3774 3780 3782 3787 3787 3785
			                   3761 3767 3773 3774 3772 3768
			                   3748 3753 3762 3760 3753 3741
			                   3735 3734 3746 3742 3733 3720
			                   3720 3715 3720 3714 3707 3696
			                   3699 3693 3691 3690 3684 3672
			                   3692 3687 3688 3689 3683 3671
			                   3684 3683 3685 3687 3681 3670
			                   3675 3678 3681 3684 3679 3668
			                   3663 3671 3674 3679 3674 3662
			                   3647 3657 3662 3658 3659 3644
			                   3615 3627 3631 3617 3623 3608
			                   3569 3577 3577 3560 3570 3558
			                   3502 3508 3505 3481 3500 3489
			                   3397 3404 3398 3365 3400 3390
			                   3200 3200 3200 3200 3200 3200
			                  >;
			vol_dec2=  <48>;
			pc_temp_ocv_ocv2 = <
			                   4330 4327 4323 4333 4313 4307
			                   4251 4255 4257 4272 4253 4248
			                   4188 4196 4200 4215 4197 4192
			                   4131 4138 4146 4159 4142 4138
			                   4080 4090 4099 4105 4090 4087
			                   4008 4023 4047 4056 4042 4039
			                   3941 3955 3984 4007 3997 3995
			                   3905 3913 3934 3964 3957 3955
			                   3867 3877 3894 3915 3912 3911
			                   3834 3841 3859 3871 3868 3869
			                   3815 3816 3829 3841 3838 3837
			                   3800 3801 3806 3818 3816 3815
			                   3786 3790 3791 3800 3799 3798
			                   3773 3778 3781 3785 3785 3783
			                   3759 3766 3772 3772 3769 3764
			                   3747 3751 3761 3758 3751 3739
			                   3734 3733 3744 3740 3731 3718
			                   3719 3714 3717 3712 3705 3693
			                   3698 3692 3690 3690 3683 3672
			                   3691 3687 3688 3689 3682 3671
			                   3683 3682 3685 3687 3681 3670
			                   3673 3677 3680 3684 3678 3667
			                   3662 3669 3673 3678 3672 3661
			                   3644 3655 3659 3656 3655 3641
			                   3612 3624 3627 3613 3618 3604
			                   3566 3574 3573 3555 3566 3553
			                   3498 3504 3501 3477 3496 3486
			                   3395 3401 3395 3362 3397 3387
			                   3200 3200 3200 3200 3200 3200
			                  >;
			vol_dec3=  <192>;
			pc_temp_ocv_ocv3 = <
			                   4186 4183 4179 4189 4168 4163
			                   4159 4158 4157 4154 4133 4128
			                   4110 4108 4112 4109 4090 4086
			                   4065 4071 4070 4065 4047 4043
			                   3985 3988 4015 4021 4006 4003
			                   3935 3941 3956 3979 3969 3967
			                   3902 3906 3921 3941 3934 3932
			                   3867 3872 3885 3896 3890 3890
			                   3836 3839 3854 3860 3856 3856
			                   3817 3816 3828 3836 3833 3832
			                   3803 3803 3807 3817 3814 3813
			                   3790 3793 3793 3801 3799 3798
			                   3778 3782 3783 3787 3786 3784
			                   3765 3771 3775 3775 3773 3770
			                   3754 3759 3766 3763 3757 3746
			                   3742 3744 3755 3749 3740 3728
			                   3729 3725 3736 3730 3722 3709
			                   3716 3710 3708 3701 3694 3683
			                   3693 3687 3688 3689 3682 3671
			                   3685 3683 3685 3687 3681 3670
			                   3677 3679 3682 3684 3679 3668
			                   3667 3673 3676 3679 3675 3663
			                   3654 3663 3666 3664 3666 3650
			                   3632 3644 3645 3633 3637 3623
			                   3599 3608 3608 3589 3597 3583
			                   3551 3558 3554 3531 3545 3534
			                   3483 3489 3482 3454 3477 3469
			                   3383 3389 3379 3347 3383 3374
			                   3200 3200 3200 3200 3200 3200
			                  >;
		};
};
