/**
 * Copyright (C) 2014 Hisilicon Ltd.
 *
 *  This program is free software; you can redistribute it and/or modify
 *  it under the terms of the GNU General Public License version 2 as
 *  publishhed by the Free Software Foundation.
 */

/include/ "HMA_LX9_VE_overlay.dtsi"

/ {
    board_id = <8415>;
};
	&rootparam{
		hisi,boardid = <8 4 1 5>;
		hisi,boardname = "HMA_LX9_VF";
		hisi,modem_id = <0x37003000>;
	};