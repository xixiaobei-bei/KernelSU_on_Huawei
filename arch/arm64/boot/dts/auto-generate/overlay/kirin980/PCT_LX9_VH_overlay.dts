/**
 * Copyright (C) 2014 Hisilicon Ltd.
 *
 *  This program is free software; you can redistribute it and/or modify
 *  it under the terms of the GNU General Public License version 2 as
 *  publishhed by the Free Software Foundation.
 */

/dts-v1/;
/plugin/;
/include/ "PCT_LX9_VG_overlay.dtsi"
/include/ "PCT_LX9_VH_pin.dtsi"
/include/ "PCT_LX9_VH_modem_pin.dtsi"

/ {
    board_id = <8919>;
};

	&rootparam{
		hisi,boardid = <8 9 1 9>;
		hisi,boardname = "PCT_LX9_VH";
		hisi,modem_id = <0x37614C00>;
	};