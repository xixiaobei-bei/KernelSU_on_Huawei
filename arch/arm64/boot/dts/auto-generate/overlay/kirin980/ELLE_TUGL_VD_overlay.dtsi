/**
 * Copyright (C) 2014 Hisilicon Ltd.
 *
 *  This program is free software; you can redistribute it and/or modify
 *  it under the terms of the GNU General Public License version 2 as
 *  publishhed by the Free Software Foundation.
 */

/include/ "ELLE_TUGL_VC2_overlay.dtsi"

/ {
    board_id = <8494>;
};
    &rootparam{
		compatible = "hisilicon,vendor";
		hisi,boardid = <8 4 9 4>;
		hisi,boardname = "ELLE_TUGL_VD";
		hisi,modem_id = <0x37043800>;
		hisi,product_id = <0x37043800>;
		hisi,product_name = "ELE-AL00";
	};

    /*hisi customize*/
    &hisi_cust_cfg {
        ini_file_name = "/vendor/etc/cfg_elle_tugl_vd.ini";
    };

	&sensorhub_ext_config {
        homo_activity = "enabled";
    }; 

