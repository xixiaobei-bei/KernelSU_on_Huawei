/**
 * Copyright (C) 2014 Hisilicon Ltd.
 *
 *  This program is free software; you can redistribute it and/or modify
 *  it under the terms of the GNU General Public License version 2 as
 *  publishhed by the Free Software Foundation.
 */

/include/ "PCT_LX9_VD_overlay.dtsi"

/ {
    board_id = <8938>;
};

	&rootparam{
		hisi,boardid = <8 9 3 8>;
		hisi,boardname = "PCT_LX9_VE";
		hisi,modem_id = <0x37613C00>;
	};