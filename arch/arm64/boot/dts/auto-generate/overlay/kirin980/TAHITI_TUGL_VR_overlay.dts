/**
 * Copyright (C) 2014 Hisilicon Ltd.
 *
 *  This program is free software; you can redistribute it and/or modify
 *  it under the terms of the GNU General Public License version 2 as
 *  publishhed by the Free Software Foundation.
 */

/dts-v1/;
/plugin/;
/include/ "TAHITI_TUGL_VQ_overlay.dtsi"
/include/ "TAHITI_TUGL_VR_pin.dtsi"
/include/ "TAHITI_TUGL_VR_modem_pin.dtsi"

/ {
    board_id = <8535>;
};
    &rootparam{
		compatible = "hisilicon,vendor";
		hisi,boardid = <8 5 3 5>;
		hisi,boardname = "TAHITI_TUGL_VR";
		hisi,modem_id = <0x37030800>;
		hisi,product_id = <0x37030800>;
		hisi,product_name = "TAH-AL00";
	};
