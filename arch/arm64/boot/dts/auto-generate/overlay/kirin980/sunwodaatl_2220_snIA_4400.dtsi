/* DO NOT EDIT - Automatically generated by python */
		&sunwodaatl_2220_snIA_4400 {
			fcc = <2220>;
			default_rbatt_mohm = <100>;
			identify_type = "id_sn";
			id_sn = "IA";
			vbat_max = <4400>;
			temp_para = 
						"-32767","0","-1","0","4100","0",
						"0","5","-1","222","4400","0",
						"5","10","-1","666","4400","3",
						"10","45","-1","-1","4400","3",
						"45","50","-1","777","4100","3",
						"50","32767","-1","0","4100","0";
			vbat_para = 
						"-32767","3400","-1","820","0",
						"3400","32767","-1","-1","0";
			segment_para = 
						"-32767","4150","2220","4208","50",
						"4150","4450","1554","4400","0";
			batt_brand = "sunwodaatl";
			fcc_temp = <2229 2229 2233 2232 2220 2191>;
			fcc_sf_x = <0 100 200 300 400 500 600 700 800 1000 1500>;
			fcc_sf_y = <100 96 94 92 90 88 87 84 81 75 50>;
			fcc_sf_cols = <11>;
			pc_sf_rows = <1>;
			pc_sf_cols = <1>;
			pc_sf_row_entries = <0>;
			pc_sf_percent = <100>;
			pc_sf_sf = <100>;
			rbatt_sf_rows = <28>;
			rbatt_sf_cols = <6>;
			rbatt_sf_percent = <100 95 90 85 80 75 70 65 60 55 50 45 40 35 30 25 20 15 10 9 8 7 6 5 4 3 2 1>;
			rbatt_sf_sf = <
			               2589 1148 463 93 60 44
			               2588 1148 463 93 60 44
			               2464 1107 448 93 62 46
			               2330 1074 438 93 63 49
			               2227 1051 441 96 67 50
			               2209 1065 446 100 69 52
			               1962 1054 498 111 75 55
			               1934 903 447 124 81 60
			               1937 902 413 151 99 70
			               1907 883 387 125 86 54
			               1940 890 378 91 63 49
			               2007 912 381 89 64 50
			               2093 965 391 95 67 52
			               2204 1047 400 102 72 56
			               2333 1150 430 108 81 58
			               2490 1281 473 99 64 51
			               2665 1450 525 88 63 51
			               2893 1705 601 90 62 51
			               3378 1705 602 115 73 52
			               3854 1810 602 112 81 58
			               4229 2017 635 110 81 72
			               4647 2264 683 112 83 66
			               5130 2541 754 116 89 66
			               5638 2786 800 119 89 74
			               6166 3034 827 135 109 87
			               6878 3446 919 163 115 87
			               7905 4027 1028 172 118 95
			               8175 3377 1287 194 160 131
			              >;
			pc_temp_ocv_rows = <29>;
			pc_temp_ocv_cols = <6>;
			pc_temp_ocv_percent = <100 95 90 85 80 75 70 65 60 55 50 45 40 35 30 25 20 15 10 9 8 7 6 5 4 3 2 1>;
			pc_temp_ocv_ocv = <
			                   4400 4396 4398 4394 4389 4383
			                   4310 4318 4331 4332 4327 4320
			                   4239 4254 4271 4273 4268 4262
			                   4177 4197 4213 4214 4210 4205
			                   4118 4141 4157 4157 4154 4149
			                   4073 4091 4104 4103 4099 4095
			                   3980 4034 4056 4054 4050 4045
			                   3936 3955 3983 4002 4000 4000
			                   3899 3918 3937 3961 3960 3959
			                   3858 3879 3896 3909 3907 3902
			                   3831 3847 3860 3866 3865 3865
			                   3813 3821 3833 3839 3838 3838
			                   3799 3803 3811 3817 3817 3816
			                   3786 3791 3794 3800 3799 3798
			                   3773 3780 3783 3784 3784 3778
			                   3758 3767 3772 3766 3757 3746
			                   3739 3748 3753 3743 3735 3723
			                   3719 3723 3725 3718 3709 3695
			                   3701 3701 3699 3692 3684 3674
			                   3695 3696 3697 3691 3682 3671
			                   3688 3690 3694 3689 3681 3669
			                   3679 3682 3690 3687 3678 3666
			                   3666 3671 3681 3681 3672 3658
			                   3643 3651 3659 3664 3652 3635
			                   3608 3617 3617 3626 3614 3596
			                   3555 3564 3561 3574 3561 3544
			                   3483 3492 3485 3504 3491 3474
			                   3387 3397 3374 3400 3386 3374
			                   3200 3200 3200 3200 3200 3200
			                  >;
		};
