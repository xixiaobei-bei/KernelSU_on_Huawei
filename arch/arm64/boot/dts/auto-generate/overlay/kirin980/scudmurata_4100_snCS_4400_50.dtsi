/* DO NOT EDIT - Automatically generated by python */
		&scudmurata_4100_snCS_4400_50 {
			fcc = <4100>;
			default_rbatt_mohm = <100>;
			identify_type = "id_sn";
			id_sn = "CS";
			vbat_max = <4400>;
			temp_para = 
						"-32767","0","-1","0","4100","0",
						"0","5","-1","410","4400","0",
						"5","10","-1","1230","4400","3",
						"10","45","-1","-1","4400","3",
						"45","50","-1","1435","4100","3",
						"50","32767","-1","0","4100","0";
			vbat_para = 
						"-32767","3400","-1","820","0",
						"3400","32767","-1","-1","0";
			segment_para = 
						"-32767","4150","4100","4208","50",
						"4150","4450","2870","4400","0";
			batt_brand = "scudmurata";
			fcc_temp = <4071 4069 4074 4099 4093 4068>;
			fcc_sf_x = <0 100 200 300 400 500 600 700 800 1000 1500>;
			fcc_sf_y = <100 96 94 92 90 88 87 84 81 75 50>;
			fcc_sf_cols = <11>;
			pc_sf_rows = <1>;
			pc_sf_cols = <1>;
			pc_sf_row_entries = <0>;
			pc_sf_percent = <100>;
			pc_sf_sf = <100>;
			rbatt_sf_rows = <28>;
			rbatt_sf_cols = <6>;
			rbatt_sf_percent = <100 95 90 85 80 75 70 65 60 55 50 45 40 35 30 25 20 15 10 9 8 7 6 5 4 3 2 1>;
			rbatt_sf_sf = <
			               1346 634 298 107 82 71
			               1350 638 302 108 81 71
			               1338 640 308 110 82 72
			               1319 636 313 113 84 73
			               1307 630 319 119 86 73
			               1283 621 322 125 89 75
			               1262 607 311 133 95 78
			               1263 602 300 135 103 83
			               1262 604 292 121 94 80
			               1263 607 289 109 83 73
			               1277 614 292 105 80 70
			               1302 626 296 107 80 70
			               1339 645 302 110 82 72
			               1392 659 312 114 86 76
			               1461 694 326 114 83 74
			               1556 756 345 110 80 71
			               1690 816 364 110 82 74
			               1886 914 391 111 82 72
			               2920 999 366 113 86 75
			               3119 1052 373 113 86 76
			               3363 1135 385 115 86 78
			               3657 1239 415 120 90 82
			               4099 1370 455 123 89 81
			               4743 1524 491 123 84 79
			               5538 1706 536 126 90 81
			               6971 2099 650 140 96 85
			               9710 2915 952 158 102 92
			               18449 4327 1478 193 127 95
			              >;
			pc_temp_ocv_rows = <29>;
			pc_temp_ocv_cols = <6>;
			pc_temp_ocv_percent = <100 95 90 85 80 75 70 65 60 55 50 45 40 35 30 25 20 15 10 9 8 7 6 5 4 3 2 1>;
			pc_temp_ocv_ocv = <
			                   4346 4344 4343 4338 4335 4329
			                   4270 4277 4281 4278 4274 4269
			                   4202 4217 4222 4220 4217 4212
			                   4139 4159 4166 4163 4160 4156
			                   4081 4100 4110 4110 4107 4103
			                   4022 4043 4057 4058 4056 4053
			                   3967 3987 4000 4010 4010 4007
			                   3921 3939 3950 3963 3965 3964
			                   3879 3898 3907 3915 3917 3917
			                   3844 3862 3870 3874 3875 3874
			                   3816 3832 3840 3844 3844 3843
			                   3792 3807 3815 3821 3821 3819
			                   3773 3788 3795 3801 3802 3800
			                   3754 3772 3779 3785 3786 3783
			                   3736 3758 3767 3768 3765 3758
			                   3718 3743 3753 3748 3742 3731
			                   3698 3722 3733 3728 3722 3709
			                   3675 3691 3704 3699 3695 3683
			                   3649 3660 3670 3675 3670 3658
			                   3637 3653 3665 3671 3666 3654
			                   3627 3645 3658 3665 3661 3649
			                   3614 3637 3651 3656 3654 3642
			                   3596 3627 3640 3640 3640 3627
			                   3578 3610 3621 3609 3609 3596
			                   3546 3579 3587 3563 3565 3553
			                   3498 3529 3532 3505 3508 3499
			                   3438 3452 3456 3429 3435 3428
			                   3340 3347 3352 3335 3338 3341
			                   3200 3200 3200 3200 3200 3200
			                  >;
		};
