/{
    gpu: mali@E82C0000 {
        compatible = "arm,malit6xx", "arm,mali-midgard";
        #cooling-cells = <3>; /* min followed by max */
        gpu_outstanding = <0x0>;
        reg = <0x0 0xE82C0000 0x0 0x4000>;
        interrupts = <0 258 4 0 259 4 0 260 4>;
	interrupt-names = "JOB", "MMU", "GPU";
	clocks = <&clk_g3d>;
	gpu-supply = <&g3d>;
	operating-points = <
		/* <frequency> <voltage>*/
		111000	550000
		185000	650000
		238000	650000
		332000	650000
		404000	700000
		480000	700000
		576000	800000
		653000	800000
		730000	900000
		807000	900000
	>;
	system-coherency=<1>;
    };
};
