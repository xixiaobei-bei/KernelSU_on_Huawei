/**
 * Copyright (C) 2014 Hisilicon Ltd.
 *
 *  This program is free software; you can redistribute it and/or modify
 *  it under the terms of the GNU General Public License version 2 as
 *  publishhed by the Free Software Foundation.
 */

/include/ "ELLE_TUGL_VD_overlay.dtsi"

/ {
    board_id = <8552>;
};
    &rootparam{
		compatible = "hisilicon,vendor";
		hisi,boardid = <8 5 5 2>;
		hisi,boardname = "ELLE_TUGL_VF";
		hisi,modem_id = <0x37044800>;
		hisi,product_id = <0x37044800>;
		hisi,product_name = "ELE-AL00";
	};
