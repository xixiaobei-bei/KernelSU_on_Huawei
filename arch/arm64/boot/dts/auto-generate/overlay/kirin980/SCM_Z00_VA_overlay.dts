/**
 * Copyright (C) 2014 Hisilicon Ltd.
 *
 *  This program is free software; you can redistribute it and/or modify
 *  it under the terms of the GNU General Public License version 2 as
 *  publishhed by the Free Software Foundation.
 */

/dts-v1/;
/plugin/;
/include/ "SCM_Z00_VA_pin.dtsi"
/include/ "SCM_Z00_VA_modem_pin.dtsi"
/include/ "SCM_Z00_VA_hi6402_pin.dtsi"
/include/ "huawei_audio_dto.dtsi"
/include/ "huawei_hall_inputhub_dto.dtsi"
/include/ "huawei_pmucurr_test_dto.dtsi"
/include/ "usb_short_circuit_protect_dto.dtsi"
/include/ "hi11xx_connectivity_dto.dtsi"
/include/ "lcdkit3.0/default/devkit_lcd_kit.dtsi"
/include/ "lcdkit3.0/scm/devkit_lcd_kit.dtsi"
/include/ "default_3000_68k_4352.dtsi"
/include/ "desayatl_7350_39k_4400.dtsi"
/include/ "scudsony_7350_110k_4400.dtsi"
/include/ "sunwodaguangyu_7350_22k_4400.dtsi"

/ {
    board_id = <8100>;
};

&hisi_peripheral_tm {
    compatible = "hisi,hisi-peripheral-tm";
    hisi,peripheral_sensors = <13>;

    hisi,detect_system_h_tm_chanel = <7>;
    hisi,detect_system_h_tm_ntc = "austin_hkadc_soc_temp_table";
    hisi,detect_system_h_tm_state = "enable";
    hisi,detect_system_h_throttling = <53>;
    hisi,detect_system_h_shutdown = <55>;
    hisi,detect_system_h_below_vr_min = <53>;
    hisi,detect_system_h_over_skin = <12>;

    hisi,detect_flash_led_tm_chanel = <3>;
    hisi,detect_flash_led_tm_ntc = "austin_hkadc_soc_temp_table";
    hisi,detect_flash_led_tm_state = "disable";

    hisi,detect_charger_tm_chanel = <4>;
    hisi,detect_charger_tm_ntc = "austin_hkadc_soc_temp_table";
    hisi,detect_charger_tm_state = "enable";

    hisi,detect_pa_0_tm_chanel = <5>;
    hisi,detect_pa_0_tm_ntc = "austin_hkadc_pa_temp_table";
    hisi,detect_pa_0_tm_state = "enable";

    hisi,detect_pa_1_tm_chanel = <6>;
    hisi,detect_pa_1_tm_ntc = "austin_hkadc_pa_temp_table";
    hisi,detect_pa_1_tm_state = "enable";

    hisi,detect_dcxo0_tm_chanel = <15>;
    hisi,detect_dcxo0_tm_ntc = "austin_hkadc_adc_temp_table";
    hisi,detect_dcxo0_tm_state = "enable";

    hisi,detect_shell_tm_chanel = <7>;
    hisi,detect_shell_tm_ntc = "austin_hkadc_soc_temp_table";
    hisi,detect_shell_tm_state = "disable";

    hisi,detect_charger1_tm_chanel = <4>;
    hisi,detect_charger1_tm_ntc = "austin_hkadc_soc_temp_table";
    hisi,detect_charger1_tm_state = "disable";

    hisi,detect_usb_tm_chanel = <3>;
    hisi,detect_usb_tm_ntc = "austin_hkadc_soc_temp_table";
    hisi,detect_usb_tm_state = "enable";

    hisi,detect_rfboard_tm_chanel = <8>;
    hisi,detect_rfboard_tm_ntc = "austin_hkadc_soc_temp_table";
    hisi,detect_rfboard_tm_state = "enable";

    hisi,detect_wireless_tm_chanel = <9>;
    hisi,detect_wireless_tm_ntc = "austin_hkadc_soc_temp_table";
    hisi,detect_wireless_tm_state = "enable";

    hisi,detect_ir_tm_chanel = <12>;
    hisi,detect_ir_tm_ntc = "austin_hkadc_soc_temp_table";
    hisi,detect_ir_tm_state = "enable";

    hisi,detect_dot_tm_chanel = <13>;
    hisi,detect_dot_tm_ntc = "austin_hkadc_soc_temp_table";
    hisi,detect_dot_tm_state = "enable";

    status = "ok";
};

&hisi_shell {
    compatible = "hisi,shell-temp";
    interval = <5000>;
    bias = <0>;
    count = <6>;
    status = "ok";
    sensors {
        sensor0 {
            type = "system_h";
            coef = "0","0","0","0","0","0";
        };
        sensor1 {
            type = "charger";
            coef = "0","0","0","0","0","0";
        };
        sensor2 {
            type = "pa_0";
            coef = "0","0","0","0","0","0";
        };
        sensor3 {
            type = "dcxo0";
            coef = "0","0","0","0","0","0";
        };
    };
};

&hisi_ambient {
    compatible = "hisi,ambient-temp";
    interval = <900>;
    bias = <1>;
    status = "ok";
    sensors {
        sensor0 {
            type = "system_h";
        };
        sensor1 {
            type = "charger";
        };
        sensor2 {
            type = "pa_0";
        };
        sensor3 {
            type = "dcxo0";
        };
    };
};

&fastboot_pmic {
	hisilicon,init-reg-num = <1>;
	hisilicon,init-reg-addrs = <0x18C>;
	hisilicon,init-reg-vals  = <0x1>;
};

	&rootparam {
		compatible = "hisilicon,vendor";
		hisi,boardid = <8 1 0 0>;
		hisi,boardname = "SCM_Z00_VA";
		hisi,modem_id = <0x37218000>;
		hisi,product_id = <0x37218000>;
	};

	&chosen {};

	&hisi_ion {
		heap_sec_drm@20 {
			status = "disabled";
		};
	};
	&spmi {
		pmic@0 {
			gpios = <&gpio28 0 0>;
			hisilicon,pmic_fpga_flag=<0>;
				pmic_led@a0 {
					status = "ok";
					led@a0 {  /*red*/
						hisilicon,each_max_iset = <0x02>;
					};
					led@a1 {  /*green*/
						hisilicon,each_max_iset = <0x02>;
					};
					led@a2 {  /*blue*/
						hisilicon,each_max_iset = <0x02>;
					};
				};
				pmic_rtc@a0 {
					status = "ok";
				};
				ponkey@b1{
		           		status = "ok";
				};
				pmic_mntn@a0 {
					status = "ok";
				};
				hi6421v700_coul@1 {
					status = "ok";
                                };
				hisi_soh_pmic@1 {
					status = "ok";
				};
				pmic_vibrator {
					hisi_pmic_vibrator,max-timeout-ms = <10000>;
					hisi_pmic_vibrator,label = "vibrator";
					vibrator-reg-on = <0xA000>;
					vibrator-reg-off = <0xA001>;
					vibrator-voltage = <1800>;
					vibrator-boost-power = <0>; //0 not used 5v , 1 used
					haptics-cfg =
						<0x00 0x00 0x08 0x0f 0x10 0x00 0x18 0x0f 0x1f 0x00 0x26 0x0f 0x2d 0x00 0x32 0x0f 0x37 0x00 0x3b 0x0f 0x3d 0xc0 0x3f 0x0d 0x40 0x00 0x40 0x00 0x40 0x00 0x40 0x00 0x40 0x00 0x40 0x00 0x40 0x00 0x40 0x00>,//6 cycle
						<0x00 0x00 0x08 0x0f 0x10 0x00 0x18 0x0f 0x1f 0x00 0x26 0x0f 0x2d 0x00 0x32 0x0f 0x37 0x00 0x3b 0x0f 0x3d 0x00 0x3f 0x0f 0x40 0x00 0x40 0x0f 0x40 0xf0 0x40 0x07 0x40 0x00 0x40 0x00 0x40 0x00 0x40 0x00>,//8 cycle
						<0x00 0x00 0x08 0x0f 0x10 0x00 0x18 0x0f 0x1f 0x00 0x26 0x0f 0x2d 0x00 0x32 0x0f 0x37 0x00 0x3b 0x0f 0x3d 0x00 0x3f 0x0f 0x40 0x00 0x40 0x0f 0x40 0x00 0x40 0x0f 0x40 0x00 0x40 0x0f 0x40 0xf0 0x40 0x07>;//10 cycle
					status = "disabled";
				};

			ldo34@33 {
				compatible = "hisilicon-hisi-ldo";
				regulator-name = "ldo34";
				regulator-always-on;
				regulator-min-microvolt = <3100000>;
				regulator-max-microvolt = <3100000>;
				hisilicon,hisi-ctrl = <0x33 0x01 0x10>;
				hisilicon,hisi-vset = <0x76 0x07>;
				hisilicon,hisi-n-voltages = <8>;
				hisilicon,hisi-vset-table = <2900000>, <2800000>,
				                            <2700000>, <2600000>,
				                            <3300000>, <3200000>,
				                            <3100000>, <3000000>;
				hisilicon,hisi-off-on-delay-us = <20000>;
				hisilicon,hisi-enable-time-us = <360>;
				hisilicon,hisi-eco-microamp = <10000>;
				hisilicon,valid-modes-mask = <0x06>;
				hisilicon,valid-idle-mask = <0x0D>;
				status = "ok";
			};
		};
	};
	&soh_core {
		status = "ok";
	};
	&pd_dpm {
		otg_channel = <0>;
		switch_manual_enable = <0>;
		abnormal_cc_detection = <1>;
		status = "ok";
	};
	&hisi_vibrator {
		compatible = "hisilicon,vibrator";
		vibrator-reg-on = <0x1D7>;
		vibrator-reg-off = <0x1D7>;
		vibrator-bit-on = <0x1>;
		vibrator-reg-current = <0x1E4>;
		vibrator-bit-current = <0xF>;
		vibrator-use-dr = <1>;
		status = "ok";
	};

	&fastboot_battery {
		status = "ok";
	};
	&fastboot_charger {
		hw_charger_type = <4>;
		chip_i2c_num = <6>;
		status = "ok";
	};
	&hisi_battery {
		batt_name = <&default_3000_68k_4352 &desayatl_7350_39k_4400 &scudsony_7350_110k_4400 &sunwodaguangyu_7350_22k_4400>;
		status = "ok";
	};
	&desayatl_7350_39k_4400 {
		temp_para =
			"-32767","0","-1","0","4100","0",
			"0","5","-1","700","4400","0",
			"5","10","-1","2000","4400","3",
			"10","40","-1","-1","4400","3",
			"40","50","-1","2500","4100","3",
			"50","32767","-1","0","4100","0";
	};
	&scudsony_7350_110k_4400 {
		temp_para =
			"-32767","0","-1","0","4100","0",
			"0","5","-1","700","4400","0",
			"5","10","-1","2000","4400","3",
			"10","40","-1","-1","4400","3",
			"40","50","-1","2500","4100","3",
			"50","32767","-1","0","4100","0";
	};
	&sunwodaguangyu_7350_22k_4400 {
		temp_para =
			"-32767","0","-1","0","4100","0",
			"0","5","-1","700","4400","0",
			"5","10","-1","2000","4400","3",
			"10","40","-1","-1","4400","3",
			"40","50","-1","2500","4100","3",
			"50","32767","-1","0","4100","0";
	};
	&hisi_bci_battery {
		battery_design_fcc = <7500>;
		battery_board_type = <2>; /*0:sft 1:udp 2:asic*/
		status = "ok";
	};
	&coul_core {
		adc_batt_id = <11>;
		adc_batt_temp = <10>;
		r_coul_mohm = <5>;
                r_pcb = <0>;
		last_soc_enable = <1>;
		soc_at_term = <97>;
		iscd_enable = <1>;
		ntc_compensation_is = <1>;
		ntc_temp_compensation_para =
			"6000", "50",
			"5000", "40",
			"4000", "30";
		basp_policy = <
			3 100000 60  200 200 60  0 920001032
			2 70000 80  40  50  80  0 920001031
			1 40000 90  20  0   90  0 920001029
			0 0     0   0   0   100 0 0
		>;
		normal_cutoff_vol_mv = <3000>;
		sleep_cutoff_vol_mv = <3200>;
		status = "ok";
	};
	&hisi_coul_drv_test {
		status = "ok";
	};
	&hw_pmucurr_test {
		power_numbers = <2>;
		status = "ok";
	};
	&wireless_charger {
		interference_para = <
			0x01 0xfe 138 1 470
			0x02 0xfd 0   0 900
		>;

		status = "disabled";
	};
	&wireless_tx {
		tx_iin_limit = <0 500 300 1000 1000 0 0 0 0 1000 0 0>;
		status = "disabled";
	};

	&vbus_channel_boost_gpio {
		gpio_otg_switch = <&gpio16 7 0>;
		status = "disabled";
	};

	&wired_channel_switch {
		use_ovp_cutoff_wired_channel = <0>;
		use_super_switch_cutoff_wired_channel = <0>;
		use_wireless_switch_cutoff_wired_channel = <1>;
		status = "disabled";
	};

	&ncp3902_channel_switch {
		gpio_chgsw_en = <&gpio21 2 0>;
		status = "disabled";
	};
	&huawei_charger {
		pd_support = <1>;
		support_usb_nonstandard_ico = <1>;
		support_standard_ico = <0>;
		ico_all_the_way = <0>;
		water_check_enabled = <1>;
		fcp_vindpm = <8100>;
		charge_done_sleep_enabled;
		leak_current_check = <1>;
		status = "ok";
	};
	&huawei_batt_info {
		status = "disabled";
	};

	&hwsw_kb {
		compatible = "huawei,sw_kb";
		adc_kb_detect = <12>;
		kb_connect_adc_min = <120>;
		kb_connect_adc_max = <260>;
		kb_online_adc_min = <1400>;
		kb_online_adc_max = <1600>;
		product_id = <0x1000>;
		gpio_kb_int = <&gpio29 3 0>;           /*gpio235*/
		gpio_kb_tx = <&gpio24 5 0>;            /*gpio197*/
		gpio_kb_vdd_ctrl = <&gpio26 1 0>;      /*gpio209*/
		status = "ok";
	};

	&ds28el15 {
		id-mask = /bits/ 8 <0xFF 0x00 0x00 0x00 0x00 0xF0 0xFF 0x00>;
		id-example = /bits/ 8 <0x97 0x00 0x00 0x00 0x00 0xD0 0x04 0x00>;
		status = "disabled";
	};
	&gpio_pl061_ctrl {
		onewire-gpio = <&gpio28 4 0>;
		status = "disabled";
	};
	&charging_core {
		status = "ok";
		iterm = <160>;
		iin_usb = <470>;
		ichg_usb = <500>;
		ichg_fcp = <3000>;
		iin_fcp = <1600>;
		ichg_ac = <2100>;
		iin_ac = <2000>;
		iin_wireless = <1250>;
		ichg_wireless = <2100>;
		inductance_para =
			"-32767", "15", "1900", "0",
			"15", "32767", "1900", "0";
		wireless_para = <
			0x01 0 0 0 5000 500  5000 500
			0x02 0 0 0 5000 1000 5000 1000
			0x03 0 0 0 5000 1000 5000 1000
			0x04 0 0 0 5000 1000 5000 1000
			0x05 0 1 1 9000 1050 5000 1000
			0x06 0 0 0 5000 1000 5000 1000
			0x07 0 0 0 5000 1000 5000 1000
			0x08 0 1 1 9000 1050 5000 1000
			0x09 0 0 0 5000 500  5000 500
			0xff 0 0 0 5000 1000 5000 1000
		>;
	};
	&direct_charge_ps {
		boost_5v_support_scp_power = <1>;
		bst_ctrl_use_common_gpio = <1>;
		is_need_bst_ctrl = <1>;
		status = "disabled";
	};
	&direct_charger {
		use_5A = <1>;
		volt_para =
			"4100", "5000", "4650",
			"4250", "4650", "2800",
			"4360", "2800", "1200";
		compensate_r = <20>;
		cc_cable_detect_enable = <1>;
		full_path_res_max = <160>;
		scp_work_on_charger = <1>;
		standard_cable_full_path_res_max = <200>;
		first_cc_stage_timer_in_min = <5>;
		stage_need_to_jump = "1";
		temp_para =
			"-32767", "10", "0",
			"10", "45", "5000",
			"45", "32767", "0";
		status = "disabled";
	};

	&direct_charger_sc {
		use_5A = <1>;
		dc_volt_ratio = <2>;
		max_adaptor_vset = <10000>;
		init_adapter_vset = <8800>;
		vol_err_th = <500>;
		adaptor_leakage_current_th = <600>;
		init_delt_vset = <400>;
		vstep = <20>;
		max_dc_bat_vol = <4380>;
		max_current_for_none_standard_cable = <6000>;
		volt_para =
			"4250", "8300", "6300",
			"4330", "6300", "5300",
			"4350", "5300", "4400",
			"4380", "4400", "1200";
		compensate_r = <13>;
		cc_cable_detect_enable = <1>;
		full_path_res_max = <220>;
		scp_work_on_charger = <1>;
		standard_cable_full_path_res_max = <220>;
		first_cc_stage_timer_in_min = <5>;
		stage_need_to_jump = "1";
		temp_para =
			"-32767", "10", "0",
			"10", "45", "8000",
			"45", "32767", "0";
		status = "disabled";
	};

	&huawei_smpl {
		status = "ok";
	};

	&vbat_ovp {
		status = "disabled";
	};

	&huawei_cpu_buck {
		status = "disabled";
	};

	&huawei_hi6422v200_pmu1 {
		status = "disabled";
	};

	&huawei_hi6422v200_pmu2 {
		status = "disabled";
	};

	&usb_short_circuit_protect {
		gpio_usb_short_circuit_protect = <&gpio16 6 0>;
		status = "disabled";
	};

	&power_thermalzone {
		status = "disabled";
		sensors{
			sensor0{
				sensor_name = "usb_port";
				ops_name = "hisi_adc";
				adc_channel = <3>;
				ntc_index = <1>;
			};
			sensor1{
				sensor_name = "charger1";
				ops_name = "bq25970";
				adc_channel = <0>;
				ntc_index = <0>;
			};
		};
	};

	&boost_5v {
		boost_5v_use_common_pmic = <1>;
		status = "disabled";
	};

	&water_check {
		need_pinctrl_config = <0>;
		gpio_sim = <&gpio7 1 0>;
		gpio_key = <&gpio7 0 0>;
		/*check_type, gpio_name, irq_no, multiple_handle, dmd_offset, prompt, action*/
		water_check_para =
				"1","sim","-1","1","2","0","0",
				"1","key","-1","1","3","0","0",
				"2","null","-1","0","4","0","0";
		status = "ok";
	};
	&spmi {
		pmic@0 {
			gpios = <&gpio22 1 0>;
		};
	};
	&huawei_usb {
		maximum-speed = "super-speed";
	};
	/*antenna board detect*/
	&antenna_boardid_detect{
		compatible = "huawei,antenna_boardid_detect";
		gpio30 = <&gpio30 2 0>;
		temp_gpio = "gpio30";
		expect_value = <0>;
		pinctrl-names = "default", "idle";
		pinctrl-0 = <&gpio242_cfg_func &gpio242_pmx_func>;
		pinctrl-1 = <&gpio242_cfg_idle &gpio242_pmx_idle>;
		status = "disabled";
	};

	&fastboot {
		compatible = "hisilicon,fastboot";
		i2c3-pin = <0>;
		gpio-keyup = <213>;
		gpio-keydown = <210>;
		uart-board-type = <1>;
		/*UDP_TYPE 0,PRODUCT 1,FPGA 2,EMU 3*/
		lpm3-board-type = <0>;
		jtagtosd-board-type = <2>;
		motor-vib_type = <0>;

		i2c-select = <1>;
		i2c-sel0-gpio = <164>;
		i2c-sel1-gpio = <165>;
		i2c-sel0-val = <0>;
		i2c-sel1-val = <0>;
	};

	&pmu {
		compatible = "hisilicon,pmu";
		reg = <0x00 0xFFF34000 0x00 0x1000>;
		status = "ok";
	};

	&hisi_ipc {

	};
	&hisi_ao_ipc {

	};

        &hisi_sysctrl {
                compatible = "hisilicon,sysctrl";
                reg = <0x0 0xfff0a000 0x0 0x1000>;
                status = "ok";
        };

        &hisi_pctrl {
                compatible = "hisilicon,pctrl";
                reg = <0x0 0xe8a09000 0x0 0x1000>;
                status = "ok";
        };

        &hisi_crgctrl {
                compatible = "hisilicon,crgctrl";
                reg = <0x0 0xfff35000 0x0 0x1000>;
                status = "ok";
        };

	&hisi_iomcuctrl {
                compatible = "hisilicon,iomcuctrl";
                reg = <0x0 0xFFD7e000 0x0 0x1000>;
                status = "ok";
        };

        &hisi_pmctrl {
                compatible = "hisilicon,pmctrl";
                reg = <0x0 0xfff31000 0x0 0x1000>;
                status = "ok";
        };

        &hisi_mmc1_sysctrl {
                compatible = "hisilicon,mmc1_sysctrl";
                reg = <0x0 0xfc186000 0x0 0x1000>;
                status = "ok";
        };

        &hisi_media1ctrl {
                compatible = "hisilicon,media1ctrl";
                reg = <0x0 0xE87FF000 0x0 0x1000>;
                status = "ok";
        };

        &hisi_media2ctrl {
                compatible = "hisilicon,media2ctrl";
                reg = <0x0 0xE8900000 0x0 0x1000>;
                status = "ok";
        };
	&kirin_pcie_rc {
		/* LTR latency param comes from EP: BCM43596 -- 0x10031003 */
		ep_ltr_latency = <0x10031003>;

		/* T-poweron comes from EP: BCM43596 -- 0x10031003 */
		ep_l1ss_ctrl2 = <0x61>;

		/* the lower_16(l1ss_ctrl1) 0x370F needed by RC and must be set; the upper_16 comes from EP*/
		l1ss_ctrl1 = <0x4004370F>;

		/* Delay time come from BCM43596 powerup sequence */
		t_ref2perst = <21000 23000>;
		t_perst2access = <7000 8000>;
		t_perst2rst = <10000 11000>;
	};


	&kirin_pcie_ep {
	};

	&hisi_axierr {
	        compatible = "hisi,hi3xxx-axi";
	        interrupts = <0 23 4>, <0 1 4>;
	        status = "ok";
        };

    &hisi_reset {
            compatible = "hisilicon,hi3xxx-reset";
            status = "ok";
        };

	&peripherals {
		compatible = "simple-bus";
		#address-cells = <1>;
		#size-cells = <1>;
		ranges = <0x0 0x00000000 0x0 0xffffffff>;

		clk6250khz {
			compatible = "fixed-clock";
			#clock-cells = <0>;
			clock-frequency = <6297600>;
			clock-output-names = "clk6250khz";
		};
/*
		clk4800khz {
			compatible = "fixed-clock";
			#clock-cells = <0>;
			clock-frequency = <32768>;
			clock-output-names = "clk4800khz";
		};
*/

		dma@fdf30000 {
			status = "ok";
		};
	};

	&maxim_ioctl {
		compatible = "huawei,maxim_ioctl";
		status = "ok";
	};

	&nve_uartctl {
		compatible = "hisilicon,hisi-uartctl";
		uartctl = "0000060F0F0F0F0F0F0F0F0F0F";
	};
	&amba {
		#address-cells = <2>;
		#size-cells = <2>;
		compatible = "arm,amba-bus";
		interrupt-parent = <&gic>;
		ranges;

		/*rtc0: rtc@FFF04000 {
				compatible = "arm,rtc-pl031", "arm,primecell";
				reg = <0xfff04000 0x1000>;
				interrupts = <0 46 0x4>;
				clocks = <&pclk>;
				clock-names = "apb_pclk";
				status = "ok";
		};*/

		/* rtc@FFF05000 {
				compatible = "arm,rtc-pl031", "arm,primecell";
				reg = <0xfff05000 0x1000>;
				interrupts = <0 47 0x4>;
				clocks = <&pclk>;
				clock-names = "apb_pclk";
				status = "ok";
		};*/


                watchdog@ffd7c000{
                        compatible = "hisilicon,iomcu-watchdog";
                        reg = <0x0 0xFFD7C000 0x0 0x1000>;
                        status = "ok";
                };

		/*wdt1@e8a07000 {
			compatible = "arm,sp805", "arm,primecell";
			reg = <0x0 0xe8a07000 0x0 0x1000>;
			interrupts = <0 45 4>;
			clocks = <&pclk_gate_wd0 &pclk>;
			clock-names = "pclk_wd0", "apb_pclk";
		};*/

		uart@fdf02000 {
			status = "ok";
		};

		uart@fdf00000 {
			status = "disabled";
		};

		uart@fdf03000 {
			status = "ok";
		};

		uart@ffd74000 {
			status = "disabled";
		};

		uart@fdf01000 {
			status = "ok";
		};

		uart@fdf05000 {
			status = "ok";
		};

		uart@fff32000 {
			status = "ok";
		};

		dx_cc63p@fdf0e000 {
			compatible = "dx,cc63p";
			reg = <0x0 0xfdf0e000 0x0 0x1000>;
			interrupt-parent = <&gic>;
			interrupts = <0 135 4>;
			status = "ok";
		};

		spi@ffd70000 {
			status = "disabled";

			spi_dev0@0 {
					compatible = "spi_dev0";
					spi-max-frequency = <100000>;
					reg = <0>;
					pl022,com-mode = <0>;
					pl022,interface = <0>;
					pl022,rx-level-trig = <3>;
					pl022,tx-level-trig = <3>;
					pl022,ctrl-len = <7>;
					pl022,wait-state = <0>;
					pl022,duplex = <0>;
					pl022,slave-tx-disable = <0>;
			};

			spi_dev1@1 {
					compatible = "spi_dev1";
					spi-max-frequency = <13000000>;
					reg = <1>;
					pl022,com-mode = <1>;
					pl022,interface = <0>;
					pl022,rx-level-trig = <3>;
					pl022,tx-level-trig = <3>;
					pl022,ctrl-len = <7>;
					pl022,wait-state = <0>;
					pl022,duplex = <0>;
					pl022,slave-tx-disable = <0>;
			};

			spi_dev2@2 {
					compatible = "spi_dev2";
					spi-max-frequency = <13000000>;
					reg = <2>;
					pl022,com-mode = <2>;
					pl022,interface = <0>;
					pl022,rx-level-trig = <3>;
					pl022,tx-level-trig = <3>;
					pl022,ctrl-len = <7>;
					pl022,wait-state = <0>;
					pl022,duplex = <0>;
					pl022,slave-tx-disable = <0>;
			};

			spi_dev3@3 {
					compatible = "spi_dev3";
					spi-max-frequency = <13000000>;
					reg = <3>;
					pl022,com-mode = <0>;
					pl022,interface = <0>;
					pl022,rx-level-trig = <3>;
					pl022,tx-level-trig = <3>;
					pl022,ctrl-len = <7>;
					pl022,wait-state = <0>;
					pl022,duplex = <0>;
					pl022,slave-tx-disable = <0>;
			};
		};

		spi@fdf08000 {
			status = "disabled";

			spi_dev10@10 {
					compatible = "spi_dev10";
					spi-max-frequency = <100000>;
					reg = <0>;
					pl022,com-mode = <0>;
					pl022,interface = <0>;
					pl022,rx-level-trig = <3>;
					pl022,tx-level-trig = <3>;
					pl022,ctrl-len = <7>;
					pl022,wait-state = <0>;
					pl022,duplex = <0>;
					pl022,slave-tx-disable = <0>;
			};
		};

		spi@fff2a000 {
			status = "disabled";
		};
		/* I2C0 ~ I2C4 */
		i2c@FFD71000 {
			status = "disabled";
		};

		i2c@FFD72000 {
			status = "disabled";
		};

		i2c@FDF0C000 {
			status = "ok";

			fusb30x_kirin980_i2c3@22 {
				status = "ok";
				fairchild,int_n = <&gpio33 3 0>;
			};
			rt1711_kirin980_i2c3@4e {
				status = "ok";
				rt1711,irq_pin = <&gpio33 3 0>;
			};
			tusb422_kirin980_i2c3@20 {
				status = "ok";
				ti,alert-gpio = <&gpio33 3 0>;
			};
			rt9748: rt9748@67 {
				compatible = "rt9748";
				loadswitch_int = <&gpio27 4 0>;
				loadswitch_en = <&gpio31 1 0>;
				sense_r_mohm = <20>;
				reg = <0x67>;
				status = "disabled";
			};
			bq25970: bq25970@65 {
				compatible = "bq25970";
				switchcap_int = <&gpio27 5 0>;
				reg = <0x65>;
				tsbus_high_r_kohm = <100>;
				tsbus_low_r_kohm = <100>;
				status = "disabled";
			};
		};

		i2c@FDF0D000 {
			status = "ok";

			smartpa@34{
				compatible = "huawei,smartpakit_i2c";
				reg = <0x34>;
				/* 0 MAXIM, 1 NXP, 2 TI, 3 OTHER, 4:huawei customize */
				chip_vendor = <4>;
				/* refer to smartpakit.out_device prop */
				chip_id = <0>;
				chip_model = "tfa9874";
				status = "ok";

				/* reg_ctl node: a node contains three data<addr value ctl_type>
				* ctl_type: 0 read reg(default), 1 write reg, 2 only time delay
				* value:
				*     read:  reg number(num >= 1)
				*     write: reg value
				*     delay: time delay
				* time delay unit: msecs */
				version_regs = <0x03 1 0>;
				dump_regs = <0 256 0>;

				hw_reset {
					gpio_reset = <&gpio30 5 0>;
					/* gpio_state node: a node contains two data<state delay>
					* time delay unit: msecs */
					ctl_sequence = <1 1 0 1>;
				};
				irq_handler {
					gpio_irq = <&gpio25 1 0>;
					/* 0x0 IRQF_TRIGGER_NONE, 0x1 IRQF_TRIGGER_RISING, 0x2 IRQF_TRIGGER_FALLING, 0x4 IRQF_TRIGGER_HIGH, 0x8 IRQF_TRIGGER_LOW*/
					irq_flags = <2>;
					/* whether or not need reset chip*/
					need_reset;
					rw_sequence = <
						0x10 1 0
						0x11 1 0
						0x13 1 0
						0x14 1 0
						0x40 1 0
						0x41 1 0
						0x42 1 0
					>;
				};

				regmap_cfg {
					reg_bits = <8>;
					val_bits = <16>;
					/* 0 REGCACHE_NONE, 1 REGCACHE_RBTREE, 2 REGCACHE_COMPRESSED, 3 REGCACHE_FLAT */
					cache_type = <0>;
					max_register = <0xff>;
					reg_defaults = <
						0x00 0x1801
						0x01 0x0014
					>;
				};
			};

			smartpa@35 {
				compatible = "huawei,smartpakit_i2c";
				reg = <0x35>;
				/* 0 MAXIM, 1 NXP, 2 TI, 3 OTHER, 4:huawei customize */
				chip_vendor = <4>;
				/* refer to smartpakit.out_device prop */
				chip_id = <1>;
				chip_model = "tfa9874";
				status = "ok";

				/* reg_ctl node: a node contains three data<addr value ctl_type>
				* ctl_type: 0 read reg(default), 1 write reg, 2 only time delay
				* value:
				*     read:  reg number(num >= 1)
				*     write: reg value
				*     delay: time delay
				* time delay unit: msecs */
				version_regs = <0x03 1 0>;
				dump_regs = <0 256 0>;

				hw_reset {
					gpio_reset = <&gpio30 5 0>;
					/* gpio_state node: a node contains two data<state delay>
					* time delay unit: msecs */
					ctl_sequence = <1 1 0 1>;
				};

				irq_handler {
					gpio_irq = <&gpio25 3 0>;
					/* 0x0 IRQF_TRIGGER_NONE, 0x1 IRQF_TRIGGER_RISING, 0x2 IRQF_TRIGGER_FALLING, 0x4 IRQF_TRIGGER_HIGH, 0x8 IRQF_TRIGGER_LOW*/
					irq_flags = <2>;
					/* whether or not need reset chip*/
					need_reset;
					rw_sequence = <
						0x10 1 0
						0x11 1 0
						0x13 1 0
						0x14 1 0
						0x40 1 0
						0x41 1 0
						0x42 1 0
					>;
				};

				regmap_cfg {
					reg_bits = <8>;
					val_bits = <16>;
					/* 0 REGCACHE_NONE, 1 REGCACHE_RBTREE, 2 REGCACHE_COMPRESSED, 3 REGCACHE_FLAT */
					cache_type = <0>;
					max_register = <0xff>;
					reg_defaults = <
						0x00 0x1801
						0x01 0x0014
					>;
				};
			};

			smartpa@36 {
				compatible = "huawei,smartpakit_i2c";
				reg = <0x36>;
				/* 0 MAXIM, 1 NXP, 2 TI, 3 OTHER, 4:huawei customize */
				chip_vendor = <4>;
				/* refer to smartpakit.out_device prop */
				chip_id = <2>;
				chip_model = "tfa9874";
				status = "ok";

				/* reg_ctl node: a node contains three data<addr value ctl_type>
				 * ctl_type: 0 read reg(default), 1 write reg, 2 only time delay
				 * value:
				 *     read:  reg number(num >= 1)
				 *     write: reg value
				 *     delay: time delay
				 * time delay unit: msecs */
				version_regs = <0x03 1 0>;
				dump_regs = <0 256 0>;
				hw_reset {
					gpio_reset = <&gpio30 5 0>;
					/* gpio_state node: a node contains two data<state delay>
					 * time delay unit: msecs */
					ctl_sequence = <1 1 0 1>;
				};
				irq_handler {
					gpio_irq = <&gpio29 1 0>;
					/* 0x0 IRQF_TRIGGER_NONE, 0x1 IRQF_TRIGGER_RISING, 0x2 IRQF_TRIGGER_FALLING, 0x4 IRQF_TRIGGER_HIGH, 0x8 IRQF_TRIGGER_LOW*/
					irq_flags = <2>;
					/* whether or not need reset chip*/
					need_reset;
					rw_sequence = <
						0x10 1 0
						0x11 1 0
						0x13 1 0
						0x14 1 0
						0x40 1 0
						0x41 1 0
						0x42 1 0
					>;
				};
				regmap_cfg {
					reg_bits = <8>;
					val_bits = <16>;
					/* 0 REGCACHE_NONE, 1 REGCACHE_RBTREE, 2 REGCACHE_COMPRESSED, 3 REGCACHE_FLAT */
					cache_type = <0>;
					max_register = <0xff>;
					reg_defaults = <
						0x00 0x1801
						0x01 0x0014
					>;
				};
			};

			smartpa@37 {
				compatible = "huawei,smartpakit_i2c";
				reg = <0x37>;
				/* 0 MAXIM, 1 NXP, 2 TI, 3 OTHER, 4:huawei customize */
				chip_vendor = <4>;
				/* refer to smartpakit.out_device prop */
				chip_id = <3>;
				chip_model = "tfa9874";
				status = "ok";

				/* reg_ctl node: a node contains three data<addr value ctl_type>
				 * ctl_type: 0 read reg(default), 1 write reg, 2 only time delay
				 * value:
				 *     read:  reg number(num >= 1)
				 *     write: reg value
				 *     delay: time delay
				 * time delay unit: msecs */
				version_regs = <0x03 1 0>;
				dump_regs = <0 256 0>;
				hw_reset {
					gpio_reset = <&gpio30 5 0>;
					/* gpio_state node: a node contains two data<state delay>
					 * time delay unit: msecs */
					ctl_sequence = <1 1 0 1>;
				};
				irq_handler {
					gpio_irq = <&gpio28 7 0>;
					/* 0x0 IRQF_TRIGGER_NONE, 0x1 IRQF_TRIGGER_RISING, 0x2 IRQF_TRIGGER_FALLING, 0x4 IRQF_TRIGGER_HIGH, 0x8 IRQF_TRIGGER_LOW*/
					irq_flags = <2>;
					/* whether or not need reset chip*/
					need_reset;
					rw_sequence = <
						0x10 1 0
						0x11 1 0
						0x13 1 0
						0x14 1 0
						0x40 1 0
						0x41 1 0
						0x42 1 0
					>;
				};
				regmap_cfg {
					reg_bits = <8>;
					val_bits = <16>;
					/* 0 REGCACHE_NONE, 1 REGCACHE_RBTREE, 2 REGCACHE_COMPRESSED, 3 REGCACHE_FLAT */
					cache_type = <0>;
					max_register = <0xff>;
					reg_defaults = <
						0x00 0x1801
						0x01 0x0014
					>;
				};
			};

			smartpa@4C {
				compatible = "huawei,smartpakit_i2c";
				reg = <0x4C>;
				/* 0 MAXIM, 1 NXP, 2 TI, 3 OTHER, 4:huawei customize */
				chip_vendor = <4>;
				/* refer to smartpakit.out_device prop */
				chip_id = <0>;
				chip_model = "tas2562";
				/* maybe trigger one irq after some chip reset, ext. tas2560
				* debounce wait time unit: msecs */
				reset_debounce_wait_time = <100>;
				status = "ok";

				/* reg_ctl node: a node contains three data<addr value ctl_type>
				* ctl_type: 0 read reg(default), 1 write reg, 2 only time delay
				* value:
				*     read:  reg number(num >= 1)
				*     write: reg value
				*     delay: time delay
				* time delay unit: msecs */
				version_regs = <
					0	0	1
					125	1	0
					>;
				dump_regs = <
					0	0	1
					0	128	0
					0	50	1
					0	128	0
					0	51	1
					0	128	0
					0	52	1
					0	128	0
				>;
				hw_reset {
					gpio_reset = <&gpio30 5 0>;	/* GPIO 245 */
					/* gpio_state node: a node contains two data<state delay>
					* time delay unit: msecs */
					ctl_sequence = <0 3 1 2>;
				};

				irq_handler {
					gpio_irq = <&gpio25 1 0>;	/* GPIO 201 */
					/* 0x0 IRQF_TRIGGER_NONE, 0x1 IRQF_TRIGGER_RISING, 0x2 IRQF_TRIGGER_FALLING, 0x4 IRQF_TRIGGER_HIGH, 0x8 IRQF_TRIGGER_LOW*/
					irq_flags = <2>;
					/* whether or not need reset chip*/
					need_reset;
					rw_sequence = <
						0	20	2
						0	0	1
						26	1	0
						27	1	0
						31	1	0
						32	1	0
						36	1	0
						37	1	0
						2	1	0
						120	1	0
					>;
				};

				regmap_cfg {
					reg_bits = <8>;
					val_bits = <8>;
					/* 0 REGCACHE_NONE, 1 REGCACHE_RBTREE, 2 REGCACHE_COMPRESSED, 3 REGCACHE_FLAT */
					cache_type = <0>;
					max_register = <128>;
				};
			};

			smartpa@4D {
				compatible = "huawei,smartpakit_i2c";
				reg = <0x4D>;
				/* 0 MAXIM, 1 NXP, 2 TI, 3 OTHER, 4:huawei customize */
				chip_vendor = <4>;
				/* refer to smartpakit.out_device prop */
				chip_id = <1>;
				chip_model = "tas2562";
				/* maybe trigger one irq after some chip reset, ext. tas2560
				* debounce wait time unit: msecs */
				reset_debounce_wait_time = <100>;
				status = "ok";

				/* reg_ctl node: a node contains three data<addr value ctl_type>
				* ctl_type: 0 read reg(default), 1 write reg, 2 only time delay
				* value:
				*     read:  reg number(num >= 1)
				*     write: reg value
				*     delay: time delay
				* time delay unit: msecs */
				version_regs = <
					0	0	1
					125	1	0
					>;
				dump_regs = <
					0	0	1
					0	128	0
					0	50	1
					0	128	0
					0	51	1
					0	128	0
					0	52	1
					0	128	0
				>;
				hw_reset {
					gpio_reset = <&gpio30 5 0>;	/* GPIO 245 */
					/* gpio_state node: a node contains two data<state delay>
					* time delay unit: msecs */
					ctl_sequence = <0 3 1 2>;
				};

				irq_handler {
					gpio_irq = <&gpio25 3 0>;	/* GPIO 203 */
					/* 0x0 IRQF_TRIGGER_NONE, 0x1 IRQF_TRIGGER_RISING, 0x2 IRQF_TRIGGER_FALLING, 0x4 IRQF_TRIGGER_HIGH, 0x8 IRQF_TRIGGER_LOW*/
					irq_flags = <2>;
					/* whether or not need reset chip*/
					need_reset;
					rw_sequence = <
						0	20	2
						0	0	1
						26	1	0
						27	1	0
						31	1	0
						32	1	0
						36	1	0
						37	1	0
						2	1	0
						120	1	0
					>;
				};

				regmap_cfg {
					reg_bits = <8>;
					val_bits = <8>;
					/* 0 REGCACHE_NONE, 1 REGCACHE_RBTREE, 2 REGCACHE_COMPRESSED, 3 REGCACHE_FLAT */
					cache_type = <0>;
					max_register = <128>;
				};
			};

			smartpa@4E {
				compatible = "huawei,smartpakit_i2c";
				reg = <0x4E>;
				/* 0 MAXIM, 1 NXP, 2 TI, 3 OTHER, 4:huawei customize */
				chip_vendor = <4>;
				/* refer to smartpakit.out_device prop */
				chip_id = <2>;
				chip_model = "tas2562";
				/* maybe trigger one irq after some chip reset, ext. tas2560
				* debounce wait time unit: msecs */
				reset_debounce_wait_time = <100>;
				status = "ok";

				/* reg_ctl node: a node contains three data<addr value ctl_type>
				* ctl_type: 0 read reg(default), 1 write reg, 2 only time delay
				* value:
				*     read:  reg number(num >= 1)
				*     write: reg value
				*     delay: time delay
				* time delay unit: msecs */
				version_regs = <
					0	0	1
					125	1	0
					>;
				dump_regs = <
					0	0	1
					0	128	0
					0	50	1
					0	128	0
					0	51	1
					0	128	0
					0	52	1
					0	128	0
				>;
				hw_reset {
					gpio_reset = <&gpio30 5 0>;	/* GPIO 245 */
					/* gpio_state node: a node contains two data<state delay>
					* time delay unit: msecs */
					ctl_sequence = <0 3 1 2>;
				};

				irq_handler {
					gpio_irq = <&gpio29 1 0>;	/* GPIO 233 */
					/* 0x0 IRQF_TRIGGER_NONE, 0x1 IRQF_TRIGGER_RISING, 0x2 IRQF_TRIGGER_FALLING, 0x4 IRQF_TRIGGER_HIGH, 0x8 IRQF_TRIGGER_LOW*/
					irq_flags = <2>;
					/* whether or not need reset chip*/
					need_reset;
					rw_sequence = <
						0	20	2
						0	0	1
						26	1	0
						27	1	0
						31	1	0
						32	1	0
						36	1	0
						37	1	0
						2	1	0
						120	1	0
					>;
				};

				regmap_cfg {
					reg_bits = <8>;
					val_bits = <8>;
					/* 0 REGCACHE_NONE, 1 REGCACHE_RBTREE, 2 REGCACHE_COMPRESSED, 3 REGCACHE_FLAT */
					cache_type = <0>;
					max_register = <128>;
				};
			};

			smartpa@4F {
				compatible = "huawei,smartpakit_i2c";
				reg = <0x4F>;
				/* 0 MAXIM, 1 NXP, 2 TI, 3 OTHER, 4:huawei customize */
				chip_vendor = <4>;
				/* refer to smartpakit.out_device prop */
				chip_id = <3>;
				chip_model = "tas2562";
				/* maybe trigger one irq after some chip reset, ext. tas2560
				* debounce wait time unit: msecs */
				reset_debounce_wait_time = <100>;
				status = "ok";

				/* reg_ctl node: a node contains three data<addr value ctl_type>
				* ctl_type: 0 read reg(default), 1 write reg, 2 only time delay
				* value:
				*     read:  reg number(num >= 1)
				*     write: reg value
				*     delay: time delay
				* time delay unit: msecs */
				version_regs = <
					0	0	1
					125	1	0
					>;
				dump_regs = <
					0	0	1
					0	128	0
					0	50	1
					0	128	0
					0	51	1
					0	128	0
					0	52	1
					0	128	0
				>;
				hw_reset {
					gpio_reset = <&gpio30 5 0>;	/* GPIO 245 */
					/* gpio_state node: a node contains two data<state delay>
					* time delay unit: msecs */
					ctl_sequence = <0 3 1 2>;
				};

				irq_handler {
					gpio_irq = <&gpio28 7 0>;	/* GPIO 231 */
					/* 0x0 IRQF_TRIGGER_NONE, 0x1 IRQF_TRIGGER_RISING, 0x2 IRQF_TRIGGER_FALLING, 0x4 IRQF_TRIGGER_HIGH, 0x8 IRQF_TRIGGER_LOW*/
					irq_flags = <2>;
					/* whether or not need reset chip*/
					need_reset;
					rw_sequence = <
						0	20	2
						0	0	1
						26	1	0
						27	1	0
						31	1	0
						32	1	0
						36	1	0
						37	1	0
						2	1	0
						120	1	0
					>;
				};

				regmap_cfg {
					reg_bits = <8>;
					val_bits = <8>;
					/* 0 REGCACHE_NONE, 1 REGCACHE_RBTREE, 2 REGCACHE_COMPRESSED, 3 REGCACHE_FLAT */
					cache_type = <0>;
					max_register = <128>;
				};
			};

			nfc@28{
				status = "disabled";
				reg = <0x28>;
				compatible = "hisilicon,pn547_nfc";
				nfc_on_type = "hi6421v700_pmic";
				nfc_brcm_conf_name = "libnfc-brcm.conf";
				nfc_nxp_name = "libnfc-nxp.conf";
				nfc_card_num = <0x2>;
				clk_status ="pmu_hi6421v700";
				pn547,dload = <&gpio31 2 0>;
				pn547,irq = <&gpio27 3 0>;
				pn547,ven = <>;
				pinctrl-1 = <&gpio250_pmx_idle &gpio219_pmx_idle>;
				pinctrl-0 = <&gpio250_pmx_func &gpio219_pmx_func>;
				pinctrl-names = "default","idle";
				clock-names = "clk_out0";
				clocks = <&clk_gate_out0>;
				nfc_chip_type = "pn553";
				nfc_single_channel = "true";
				nfc_ese_type = "hisee";
			};

		tps65132@3e {
				compatible = "hisilicon,tps65132_phy";
				reg = <0x3e>;
				gpios = <&gpio23 1 0>, <&gpio27 6 0>;
				tps65132_i2c_bus_id = <4>;
				tps65132_support = <1>;
				status = "ok";
			};
                        hw_lm3642@63{
                                compatible = "huawei,lm3642";
                                reg = <0x63>;
                                huawei,flash-name = "lm3642";
                                huawei,flash-index = <0>;
                                huawei,flash-type = <0>;
                                huawei,need-wakelock = <0>;
                                huawei,slave-address = <0x63>;
                                huawei,flash-pin = <013 999 999>;
                                huawei,led-type = <0>; /* 1, dual tempature; 0, dual white */
                                huawei,flash-chipid = <0x00>;
                                huawei,flash_current = <7>;
                                huawei,torch_current = <2>;
                                status = "ok";
                        };

                        hw_mp3331@67{
                                compatible = "huawei,mp3331";
                                reg = <0x67>;
                                huawei,flash-name = "mp3331";
                                huawei,flash-index = <0>;
                                huawei,flash-type = <0>;
                                huawei,need-wakelock = <0>;
                                huawei,slave-address = <0x67>;
                                huawei,flash-pin = <013 999 999>;
                                huawei,led-type = <0>;
                                huawei,flash_current = <24>;
                                huawei,torch_current = <5>;
                                huawei,flash-chipid = <0x18>;
                                status = "ok";
                        };

                        huawei,aw3642@7F{
                                compatible = "huawei,aw3642";
                                reg = <0x7f>;/*actual 0x63*/
                                huawei,flash-name = "aw3642";
                                huawei,flash-index = <0>;
                                huawei,flash-type = <0>;
                                huawei,need-wakelock = <0>;
                                huawei,slave-address = <0x7f>;/*actual 0x63*/
                                huawei,flash-pin = <013 999 999>;
                                huawei,led-type = <0>; /* 1, dual tempature; 0, dual white */
                                huawei,flash-chipid = <0x36>;
                                huawei,flash_current = <31>;
                                huawei,torch_current = <23>;
                                status = "ok";
                        };

			ti,lp8556{
				compatible = "ti,lp8556";
				lp8556_support = <1>;
				reg = <0x2C>;
				lp8556_i2c_bus_id = <4>;
				lp8556_hw_en_gpio = <10>;
				bl_on_lk_mdelay = <20>;
				bl_on_kernel_mdelay = <32>;
				bl_led_num = <6>;
				lp8556_device_control = <0x85>;
				lp8556_eprom_cfg0 = <0xff>;
				lp8556_eprom_cfg1 = <0xcf>;
				lp8556_eprom_cfg2 = <0x28>;
				lp8556_eprom_cfg3 = <0x52>;
				lp8556_eprom_cfg4 = <0x72>;
				lp8556_eprom_cfg5 = <0x20>;
				lp8556_eprom_cfg6 = <0x40>;
				lp8556_eprom_cfg7 = <0xF7>;
				lp8556_eprom_cfg9 = <0x80>;
				lp8556_eprom_cfgA = <0x0f>;
				lp8556_eprom_cfgE = <0x0e>;
				lp8556_eprom_cfg9E = <0x22>;
				lp8556_led_enable = <0x3f>;
				lp8556_level_lsb = <0x10>;
				lp8556_level_msb = <0x11>;
				status = "ok";
			};

			rohm_bh1749@38{
				status = "disabled";
				reg = <0x38>;
				compatible = "rohm,bh1749";
			};


		};

		i2c@FDF0A000 {
			status = "ok";

			hi6523_charger_i2c6@6B{
				status = "ok";
				fcp_support = <1>;
				scp_support = <1>;
				vclamp = <150>;
				bat_comp = <30>;
				gpio_int = <&gpio27 2 0>;
				ico_current_mode = <0>;
			};
			wireless_idtp9221_i2c6@61 {
				gpio_int = <&gpio28 5 0>;
				gpio_en = <&gpio2 0 0>;
				gpio_sleep_en = <&gpio1 1 0>;
				rx_fod_5v = <5312 4252 4246 4246 4248 4248 5140 0>;
				rx_fod_9v = <11670 11656 10376 10374 6534 6534 0 0>;
				latest_otp_version = "0x88 0x66 0x03 0x0f";
				status = "disabled";
			};
		};

		i2c@FDF0B000 {
			status = "ok";
		};
	};
	/* end amba */

	/*ts kit*/
	&ts_kit {
		compatible = "huawei,ts_kit";
		bus_type = "i2c";
		product = "schumann";
		bus_id = <7>;
		has_virtualkey = <0>;
		fpga_flag = <0>;
		reset_gpio = <&gpio1 7 0>;
		irq_gpio = <&gpio26 4 0>;
		parade: touchscreen@24 {
			status = "ok";
			compatible = "parade";
			reg = <0x24>;
			slave_address = <0x24>;
			parade,adapter_id = "cyttsp5_i2c_adapter";

			/*project related info*/
			project_id = "CAME31010"; /* 31: tt41701, 010:eely*/
			chip_vendor = "parade";
			chip_name = "tt41701";
			module_vendor = "eely"; /* first vendor, will rewirte from panel id*/

			parade,pinctrl_set = <1>; /* 0-no set, 1-set by self */
			pinctrl-names = "default", "idle";
			pinctrl-0 = <&gpio212_cfg_func>;
			pinctrl-1 = <&gpio212_cfg_idle>;

			power_self_ctrl=<1>; /*0-Power is controlled by LCD, 1-Power is self controlled*/
			ts-kit-iovdd-type = <1>; /* 0-unused 1-ldo 2-gpio */
			ts-kit-iovdd-supply = <&ldo29>;
			ts-kit-iovdd-value = <1850000>;
			ts-kit-vcc-type = <1>; /* 0-unused 1-ldo 2-gpio */
			ts-kit-vcc-supply = <&ldo17>;
			ts-kit-vcc-value = <3300000>;
			touch_switch_flag = <0>;
			get_brightness_info_flag = <0>; /* 0 - no need 1 - need */
			create_project_id_flag = <1>;
			need_wd_check_status = <1>;
			support_get_tp_color = <1>;/*0 - no need, 1 - need */
			glove_supported = <0>;
			holster_supported = <0>;
			roi_supported = <0>;
			need_set_rst_after_iovcc_flag = <1>;
			need_check_report_descriptor_flag = <1>;
			parade,is_parade_solution = <1>;
			parade,direct_proc_cmd = <1>;
			parade,sleep_in_mode = <0>;/*0-use sleep command, 1-power down, 2-easy wake*/
			i2c_one_byte = <1>;
			use_new_oem_structure = <0>;
			//parade,i2c_read_length = <100>;
			parade,hid_desc_register = <1>;
			irq_config = <3>;/* 0 - LOW LEVEL  1 - HIGH LEVEL  2 - RAISE EDGE  3 - FALL EDGE*/
			parade,core_flags = <0>;/* CY_CORE_FLAG_WAKE_ON_GESTURE */
			parade,mt_flags = <0x18>;/* CY_MT_FLAG_FLIP | CY_MT_FLAG_INV_X | CY_MT_FLAG_INV_Y */
			//parade,slots_max = <32>;
			parade,easy_wakeup_supported_gestures = <0>;
			parade,need_delay_after_power_off = <1>;
			//parade,upgrade_ttconfig = <0>;
			parade,need_upgrade_again = <0>;
			parade,check_irq_state = <1>;
			parade,no_need_doing_after_resume = <1>;
			parade,need_wait_after_cm_test = <1>;/* 1 - need 0 - no need ,for cm test,some waiting is not enough */
			cy_hid_reset_timeout = <1000>; /* 1000ms, for ESD reset*/
			parade,abs_min_x = <0>;		parade,abs_max_x = <1599>;	/* ABS_MT_POSITION_X, CY_ABS_MIN_X, CY_ABS_MAX_X, 0, 0 */
			parade,abs_min_y = <0>;		parade,abs_max_y = <2559>;	/* ABS_MT_POSITION_Y, CY_ABS_MIN_Y, CY_ABS_MAX_Y, 0, 0 */
			parade,abs_min_p = <0>;		parade,abs_max_p = <1200>;	/* ABS_MT_PRESSURE,   CY_ABS_MIN_P, CY_ABS_MAX_P, 0, 0 */
			parade,abs_min_w = <0>;		parade,abs_max_w = <255>; 	/* CY_IGNORE_VALUE,   CY_ABS_MIN_W, CY_ABS_MAX_W, 0, 0 */
			parade,abs_min_t = <0>;		parade,abs_max_t = <15>;	/* ABS_MT_TRACKING_ID,CY_ABS_MIN_T, CY_ABS_MAX_T, 0, 0 */
			parade,abs_min_mj = <0>;	parade,abs_max_mj = <255>;	/* ABS_MT_TOUCH_MAJOR,0, 255, 0, 0 */
			parade,abs_min_mn = <0>;	parade,abs_max_mn = <255>;	/* ABS_MT_TOUCH_MINOR,0, 255, 0, 0 */
			parade,abs_min_or = <0>;	parade,abs_max_or = <127>;	/* ABS_MT_ORIENTATION,-128, 127, 0, 0 */
		};
		atmel: touchscreen@4a{
			compatible = "atmel";
			y_max_mt = <2560>;
			x_max_mt = <1600>;
			y_max = <2560>;
			x_max = <1600>;
			ic_name = "mxt1066t2";
			ts-kit-iovdd-type = <1>; /* 0-unused 1-ldo 2-gpio */
			ts-kit-iovdd-supply = <&ldo29>;
			ts-kit-iovdd-value = <1850000>;
			ts-kit-vcc-type = <1>; /* 0-unused 1-ldo 2-gpio */
			ts-kit-vcc-supply = <&ldo17>;
			ts-kit-vcc-value = <3300000>;
			slave_address = <0x4a>;
			irq_config = <0>;
			
			pinctrl-names = "default", "idle";
			pinctrl-0 = <&gpio212_cfg_func>;
			pinctrl-1 = <&gpio212_cfg_idle>;
			rawdata_get_timeout = <10>;
			ic_type = <0>;
			algo_id = <1>;
			support_get_tp_color = <1>;
			doze_mode_enable = <0>;
			CAME55020 {
				compatible = "CAME55020";/* 55: atmel, 020: truly*/
				producer = "TRULY";
				description = "cameron_atmel_truly";
			};
		};
		wacom: touchscreen@0A{
			compatible = "wacom";
			slave_address = <0x0A>;
			doze_mode_enable = <0x0>;
			ic_type = <0x0>;
			algo_id = <0>;
			irq_config = <0x0>;
			rawdata_get_timeout = <10>;
			delay_after_reset = <150>;

			/*projectid info*/
			project_id = "CAME58000";
			chip_vendor = "wacom";
			chip_name = "W9015";
			module_vendor = "ofilm";
			pen_mode_supported = <1>;

			/*pinctrl*/
			pinctrl-names = "default", "idle";
			pinctrl-0 = <&gpio212_cfg_func>;
			pinctrl-1 = <&gpio212_cfg_idle>;

			/*vci power*/
			vci_gpio_type = <0x0>;
			vci_ctrl_gpio;
			vci_regulator_type = <0x1>;
			wacom_vci-supply = <&ldo17>;
			vci_ldo_value = <3300000>;

			/*vddio power*/
			vddio_gpio_type = <0x0>;
			vddio_ctrl_gpio;
			vddio_regulator_type = <0x1>;
			vddio_ldo_need_set = <0x1>;
			wacom_vddio-supply=<&ldo29>;
			vddio_ldo_value = <1850000>;

			/*coordinate*/
			x_max = <1199>;
			y_max = <1919>;
			touch_report_x_max = <5415>;
			touch_report_y_max = <8663>;
			pen_report_x_max = <13535>;
			pen_report_y_max = <21657>;

			/*pen pressure*/
			pen_max_pressure = <4096>;

			/*pid info*/
			pid_num = <6>;
			pid = <0x487A 0x487B 0x487C 0x487D 0x487E 0x487F>;
			pid_panelid =<0x000 0x000 0x001 0x001 0x050 0x050>;
			pid_lcd_module ="boe", "inx", "boe", "inx", "boe", "inx";
			pinid_num = <3>;
			pinid = <0x0 0x2 0x1>;
			pinid_panelid =<0x000 0x001 0x050>;
		};
		elan: touchscreen@10 {
			status = "ok";
			compatible = "elan";
			reg = <0x10>;
			slave_address = <0x10>;
			elan,adapter_id = "elan_i2c_adapter";
			/*project related info*/
			project_id = "SCHU70000";
			chip_vendor = "elan";
			chip_name = "ekth5512c";
			module_vendor = "ofilm"; /* first vendor, will rewirte from panel id*/
			elan,pinctrl_set = <1>; /* 0-no set, 1-set by self */
			pinctrl-names = "default", "idle";
			pinctrl-0 = <&gpio015_pmx_func
					&gpio015_cfg_func
					&gpio212_cfg_func>;
			pinctrl-1 = <&gpio015_pmx_idle
					&gpio015_cfg_idle
					&gpio212_cfg_idle>;
			power_self_ctrl=<1>; /*0-Power is controlled by LCD, 1-Power is self controlled*/
			ts-kit-iovdd-type = <1>; /* 0-unused 1-ldo 2-gpio */
			ts-kit-iovdd-supply = <&ldo29>;
			ts-kit-iovdd-value = <1900000>;
			ts-kit-vcc-type = <1>; /* 0-unused 1-ldo 2-gpio */
			ts-kit-vcc-supply = <&ldo17>;
			ts-kit-vcc-value = <3300000>;
			pen_support = <1>;
			support_get_tp_color = <0>;/*0 - no need, 1 - need */
			glove_mode_supported = <0>;
			holster_mode_supported = <0>;
			roi_supported = <0>;
			provide_panel_id_suppot = <1>;
			irq_config = <0>;/* 0 - LOW LEVEL  1 - HIGH LEVEL  2 - RAISE EDGE  3 - FALL EDGE*/
			elan,abs_min_x = <0>;           /* not used */
			x_max = <1600>;
			elan,abs_min_y = <0>;           /* not used */
			y_max = <2560>;
			rawdata_get_timeout = <10>;
			mt_flags = <0x18>;
		};
	};
	&hisi_gpio_key {
		compatible = "hisilicon,gpio-key";
		pinctrl-names = "default", "idle";
		pinctrl-0 = <&gpio213_cfg_func &gpio210_cfg_func>;
		pinctrl-1 = <&gpio213_cfg_idle &gpio210_cfg_idle>;
		gpio-keyup,gpio-irq = <&gpio26 5 0>;
		gpio-keydown,gpio-irq = <&gpio26 2 0>;
		status = "ok";
	};

	/* display start */
	&framebuffer {
		fpga_flag = <0>;
		//FB_ACCEL_KIRIN980
		dss_version_tag = <0x100>;
	};

	&panel_pwm {
		#address-cells = <2>;
		#size-cells = <2>;
		compatible = "hisilicon,hisipwm";
		reg = <0 0xE8A04000 0 0x1000>;
		clocks = <&clk_gate_pwm>;
		clock-names = "clk_pwm";
		//pinctrl-names = "default","idle";
		//pinctrl-0 = <&gpio182_pmx_func &gpio182_cfg_func>;
		//pinctrl-1 = <&gpio182_pmx_idle &gpio182_cfg_idle>;
		fpga_flag = <0>;
		status = "disabled";
	};

	&panel_blpwm {
		#address-cells = <2>;
		#size-cells = <2>;
		compatible = "hisilicon,hisiblpwm";
		reg = <0 0xFFD75000 0 0x1000>;
		clocks = <&clk_gate_blpwm>;
		clock-names = "clk_blpwm";
		pinctrl-names = "default","idle";
		pinctrl-0 = <&gpio185_pmx_func &gpio186_pmx_func &gpio185_cfg_func &gpio186_cfg_func>;
		pinctrl-1 = <&gpio185_pmx_idle &gpio186_pmx_idle &gpio185_cfg_idle &gpio186_cfg_idle>;
		fpga_flag = <0>;
		status = "ok";
	};

	&panel_lcdc_fake {
		#address-cells = <2>;
		#size-cells = <2>;
		compatible = "hisilicon,lcdc_fake_panel";
		fpga_flag = <0>;
		status = "disabled";
	};

	&panel_mipi_fake {
		#address-cells = <2>;
		#size-cells = <2>;
		compatible = "hisilicon,mipi_fake_panel";
		fpga_flag = <0>;
		status = "disabled";
	};

	&huawei_lcd_panel {
		compatible = "huawei,lcd_panel_type";
		product_id = <7001>;
		detect_type = <2>; /*0:DETECT_GPIOID  1:DETECT_CHIPID  2:DETECT_LCD_TYPE */
		gpio_id = <16 9>; /*ID0 ID1*/
		gpio_cfg_addr = <0xE896CF24 0xE896CF08>; /*IOCG*/
		support_lcd_type = "LCD_KIT";
		iovcc_ctrl_mode = <1>;
		lcd_panel_type = "auo_otm1901a_5p2_1080p_video";
	};


	&huawei_lcd_config {
		compatible = "simple-bus";
	};

	&panel_lcd_cmi_NT35521 {
		#address-cells = <2>;
		#size-cells = <2>;
		compatible = "hisilicon,mipi_cmi_NT35521";
		//2:PWM,  4:BLPWM,  8:MIPI
		lcd-bl-type = <8>;
		//8:PANEL_MIPI_VIDEO,  16:PANEL_MIPI_CMD
		lcd-display-type = <8>;
		//0:IFBC_TYPE_NONE
		lcd-ifbc-type = <0>;
		//gpio_lcd_vcc1v8, gpio_lcd_p5v5_enable, gpio_lcd_n5v5_enable, gpio_lcd_reset, gpio_lcd_bl_enable
		gpios = <&gpio16 2 0>, <&gpio16 0 0>,  <&gpio20 7 0>, <&gpio17 3 0>, <&gpio20 6 0>;
		gpio_nums = <130 128 167 139 166>;
		//lcdio-vcc-supply = <&ldo4>;
		//lcdanalog-vcc-supply = <&ldo17>;
		//pinctrl-names = "default", "idle";
		//pinctrl-0 = <&gpio021_pmx_func &gpio021_cfg_func &gpio009_cfg_func &gpio010_cfg_func &gpio015_cfg_func &gpio020_cfg_func>;
		//pinctrl-1 = <&gpio021_pmx_idle &gpio021_cfg_idle &gpio009_cfg_idle &gpio010_cfg_idle &gpio015_cfg_idle &gpio020_cfg_idle>;
		fpga_flag = <1>;
		status = "disabled";
	};

	&panel_lcd_jdi_R63452 {
		#address-cells = <2>;
		#size-cells = <2>;
		compatible = "hisilicon,mipi_jdi_R63452";
		//2:PWM,  4:BLPWM,  8:MIPI
		lcd-bl-type = <4>;
		//8:PANEL_MIPI_VIDEO,  16:PANEL_MIPI_CMD ,32:PANEL_DUAL_MIPI_VIDEO, 64:PANEL_DUAL_MIPI_CMD
		lcd-display-type = <16>;
		//0:IFBC_TYPE_NONE 7:IFBC_TYPE_VESA3X_SINGLE 9:IFBC_TYPE_VESA3X_DUAL
		lcd-ifbc-type = <0>;
		//vsp, vsn, lcd_reset, bl_enable, ID0,ID1,TE0
		/*vsp, vsn, rst, bl_en, id0, id1, te0*/
		//GPIO_011, GPIO_008, GPIO_189, GPIO_010, GPIO_016, GPIO_009, GPIO_003
		gpios = <&gpio1 3 0>, <&gpio1 0 0>,  <&gpio23 5 0>, <&gpio1 2 0>, <&gpio2 0 0>, <&gpio1 1 0>, <&gpio0 3 0>;
		gpio_nums = <11 8 189 10 16 9 3>;
		lcdio-vcc-supply = <&ldo4>;
		lcdanalog-vcc-supply = <&ldo17>;
		pinctrl-names = "default", "idle";

		pinctrl-0 = <&gpio011_pmx_func &gpio008_pmx_func &gpio189_pmx_func &gpio010_pmx_func &gpio011_cfg_func &gpio008_cfg_func &gpio189_cfg_func &gpio010_cfg_func &gpio016_cfg_func &gpio009_cfg_func>;
		pinctrl-1 = <&gpio011_pmx_idle &gpio008_pmx_idle &gpio189_pmx_idle &gpio010_pmx_idle &gpio011_cfg_idle &gpio008_cfg_idle &gpio189_cfg_idle &gpio010_cfg_idle &gpio016_cfg_idle &gpio009_cfg_idle>;
		fpga_flag = <0>;
		status = "disabled";
	};
	&panel_lcd_lg_TD4322 {
		compatible = "hisilicon,mipi_lg_TD4322";
		//2:PWM,  4:BLPWM,  8:MIPI
		lcd-bl-type = <4>;
		//8:PANEL_MIPI_VIDEO,  16:PANEL_MIPI_CMD ,32:PANEL_DUAL_MIPI_VIDEO, 64:PANEL_DUAL_MIPI_CMD
		lcd-display-type = <16>;
		//0:IFBC_TYPE_NONE 7:IFBC_TYPE_VESA3X_SINGLE 9:IFBC_TYPE_VESA3X_DUAL
		lcd-ifbc-type = <0>;
		//vsp, vsn, lcd_reset, bl_enable, ID0,ID1,TE0
		/*vsp, vsn, rst, bl_en, id0, id1, te0*/
		//GPIO_011, GPIO_008, GPIO_189, GPIO_010, GPIO_016, GPIO_009, GPIO_003
		gpios = <&gpio1 3 0>, <&gpio1 0 0>,  <&gpio23 5 0>, <&gpio1 2 0>, <&gpio2 0 0>, <&gpio1 1 0>, <&gpio0 3 0>;
		gpio_nums = <11 8 189 10 16 9 3>;
		lcdio-vcc-supply = <&ldo4>;
		lcdanalog-vcc-supply = <&ldo17>;
		pinctrl-names = "default", "idle";

		pinctrl-0 = <&gpio011_pmx_func &gpio008_pmx_func &gpio189_pmx_func &gpio010_pmx_func &gpio011_cfg_func &gpio008_cfg_func &gpio189_cfg_func &gpio010_cfg_func &gpio016_cfg_func &gpio009_cfg_func>;
		pinctrl-1 = <&gpio011_pmx_idle &gpio008_pmx_idle &gpio189_pmx_idle &gpio010_pmx_idle &gpio011_cfg_idle &gpio008_cfg_idle &gpio189_cfg_idle &gpio010_cfg_idle &gpio016_cfg_idle &gpio009_cfg_idle>;
		fpga_flag = <0>;
		status = "disabled";
	};
	&panel_lcd_sharp_NT36870 {
		compatible = "hisilicon,mipi_sharp_NT36870";
		//2:PWM,  4:BLPWM,  8:MIPI
		lcd-bl-type = <4>;
		//8:PANEL_MIPI_VIDEO,  16:PANEL_MIPI_CMD ,32:PANEL_DUAL_MIPI_VIDEO, 64:PANEL_DUAL_MIPI_CMD
		lcd-display-type = <16>;
		//0:IFBC_TYPE_NONE 7:IFBC_TYPE_VESA3X_SINGLE 9:IFBC_TYPE_VESA3X_DUAL
		lcd-ifbc-type = <0>;
		//vsp, vsn, lcd_reset, bl_enable, ID0,ID1,TE0
		/*vsp, vsn, rst, bl_en, id0, id1, te0*/
		//GPIO_011, GPIO_008, GPIO_189, GPIO_010, GPIO_016, GPIO_009, GPIO_003
		gpios = <&gpio1 3 0>, <&gpio1 0 0>,  <&gpio23 5 0>, <&gpio1 2 0>, <&gpio2 0 0>, <&gpio1 1 0>, <&gpio0 3 0>;
		gpio_nums = <11 8 189 10 16 9 3>;
		lcdio-vcc-supply = <&ldo4>;
		lcdanalog-vcc-supply = <&ldo17>;
		pinctrl-names = "default", "idle";

		pinctrl-0 = <&gpio011_pmx_func &gpio008_pmx_func &gpio189_pmx_func &gpio010_pmx_func &gpio011_cfg_func &gpio008_cfg_func &gpio189_cfg_func &gpio010_cfg_func &gpio016_cfg_func &gpio009_cfg_func>;
		pinctrl-1 = <&gpio011_pmx_idle &gpio008_pmx_idle &gpio189_pmx_idle &gpio010_pmx_idle &gpio011_cfg_idle &gpio008_cfg_idle &gpio189_cfg_idle &gpio010_cfg_idle &gpio016_cfg_idle &gpio009_cfg_idle>;
		fpga_flag = <0>;
		status = "disabled";
	};

	&panel_lcd_jdi_NT36860 {
		#address-cells = <2>;
		#size-cells = <2>;
		compatible = "hisilicon,mipi_jdi_NT36860";
		//2:PWM,  4:BLPWM,  8:MIPI
		lcd-bl-type = <8>;
		//8:PANEL_MIPI_VIDEO,  16:PANEL_MIPI_CMD
		lcd-display-type = <16>;
		//0:IFBC_TYPE_NONE 7:IFBC_TYPE_VESA3X_SINGLE 9:IFBC_TYPE_VESA3X_DUAL
		lcd-ifbc-type = <0>;
		//gpio_lcd_vcc1v8, gpio_lcd_p5v5_enable, gpio_lcd_n5v5_enable, gpio_lcd_reset, gpio_lcd_bl_enable, gpio_lcd_tp2v85 ,gpio_lcd_tp1v8
		gpios = <&gpio16 2 0>, <&gpio16 0 0>,  <&gpio20 7 0>, <&gpio17 3 0>, <&gpio20 6 0>, <&gpio17 1 0>, <&gpio16 1 0>;
		gpio_nums = <130 128 167 139 166 137 129>;
		//lcdio-vcc-supply = <&ldo4>;
		//lcdanalog-vcc-supply = <&ldo17>;
		//pinctrl-names = "default", "idle";
		//pinctrl-0 = <&gpio021_pmx_func &gpio021_cfg_func &gpio009_cfg_func &gpio010_cfg_func &gpio015_cfg_func &gpio020_cfg_func>;
		//pinctrl-1 = <&gpio021_pmx_idle &gpio021_cfg_idle &gpio009_cfg_idle &gpio010_cfg_idle &gpio015_cfg_idle &gpio020_cfg_idle>;
		fpga_flag = <0>;
		status = "disabled";
	};

	&panel_lcd_sharp_NT36860 {
		#address-cells = <2>;
		#size-cells = <2>;
		compatible = "hisilicon,mipi_sharp_NT36860";
		//2:PWM,  4:BLPWM,  8:MIPI
		lcd-bl-type = <8>;
		//8:PANEL_MIPI_VIDEO,  16:PANEL_MIPI_CMD
		lcd-display-type = <16>;
		//0:IFBC_TYPE_NONE 7:IFBC_TYPE_VESA3X_SINGLE 9:IFBC_TYPE_VESA3X_DUAL
		lcd-ifbc-type = <0>;
		//gpio_lcd_vcc1v8, gpio_lcd_p5v5_enable, gpio_lcd_n5v5_enable, gpio_lcd_reset, gpio_lcd_bl_enable, gpio_lcd_tp2v85 ,gpio_lcd_tp1v8
		gpios = <&gpio16 2 0>, <&gpio16 0 0>,  <&gpio20 7 0>, <&gpio17 3 0>, <&gpio20 6 0>, <&gpio17 1 0>, <&gpio16 1 0>;
		gpio_nums = <130 128 167 139 166 137 129>;
		//lcdio-vcc-supply = <&ldo4>;
		//lcdanalog-vcc-supply = <&ldo17>;
		//pinctrl-names = "default", "idle";
		//pinctrl-0 = <&gpio021_pmx_func &gpio021_cfg_func &gpio009_cfg_func &gpio010_cfg_func &gpio015_cfg_func &gpio020_cfg_func>;
		//pinctrl-1 = <&gpio021_pmx_idle &gpio021_cfg_idle &gpio009_cfg_idle &gpio010_cfg_idle &gpio015_cfg_idle &gpio020_cfg_idle>;
		fpga_flag = <0>;
		status = "disabled";
	};

	&panel_mipi_lcd_external {
		#address-cells = <2>;
		#size-cells = <2>;
		compatible = "hisilicon,mipi_lcd_external_panel";
		//2:PWM,  4:BLPWM,  8:MIPI
		lcd-bl-type = <8>;
		//8:PANEL_MIPI_VIDEO,  16:PANEL_MIPI_CMD
		lcd-display-type = <8>;
		//0:IFBC_TYPE_NONE
		lcd-ifbc-type = <0>;
		//gpio_lcd_vcc1v8, gpio_lcd_p5v5_enable, gpio_lcd_n5v5_enable, gpio_lcd_reset, gpio_lcd_bl_enable, gpio_TP_2V85_EN_B, gpio_TP_1V8_EN_B
		gpios = <&gpio16 3 0>, <&gpio17 0 0>,  <&gpio20 1 0>, <&gpio17 7 0>, <&gpio20 0 0>, <&gpio17 5 0>, <&gpio16 4 0>;
		gpio_nums = <131 136 161 143 160 141 132>;
		//lcdio-vcc-supply = <&ldo4>;
		//lcdanalog-vcc-supply = <&ldo17>;
		//pinctrl-names = "default", "idle";
		//pinctrl-0 = <&gpio021_pmx_func &gpio021_cfg_func &gpio009_cfg_func &gpio010_cfg_func &gpio015_cfg_func &gpio020_cfg_func>;
		//pinctrl-1 = <&gpio021_pmx_idle &gpio021_cfg_idle &gpio009_cfg_idle &gpio010_cfg_idle &gpio015_cfg_idle &gpio020_cfg_idle>;
		fpga_flag = <0>;
		status = "disabled";
	};
	&panel_hdmi_fake {
		#address-cells = <2>;
		#size-cells = <2>;
		compatible = "hisilicon,hdmi_fake_panel";
		fake_hdmi = <1>;
		status = "disabled";
	};
	&panel_dp_fake {
		#address-cells = <2>;
		#size-cells = <2>;
		compatible = "hisilicon,dp_fake_panel";
		fake_dp = <1>;
		status = "ok";
	};
	&hisi_dp {
		preemphasis_swing = <0xB0>, <0x598>, <0x2040>, <0x5D8>, <0x22C0>, <0x638>, <0x25C0>, <0x6B8>, <0x29C0>,
			<0x638>, <0x2040>, <0x698>, <0x23C0>, <0x6F8>, <0x27C0>, <0x728>, <0x2140>, <0x748>, <0x2540>, <0x7E8>, <0x2040>;
		status = "ok";
	};

	&dp_aux_switch {
		compatible = "huawei,dp_aux_switch";
		cs-gpios = <&gpio17 1 0>;
		status = "ok";
	};

	/*set dp source default mode*/
	&dp_source_switch {
		compatible = "huawei,dp_source_switch";
		dp_default_source_mode = <0>; /*0:diff mode 1:same mode*/
		status = "ok";
	};

	&huawei_usbvbus {
		support_pd = <1>;
		support_dp = <1>;
		pmic_vbus_attach_enable = <1>;
		status = "ok";
	};
	/* display end */

	/* audio device beg */
	&codec_controller {
		gpios = <&gpio26 3 0>; /* GPIO_211 */
		gpio_reset = <74>; /* GPIO_74*/
		gpio_codec_ssi = <204>;
		gpio_codec_ssi_func = <1>;
		gpio_ssi_mux = <16>; /* Chicago only */
		hisilicon,codec-sel = "hi6405";
		slimbusclk_io_driver = <0x3>;
		slimbusdata_io_driver = <0x3>;
		pm_runtime_support;
		status = "ok";

		hi64xx_irq: hi64xx_irq@0 {
			status = "ok";

			hi6402_codec: hi6402_codec@0{
				hisilicon,mic_num = <2>;
				status = "disabled";
			};

			hi6403_codec: hi6403_codec@0{
				hisilicon,mic_num = <2>;
				status = "disabled";
			};

			hi6405_codec: hi6405_codec@0{
				hisilicon,mic_num = <4>;
				hisilicon,wakeup_hisi_algo_support = <1>;
				status = "ok";
			};

			pmx4: hi6402_pinctrl {
				status = "disabled";
			};
		};
	};

	&codecssi {
		status = "ok";
	};

	&sound_hi6403 {
		compatible = "hisilicon,hi3xxx-hi6403";
		status = "disabled";
	};

	&sound_hi6405 {
		compatible = "hisilicon,hi3xxx-hi6405";
		status = "ok";
	};

	&hi6210_hifi {
		compatible = "hi6210-hifi";
		status = "ok";
	};

	&hisi_dp_machine {
		compatible = "hisilicon,hisi-dp-audio-machine";
		status = "ok";
	};

	&asp_irq {
		compatible = "hisilicon,hi3630-asp-irq";
		reg = <0x0 0xe804e000 0x0 0xa000>;
		#interrupt-cells = <0x2>;
		asp-irq-supply = <&asp>;
		interrupt-controller;
		interrupts = <0x0 0x88 0x4>;
		interrupt-names = "asp_irq";

		asp_common@0 {
			compatible = "hisilicon,hi3630-asp-common";
		};

		asp_srcup_normal@0 {
			compatible = "hisilicon,hi3630-srcup-normal";
			asp-srcup-normal-supply = <&asp>;
			interrupt-parent = <&asp_irq>;
			interrupts = <0x1 0x0>;
			interrupt-names = "asp_srcup_normal";
		};

		asp_srcup_dsp@0 {
			compatible = "hisilicon,hi3630-srcup-dsp";
		};

		asp_srcdown@0 {
			compatible = "hisilicon,hi3630-srcdown";
			interrupt-parent = <&asp_irq>;
		};

		asp_hdmi@0 {
			compatible = "hisilicon,hi3630-pcm-hdmi";
			interrupt-parent = <&asp_irq>;
			interrupts = <0x0 0x0>;
			interrupt-names = "asp_irq_hdmi";
		};
	};
	&slimbusmisc {
		compatible = "candance,slimbus";
		reg = <0x0 0xe8050000 0x0 0xb00>,
			<0x0 0xe804e000 0x0 0xa000>,
			<0x0 0xfff0a000 0x0 0x1000>;
		interrupts = <0x0 0x96 0x4>;
		interrupt-names = "asp_irq_slimbus";
		slimbus-reg-supply = <&asp>;
		pinctrl-names = "default", "idle";
		pinctrl-0 = <&gpio193_pmx_func
				&gpio194_pmx_func
				&gpio193_cfg_func
				&gpio194_cfg_func>;
		pinctrl-1 = <&gpio193_pmx_idle
				&gpio194_pmx_idle
				&gpio193_cfg_idle
				&gpio194_cfg_idle>;
		slimbus-ssi-sel = "slimbus";
		asp_power_state_offset = <0x06c>;
		slimbusclk_io_driver = <0xa8>;
		slimbusdata_io_driver = <0xa3>;
		slimbusclk_offset = <0x034>;
		slimbusdata_offset = <0x038>;
		slimbusclk_cfg_offset = <0x85C>;
		slimbusdata_cfg_offset = <0x860>;
		platform-type   = "UDP";
		codec-type = "slimbus-6405";
		clk_asp_subsys = <415000>;
		slimbus_dynamic_freq= "true";
		pm_runtime_support;
		status = "ok";
	};
	&slimbus_dai {
		compatible = "hisilicon,slimbus-dai";
		status = "ok";
	};

	&sio1 {
		compatible = "hisilicon,hi3630-sio";
		reg = <0x0 0xE804F000 0x0 0x400>;
		sio-audio-supply = <&asp>;
		/* wbd
		pinctrl-names = "default", "idle";
		pinctrl-0 = <&gpio183_pmx_func
				    &gpio184_pmx_func
				    &gpio185_pmx_func
				    &gpio186_pmx_func
				    &gpio183_cfg_func
				    &gpio184_cfg_func
				    &gpio185_cfg_func
				     &gpio186_cfg_func>;
		pinctrl-1 = <&gpio183_pmx_idle
				    &gpio184_pmx_idle
				    &gpio185_pmx_idle
				    &gpio186_pmx_idle
				    &gpio183_cfg_idle
				    &gpio184_cfg_idle
				    &gpio185_cfg_idle
				    &gpio186_cfg_idle>;
		*/
		status = "disabled";
	};

	&sio2 {
		compatible = "hisilicon,hi3630-sio";
		reg = <0x0 0xE804F400 0x0 0x400>;
		sio-voice-supply = <&asp>;
		/* wbd
		pinctrl-names = "default", "idle";
		pinctrl-0 = <&gpio043_pmx_func
				     &gpio044_pmx_func
				     &gpio045_pmx_func
				     &gpio046_pmx_func
				     &gpio043_cfg_func
				     &gpio044_cfg_func
				     &gpio045_cfg_func
				     &gpio046_cfg_func>;
			pinctrl-1 = <&gpio043_pmx_idle
				     &gpio044_pmx_idle
				     &gpio045_pmx_idle
				     &gpio046_pmx_idle
				     &gpio043_cfg_idle
				     &gpio044_cfg_idle
				     &gpio045_cfg_idle
				     &gpio046_cfg_idle>;
		*/
		status = "disabled";
	};

	&sio3 {
		compatible = "hisilicon,hi3630-sio";
		reg = <0x0 0xE804F800 0x0 0x400>;
		status = "disabled";
	};

	&sio4 {
		compatible = "hisilicon,hi3630-sio";
		reg = <0x0 0xE804FC00 0x0 0x400>;
		status = "disabled";
	};

	&soundtrigger {
		compatible = "hisilicon,soundtrigger_dma_drv";
		reg = <0x0 0xe804b000 0x0 0x1000>;
		asp-dmac-supply = <&asp>;
		status = "ok";
	};

	&hi64xx_asp_dmac {
		compatible = "hisilicon,hi64xx-asp-dma";
		reg = <0x0 0xe804b000 0x0 0x1000>;
		asp-dmac-supply = <&asp>;
		interrupts = <0 216 4>;
		interrupt-names = "asp_dma_irq";
		status = "ok";
	};

	&asp_hdmi_dmac {
		compatible = "hisilicon,asp-hdmi-dma";
		reg = <0x0 0xe804e400 0x0 0x1000>;
		status = "ok";
	};

	&asp_cfg {
		compatible = "hisilicon,asp-cfg";
		reg = <0x0 0xe804e000 0x0 0xa000>;
		asp-supply = <&asp>;
		status = "ok";
	};

	&dp_i2s {
		compatible = "hisilicon,hisi-dp-i2s";
		status = "ok";
        };

	&dp_audio {
		compatible = "hisilicon,dp-audio";
		status = "ok";
        };

	&hisi_pcm_dp {
		compatible = "hisilicon,hisi-pcm-dp";
		interrupts = <0x0 0x96 0x4>;
		interrupt-names = "asp_hdmi_dma";
		dp-pcm-supply = <&asp>;
		status = "ok";
	};

	&hifidsp {
			compatible = "hisilicon,k3hifidsp";
			status = "ok";
			platform-type = "ASIC";
	};

	&sochifi_watchdog {
		compatible = "hisilicon,sochifi-watchdog";
		interrupts = <0 213 4>;
		status = "ok";
	};

	&asp_dmac {
		compatible = "hisilicon,hi3xxx-pcm-asp-dma";
		reg = <0x0 0xe804b000 0x0 0x1000>;
		asp-dmac-supply = <&asp>;
		status = "ok";
	};

	&usbaudio_dsp {
		compatible = "hisilicon,usbaudiodsp";
		status = "ok";
	};

	&deviceboxID {
		check_mode = "gpio";
		box_num = <4>;
		enable_boxID = <1 1 1 1>;
		gpio_num = <1 1 1 1>;
		gpio_speakerID = <&gpio27 3 0>;
		gpio_receiverID = <&gpio27 4 0>;
		gpio_3rdboxID = <&gpio31 7 0>;
		gpio_4thboxID = <&gpio32 1 0>;
		speaker_map = <3 2>;/*3 means GD, 2 means GEER*/
		receiver_map = <3 2>;/*3 means GD, 2 means GEER*/
		box3rd_map = <3 2>;/*3 means GD, 2 means GEER*/
		box4th_map = <3 2>;/*3 means GD, 2 means GEER*/
		pinctrl-names = "default", "idle";
		pinctrl-0 = <&gpio219_pmx_func &gpio219_cfg_func &gpio220_pmx_func &gpio220_cfg_func &gpio255_pmx_func &gpio255_cfg_func &gpio257_pmx_func &gpio257_cfg_func>;
		pinctrl-1 = <&gpio219_pmx_idle &gpio219_cfg_idle &gpio220_pmx_idle &gpio220_cfg_idle &gpio255_pmx_idle &gpio255_cfg_idle &gpio257_pmx_idle &gpio257_cfg_idle>;
		deviceboxID_limit = <500>;
		status = "ok";
	};

	&smartpakit {
		compatible = "huawei,smartpakit";
		/* 0 hisi, 1 qcom */
		soc_platform = <0>;
		/* algo running on: 0 codec_dsp, 1 soc_dsp, 2 smartpa_dsp, 3 simple pa(not smpartpa), 4 simple pa(with i2c) */
		algo_in = <1>;
		/* algo_in params need match out_device for smartpa.
		* Now, up to only support four pa, so out_device = <0 0 0 0>;
		* 1. This array is arranged in the following order:
		*    <0 1 2 3>
		*    <pril prir secl secr>
		* 2. This array element value is 0 or 1:
		*    smartpa: 0 speaker, 1 receiver
		*    simple pa: out_device not applicable, only set 0 to indicate pa_num
		* 3. The length of this array is variable, for example:
		*    single pa: out_device = <0>;
		*    two pa: out_device = <0 0>;
		*    four pa: out_device = <1 1 0 0>; */
		out_device = <0 0 0 0>;
		dsp_img_name = "hifi_6405_smart4pa_in_sochifi.img";
		status = "ok";
	};

	&usb_analog_hs_interface {
		compatible = "huawei,usb_analog_hs_interface";
		status = "disabled";
	};

	&usb_ana_hs_fsa4476 {
		status = "disabled";
	};

	&usb_audio_power {
		compatible = "huawei,usb_audio_power";
		status = "disabled";
	};

	&usb_audio_common {
		compatible = "huawei,usb_audio_common";
		status = "disabled";
	};

	&anc_hs_default {
		compatible = "huawei,anc_hs_default";
		status = "ok";
	};

	&audio_hw_config {
		product_name = "SCM";
		multi_mic_enable = "true";
		vqm_enable = "true";
		spk_pa_name = "smartpakit";
		cust_name = "audio_custom";
		soc_name = "hi363x";
		codec_name = "hi6405";
		codec_dsp_algo = "mad";
		modem_sio_master = "false";
		asr_enable = "true";
		pa_alg_bypass = "false";
		status = "ok";
		audio_sar_support = "true";
		record_algo_version = "record5_0";
		speaker_test_content = "main_left_speaker,main_right_speaker,sec_left_speaker,sec_right_speaker";
		hifi_info {
			dsp_voice_vol_control = "1";/* 1 :need socdsp control volume; 0:platform codec */
		};

		hardware_info {
			mic_num = "4";
			mic_type = "000F";/*0001 deputy mic   0002 main mic   0004 deputy mic2   0008 main mic2*/
			status = "ok";
		};
		smartpa_info {
				pa_num = "4";
				algo_in = "1"; /*algo running on: 0 codec_dsp | 1 soc_dsp | 2 smartpa_dsp */
				pa_type = "1111";/*0 as receiver pa 1 as spk pa eg:0011 means dual smartpa and only as spk, 0001 means dual smartpa and as spk+rcv*/
				status = "ok";
		};
		audio_capability {
			bwe_ui_support = "true";
			bwe_support = "true";
			swb_support = "true";
			wnr_support = "false";
			nv_evs_support = "true";
			lvm_support = "false";
			dhf_support = "false";
			voice_anc_support = "false";
			dual_smartpa_support = "false";
			stereo_handfree_support = "false";
			spk_rcv_stereo_support = "true";
			dual_smartpa_version = "2.0";
			earphone_multi_eq_support = "true";
			vdr_ui_support = "false";
			asr_vibrate_support = "true";
			mmi_capture_enable = "false";
			irda_support = "false";
			visualizer_support = "true";
			visualizer_frame = "Medium";
			/*
				sound trigger feature.
				false: this product doesn't support soundtrigger feature.
				2.0: this product supports the twice wakeup feature.
			*/
			soundtrigger_version = "2.0";
			soundtrigger_enhance_enable = "true";
			soundtrigger_mic_info = "3";
			/*
				max stream volume to replace Android default volume.
			*/
			max_stream_volume = "15";
			/*
				usb compatibility report feature.
				true: this product needs usb compatibility report.
				false: this product doesn't need usb compatibility report.
			*/
			usb_compatibility_report = "false";
			music_region_enable = "false";
			voice_region_enable = "true";
			/*
				use hisilicon wakeup engine.
				true: use hisilicon wakeup engine.
				false: DO NOT use hisilicon wakeup engine.
			*/
			wakeup_hisiengine = "true";
		};
	};

	&hw_soundtrigger_event {
		status = "ok";
	};

	/* audio device end */

	/* UFS */
	&ufs {
		status = "ok";
	};

	/* rename eMMC,SD,SDIO */
	&aliases {
	};

	/* eMMC 4.5
	&dwmmc0 {
		status = "ok";
	};
	*/

	/* SD */
	/*
	while set mux-sdsim as 1,driver_strength for clk,cmd,data must be specified in dts,check config table below to make sure right value

	2MA_0   0x00
	4MA_0   0x10
	6MA_0   0x20
	8MA_0   0x30
	10MA_0  0x40
	12MA_0  0x50
	14MA_0  0x60
	16MA_0  0x70
	5MA_1   0x00
	7MA_1   0x10
	9MA_1   0x20
	11MA_1  0x30
	14MA_1  0x40
	16MA_1  0x50
	18MA_1  0x60
	20MA_1  0x70
	22MA_1  0x80
	25MA_1  0x90
	27MA_1  0xA0
	29MA_1  0xB0
	32MA_1  0xC0
	34MA_1  0xD0
	36MA_1  0xE0
	38MA_1  0xF0
	*/

	&dwmmc1 {
		caps2-mmc-hs200-1_8v;
		caps2-mmc-cache-ctrl;
		vmmc-supply = <&ldo16>;
		vqmmc-supply = <&ldo9>;
		cs_sd_timing_config_cancer;
		use_samdly_range = <5 8>;
		mux-sdsim = <1>;
		/*25MA_1 for sd clk*/
		driverstrength_clk = <0x90>;
		/*25MA_1 for sd cmd*/
		driverstrength_cmd = <0x90>;
		/*11MA_1 for sd data*/
		driverstrength_data = <0x30>;
		enable_shift_range = <4 8>;
		cd-vol = <1>;
		cd-gpio = <&gpio22 7 0>;
		shared-irq = <1>;
		status = "ok";
	};

	/* sdio */

	&dwmmc2 {
		status = "ok";
	};

	&pddevice {
		update_combophy_firmware = <1>;
	};

	&hisi_usb {
		usb_support_check_voltage = <0x1>;
		eye_diagram_host_param = <0x371E7E7>;
		host-maximum-speed = "super-speed-plus";
		usb_support_dp = <1>;
		quirk_enable_hst_imm_retry;
		quirk_disable_rx_thres_cfg;
		quirk_disable_usb2phy_suspend;
		quirk_clear_svc_opp_per_hs;
		quirk_set_svc_opp_per_hs_sep;
		quirk_adjust_dtout;
		quirk_force_disable_host_lpm;
		quirk_enable_p4_gate;
	};


	&sensorhub_status{
		compatible = "huawei,sensorhub_status";
		status= "ok";
	};

	&sensorhub_nmi{
		compatible = "huawei,sensorhub_nmi";
		nmi_reg=<0x588>;
	};

	&sensorhub{
		#address-cells=<1>;
		#size-cells=<0>;
		als_sensor:light{
			als1{
				compatible="huawei,rohm_bh1749";
				bus_number=<0>;
				reg=<0x38>;
				chip_id_register=<0x92>;
				chip_id_value=<0xE0>;
				file_id=<128>;
				tp_color_from_nv=<1>;
				sensor_list_info_id=<0x03>;
				sensor_type="als";
				poll_interval=<350>;
				threshold_value=<1>;
				GA1=<4166>;
				GA2=<3900>;
				GA3=<4500>;
				tp_color=<0>;
				als_phone_type =<51>;
				als_phone_version=<10>;
				als_extend_data = <0 0 0 0 0 0 0 0 0 0 0 0>;
				again=<1>;
				atime=<0xdb>;
				init_time =<150>;
				sensorlist_name="als-bh1749";
				vendor="rohm";
				status="ok";
			};
		};
		ps_sensor:proximity{
		};
		gsensor{
			acc1{
				compatible ="huawei,st-lsm6ds3-c";
				bus_number =<1>;
				reg =<0x6a>;
				chip_id_register =<0x0f>;
				chip_id_value =<0x6a>;
				file_id =<34>;
				sensor_list_info_id =<0>;
				sensor_type ="acc";
				axis_map_x =<1>;
				axis_map_y =<0>;
				axis_map_z =<2>;
				negate_x =<0>;
				negate_y =<1>;
				negate_z =<0>;
				offset_x =<0>;
				offset_y =<0>;
				offset_z =<0>;
				sensitivity_x =<1>;
				sensitivity_y =<1>;
				sensitivity_z =<1>;
				poll_interval =<10>;
				gpio_int2=<&gpio25 7 0>;
				gpio_int2_sh=<1013>;
				used_int_pin =<1>;
				calibrate_style =<0>;
				x_calibrate_thredhold = <250>;
				y_calibrate_thredhold = <250>;
				z_calibrate_thredhold = <320>;
				sensorlist_name="accelerometer-lsm6ds3-c";
				vendor="st";
				minDelay=<4000>;
				status = "ok";
			};
			acc2{
				compatible="huawei,bosch-bmi160";
				bus_number=<1>;
				reg=<0x68>;
				chip_id_register=<0x0>;
				chip_id_value=<0xd1>;
				file_id=<33>;
				sensor_list_info_id=<0>;
				sensor_type="acc";
				status = "ok";
				used_int_pin =<1>;
				axis_map_x=<0>;
				axis_map_y=<1>;
				axis_map_z=<2>;
				negate_x=<0>;
				negate_y=<0>;
				negate_z=<0>;
				offset_x=<0>;
				offset_y=<0>;
				offset_z=<0>;
				x_calibrate_thredhold = <250>;
				y_calibrate_thredhold = <250>;
				z_calibrate_thredhold = <320>;
				gpio_int2=<&gpio25 7 0>;
				gpio_int2_sh=<1013>;
				calibrate_style=<0>;
				minDelay=<4000>;
				sensorlist_name="accelerometer-bmi160";
				vendor="bosch";
			};
		};
		gyroscope{
			gyro1{
				compatible ="huawei,st-lsm6ds3-c";
				bus_number =<1>;
				reg =<0x6a>;
				chip_id_register =<0x0f>;
				chip_id_value =<0x6a>;
				file_id =<36>;
				sensor_list_info_id =<5>;
				sensor_type ="gyro";
				position = <2>;
				axis_map_x =<1>;
				axis_map_y =<0>;
				axis_map_z =<2>;
				negate_x =<0>;
				negate_y =<1>;
				negate_z =<0>;
				poll_interval =<10>;
				used_int_pin =<1>;
				gpio_int2=<&gpio25 7 0>;
				gpio_int2_sh=<1013>;
				calibrate_thredhold = <572>;
				sensorlist_name="gyroscope-lsm6ds3-c";
				vendor="st";
				minDelay=<4000>;
				calibrate_way=<1>;
				status = "ok";
			};
			gyro2{
				compatible="huawei,bosch-bmi160";
				bus_number =<1>;
				reg=<0x68>;
				chip_id_register=<0x0>;
				chip_id_value=<0xd1>;
				file_id=<35>;
				sensor_list_info_id =<5>;
				sensor_type ="gyro";
				axis_map_x =<0>;
				axis_map_y =<1>;
				axis_map_z =<2>;
				negate_x =<0>;
				negate_y =<0>;
				negate_z =<0>;
				poll_interval =<10>;
				gpio_int2=<&gpio25 7 0>;
				gpio_int2_sh=<1013>;
				minDelay=<4000>;
				sensorlist_name="gyroscope-bmi160";
				vendor="bosch";
				status = "ok";
			};
		};
		compass{
			mag1 {
				compatible="huawei,akm-akm09918";
				bus_number=<0>;
				reg=<0x0C>;
				chip_id_register=<0x00>;
				chip_id_value=<0x48>;
				file_id=<67>;
				sensor_list_info_id=<1>;
				sensor_type="mag";
				/*sensor-vdd-supply = <&ldo24>;*/
				outbit=<0>;
				calibrate_method=<2>;
				axis_map_x=<1>;
				axis_map_y=<0>;
				axis_map_z=<2>;
				negate_x=<0>;
				negate_y=<0>;
				negate_z=<1>;
				poll_interval=<10>;
				gpio_int1=<&gpio0 0 0>;
				gpio_reset=<&gpio0 0 0>;
				softiron_parameter = <15 40 249 1 234 0 249 1 134 35 164 255 234 0 165 255 228 39 0 0 0 0 0 0 0 0 0>;
				sensorlist_name="akm-akm09918";
				vendor="akm";
				minDelay=<10000>;
				threshold_for_als_calibrate=<1000>;
				fifoReservedEventCount=<0>;
				fifoMaxEventCount=<0>;
				status = "ok";
			};
			mag2{
				compatible="huawei,mmc5603";
				outbit=<0>;
				calibrate_method=<2>;
				bus_number=<0>;
				sensor_list_info_id=<1>;
				reg=<0x30>;
				chip_id_register=<0x39>;
				chip_id_value=<0x10>;
				file_id=<123>;
				axis_map_x=<1>;
				axis_map_y=<0>;
				axis_map_z=<2>;
				negate_x=<0>;
				negate_y=<0>;
				negate_z=<1>;
				sensor_type="mag";
				poll_interval=<10>;
				softiron_parameter = <16 39 0 0 0 0 0 0 16 39 0 0 0 0 0 0 16 39 0 0 0 0 0 0 0 0 0>;
				threshold_for_als_calibrate=<1000>;
				status = "ok";
				minDelay=<10000>;
				sensorlist_name="mag-mmc5603";
			};
		};
		airpress{
		};
		tof_sensor:tof{
		};
		sar {
			sar1 {
				compatible="huawei,semtech-sx9323";
				bus_number=<0>;
				reg=<0x28>;
				chip_id_register=<0xFA>;
				chip_id_value=<0x23 0x20>;
				file_id=<62>;
				sensor_type="cap_prox";
				sensor_list_info_id=<20>;
				poll_interval=<200>;
				calibrate_type=<6>; // bit config 101(b) adapt to the param calibrate calibrate order
				calibrate_order = "999 2 1"; // 0:free  1:near  2:far  3:other
				shared_flag=<0>;
				status = "ok";
				phone_type = /bits/ 16 <0x07>; // 1:ALPS  2:BLANC  3:EMILY  4:NEO  5:CHARLOTTE  6:AFTER_EVER  7:SCM
				to_ap_threshold = /bits/ 16 <0xc8>;
				to_modem_threshold = /bits/ 16 <0x7530 0x200 0x200 0x00 0x00 0x00 0x00 0x00>;
				init_reg_val = <0x00000014 0x1016112e 0x28002904 0x2a102b01
				                0x24472747 0x2d06301b 0x311b340c 0x35103619
				                0x37194200 0x43004400 0x030f0000 0x0000>;
				ph = <0x2e>;
				calibrate_thred = /bits/ 16 <0 0 0 0>; // for the factory far and near calibrate
				sensorlist_name="CAP_PROX sensor-sx9323";
				vendor="semtech";
			};
		};
		rpc{
			rpc{
				compatible = "huawei,rpc";
				file_id = <0x18>;
				sensor_list_info_id = <24>;
				sensor_type = "rpc";
				sensorlist_name = "rpc";
				mask = <0xFFFF 0xC00F 0xC00F 0xC00F 0xC00F 0xC00F 0xC00F 0xC00F
				        0xC00F 0xC00F 0xC00F 0xC00F 0xC00F 0xC00F 0xC00F 0xC00F
				        0xC00F 0xFFFF 0xFFFF 0xFFFF 0xFFFF 0xFFFF 0xFFFF 0xFFFF
				        0xFFFF 0xFFFF 0xFFFF 0xFFFF 0xFFFF 0xFFFF 0xFFFF 0xFFFF>;
				table = <0xFFFF 0x7    0x1    0x2    0x3    0x4007 0x4001 0x4002
				         0x4003 0x8007 0x8001 0x8002 0x8003 0xC007 0xC001 0xC002
				         0xC003 0xFFFF 0xFFFF 0xFFFF 0xFFFF 0xFFFF 0xFFFF 0xFFFF
				         0xFFFF 0xFFFF 0xFFFF 0xFFFF 0xFFFF 0xFFFF 0xFFFF 0xFFFF>;
				default_value = <0x1D>;
				status = "ok";
			};
		};
		fingerprint {
		};

		fingerprint_ud {
			finger1 {
				compatible="goodix,goodixBaikal";
				combo_bus_type = "spi";
				combo_bus_num = <2>;
				combo_data = <217>;
				combo_tx = /bits/ 8 <0xF1>;
				combo_rx_mask = /bits/ 8 <0xFF 0xFF>;
				combo_rx_exp = /bits/ 8 <0x04 0x0A>;

				bus_type=<1>;
				bus_number=<2>;
				reg=<0x0>;
				chip_id_register=<0xF1>;
				chip_id_value=<0x1204>;
				product_id_value=<42>;
				file_id=<88>;
				sensor_list_info_id = <0x12>;
				sensor_type ="fingerprint_ud";
				poll_interval = <500>;
				gpio_irq = <226>;
				gpio_irq_sh = <1005>;
				gpio_reset = <238>;
				gpio_cs = <217>;
				tp_hover_support = <1>;
				status = "ok";
			};

			finger2 {
				compatible="syna,steller";
				combo_bus_type = "spi";
				combo_bus_num = <2>;
				combo_data = <217>;
				combo_tx = /bits/ 8 <0x61>;
				combo_rx_mask = /bits/ 8 <0xFF 0xFF 0xFF 0xFF 0xFF 0xFF>;
				combo_rx_exp = /bits/ 8 <0x0FF 0x01 0x00 0x00 0x68 0x00>;

				bus_type=<1>;
				bus_number=<2>;
				reg=<0x0>;
				chip_id_register=<0x61>;
				chip_id_value=<0x10f>;
				product_id_value=<42>;
				file_id=<104>;
				sensor_list_info_id = <0x12>;
				sensor_type ="fingerprint_ud";
				poll_interval = <500>;
				gpio_irq = <226>;
				gpio_irq_sh = <1005>;
				gpio_reset = <238>;
				gpio_cs = <217>;
				tp_hover_support = <1>;
				status = "ok";
			};
		};
		tp_ud {
			tp1 {
				compatible="tp,synaptics";
				status="ok";
				sensor_type="tp_ud";
				vendor_name="synaptics";
				bus_type = "i3c";
				bus_number=<0>;
				i2c_address=<0x70>;
				file_id=<108>;
				pressure_support=<1>;
				gpio_irq=<226>;
				gpio_irq_sh=<1005>;
			};
		};
		connectivity_sensor:connectivity{
			connectivity1{
				compatible="huawei,connectivity-vs";
				bus_type = <145>;
				bus_number = <1>;
				i2c_address = <0x6e>;
				reg=<0x6e>;
				chip_id_register=<0x91>;
				chip_id_value=<0x00>;
				file_id=<47>;
				sensor_type="connectivity";
				gpio1_gps_cmd_ap = <227>;
				gpio1_gps_cmd_sh = <1027>;
				gpio2_gps_ready_ap = <225>;
				gpio2_gps_ready_sh = <1025>;
				gpio3_wakeup_gps_ap = <199>;
				gpio3_wakeup_gps_sh = <1006>;
				status = "ok";
			};
		};
		magn_bracket{
			magn_bracket{
				compatible="huawei,magn_bracket";
				sensor_type="hw_magn_bracket";
				file_id=<21>;
				sensor_list_info_id = <23>;
				mag_axis_change = <0xfffffe0c 0x32 0x28 0x3e8 0xfffff254 0xffffff83>;
				sensorlist_name="magn_bracket";
				vendor="hw";
				status = "ok";
			};
		};
		kb {
			kb {
				compatible="huawei,kb";
				sensor_type="kb";
				uart_num=<7>;
				kb_detect_adc_num = <12>;
				kb_disconnect_adc_min = <1700>;
				status = "ok";
			};
		};
	};

	&gps_power {
		status = "ok";
		batching,channel_type = "sensorhub";
	};

	&sensorhub_ext_config {
		compatible = "huawei,sensorhub";
		akm_need_current = "no";
		invensense_exist = "no";
		isensor_version = "no";
		adapt_sensor_list_id = <2 6 7 8 11 12 13 14 15 18 27>;
		adapt_file_id = <8 14 15 28 107 133>;
	};

	&sensorhub_io_power{
		compatible = "huawei,sensorhub_io";
		sensor-io-supply = <&ldo24>;
		status="ok";
	};

	&hall {
		compatible = "huawei,hall_sensor,ak8789";
		status = "ok";
		huawei,hall_0{
			huawei,single-n-pole = <&gpio23 0 0>;
			huawei,type = <0x01>;
			huawei,default-state = "on";
			huawei,int-delay-time = <100>;
		};
	};
	/*
		device check : the 0 means that it don't need to check;
			the 1 means that it check at board check and running test;
			the 2 means that it check at running test
	*/
	&devcheck {
		touch_panel = <2>;
		compass = <1>;
		g_sensor = <1>;
		gyroscope = <1>;
		nfc = <0>;
		dc_dc = <0>;
		tps = <0>;
		l_sensor = <2>;
		charge = <1>;
		usb_switch = <0>;
		charge_loadswitch = <0>;
		charge_switchcap = <0>;
		wifi = <1>;
		bt = <1>;
		gps = <1>;
		antenna_ctl = <0>;
		airpress = <0>;
		vibrator_lra = <0>;
		laser = <0>;
		camera_pmic = <0>;
		status = "ok";
	};

	&huawei_hisi_isp200 {
		hisi,is_fpga = <0>;
	pinctrl-names = "default", "idle";
	pinctrl-0 = <
		&gpio020_pmx_func
		&gpio021_pmx_func
		&gpio022_pmx_func
		&gpio023_pmx_func
		&gpio024_pmx_func
		&gpio025_pmx_func
		&gpio026_pmx_func
		&gpio027_pmx_func
		&gpio028_pmx_func
		&gpio012_pmx_func
		&gpio017_pmx_func

		&gpio020_cfg_func
		&gpio021_cfg_func
		&gpio022_cfg_func
		&gpio023_cfg_func
		&gpio024_cfg_func
		&gpio025_cfg_func
		&gpio026_cfg_func
		&gpio027_cfg_func
		&gpio028_cfg_func
		&gpio012_cfg_func
		&gpio017_cfg_func

		>;
	pinctrl-1 = <
		&gpio020_pmx_idle
		&gpio021_pmx_idle
		&gpio022_pmx_idle
		&gpio023_pmx_idle
		&gpio024_pmx_idle
		&gpio025_pmx_idle
		&gpio026_pmx_idle
		&gpio027_pmx_idle
		&gpio028_pmx_idle
		&gpio012_pmx_idle
		&gpio017_pmx_idle

		&gpio020_cfg_idle
		&gpio021_cfg_idle
		&gpio022_cfg_idle
		&gpio023_cfg_idle
		&gpio024_cfg_idle
		&gpio025_cfg_idle
		&gpio026_cfg_idle
		&gpio027_cfg_idle
		&gpio028_cfg_idle
		&gpio012_cfg_idle
		&gpio017_cfg_idle
		>;
	status = "ok";
	};

	&hisi_camera {
		hisi,is_fpga = <0>;
	};

	&huawei_hisi_fd {
		compatible = "hisilicon,hisi-fd";
		reg = <0x0 0xE8340000 0x0 0x20000>,    //FD reg
		      <0x0 0xE8320000 0x0 0x20000>,    //smmu reg
		      <0x0 0xE8303000 0x0 0x1000>;     //smmu master reg
		      huawei,top-base = <0xE8304000 0x1000>;
		hisi-fd-supply = <&ispsubsys>;
		hisi-media-supply = <&media1_subsys>;
		clocks = <&clk_gate_fd_func &clk_gate_jpg_func>;
		clock-names = "clk_fd_func", "clk_jpg_func";
		clock-value = <384000000>;
		clock-low-frequency = <277000000>;
		interrupts = <0 307 4>;
		huawei,smmu-flag = <1>;
		huawei,ram-config = <1>;
		smmu_offset_list = <0x10 0x1c 0x20 0x204 0x20c 0x220 0x224>;
		mstr_offset_list = <0x28 0x34 0x100 0x260 0x3c0>;
		fd_offset_list = <0x418 0x40c 0x410 0x414 0x464 0xFD 0x7A 0x9F 0x58 0x31c 0x470>;
		status = "ok";
	};

	&huawei_s5k3l6 {
		compatible = "huawei,sensor";
		huawei,sensor_name = "S5K3L6SCM";
		huawei,sensor_index = <0>;
		huawei,is_fpga = <0>;
		huawei,pd_valid = <1>;
		huawei,reset_valid = <1>;
		huawei,vcmpd_valid = <0>;
		huawei,csi_index = <0>;
		huawei,i2c_index = <0>;
		/*cdphy-csi2*/
		huawei,phyinfo_valid = <1>;
		huawei,is_master_sensor = <1>;
		huawei,phy_id = <0>;
		huawei,phy_mode = <0>;
		huawei,phy_freq_mode = <0>;
		huawei,phy_freq = <80000000>;
		huawei,phy_work_mode = <0>;
		clocks = <&clk_gate_rxdphy0_cfg &clk_gate_rxdphy1_cfg &clk_gate_rxdphy2_cfg &clk_gate_rxdphy3_cfg &clk_gate_isp_snclk0>;
		clock-names = "clk_rxdphy0_cfg", "clk_rxdphy1_cfg", "clk_rxdphy2_cfg", "clk_rxdphy3_cfg", "clk_isp_snclk0";
		huawei,phyclk = <80000000>;
		phy-clock-num = <4>;
		huawei,mclk = <24000000>;
		dvdd-supply = <&ldo25>;
		dvdd2-supply = <&ldo32>;
		iovdd-supply = <&ldo21>;
		huawei,ldo-names = "dvdd", "dvdd2", "iovdd";
		gpios = <&gpio1 4 0 &gpio2 1 0 &gpio9 3 0 &gpio32 0 0>;
		huawei,gpio-ctrl-types ="reset", "reset2", "avdd1_en","avdd2_en";

		huawei,cam-power-seq-type = "sensor_avdd2_en", "sensor_avdd1_en", "sensor_dvdd2", "sensor_dvdd", "sensor_iovdd", "sensor_rst", "sensor_mclk";
		huawei,cam-power-seq-cfg-val = <0 0 1220000 1100000 1800000 0 0>;
		huawei,cam-power-seq-sensor-index = <0xFF 0xFF 0xFF 0xFF 0xFF 0xFF 0xFF>;
		huawei,cam-power-seq-delay = <1 1 0 0 1 1 1>;

		huawei,cam-power-down-seq-type ="sensor_mclk", "sensor_rst", "sensor_iovdd", "sensor_dvdd", "sensor_dvdd2", "sensor_avdd1_en", "sensor_avdd2_en", "sensor_rst2";
		huawei,cam-power-down-seq-cfg-val = <0 0 1800000 1100000 1220000 0 0 0>;
		huawei,cam-power-down-seq-sensor-index = <0xFF 0xFF 0xFF 0xFF 0xFF 0xFF 0xFF 0xFF>;
		huawei,cam-power-down-seq-delay = <1 1 0 0 1 1 1 0>;
		status = "ok";
	};

	&huawei_ov13855 {
		compatible = "huawei,sensor";
		huawei,sensor_name = "OV13855SCM";
		huawei,sensor_index = <0>;
		huawei,is_fpga = <0>;
		huawei,pd_valid = <1>;
		huawei,reset_valid = <1>;
		huawei,vcmpd_valid = <0>;
		huawei,csi_index = <0>;
		huawei,i2c_index = <0>;
		/*cdphy-csi2*/
		huawei,phyinfo_valid = <1>;
		huawei,is_master_sensor = <1>;
		huawei,phy_id = <0>;
		huawei,phy_mode = <0>;
		huawei,phy_freq_mode = <0>;
		huawei,phy_freq = <80000000>;
		huawei,phy_work_mode = <0>;
		clocks = <&clk_gate_rxdphy0_cfg &clk_gate_rxdphy1_cfg &clk_gate_rxdphy2_cfg &clk_gate_rxdphy3_cfg &clk_gate_isp_snclk0>;
		clock-names = "clk_rxdphy0_cfg", "clk_rxdphy1_cfg", "clk_rxdphy2_cfg", "clk_rxdphy3_cfg", "clk_isp_snclk0";
		huawei,phyclk = <80000000>;
		phy-clock-num = <4>;
		huawei,mclk = <24000000>;
		dvdd-supply = <&ldo25>;
		dvdd2-supply = <&ldo32>;
		iovdd-supply = <&ldo21>;
		huawei,ldo-names = "dvdd", "dvdd2", "iovdd";
		gpios = <&gpio1 4 0 &gpio2 1 0 &gpio9 3 0 &gpio32 0 0>;
		huawei,gpio-ctrl-types ="reset", "reset2", "avdd1_en","avdd2_en";

		huawei,cam-power-seq-type = "sensor_avdd2_en", "sensor_avdd1_en", "sensor_dvdd2", "sensor_dvdd", "sensor_iovdd", "sensor_rst", "sensor_mclk";
		huawei,cam-power-seq-cfg-val = <0 0 1220000 1220000 1800000 0 0>;
		huawei,cam-power-seq-sensor-index = <0xFF 0xFF 0xFF 0xFF 0xFF 0xFF 0xFF>;
		huawei,cam-power-seq-delay = <1 1 0 0 1 1 1>;

		huawei,cam-power-down-seq-type ="sensor_mclk", "sensor_rst", "sensor_iovdd", "sensor_dvdd", "sensor_dvdd2", "sensor_avdd1_en", "sensor_avdd2_en", "sensor_rst2";
		huawei,cam-power-down-seq-cfg-val = <0 0 1800000 1220000 1220000 0 0 0>;
		huawei,cam-power-down-seq-sensor-index = <0xFF 0xFF 0xFF 0xFF 0xFF 0xFF 0xFF 0xFF>;
		huawei,cam-power-down-seq-delay = <1 1 0 0 1 1 1 0>;
		status = "ok";
	};

	&huawei_hi846 {
		compatible = "huawei,sensor";
		huawei,sensor_name = "HI846SCM";
		huawei,is_fpga = <0>;
		huawei,pd_valid = <1>;
		huawei,vcmpd_valid = <0>;
		huawei,sensor_index = <1>;
		huawei,csi_index = <0>;
		huawei,i2c_index = <1>;
		huawei,reset_valid = <1>;
		/*cdphy-csi2*/
		huawei,phyinfo_valid = <1>;
		huawei,is_master_sensor = <1>;
		huawei,phy_id = <1>;
		huawei,phy_mode = <0>;
		huawei,phy_freq_mode = <0>;
		huawei,phy_freq = <80000000>;
		huawei,phy_work_mode = <0>;
		clocks = <&clk_gate_rxdphy0_cfg &clk_gate_rxdphy1_cfg &clk_gate_rxdphy2_cfg &clk_gate_rxdphy3_cfg &clk_gate_isp_snclk1>;
		clock-names = "clk_rxdphy0_cfg", "clk_rxdphy1_cfg", "clk_rxdphy2_cfg", "clk_rxdphy3_cfg", "clk_isp_snclk1";
		huawei,mclk = <24000000>;
		huawei,rxdphyclk = <80000000>;
		huawei,phyclk = <80000000>;
		phy-clock-num = <4>;
		dvdd-supply = <&ldo25>;
		dvdd2-supply = <&ldo32>;
		iovdd-supply = <&ldo21>;
		huawei,ldo-names = "dvdd", "dvdd2", "iovdd";
		gpios = <&gpio1 4 0 &gpio2 1 0 &gpio9 3 0 &gpio32 0 0>;
		huawei,gpio-ctrl-types ="reset", "reset2", "avdd1_en","avdd2_en";

		huawei,cam-power-seq-type = "sensor_avdd1_en", "sensor_dvdd2", "sensor_dvdd", "sensor_iovdd", "sensor_mclk", "sensor_rst2";
		huawei,cam-power-seq-cfg-val = <0 1240000 1100000 1800000 0 0>;
		huawei,cam-power-seq-sensor-index = <0xFF 0xFF 0xFF 0xFF 0xFF 0xFF>;
		huawei,cam-power-seq-delay = <1 0 0 1 1 1>;

		huawei,cam-power-down-seq-type ="sensor_rst2", "sensor_mclk", "sensor_iovdd", "sensor_dvdd", "sensor_dvdd2", "sensor_avdd1_en", "sensor_rst";
		huawei,cam-power-down-seq-cfg-val = <0 0 1800000 1100000 1240000 0 0>;
		huawei,cam-power-down-seq-sensor-index = <0xFF 0xFF 0xFF 0xFF 0xFF 0xFF 0xFF>;
		huawei,cam-power-down-seq-delay = <1 1 0 0 1 1 0>;
		status = "ok";
	};

	&huawei_s5k4h7 {
		compatible = "huawei,sensor";
		huawei,sensor_name = "S5K4H7SCM";
		huawei,is_fpga = <0>;
		huawei,pd_valid = <1>;
		huawei,vcmpd_valid = <0>;
		huawei,sensor_index = <1>;
		huawei,csi_index = <0>;
		huawei,i2c_index = <1>;
		huawei,reset_valid = <1>;
		/*cdphy-csi2*/
		huawei,phyinfo_valid = <1>;
		huawei,is_master_sensor = <1>;
		huawei,phy_id = <1>;
		huawei,phy_mode = <0>;
		huawei,phy_freq_mode = <0>;
		huawei,phy_freq = <80000000>;
		huawei,phy_work_mode = <0>;
		clocks = <&clk_gate_rxdphy0_cfg &clk_gate_rxdphy1_cfg &clk_gate_rxdphy2_cfg &clk_gate_rxdphy3_cfg &clk_gate_isp_snclk1>;
		clock-names = "clk_rxdphy0_cfg", "clk_rxdphy1_cfg", "clk_rxdphy2_cfg", "clk_rxdphy3_cfg", "clk_isp_snclk1";
		huawei,mclk = <24000000>;
		huawei,rxdphyclk = <80000000>;
		huawei,phyclk = <80000000>;
		phy-clock-num = <4>;
		dvdd-supply = <&ldo25>;
		dvdd2-supply = <&ldo32>;
		iovdd-supply = <&ldo21>;
		huawei,ldo-names = "dvdd", "dvdd2", "iovdd";
		gpios = <&gpio1 4 0 &gpio2 1 0 &gpio9 3 0 &gpio32 0 0>;
		huawei,gpio-ctrl-types ="reset", "reset2", "avdd1_en","avdd2_en";

		huawei,cam-power-seq-type = "sensor_avdd1_en", "sensor_dvdd2", "sensor_dvdd", "sensor_iovdd", "sensor_rst2", "sensor_mclk";
		huawei,cam-power-seq-cfg-val = <0 1220000 1100000 1800000 0 0>;
		huawei,cam-power-seq-sensor-index = <0xFF 0xFF 0xFF 0xFF 0xFF 0xFF>;
		huawei,cam-power-seq-delay = <1 0 0 1 1 1>;

		huawei,cam-power-down-seq-type ="sensor_mclk", "sensor_rst2", "sensor_iovdd", "sensor_dvdd", "sensor_dvdd2", "sensor_avdd1_en", "sensor_rst";
		huawei,cam-power-down-seq-cfg-val = <0 0 1800000 1100000 1220000 0 0>;
		huawei,cam-power-down-seq-sensor-index = <0xFF 0xFF 0xFF 0xFF 0xFF 0xFF 0xFF>;
		huawei,cam-power-down-seq-delay = <1 1 0 0 1 1 0>;
		status = "ok";
	};

	&fingerprint {
		compatible = "fpc,fingerprint";
		spi-max-frequency = <5000000>;
		fingerprint,product = "scm";

		fingerprint,navigation_adjust1 = <1>;
		fingerprint,navigation_adjust2 = <0>;

		fingerprint,reset_gpio = <238>;
		fingerprint,irq_gpio = <237>;
		fingerprint,cs_gpio = <217>;
		fingerprint,spi_num = <2>;
		fingerprint,force_storage_type = <1>;

		fingerprint,extern_ldo_name = "EXTERN_LDO";
		fingerprint,extern_ldo_num = <34>;
		fingreprint_ldo-supply = <&ldo34>;
		fingerprint,extern_vol = <3300000>;
		fingerprint,custom_timing;
	};

    /*hisi power*/
    &hi110x {
        hi110x,subchip_type="hi1103";
        hi110x,gpio_power_on = <&gpio32 2 0>;                /*GPIO_258*/
        hi110x,gpio_bfgx_power_on = <&gpio25 2 0>;           /*GPIO_202*/
        hi110x,gpio_wlan_power_on = <&gpio25 0 0>;           /*GPIO_200*/

        hi110x,gpio_ssi_clk  = <&gpio33 1 0>;                /*GPIO_265*/
        hi110x,gpio_ssi_data = <&gpio33 2 0>;                /*GPIO_266*/

        huawei,pmu_clk32b = "clk_pmu32kb";
        hi110x,asic_version;
    };

    /*hisi wifi*/
    &hisi_wifi {
        hi110x,gpio_wlan_wakeup_host =  <&gpio31 4 0>;       /*GPIO_252*/
        hi110x,gpio_host_wakeup_wlan =  <&gpio32 7 0>;       /*GPIO_263*/
    };

    /*hisi bfgx*/
    &hisi_bfgx {
        hi110x,gpio_bfgx_wakeup_host = <&gpio25 6 0>;        /*GPIO_206*/
        hi110x,uart_port = "/dev/ttyAMA4";
    };

    /*hisi customize*/
    &hisi_cust_cfg {
        ini_file_name = "/vendor/etc/cfg_scm_al09.ini";
    };

    /*hisi gps*/
    &hisi_gps {
        clocks = <&clk_gate_gps_ref>, <&clk_mux_gps_ref>, <&clk_gate_mdm2gps0>, <&clk_gate_mdm2gps1>, <&clk_gate_mdm2gps2>;
        clock-names = "ref_clk", "mux_clk", "mdm_clk0", "mdm_clk1", "mdm_clk2";
        /*hisi gps iomux config*/
        pinctrl-names = "default", "idle";
        pinctrl-0 = <&gpio248_pmx_func &gpio248_cfg_func>;
        pinctrl-1 = <&gpio248_pmx_idle &gpio248_cfg_idle>;
    };

    /*hisi gps sync*/
    &hisi_gps_sync {
        version = <1>;
        /*sync register configuration*/
        addr_base = <0xfff11000>;
        addr_offset = <0x0b8>;
    };

	/*nfc*/
	&nfc_exist {
		nfc_exist_flag = "1";
		hisee_exist_flag = "1";
		status = "ok";
	};

    /*irda*/
    &irda {
        compatible = "irda,config";
        irda,chiptype = <2>; /*hi110x*/
    };

    &irda_maxim {
        compatible = "huawei,irda_maxim";
        irda,power_type = <3>;
        status = "ok";
    };


&spmi {
    pmic@0 {
        sim0 {
            status = "ok";
            det_normal_direction = "closed";
            allocate_gpio = <0>;
            shared_det_irq = <1>;
            card_tray_style = <1>;
            det_high_debounce_wait_time = <400>;
            det_low_debounce_wait_time = <300>;
            factory_send_msg_to_cp = <1>;
            mux_sdsim = <0>;
        };

        sim1 {
            status = "ok";
            det_normal_direction = "closed";
            allocate_gpio = <0>;
            shared_det_irq = <1>;
            card_tray_style = <1>;
            det_high_debounce_wait_time = <400>;
            det_low_debounce_wait_time = <300>;
            factory_send_msg_to_cp = <1>;
            mux_sdsim = <0>;
        };
    };
};

&secfacedetect {
    status = "ok";
};
&hisi_iris_static_cma {
    status = "ok";
};
&hisi_algo_static_cma {
    status = "ok";
};
