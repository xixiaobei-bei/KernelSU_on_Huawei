/**
 * Copyright (C) 2014 Hisilicon Ltd.
 *
 *  This program is free software; you can redistribute it and/or modify
 *  it under the terms of the GNU General Public License version 2 as
 *  publishhed by the Free Software Foundation.
 */

/dts-v1/;
/plugin/;
/include/ "YALZX_AL10_VA_overlay.dtsi"
/include/ "YALZX_AL10_VB_pin.dtsi"
/include/ "YALZX_AL10_VB_modem_pin.dtsi"

/ {
	board_id = <8813>;
};

	&rootparam{
		hisi,boardid = <8 8 1 3>;
		hisi,boardname = "YALZX_AL10_VB";
		hisi,modem_id = <0x37660800>;
		hisi,product_id = <0x37660800>;
		hisi,product_name = "YALZX-AL10";
	};
