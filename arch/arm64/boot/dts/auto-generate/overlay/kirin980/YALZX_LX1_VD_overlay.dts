/**
 * Copyright (C) 2014 Hisilicon Ltd.
 *
 *  This program is free software; you can redistribute it and/or modify
 *  it under the terms of the GNU General Public License version 2 as
 *  publishhed by the Free Software Foundation.
 */

/dts-v1/;
/plugin/;
/include/ "YALZX_LX1_VC_overlay.dtsi"
/include/ "YALZX_LX1_VD_pin.dtsi"
/include/ "YALZX_LX1_VD_modem_pin.dtsi"

/ {
	board_id = <8818>;
};

	&rootparam{
		hisi,boardid = <8 8 1 8>;
		hisi,boardname = "YALZX_LX1_VD";
		hisi,modem_id = <0x37662C00>;
		hisi,product_id = <0x37662C00>;
		hisi,product_name = "YALZX-LX1";
	};
