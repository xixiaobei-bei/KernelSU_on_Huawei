/**
 * Copyright (C) 2014 Hisilicon Ltd.
 *
 *  This program is free software; you can redistribute it and/or modify
 *  it under the terms of the GNU General Public License version 2 as
 *  publishhed by the Free Software Foundation.
 */

/include/ "lcdkit3.0/yal_v4/devkit_lcd_kit.dtsi"
/include/ "YALZX_LX1_VB_overlay.dtsi"

/ {
	board_id = <8816>;
};

	&rootparam{
		hisi,boardid = <8 8 1 6>;
		hisi,boardname = "YALZX_LX1_VC";
		hisi,modem_id = <0x37661000>;
		hisi,product_id = <0x37661000>;
		hisi,product_name = "YALZX-LX1";
	};

	&huawei_lcd_panel {
		product_id = <13001>;
	};
