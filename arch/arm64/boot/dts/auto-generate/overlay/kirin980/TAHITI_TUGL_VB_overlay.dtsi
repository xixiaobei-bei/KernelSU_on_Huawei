/**
 * Copyright (C) 2014 Hisilicon Ltd.
 *
 *  This program is free software; you can redistribute it and/or modify
 *  it under the terms of the GNU General Public License version 2 as
 *  publishhed by the Free Software Foundation.
 */

/include/ "TAHITI_TUGL_VA_overlay.dtsi"

/ {
    board_id = <8521>;
};
    &rootparam{
		compatible = "hisilicon,vendor";
		hisi,boardid = <8 5 2 1>;
		hisi,boardname = "TAHITI_TUGL_VB";
		hisi,modem_id = <0x37030400>;
		hisi,product_id = <0x37030400>;
		hisi,product_name = "TAH-AL00";
	};
	&huawei_lcd_panel {
		compatible = "huawei,lcd_panel_type";
		product_id = <9001>;
		detect_type = <2>; /*0:DETECT_GPIOID  1:DETECT_CHIPID  2:DETECT_LCD_TYPE */
		gpio_id = <16>; /*ID0 */
		gpio_cfg_addr = <0xE896CF24>; /*IOCG*/
		support_lcd_type = "LCD_KIT";
		lcd_panel_type = "auo_otm1901a_5p2_1080p_video";
	};
	&huawei_aod {
		compatible = "huawei,aod";
		memory-region = <&fastboot_cma>;
		x_res = <2480>;
		y_res = <2200>;
		bpp = <0x10>;
		status = "ok";
	};
