/* DO NOT EDIT - Automatically generated by python */
		&desaysony_3650_68k_4400_16 {
			fcc = <3650>;
			default_rbatt_mohm = <100>;
			identify_type = "id_volt";
			id_identify_min = <1759>;
			id_identify_max = <2281>;
			id_voltage_min = <1956>;
			id_voltage_max = <2135>;
			vbat_max = <4400>;
			temp_para = 
						"-32767","0","-1","0","4100","0",
						"0","5","-1","365","4400","0",
						"5","10","-1","1095","4400","3",
						"10","45","-1","-1","4400","3",
						"45","50","-1","1277","4100","3",
						"50","32767","-1","0","4100","0";
			vbat_para = 
						"-32767","3400","-1","820","0",
						"3400","32767","-1","-1","0";
			segment_para = 
						"-32767","4150","3650","4208","50",
						"4150","4450","2555","4400","0";
			batt_brand = "desaysony";
			fcc_temp = <3577 3582 3599 3637 3625 3608>;
			fcc_sf_x = <0 100 200 300 400 500 600 700 800 1000 1500>;
			fcc_sf_y = <100 96 94 92 90 88 87 84 81 75 50>;
			fcc_sf_cols = <11>;
			pc_sf_rows = <1>;
			pc_sf_cols = <1>;
			pc_sf_row_entries = <0>;
			pc_sf_percent = <100>;
			pc_sf_sf = <100>;
			rbatt_sf_rows = <28>;
			rbatt_sf_cols = <6>;
			rbatt_sf_percent = <100 95 90 85 80 75 70 65 60 55 50 45 40 35 30 25 20 15 10 9 8 7 6 5 4 3 2 1>;
			rbatt_sf_sf = <
			               1407 701 343 141 111 101
			               1409 704 345 142 112 101
			               1416 720 356 146 114 102
			               1398 723 366 150 116 103
			               1398 736 373 156 119 104
			               1371 744 388 162 123 106
			               1359 707 382 171 128 110
			               1346 709 369 174 134 114
			               1332 715 357 158 129 113
			               1346 715 351 142 113 102
			               1372 718 348 141 112 102
			               1428 738 352 143 113 102
			               1497 777 359 148 117 104
			               1562 822 374 153 121 108
			               1643 876 397 152 119 105
			               1760 942 426 148 115 103
			               1912 1031 452 147 116 105
			               2194 1236 506 148 116 106
			               3740 1753 675 150 119 107
			               4147 1758 557 150 119 109
			               4860 1668 560 151 119 108
			               6172 1901 614 154 122 109
			               8238 2314 673 155 121 109
			               11965 3016 789 154 119 117
			               21126 4104 958 157 119 150
			               38322 6168 1222 171 121 110
			               60886 12238 1737 346 174 133
			               104809 27791 3074 476 328 202
			              >;
			pc_temp_ocv_rows = <29>;
			pc_temp_ocv_cols = <6>;
			pc_temp_ocv_percent = <100 95 90 85 80 75 70 65 60 55 50 45 40 35 30 25 20 15 10 9 8 7 6 5 4 3 2 1>;
			pc_temp_ocv_ocv = <
			                   4334 4333 4332 4325 4319 4312
			                   4247 4259 4264 4263 4257 4252
			                   4179 4196 4204 4204 4200 4195
			                   4116 4136 4147 4148 4144 4140
			                   4061 4083 4091 4095 4092 4088
			                   4003 4034 4042 4046 4043 4039
			                   3950 3972 3990 3999 3997 3994
			                   3904 3924 3940 3954 3955 3953
			                   3860 3884 3897 3906 3909 3908
			                   3827 3847 3860 3866 3866 3864
			                   3799 3814 3830 3838 3838 3836
			                   3777 3791 3805 3815 3816 3814
			                   3760 3774 3786 3797 3798 3795
			                   3741 3759 3772 3782 3782 3779
			                   3721 3746 3759 3765 3763 3756
			                   3704 3729 3745 3746 3740 3727
			                   3683 3703 3722 3724 3719 3707
			                   3658 3672 3687 3695 3692 3680
			                   3616 3631 3644 3664 3661 3650
			                   3607 3623 3638 3659 3656 3646
			                   3595 3614 3632 3653 3651 3641
			                   3576 3601 3624 3646 3643 3634
			                   3555 3584 3612 3633 3631 3621
			                   3527 3565 3593 3606 3604 3594
			                   3492 3535 3561 3562 3562 3555
			                   3447 3479 3510 3507 3507 3502
			                   3390 3406 3438 3445 3440 3435
			                   3302 3321 3346 3362 3354 3347
			                   3200 3200 3200 3200 3200 3200
			                  >;
		};
