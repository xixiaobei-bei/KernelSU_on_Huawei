/**
 * Copyright (C) 2014 Hisilicon Ltd.
 *
 *  This program is free software; you can redistribute it and/or modify
 *  it under the terms of the GNU General Public License version 2 as
 *  publishhed by the Free Software Foundation.
 */

/dts-v1/;
/plugin/;
/include/ "LAYA_AL_VS_overlay.dtsi"
/include/ "LAYA_AL_VW_pin.dtsi"
/include/ "LAYA_AL_VW_modem_pin.dtsi"

/ {
    board_id = <8429>;
};

	&rootparam{
		hisi,boardid = <8 4 2 9>;
		hisi,boardname = "LAYA_AL_VW";
		hisi,modem_id = <0x37014800>;
	};
