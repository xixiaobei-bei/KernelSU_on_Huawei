/*
 * Hisilicon Ltd. SoC
 *
 * Copyright (C) 2012-2013 Hisilicon Ltd.
 * Author: nobody
 *
 * This program is free software; you can redistribute it and/or modify
 * it under the terms of the GNU General Public License version 2 as
 * publishhed by the Free Software Foundation.
 */

	&modem_pinctrl {
		compatible = "arm,modem_pinctrl";
			pinctrl-names = "init","default","idle";
			/*table: gpio_group gpio_pin mux_addr mux_value cfg_addr cfg_value gpio_dir gpio_value*/
			pinctrl-0 = <
					 0         4      0x00C           1        0x010      0     0xffff     0xffff
					 4         3      0x058           2        0x05C      0     0xffff     0xffff
					 4         4      0x05C           2        0x060      0     0xffff     0xffff
					 4         5      0x060           0        0x064      0          1          0
					 4         6      0x064           0        0x068      0          1          0
					 4         7      0x068           1        0x06C      0     0xffff     0xffff
					 5         0      0x06C           4        0x070      0     0xffff     0xffff
					 5         1      0x070           4        0x074      0     0xffff     0xffff
					 5         2      0x074           1        0x078      0     0xffff     0xffff
					 5         3      0x078           1        0x07C      0     0xffff     0xffff
					 5         4      0x07C           1        0x080      0     0xffff     0xffff
					 5         5      0x080           1        0x084      0     0xffff     0xffff
					 5         6      0x084           1        0x088      0     0xffff     0xffff
					 5         7      0x088           1        0x08C      0     0xffff     0xffff
					 6         0      0x08C           1        0x090      0     0xffff     0xffff
					 6         1      0x090           1        0x094      0     0xffff     0xffff
					 6         2      0x094           1        0x098      0     0xffff     0xffff
					 6         3      0x098           1        0x09C      0     0xffff     0xffff
					 6         4      0x09C           1        0x0A0      0     0xffff     0xffff
					 6         5      0x0A0           1        0x0A4      0     0xffff     0xffff
					 6         6      0x0A4           1        0x0A8      0     0xffff     0xffff
					 6         7      0x0A8           1        0x0AC      0     0xffff     0xffff
					 7         0      0x0AC           1        0x0B0      0     0xffff     0xffff
					 7         1      0x0B0           1        0x0B4      0     0xffff     0xffff
					 7         2      0x0B4           1        0x0B8      0     0xffff     0xffff
					 7         3      0x0B8           1        0x0BC      0     0xffff     0xffff
					 7         4      0x0BC           1        0x0C0      0     0xffff     0xffff
					 7         5      0x0C0           1        0x0C4      0     0xffff     0xffff
					 7         6      0x0C4           1        0x0C8      0     0xffff     0xffff
					 7         7      0x0C8           1        0x0CC      0     0xffff     0xffff
					 8         0      0x0CC           2        0x0D0      0     0xffff     0xffff
					 8         1      0x0D0           2        0x0D4      2     0xffff     0xffff
					 8         2      0x0D4           1        0x0D8      0     0xffff     0xffff
					 8         3      0x0D8           1        0x0DC      2     0xffff     0xffff
					 8         4      0x0DC           1        0x0E0      0     0xffff     0xffff
					 8         5      0x0E0           1        0x0E4      2     0xffff     0xffff
					 8         6      0x0E4           1        0x0E8      0     0xffff     0xffff
					 8         7      0x0E8           1        0x0EC      2     0xffff     0xffff
					 9         0      0x0EC           1        0x0F0      0     0xffff     0xffff
					 9         1      0x0F0           1        0x0F4      2     0xffff     0xffff
					29         0      0x098           0        0x0C4      1          0     0xffff
					31         4      0x0D4           0        0x108      1          0     0xffff
					33         1      0x108           0        0x13C      0     0xffff     0xffff
					33         2      0x10C           0        0x140      2     0xffff     0xffff
					>;
			pinctrl-1 = <
					 0         4      0x00C           1        0x010      0     0xffff     0xffff
					 4         3      0x058           2        0x05C      0     0xffff     0xffff
					 4         4      0x05C           2        0x060      0     0xffff     0xffff
					 4         5      0x060           0        0x064      0          1     0xffff
					 4         6      0x064           0        0x068      0          1     0xffff
					 4         7      0x068           1        0x06C      0     0xffff     0xffff
					 5         0      0x06C           4        0x070      0     0xffff     0xffff
					 5         1      0x070           4        0x074      0     0xffff     0xffff
					 5         2      0x074           1        0x078      0     0xffff     0xffff
					 5         3      0x078           1        0x07C      0     0xffff     0xffff
					 5         4      0x07C           1        0x080      0     0xffff     0xffff
					 5         5      0x080           1        0x084      0     0xffff     0xffff
					 5         6      0x084           1        0x088      0     0xffff     0xffff
					 5         7      0x088           1        0x08C      0     0xffff     0xffff
					 6         0      0x08C           1        0x090      0     0xffff     0xffff
					 6         1      0x090           1        0x094      0     0xffff     0xffff
					 6         2      0x094           1        0x098      0     0xffff     0xffff
					 6         3      0x098           1        0x09C      0     0xffff     0xffff
					 6         4      0x09C           1        0x0A0      0     0xffff     0xffff
					 6         5      0x0A0           1        0x0A4      0     0xffff     0xffff
					 6         6      0x0A4           1        0x0A8      0     0xffff     0xffff
					 6         7      0x0A8           1        0x0AC      0     0xffff     0xffff
					 7         0      0x0AC           1        0x0B0      0     0xffff     0xffff
					 7         1      0x0B0           1        0x0B4      0     0xffff     0xffff
					 7         2      0x0B4           1        0x0B8      0     0xffff     0xffff
					 7         3      0x0B8           1        0x0BC      0     0xffff     0xffff
					 7         4      0x0BC           1        0x0C0      0     0xffff     0xffff
					 7         5      0x0C0           1        0x0C4      0     0xffff     0xffff
					 7         6      0x0C4           1        0x0C8      0     0xffff     0xffff
					 7         7      0x0C8           1        0x0CC      0     0xffff     0xffff
					 8         0      0x0CC           2        0x0D0      0     0xffff     0xffff
					 8         1      0x0D0           2        0x0D4      2     0xffff     0xffff
					 8         2      0x0D4           1        0x0D8      0     0xffff     0xffff
					 8         3      0x0D8           1        0x0DC      2     0xffff     0xffff
					 8         4      0x0DC           1        0x0E0      0     0xffff     0xffff
					 8         5      0x0E0           1        0x0E4      2     0xffff     0xffff
					 8         6      0x0E4           1        0x0E8      0     0xffff     0xffff
					 8         7      0x0E8           1        0x0EC      2     0xffff     0xffff
					 9         0      0x0EC           1        0x0F0      0     0xffff     0xffff
					 9         1      0x0F0           1        0x0F4      2     0xffff     0xffff
					29         0      0x098           0        0x0C4      1          0     0xffff
					31         4      0x0D4           0        0x108      1          0     0xffff
					33         1      0x108           0        0x13C      0     0xffff     0xffff
					33         2      0x10C           0        0x140      2     0xffff     0xffff
					>;
			pinctrl-2 = <
					 0         4      0x00C           1        0x010      0     0xffff     0xffff
					 4         3      0x058           2        0x05C      0     0xffff     0xffff
					 4         4      0x05C           2        0x060      0     0xffff     0xffff
					 4         5      0x060           0        0x064      0          1          0
					 4         6      0x064           0        0x068      0          1          0
					 4         7      0x068           1        0x06C      0     0xffff     0xffff
					 5         0      0x06C           4        0x070      0     0xffff     0xffff
					 5         1      0x070           4        0x074      0     0xffff     0xffff
					 5         2      0x074           1        0x078      0     0xffff     0xffff
					 5         3      0x078           1        0x07C      0     0xffff     0xffff
					 5         4      0x07C           1        0x080      0     0xffff     0xffff
					 5         5      0x080           1        0x084      0     0xffff     0xffff
					 5         6      0x084           1        0x088      0     0xffff     0xffff
					 5         7      0x088           1        0x08C      0     0xffff     0xffff
					 6         0      0x08C           1        0x090      0     0xffff     0xffff
					 6         1      0x090           1        0x094      0     0xffff     0xffff
					 6         2      0x094           1        0x098      0     0xffff     0xffff
					 6         3      0x098           1        0x09C      0     0xffff     0xffff
					 6         4      0x09C           1        0x0A0      0     0xffff     0xffff
					 6         5      0x0A0           1        0x0A4      0     0xffff     0xffff
					 6         6      0x0A4           1        0x0A8      0     0xffff     0xffff
					 6         7      0x0A8           1        0x0AC      0     0xffff     0xffff
					 7         0      0x0AC           1        0x0B0      0     0xffff     0xffff
					 7         1      0x0B0           1        0x0B4      0     0xffff     0xffff
					 7         2      0x0B4           1        0x0B8      0     0xffff     0xffff
					 7         3      0x0B8           1        0x0BC      0     0xffff     0xffff
					 7         4      0x0BC           1        0x0C0      0     0xffff     0xffff
					 7         5      0x0C0           1        0x0C4      0     0xffff     0xffff
					 7         6      0x0C4           1        0x0C8      0     0xffff     0xffff
					 7         7      0x0C8           1        0x0CC      0     0xffff     0xffff
					 8         0      0x0CC           2        0x0D0      0     0xffff     0xffff
					 8         1      0x0D0           2        0x0D4      2     0xffff     0xffff
					 8         2      0x0D4           1        0x0D8      0     0xffff     0xffff
					 8         3      0x0D8           1        0x0DC      2     0xffff     0xffff
					 8         4      0x0DC           1        0x0E0      0     0xffff     0xffff
					 8         5      0x0E0           1        0x0E4      2     0xffff     0xffff
					 8         6      0x0E4           1        0x0E8      0     0xffff     0xffff
					 8         7      0x0E8           1        0x0EC      2     0xffff     0xffff
					 9         0      0x0EC           1        0x0F0      0     0xffff     0xffff
					 9         1      0x0F0           1        0x0F4      2     0xffff     0xffff
					29         0      0x098           0        0x0C4      1          0     0xffff
					31         4      0x0D4           0        0x108      1          0     0xffff
					33         1      0x108           0        0x13C      0     0xffff     0xffff
					33         2      0x10C           0        0x140      2     0xffff     0xffff
					>;
			pinctrl-num   = <44 44 44>;
			status = "ok";
	};
