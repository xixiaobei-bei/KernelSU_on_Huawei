/* DO NOT EDIT - Automatically generated by python */
		&sunwodaatl_2220_snIA_4430 {
			fcc = <2220>;
			default_rbatt_mohm = <100>;
			identify_type = "id_sn";
			id_sn = "IA";
			vbat_max = <4430>;
			temp_para = 
						"-32767","0","-1","0","4100","0",
						"0","5","-1","222","4430","0",
						"5","10","-1","666","4430","3",
						"10","45","-1","-1","4430","3",
						"45","50","-1","777","4100","3",
						"50","32767","-1","0","4100","0";
			vbat_para = 
						"-32767","3400","-1","820","0",
						"3400","32767","-1","-1","0";
			segment_para = 
						"-32767","4150","2220","4208","50",
						"4150","4450","1554","4430","0";
			batt_brand = "sunwodaatl";
			fcc_temp = <2235 2236 2241 2239 2227 2187>;
			fcc_sf_x = <0 100 200 300 400 500 600 700 800 1000 1500>;
			fcc_sf_y = <100 96 94 92 90 88 87 84 81 75 50>;
			fcc_sf_cols = <11>;
			pc_sf_rows = <1>;
			pc_sf_cols = <1>;
			pc_sf_row_entries = <0>;
			pc_sf_percent = <100>;
			pc_sf_sf = <100>;
			rbatt_sf_rows = <28>;
			rbatt_sf_cols = <6>;
			rbatt_sf_percent = <100 95 90 85 80 75 70 65 60 55 50 45 40 35 30 25 20 15 10 9 8 7 6 5 4 3 2 1>;
			rbatt_sf_sf = <
			               2235 1075 478 90 60 43
			               2235 1075 478 90 60 43
			               2167 1076 469 88 60 45
			               2070 1023 447 88 61 48
			               1974 992 438 89 64 50
			               1979 977 440 93 67 52
			               1902 1007 461 101 71 55
			               1772 934 470 115 79 60
			               1697 855 418 145 100 72
			               1678 822 370 107 73 56
			               1730 799 356 87 63 50
			               1832 805 355 87 64 50
			               1971 867 357 91 67 52
			               2152 992 358 98 72 58
			               2337 1166 391 106 76 52
			               2514 1393 455 89 63 49
			               2681 1662 548 83 63 51
			               2887 1997 675 84 63 51
			               3365 2404 889 88 65 54
			               3969 2432 813 105 68 56
			               5082 2623 784 115 91 57
			               5907 3122 838 110 87 63
			               6811 3655 932 111 88 73
			               8002 4275 1030 118 98 82
			               9776 5137 1184 133 114 89
			               12790 6497 1458 149 111 85
			               17042 7838 1982 157 120 94
			               34991 11827 3082 183 142 144
			              >;
			pc_temp_ocv_rows = <29>;
			pc_temp_ocv_cols = <6>;
			pc_temp_ocv_percent = <100 95 90 85 80 75 70 65 60 55 50 45 40 35 30 25 20 15 10 9 8 7 6 5 4 3 2 1>;
			pc_temp_ocv_ocv = <
			                   4427 4423 4426 4423 4419 4413
			                   4332 4345 4360 4365 4360 4353
			                   4261 4286 4302 4309 4305 4297
			                   4196 4223 4244 4251 4246 4240
			                   4130 4163 4186 4191 4188 4182
			                   4083 4104 4130 4134 4131 4127
			                   4026 4058 4076 4080 4078 4074
			                   3959 3997 4022 4031 4029 4026
			                   3898 3939 3964 3984 3984 3981
			                   3856 3891 3911 3924 3924 3925
			                   3832 3851 3872 3883 3883 3885
			                   3816 3820 3841 3854 3855 3856
			                   3803 3804 3817 3830 3831 3832
			                   3789 3794 3797 3811 3812 3812
			                   3774 3782 3785 3794 3793 3784
			                   3756 3768 3773 3770 3764 3753
			                   3734 3745 3752 3746 3740 3728
			                   3709 3714 3720 3719 3711 3698
			                   3688 3686 3689 3695 3690 3676
			                   3684 3682 3688 3693 3687 3675
			                   3679 3678 3685 3691 3684 3673
			                   3670 3671 3680 3687 3681 3668
			                   3656 3658 3668 3677 3671 3654
			                   3630 3632 3641 3651 3642 3624
			                   3588 3590 3598 3609 3600 3583
			                   3532 3534 3540 3556 3547 3529
			                   3466 3465 3464 3484 3475 3458
			                   3372 3365 3359 3377 3374 3362
			                   3200 3200 3200 3200 3200 3200
			                  >;
		};
