/**
 * Copyright (C) 2014 Hisilicon Ltd.
 *
 *  This program is free software; you can redistribute it and/or modify
 *  it under the terms of the GNU General Public License version 2 as
 *  publishhed by the Free Software Foundation.
 */

/dts-v1/;
/plugin/;
/include/ "TNY_AL00_VC_overlay.dtsi"
/include/ "TNY_AL00_VE_pin.dtsi"
/include/ "TNY_AL00_VE_modem_pin.dtsi"

/ {
    board_id = <8915>;
};

	&rootparam{
		hisi,boardid = <8 9 1 5>;
		hisi,boardname = "TNY_AL00_VE";
		hisi,modem_id = <0x37600400>;
	};