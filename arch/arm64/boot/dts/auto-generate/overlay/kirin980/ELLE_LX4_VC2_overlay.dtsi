/**
 * Copyright (C) 2014 Hisilicon Ltd.
 *
 *  This program is free software; you can redistribute it and/or modify
 *  it under the terms of the GNU General Public License version 2 as
 *  publishhed by the Free Software Foundation.
 */

/include/ "ELLE_LX4_VC_overlay.dtsi"

/ {
    board_id = <8492>;
};
    &rootparam{
		compatible = "hisilicon,vendor";
		hisi,boardid = <8 4 9 2>;
		hisi,boardname = "ELLE_LX4_VC2";
		hisi,modem_id = <0x3704B000>;
		hisi,product_id = <0x3704B000>;
		hisi,product_name = "ELE-LX4";
	};

