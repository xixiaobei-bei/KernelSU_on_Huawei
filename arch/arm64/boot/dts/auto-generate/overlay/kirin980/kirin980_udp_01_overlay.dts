/**
 * Copyright (C) 2014 Hisilicon Ltd.
 *
 *  This program is free software; you can redistribute it and/or modify
 *  it under the terms of the GNU General Public License version 2 as
 *  publishhed by the Free Software Foundation.
 */

/dts-v1/;
/plugin/;
/include/ "kirin980_udp_default_overlay.dtsi"
/include/ "kirin980_udp_01_pin.dtsi"
/include/ "kirin980_udp_01_modem_pin.dtsi"

/ {
    board_id = <8001>;
};

	&rootparam{
		hisi,boardid = <8 0 0 1>;
		hisi,boardname = "kirin980_udp_01";
		hisi,product_id = <0x37F5FC01>;
	};