/**
 * Copyright (C) 2014 Hisilicon Ltd.
 *
 *  This program is free software; you can redistribute it and/or modify
 *  it under the terms of the GNU General Public License version 2 as
 *  publishhed by the Free Software Foundation.
 */

/include/ "VOGUE_LX4_VB_overlay.dtsi"

/ {
    board_id = <8507>;
};
    &rootparam{
		compatible = "hisilicon,vendor";
		hisi,boardid = <8 5 0 7>;
		hisi,boardname = "VOGUE_LX9_VB_SHASTA";
		hisi,modem_id = <0x37051C00>;
		hisi,product_id = <0x37051C00>;
		hisi,product_name = "VOG-LX9";
	};

