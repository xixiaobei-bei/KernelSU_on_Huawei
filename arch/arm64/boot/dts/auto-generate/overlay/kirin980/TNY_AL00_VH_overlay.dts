/**
 * Copyright (C) 2014 Hisilicon Ltd.
 *
 *  This program is free software; you can redistribute it and/or modify
 *  it under the terms of the GNU General Public License version 2 as
 *  publishhed by the Free Software Foundation.
 */

/dts-v1/;
/plugin/;
/include/ "TNY_AL00_VG_overlay.dtsi"
/include/ "TNY_AL00_VH_pin.dtsi"
/include/ "TNY_AL00_VH_modem_pin.dtsi"

/ {
    board_id = <8999>;
};

	&rootparam{
		hisi,boardid = <8 9 9 9>;
		hisi,boardname = "TNY_AL00_VH";
		hisi,modem_id = <0x37601400>;
	};
