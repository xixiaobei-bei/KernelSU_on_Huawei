/*
 *  Copyright (C) 2012-2013 Linaro Ltd.
 *
 *  This program is free software; you can redistribute it and/or modify
 *  it under the terms of the GNU General Public License version 2 as
 *  publishhed by the Free Software Foundation.
 */


/* pmu_type  0: HI6422  1: HI6423
 * bus_type  0: SPMI    1: PMUSSI
 */

/{
	subpmu_dieid {
		compatible = "hisilicon,subpmu-dieid";
		status = "ok";

		hi6422_1 {
			pmu-type = "Hi6422v300";
			bus-type = "spmi";
			slave-id = <3>;
		};

		hi6422_2 {
			pmu-type = "Hi6422v300";
			bus-type = "spmi";
			slave-id = <1>;
		};
	};
};
