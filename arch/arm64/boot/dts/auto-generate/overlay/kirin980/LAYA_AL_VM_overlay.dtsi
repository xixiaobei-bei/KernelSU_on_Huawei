/**
 * Copyright (C) 2014 Hisilicon Ltd.
 *
 *  This program is free software; you can redistribute it and/or modify
 *  it under the terms of the GNU General Public License version 2 as
 *  publishhed by the Free Software Foundation.
 */

/include/ "LAYA_AL_VJ_overlay.dtsi"

/ {
    board_id = <8445>;
};

	&rootparam{
		hisi,boardid = <8 4 4 5>;
		hisi,boardname = "LAYA_AL_VM";
		hisi,modem_id = <0x37012800>;
	};