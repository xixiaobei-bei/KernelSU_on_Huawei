/**
 * Copyright (C) 2014 Hisilicon Ltd.
 *
 *  This program is free software; you can redistribute it and/or modify
 *  it under the terms of the GNU General Public License version 2 as
 *  publishhed by the Free Software Foundation.
 */

/dts-v1/;
/plugin/;
/include/ "LAYA_TUGL_VA_pin.dtsi"
/include/ "LAYA_TUGL_VA_modem_pin.dtsi"
/include/ "LAYA_TUGL_VA_hi6402_pin.dtsi"
/include/ "huawei_audio_dto.dtsi"
/include/ "huawei_hall_inputhub_dto.dtsi"
/include/ "huawei_pmucurr_test_dto.dtsi"
/include/ "usb_short_circuit_protect_dto.dtsi"
/include/ "hi11xx_connectivity_dto.dtsi"
/include/ "lcdkit3.0/default/devkit_lcd_kit.dtsi"
/include/ "lcdkit3.0/laya_tugl/devkit_lcd_kit.dtsi"
/include/ "desayatl_4100_snYA_4400_25.dtsi"
/include/ "desayatl_4100_snYT_4400_25.dtsi"
/include/ "scudmurata_4100_snCS_4400_50.dtsi"

/ {
    board_id = <8430>;
};

&hisi_peripheral_tm {
    compatible = "hisi,hisi-peripheral-tm";
    hisi,peripheral_sensors = <13>;

    hisi,detect_system_h_tm_chanel = <7>;
    hisi,detect_system_h_tm_ntc = "austin_hkadc_soc_temp_table";
    hisi,detect_system_h_tm_state = "enable";
    hisi,detect_system_h_throttling = <53>;
    hisi,detect_system_h_shutdown = <55>;
    hisi,detect_system_h_below_vr_min = <53>;
    hisi,detect_system_h_over_skin = <12>;

    hisi,detect_flash_led_tm_chanel = <3>;
    hisi,detect_flash_led_tm_ntc = "austin_hkadc_soc_temp_table";
    hisi,detect_flash_led_tm_state = "disable";

    hisi,detect_charger_tm_chanel = <4>;
    hisi,detect_charger_tm_ntc = "austin_hkadc_soc_temp_table";
    hisi,detect_charger_tm_state = "enable";

    hisi,detect_pa_0_tm_chanel = <5>;
    hisi,detect_pa_0_tm_ntc = "austin_hkadc_pa_temp_table";
    hisi,detect_pa_0_tm_state = "enable";

    hisi,detect_pa_1_tm_chanel = <6>;
    hisi,detect_pa_1_tm_ntc = "austin_hkadc_pa_temp_table";
    hisi,detect_pa_1_tm_state = "enable";

    hisi,detect_dcxo0_tm_chanel = <15>;
    hisi,detect_dcxo0_tm_ntc = "austin_hkadc_adc_temp_table";
    hisi,detect_dcxo0_tm_state = "enable";

    hisi,detect_shell_tm_chanel = <7>;
    hisi,detect_shell_tm_ntc = "austin_hkadc_soc_temp_table";
    hisi,detect_shell_tm_state = "disable";

    hisi,detect_charger1_tm_chanel = <4>;
    hisi,detect_charger1_tm_ntc = "austin_hkadc_soc_temp_table";
    hisi,detect_charger1_tm_state = "disable";

    hisi,detect_usb_tm_chanel = <3>;
    hisi,detect_usb_tm_ntc = "austin_hkadc_soc_temp_table";
    hisi,detect_usb_tm_state = "enable";

    hisi,detect_rfboard_tm_chanel = <8>;
    hisi,detect_rfboard_tm_ntc = "austin_hkadc_soc_temp_table";
    hisi,detect_rfboard_tm_state = "enable";

    hisi,detect_wireless_tm_chanel = <9>;
    hisi,detect_wireless_tm_ntc = "austin_hkadc_soc_temp_table";
    hisi,detect_wireless_tm_state = "disable";

    hisi,detect_ir_tm_chanel = <12>;
    hisi,detect_ir_tm_ntc = "austin_hkadc_soc_temp_table";
    hisi,detect_ir_tm_state = "enable";

    hisi,detect_dot_tm_chanel = <13>;
    hisi,detect_dot_tm_ntc = "austin_hkadc_soc_temp_table";
    hisi,detect_dot_tm_state = "enable";

    status = "ok";
};


&hisi_shell {
	compatible = "hisi,shell-temp";
	interval = <5000>;
	bias = <50000>;
	count = <5>;
	tsensor_para = "10000","100000","0";
	ntc_para = "2000","80000","-20000";
	status = "ok";
	sensors {
		sensor0 {
			type = "usb_port";
			coef = "-14195","-9920","-6189","-1029","1834";
		};
		sensor1 {
			type = "Battery";
			coef = "-3115","-675","-461","-271","844";
		};
		sensor2 {
			type = "system_h";
			coef = "23364","14436","6550","1868","25087";
		};
		sensor3 {
			type = "charger";
			coef = "-5997","-1203","1032","-255","3257";
		};
		sensor4 {
			type = "rfboard";
			coef = "13730","13518","13803","13445","14297";
		};
		sensor5 {
			type = "ir";
			coef = "-14493","-2629","-6539","-7415","28466";
		};
	};
};

&shell_front {
	compatible = "hisi,shell-temp";
	interval = <5000>;
	bias = <500>;
	count = <6>;
	tsensor_para = "10000","100000","0";
	ntc_para = "2000","80000","-20000";
	status = "ok";
	sensors {
		sensor0 {
			type = "system_h";
			coef = "1244","-7351","-7466","-7933","-1254","11946";
		};
		sensor1 {
			type = "charger";
			coef = "6341","-1875","-1051","1003","5172","8908";
		};
		sensor2 {
			type = "pa_0";
			coef = "-7432","-40651","-37671","-22890","-16316","-75046";
		};
		sensor3 {
			type = "pa_1";
			coef = "111742","83051","68522","48240","27123","-13888";
		};
		sensor4 {
			type = "ir";
			coef = "19478","4240","-6632","-13852","-10510","-9050";
		};
		sensor5 {
			type = "dot";
			coef = "3839","-2773","-1833","-1211","-3900","-11607";
		};
	};
};

&shell_back {
	compatible = "hisi,shell-temp";
	interval = <5000>;
	bias = <500>;
	count = <6>;
	tsensor_para = "10000","100000","0";
	ntc_para = "2000","80000","-20000";
	status = "ok";
	sensors {
		sensor0 {
			type = "system_h";
			coef = "-6244","-15339","-13905","-12331","-1845","18756";
		};
		sensor1 {
			type = "pa_0";
			coef = "6630","-23289","-23554","-14701","108","-12482";
		};
		sensor2 {
			type = "pa_1";
			coef = "64763","40698","30948","17447","-2459","-41495";
		};
		sensor3 {
			type = "ir";
			coef = "104251","64346","31777","1974","-30108","-68329";
		};
		sensor4 {
			type = "dot";
			coef = "6777","-722","-2260","-970","-3031","-16029";
		};
	};
};

&hisi_ambient {
    compatible = "hisi,ambient-temp";
    interval = <900>;
    bias = <1>;
    status = "ok";
    sensors {
        sensor0 {
            type = "system_h";
        };
        sensor1 {
            type = "charger";
        };
        sensor2 {
            type = "pa_0";
        };
        sensor3 {
            type = "dcxo0";
        };
    };
};

&fastboot_pmic {
	hisilicon,init-reg-num = <3>;
	hisilicon,init-reg-addrs = <0x18C 0x1BC 0x19E>;
	hisilicon,init-reg-vals  = <0x1 0xF5 0xE4>;
};

	&rootparam {
		compatible = "hisilicon,vendor";
		hisi,boardid = <8 4 3 0>;
		hisi,boardname = "LAYA_TUGL_VA";
		hisi,modem_id = <0x37010000>;
		hisi,product_id = <0x37010000>;
		hisi,product_name = "LAYA-AL00";
	};

	&chosen {};

	&hisi_ion {
		heap_sec_drm@20 {
			status = "disabled";
		};
	};
	&spmi {
		pmic@0 {
			gpios = <&gpio28 0 0>;
			hisilicon,pmic_fpga_flag=<0>;
				pmic_led@a0 {
					status = "ok";
					led@a0 {  /*red*/
						hisilicon,each_max_iset = <0x02>;
					};
					led@a1 {  /*green*/
						hisilicon,each_max_iset = <0x02>;
					};
					led@a2 {  /*blue*/
						hisilicon,each_max_iset = <0x02>;
					};
				};
				pmic_rtc@a0 {
					status = "ok";
				};
				ponkey@b1{
		           		status = "ok";
				};
				pmic_mntn@a0 {
					status = "ok";
					OCP@2B9 {
						compatible = "hisilicon-pmic-mntn-ocp-reg0x2B9";
						hisilicon,inacceptable-event = <0xFF>;
						hisilicon,check_ocp_reset = <0x00>;
						hisilicon,check_ocp_nofify = <0xCD>;
						hisilicon,check_ocp_num = <0x0 0x0 0x0 0x0 0x0 0x0 0x0 0x3>;
						hisilicon,event-bit-name = "ldo32","ldo30","ldo29","ldo28","ldo27","ldo26","ldo25","ldo24";
						hisilicon,event-ops-reg = <0x32 0x31 0x30 0x2F 0x2E 0x2D 0x2C 0x2B>;
							};
                    OCP@2BA {
                                compatible = "hisilicon-pmic-mntn-ocp-reg0x2BA";
                                hisilicon,inacceptable-event = <0xFF>;
                                hisilicon,check_ocp_reset = <0x00>;
                                hisilicon,check_ocp_nofify = <0x89>;
                                hilicon,check_ocp_num = <0x0 0x0 0x0 0x0 0x0 0x0 0x0 0x0>;
                                hisilicon,event-bit-name = "ldo41","ldo40","ldo39","ldo38","ldo37","ldo36","pmuh","ldo34";
                                hisilicon,event-ops-reg = <0x3A 0x39 0x38 0x37 0x36 0x35 0x34 0x33>;
                            };
				};
				hi6421v700_coul@1 {
					status = "ok";
                                };
				hisi_soh_pmic@1 {
					status = "ok";
				};
				pmic_vibrator {
					hisi_pmic_vibrator,max-timeout-ms = <10000>;
					hisi_pmic_vibrator,label = "vibrator";
					vibrator-reg-on = <0xA000>;
					vibrator-reg-off = <0xA001>;
					vibrator-voltage = <1400>;
					vibrator-boost-power = <1>; //0 not used 5v , 1 used
					haptics-cfg =
						<0x00 0x00 0x08 0x0f 0x10 0x00 0x18 0x0f 0x1f 0x00 0x26 0x0f 0x2d 0x00 0x32 0x0f 0x37 0x00 0x3b 0x0f 0x3d 0xc0 0x3f 0x0d 0x40 0x00 0x40 0x00 0x40 0x00 0x40 0x00 0x40 0x00 0x40 0x00 0x40 0x00 0x40 0x00>,//6 cycle
						<0x00 0x00 0x08 0x0f 0x10 0x00 0x18 0x0f 0x1f 0x00 0x26 0x0f 0x2d 0x00 0x32 0x0f 0x37 0x00 0x3b 0x0f 0x3d 0x00 0x3f 0x0f 0x40 0x00 0x40 0x0f 0x40 0xf0 0x40 0x07 0x40 0x00 0x40 0x00 0x40 0x00 0x40 0x00>,//8 cycle
						<0x00 0x00 0x08 0x0f 0x10 0x00 0x18 0x0f 0x1f 0x00 0x26 0x0f 0x2d 0x00 0x32 0x0f 0x37 0x00 0x3b 0x0f 0x3d 0x00 0x3f 0x0f 0x40 0x00 0x40 0x0f 0x40 0x00 0x40 0x0f 0x40 0x00 0x40 0x0f 0x40 0xf0 0x40 0x07>,//10 cycle
						<0x00 0x40 0x08 0x0b 0x10 0x40 0x18 0x0b 0x1f 0x40 0x26 0x0b 0x2d 0x40 0x32 0x0b 0x37 0x40 0x3b 0x0b 0x3d 0x50 0x3f 0x0a 0x40 0x00 0x40 0x00 0x40 0x00 0x40 0x00 0x40 0x00 0x40 0x00 0x40 0x00 0x40 0x00>,//%75 6 cycle
						<0x00 0x80 0x08 0x07 0x10 0x80 0x18 0x07 0x1f 0x80 0x26 0x07 0x2d 0x80 0x32 0x07 0x37 0x80 0x3b 0x07 0x3d 0x40 0x3f 0x06 0x40 0x00 0x40 0x00 0x40 0x00 0x40 0x00 0x40 0x00 0x40 0x00 0x40 0x00 0x40 0x00>;//%50 6 cycle
					status = "ok";
				};

			ldo34@33 {
				compatible = "hisilicon-hisi-ldo";
				regulator-name = "ldo34";
				regulator-always-on;
				regulator-min-microvolt = <2600000>;
				regulator-max-microvolt = <3300000>;
				hisilicon,hisi-ctrl = <0x33 0x01 0x10>;
				hisilicon,hisi-vset = <0x76 0x07>;
				hisilicon,hisi-n-voltages = <8>;
				hisilicon,hisi-vset-table = <2900000>, <2800000>,
				                            <2700000>, <2600000>,
				                            <3300000>, <3200000>,
				                            <3100000>, <3000000>;
				hisilicon,hisi-off-on-delay-us = <20000>;
				hisilicon,hisi-enable-time-us = <360>;
				hisilicon,hisi-eco-microamp = <10000>;
				hisilicon,valid-modes-mask = <0x06>;
				hisilicon,valid-idle-mask = <0x0D>;
				status = "ok";
			};
		};
	};
	&soh_core {
		status = "ok";
	};
	&pd_dpm {
		otg_channel = <1>;
		switch_manual_enable = <0>;
		abnormal_cc_detection = <1>;
		status = "ok";
	};
	&hisi_vibrator {
		status = "disabled";
	};

	&fastboot_battery {
		status = "ok";
	};
	&fastboot_charger {
		hw_charger_type = <4>;
		chip_i2c_num = <6>;
		status = "ok";
	};
	&hisi_battery {
		batt_name = <&desayatl_4100_snYA_4400_25 &desayatl_4100_snYT_4400_25 &scudmurata_4100_snCS_4400_50>;
		status = "ok";
	};
	&hisi_bci_battery {
		capacity_dec_para = <
			100 85  140
			100 120 100
		>;
		battery_design_fcc = <4200>;
		battery_board_type = <2>; /*0:sft 1:udp 2:asic*/
		status = "ok";
	};
	&coul_core {
		adc_batt_id = <11>;
		adc_batt_temp = <10>;
		r_coul_mohm = <2>;
		last_soc_enable = <1>;
		startup_delta_soc = <10>;
		soc_at_term = <97>;
		iscd_enable = <1>;
		ntc_compensation_is = <1>;
		dischg_ocv_enable = <1>;
		ntc_temp_compensation_para =
			"6000", "50",
			"4000", "30",
			"2000", "10";
		basp_policy = <
			3 100000 60  200 200 60  0 920001032
			2 70000 80  40  50  80  0 920001031
			1 40000 90  20  0   90  0 920001029
			0 0     0   0   0   100 0 0
		>;
		normal_cutoff_vol_mv = <2900>;
		sleep_cutoff_vol_mv = <3100>;
		status = "ok";
	};
	&hisi_coul_drv_test {
		status = "ok";
	};
	&hw_pmucurr_test {
		power_numbers = <2>;
		status = "ok";
	};
	&wireless_charger {
		interference_para =
			"0x01", "0xfe", "138", "5000", "5500", "470",
			"0x02", "0xfd", "-1",  "-1",   "-1",   "900";
		rx_qval = <0x3c>;

		status = "ok";
	};
	&wireless_tx {
		tx_iin_limit = <0 500 300 1000 1000 0 0 0 0 1000 0 0>;
		status = "ok";
	};

	&wireless_otg {
		gpio_otg_switch = <&gpio16 7 0>;
		status = "ok";
	};

	&wired_channel_switch {
		use_ovp_cutoff_wired_channel = <0>;
		use_super_switch_cutoff_wired_channel = <0>;
		use_wireless_switch_cutoff_wired_channel = <1>;
		status = "ok";
	};

	&ncp3902_channel_switch {
		gpio_chgsw_en = <&gpio21 2 0>;
		status = "ok";
	};
	&huawei_charger {
		pd_support = <1>;
		support_usb_nonstandard_ico = <1>;
		support_standard_ico = <0>;
		ico_all_the_way = <0>;
		water_check_enabled = <1>;
		fcp_vindpm = <8100>;
		charge_done_sleep_enabled;
		leak_current_check = <1>;
		powerdown_yellow_led = <0>;
		status = "ok";
	};
	&huawei_batt_info {
		status = "ok";
	};
	&ds28el15 {
		id-mask = /bits/ 8 <0xFF 0x00 0x00 0x00 0x00 0xF0 0xFF 0x00>;
		id-example = /bits/ 8 <0x97 0x00 0x00 0x00 0x00 0xD0 0x04 0x00>;
		status = "ok";
	};
	&gpio_pl061_ctrl {
		onewire-gpio = <&gpio28 4 0>;
		status = "ok";
	};
	&charging_core {
		status = "ok";
		iterm = <160>;
		iin_usb = <470>;
		ichg_usb = <500>;
		ichg_fcp = <3000>;
		iin_fcp = <1600>;
		ichg_ac = <2100>;
		iin_ac = <2000>;
		iin_wireless = <1300>;
		ichg_wireless = <3000>;
		inductance_para =
			"-32767", "15", "1900", "0",
			"15", "32767", "1900", "0";
	};
	&direct_charge_ps {
		boost_5v_support_scp_power = <1>;
		bst_ctrl_use_common_gpio = <1>;
		is_need_bst_ctrl = <1>;
		status = "ok";
	};
	&direct_charger {
		use_5A = <1>;
		volt_para =
			"4100", "5000", "4650",
			"4250", "4650", "2800",
			"4360", "2800", "1200";
		compensate_r = <20>;
		cc_cable_detect_enable = <1>;
		full_path_res_max = <160>;
		scp_work_on_charger = <1>;
		standard_cable_full_path_res_max = <200>;
		first_cc_stage_timer_in_min = <5>;
		stage_need_to_jump = "1";
		temp_para =
			"-32767", "10", "0",
			"10", "45", "5000",
			"45", "32767", "0";
		status = "ok";
	};

	&direct_charger_sc {
		use_8A = <1>;
		dc_volt_ratio = <2>;
		max_adaptor_vset = <10000>;
		init_adapter_vset = <8800>;
		vol_err_th = <500>;
		adaptor_leakage_current_th = <600>;
		vstep = <20>;
		max_dc_bat_vol = <4380>;
		max_current_for_none_standard_cable = <6000>;
		adaptor_antifake_check_enable = <1>;
		adaptor_antifake_key_index = <2>;
		volt_para =
			"4150", "8000", "6100",
			"4250", "6100", "5200",
			"4300", "5200", "4100",
			"4400", "4100", "2000";
		volt_para1 =
			"4200", "8000", "6100",
			"4330", "6100", "5200",
			"4350", "5200", "4100",
			"4400", "4100", "2000";
		volt_para2 =
			"4150", "8000", "6100",
			"4250", "6100", "5200",
			"4300", "5200", "4100",
			"4400", "4100", "2000";
		volt_para3 =
			"4200", "8000", "6100",
			"4250", "6100", "5200",
			"4350", "5200", "4100",
			"4400", "4100", "2000";
		bat_para =
			"atl", "10", "20", "volt_para",
			"atl", "20", "45", "volt_para1",
			"murata", "10", "20", "volt_para2",
			"murata", "20", "45", "volt_para3";
		compensate_r = <16>;
		cc_cable_detect_enable = <1>;
		full_path_res_max = <450>;
		scp_work_on_charger = <1>;
		standard_cable_full_path_res_max = <250>;
		first_cc_stage_timer_in_min = <5>;
		stage_need_to_jump = "1";
		temp_para =
			"-32767", "10", "0",
			"10", "45", "8000",
			"45", "32767", "0";
		resist_para =
			"0", "180", "6000",
			"180", "450", "4000";
		status = "ok";
	};

	&huawei_smpl {
		status = "ok";
	};

    &fastboot_pmic {
                   hisilicon,init-reg-num = <1>;
                   hisilicon,init-reg-addrs = <0x02E9>;
                   hisilicon,init-reg-vals  = <0x06>;
    };

	&vbat_ovp {
		status = "disabled";
	};

	&huawei_cpu_buck {
		status = "disabled";
	};

	&huawei_hi6422v200_pmu1 {
		status = "disabled";
	};

	&huawei_hi6422v200_pmu2 {
		status = "disabled";
	};

	&usb_short_circuit_protect {
		gpio_usb_short_circuit_protect = <&gpio16 6 0>;
		uscp_threshold_tusb = <50>;
		status = "ok";
	};

	&power_thermalzone {
		status = "ok";
		sensors{
			sensor0{
				sensor_name = "usb_port";
				ops_name = "hisi_adc";
				adc_channel = <3>;
				ntc_index = <1>;
			};
			sensor1{
				sensor_name = "charger1";
				ops_name = "bq25970";
				adc_channel = <0>;
				ntc_index = <0>;
			};
		};
	};

	&battery_temp_fitting {
		status = "disabled";
		btf_tz_type_para = "board_thermal", "usb_port", "rfboard", "wireless", "constant";
		btf_ichg_para = "0";
		btf_fitting_para =
			"-93", "434", "221", "480", "-564";
	};

	&soft_isc {
		fatal_isc_trigger_type = <1>;
		fatal_isc_trigger_condition = <50000 3 920001078 100000 3 920001077>;
        };

	&boost_5v {
		boost_5v_use_common_pmic = <1>;
		status = "ok";
	};

	&water_check {
		need_pinctrl_config = <0>;
		gpio_sim = <&gpio6 3 0>;
		gpio_key = <&gpio6 4 0>;
		/*check_type, gpio_name, irq_no, multiple_handle, dmd_offset, prompt, action*/
		water_check_para =
				"1","sim","-1","1","2","0","0",
				"1","key","-1","1","3","0","0",
				"2","null","-1","0","4","0","1";
		status = "ok";
	};
	&spmi {
		pmic@0 {
			gpios = <&gpio22 1 0>;
		};
	};
	&huawei_usb {
		maximum-speed = "super-speed";
		usb_phy_ldo_33v-supply = <&ldo23>;
		status = "ok";
	};

	&fastboot {
		compatible = "hisilicon,fastboot";
		i2c3-pin = <0>;
		gpio-keyup = <213>;
		gpio-keydown = <210>;
		uart-board-type = <1>;
		/*UDP_TYPE 0,PRODUCT 1,FPGA 2,EMU 3*/
		lpm3-board-type = <0>;
		jtagtosd-board-type = <2>;
		motor-vib_type = <0>;

		i2c-select = <1>;
		i2c-sel0-gpio = <164>;
		i2c-sel1-gpio = <165>;
		i2c-sel0-val = <0>;
		i2c-sel1-val = <0>;
	};

	&pmu {
		compatible = "hisilicon,pmu";
		reg = <0x00 0xFFF34000 0x00 0x1000>;
		status = "ok";
	};

	&hisi_ipc {

	};
	&hisi_ao_ipc {

	};

        &hisi_sysctrl {
                compatible = "hisilicon,sysctrl";
                reg = <0x0 0xfff0a000 0x0 0x1000>;
                status = "ok";
        };

        &hisi_pctrl {
                compatible = "hisilicon,pctrl";
                reg = <0x0 0xe8a09000 0x0 0x1000>;
                status = "ok";
        };

        &hisi_crgctrl {
                compatible = "hisilicon,crgctrl";
                reg = <0x0 0xfff35000 0x0 0x1000>;
                status = "ok";
        };

	&hisi_iomcuctrl {
                compatible = "hisilicon,iomcuctrl";
                reg = <0x0 0xFFD7e000 0x0 0x1000>;
                status = "ok";
        };

        &hisi_pmctrl {
                compatible = "hisilicon,pmctrl";
                reg = <0x0 0xfff31000 0x0 0x1000>;
                status = "ok";
        };

        &hisi_mmc1_sysctrl {
                compatible = "hisilicon,mmc1_sysctrl";
                reg = <0x0 0xfc186000 0x0 0x1000>;
                status = "ok";
        };

        &hisi_media1ctrl {
                compatible = "hisilicon,media1ctrl";
                reg = <0x0 0xE87FF000 0x0 0x1000>;
                status = "ok";
        };

        &hisi_media2ctrl {
                compatible = "hisilicon,media2ctrl";
                reg = <0x0 0xE8900000 0x0 0x1000>;
                status = "ok";
        };
	&kirin_pcie_rc {
		/* LTR latency param comes from EP: BCM43596 -- 0x10031003 */
		ep_ltr_latency = <0x10031003>;

		/* T-poweron comes from EP: BCM43596 -- 0x10031003 */
		ep_l1ss_ctrl2 = <0x61>;

		/* the lower_16(l1ss_ctrl1) 0x370F needed by RC and must be set; the upper_16 comes from EP*/
		l1ss_ctrl1 = <0x4004370F>;

		/* Delay time come from BCM43596 powerup sequence */
		t_ref2perst = <21000 23000>;
		t_perst2access = <7000 8000>;
		t_perst2rst = <10000 11000>;
	};


	&kirin_pcie_ep {
	};

	&hisi_axierr {
	        compatible = "hisi,hi3xxx-axi";
	        interrupts = <0 23 4>, <0 1 4>;
	        status = "ok";
        };

    &hisi_reset {
            compatible = "hisilicon,hi3xxx-reset";
            status = "ok";
        };

	&peripherals {
		compatible = "simple-bus";
		#address-cells = <1>;
		#size-cells = <1>;
		ranges = <0x0 0x00000000 0x0 0xffffffff>;

		clk6250khz {
			compatible = "fixed-clock";
			#clock-cells = <0>;
			clock-frequency = <6297600>;
			clock-output-names = "clk6250khz";
		};
/*
		clk4800khz {
			compatible = "fixed-clock";
			#clock-cells = <0>;
			clock-frequency = <32768>;
			clock-output-names = "clk4800khz";
		};
*/

		dma@fdf30000 {
			status = "ok";
		};
	};

	&maxim_ioctl {
		compatible = "huawei,maxim_ioctl";
		status = "ok";
	};

	&nve_uartctl {
		compatible = "hisilicon,hisi-uartctl";
		uartctl = "0000060F0F0F0F0F0F0F0F0F0F";
	};
	&amba {
		#address-cells = <2>;
		#size-cells = <2>;
		compatible = "arm,amba-bus";
		interrupt-parent = <&gic>;
		ranges;

		/*rtc0: rtc@FFF04000 {
				compatible = "arm,rtc-pl031", "arm,primecell";
				reg = <0xfff04000 0x1000>;
				interrupts = <0 46 0x4>;
				clocks = <&pclk>;
				clock-names = "apb_pclk";
				status = "ok";
		};*/

		/* rtc@FFF05000 {
				compatible = "arm,rtc-pl031", "arm,primecell";
				reg = <0xfff05000 0x1000>;
				interrupts = <0 47 0x4>;
				clocks = <&pclk>;
				clock-names = "apb_pclk";
				status = "ok";
		};*/


                watchdog@ffd7c000{
                        compatible = "hisilicon,iomcu-watchdog";
                        reg = <0x0 0xFFD7C000 0x0 0x1000>;
                        status = "ok";
                };

		/*wdt1@e8a07000 {
			compatible = "arm,sp805", "arm,primecell";
			reg = <0x0 0xe8a07000 0x0 0x1000>;
			interrupts = <0 45 4>;
			clocks = <&pclk_gate_wd0 &pclk>;
			clock-names = "pclk_wd0", "apb_pclk";
		};*/

		uart@fdf02000 {
			status = "ok";
		};

		uart@fdf00000 {
			status = "disabled";
		};

		uart@fdf03000 {
			status = "ok";
		};

		uart@ffd74000 {
			status = "disabled";
		};

		uart@fdf01000 {
			status = "ok";
		};

		uart@fdf05000 {
			status = "ok";
		};

		uart@fff32000 {
			status = "ok";
		};

		dx_cc63p@fdf0e000 {
			compatible = "dx,cc63p";
			reg = <0x0 0xfdf0e000 0x0 0x1000>;
			interrupt-parent = <&gic>;
			interrupts = <0 135 4>;
			status = "ok";
		};

		spi@ffd70000 {
			status = "disabled";

			spi_dev0@0 {
					compatible = "spi_dev0";
					spi-max-frequency = <100000>;
					reg = <0>;
					pl022,com-mode = <0>;
					pl022,interface = <0>;
					pl022,rx-level-trig = <3>;
					pl022,tx-level-trig = <3>;
					pl022,ctrl-len = <7>;
					pl022,wait-state = <0>;
					pl022,duplex = <0>;
					pl022,slave-tx-disable = <0>;
			};

			spi_dev1@1 {
					compatible = "spi_dev1";
					spi-max-frequency = <13000000>;
					reg = <1>;
					pl022,com-mode = <1>;
					pl022,interface = <0>;
					pl022,rx-level-trig = <3>;
					pl022,tx-level-trig = <3>;
					pl022,ctrl-len = <7>;
					pl022,wait-state = <0>;
					pl022,duplex = <0>;
					pl022,slave-tx-disable = <0>;
			};

			spi_dev2@2 {
					compatible = "spi_dev2";
					spi-max-frequency = <13000000>;
					reg = <2>;
					pl022,com-mode = <2>;
					pl022,interface = <0>;
					pl022,rx-level-trig = <3>;
					pl022,tx-level-trig = <3>;
					pl022,ctrl-len = <7>;
					pl022,wait-state = <0>;
					pl022,duplex = <0>;
					pl022,slave-tx-disable = <0>;
			};

			spi_dev3@3 {
					compatible = "spi_dev3";
					spi-max-frequency = <13000000>;
					reg = <3>;
					pl022,com-mode = <0>;
					pl022,interface = <0>;
					pl022,rx-level-trig = <3>;
					pl022,tx-level-trig = <3>;
					pl022,ctrl-len = <7>;
					pl022,wait-state = <0>;
					pl022,duplex = <0>;
					pl022,slave-tx-disable = <0>;
			};
		};

		spi@fdf08000 {
			status = "disabled";

			spi_dev10@10 {
					compatible = "spi_dev10";
					spi-max-frequency = <100000>;
					reg = <0>;
					pl022,com-mode = <0>;
					pl022,interface = <0>;
					pl022,rx-level-trig = <3>;
					pl022,tx-level-trig = <3>;
					pl022,ctrl-len = <7>;
					pl022,wait-state = <0>;
					pl022,duplex = <0>;
					pl022,slave-tx-disable = <0>;
			};
		};

		spi@fff2a000 {
			status = "ok";
			clock-rate = <0 83000000>;
			pinctrl-names = "default", "idle";
			pinctrl-0 = <&gpio233_pmx_func &gpio234_pmx_func &gpio235_pmx_func &gpio236_pmx_func &gpio237_pmx_func &gpio233_cfg_func &gpio234_cfg_func &gpio235_cfg_func &gpio236_cfg_func &gpio237_cfg_func>;
			pinctrl-1 = <&gpio233_pmx_idle &gpio234_pmx_idle &gpio235_pmx_idle &gpio236_pmx_idle &gpio237_pmx_idle &gpio233_cfg_idle &gpio234_cfg_idle &gpio235_cfg_idle &gpio236_cfg_idle &gpio237_cfg_idle>;
			ice40_spi@0 {
				compatible = "ice40,spi";
				spi-max-frequency = <10000000>;
				spi-bus-id = <3>;
				reg = <0>;
				pl022,com-mode = <2>;
				pl022,interface = <0>;
				pl022,rx-level-trig = <3>;
				pl022,tx-level-trig = <3>;
				pl022,ctrl-len = <7>;
				pl022,wait-state = <0>;
				pl022,duplex = <0>;
				pl022,slave-tx-disable = <0>;
				clocks = <&clk_gate_out1>;
				clock-names = "clk_out1";
				huawei,mclk = <9600000>;
				/*chip-type 1:NULL  2:Al6045  4:Al6010*/
				ice40_spi,chip_type = <2>;
				ice40_spi,irq_gpio = <&gpio28 0 0>;
				ice40_spi,cs_gpio = <&gpio29 5 0>;
				ice40_spi,rst_gpio = <&gpio28 7 0>;
				ice40_spi,en_gpio = <&gpio23 1 0>;
				boot_reset_hi_delay_ms = <1>;
				boot_reset_low_delay_ms = <0>;
				boot_reset_after_delay_ms = <0>;
				resume_reset_after_delay_ms = <1>;
				suspend_reset_after_delay_ms = <0>;
				spi_sync_cs_hi_delay_ns = <200>;
				spi_sync_cs_low_delay_ns = <10>;
			};
			m25p80_spi@1 {
				compatible = "m25p80,spi";
				spi-max-frequency = <25000000>;
				spi-bus-id = <3>;
				reg = <1>;
				pl022,com-mode = <0>;
				pl022,interface = <0>;
				pl022,rx-level-trig = <3>;
				pl022,tx-level-trig = <3>;
				pl022,ctrl-len = <7>;
				pl022,wait-state = <0>;
				pl022,duplex = <0>;
				pl022,slave-tx-disable = <0>;
				m25p_spi,chip_type = <2>;
				m25p_spi,cs_gpio = <&gpio29 4 0>;
			};
		};
		/* I2C0 ~ I2C4 */
		i2c@FFD71000 {
			status = "disabled";
		};

		i2c@FFD72000 {
			status = "disabled";
		};

		i2c@FDF0C000 {
			status = "ok";

			fusb30x_kirin980_i2c3@22 {
				status = "ok";
				fairchild,int_n = <&gpio33 3 0>;
			};
			rt1711_kirin980_i2c3@4e {
				status = "ok";
				rt1711,irq_pin = <&gpio33 3 0>;
			};
			tusb422_kirin980_i2c3@20 {
				status = "ok";
				ti,alert-gpio = <&gpio33 3 0>;
			};
			rt9748: rt9748@67 {
				compatible = "rt9748";
				loadswitch_int = <&gpio27 4 0>;
				loadswitch_en = <&gpio31 1 0>;
				sense_r_mohm = <20>;
				reg = <0x67>;
				status = "ok";
			};
			bq25970: bq25970@65 {
				compatible = "bq25970";
				switchcap_int = <&gpio27 5 0>;
				reg = <0x65>;
				tsbus_high_r_kohm = <100>;
				tsbus_low_r_kohm = <100>;
				switching_frequency = <675>;
				status = "ok";
			};
		};

		i2c@FDF0D000 {
			status = "ok";

			smartpa@34{
				compatible = "huawei,smartpakit_i2c";
				reg = <0x34>;
				/* 0 MAXIM, 1 NXP, 2 TI, 3 OTHER, 4:huawei customize */
				chip_vendor = <4>;
				/* refer to smartpakit.out_device prop */
				chip_id = <0>;
				chip_model = "tfa9874o";
				status = "ok";

				/* reg_ctl node: a node contains three data<addr value ctl_type>
				* ctl_type: 0 read reg(default), 1 write reg, 2 only time delay
				* value:
				*     read:  reg number(num >= 1)
				*     write: reg value
				*     delay: time delay
				* time delay unit: msecs */
				version_regs = <0x03 1 0>;
				dump_regs = <0 256 0>;

				hw_reset {
					gpio_reset = <&gpio30 5 0>;
					/* gpio_state node: a node contains two data<state delay>
					* time delay unit: msecs */
					ctl_sequence = <1 1 0 1>;
				};
				irq_handler {
					gpio_irq = <&gpio25 1 0>;
					/* 0x0 IRQF_TRIGGER_NONE, 0x1 IRQF_TRIGGER_RISING, 0x2 IRQF_TRIGGER_FALLING, 0x4 IRQF_TRIGGER_HIGH, 0x8 IRQF_TRIGGER_LOW*/
					irq_flags = <2>;
					/* whether or not need reset chip*/
					need_reset;
					rw_sequence = <
						0x10 1 0
						0x11 1 0
						0x13 1 0
						0x14 1 0
						0x40 1 0
						0x41 1 0
						0x42 1 0
					>;
				};

				regmap_cfg {
					reg_bits = <8>;
					val_bits = <16>;
					/* 0 REGCACHE_NONE, 1 REGCACHE_RBTREE, 2 REGCACHE_COMPRESSED, 3 REGCACHE_FLAT */
					cache_type = <0>;
					max_register = <0xff>;
					reg_defaults = <
						0x00 0x1801
						0x01 0x0014
					>;
				};
			};

			smartpa@36{
				compatible = "huawei,smartpakit_i2c";
				reg = <0x36>;
				/* 0 MAXIM, 1 NXP, 2 TI, 3 OTHER, 4:huawei customize */
				chip_vendor = <4>;
				/* refer to smartpakit.out_device prop */
				chip_id = <1>;
				chip_model = "tfa9874o";
				status = "ok";

				/* reg_ctl node: a node contains three data<addr value ctl_type>
				* ctl_type: 0 read reg(default), 1 write reg, 2 only time delay
				* value:
				*     read:  reg number(num >= 1)
				*     write: reg value
				*     delay: time delay
				* time delay unit: msecs */
				version_regs = <0x03 1 0>;
				dump_regs = <0 256 0>;

				hw_reset {
					gpio_reset = <&gpio32 1 0>;
					/* gpio_state node: a node contains two data<state delay>
					* time delay unit: msecs */
					ctl_sequence = <1 1 0 1>;
				};

				irq_handler {
					gpio_irq = <&gpio30 2 0>;
					/* 0x0 IRQF_TRIGGER_NONE, 0x1 IRQF_TRIGGER_RISING, 0x2 IRQF_TRIGGER_FALLING, 0x4 IRQF_TRIGGER_HIGH, 0x8 IRQF_TRIGGER_LOW*/
					irq_flags = <2>;
					/* whether or not need reset chip*/
					need_reset;
					rw_sequence = <
						0x10 1 0
						0x11 1 0
						0x13 1 0
						0x14 1 0
						0x40 1 0
						0x41 1 0
						0x42 1 0
					>;
				};

				regmap_cfg {
					reg_bits = <8>;
					val_bits = <16>;
					/* 0 REGCACHE_NONE, 1 REGCACHE_RBTREE, 2 REGCACHE_COMPRESSED, 3 REGCACHE_FLAT */
					cache_type = <0>;
					max_register = <0xff>;
					reg_defaults = <
						0x00 0x1801
						0x01 0x0014
					>;
				};
			};

			smartpa@50{
				compatible = "huawei,smartpakit_i2c";
				reg = <0x50>;
				/* 0 MAXIM, 1 NXP, 2 TI, 3 OTHER, 4:huawei customize */
				chip_vendor = <4>;
				/* refer to smartpakit.out_device prop */
				chip_id = <0>;
				chip_model = "cs35l36o";
				status = "ok";

				/* reg_ctl node: a node contains three data<addr value ctl_type>
				* ctl_type: 0 read reg(default), 1 write reg, 2 only time delay
				* value:
				*     read:  reg number(num >= 1)
				*     write: reg value
				*     delay: time delay
				* time delay unit: msecs */
				version_regs = <0x0 1 0>;
				dump_regs = <
					0x000000 1          0
					0x000008 1          0
					0x002014 0x21       0
					0x002400 1          0
					0x002c04 0xd        0
					0x003800 0x31       0
					0x004004 1          0
					0x004220 1          0
					0x004300 1          0
					0x004800 0x3d       0
					0x004C00 1          0
					0x004C20 0x15       0
					0x006000 1          0
					0x006404 0x11       0
					0x006450 1          0
					0x006800 0x9        0
					0x006C04 1          0
					0xd00000 0x4d       0
					0xe02800 1          0>;

				hw_reset {
					gpio_reset = <&gpio30 5 0>;
					/* gpio_state node: a node contains two data<state delay>
					* time delay unit: msecs */
					ctl_sequence = <1 1 0 1>;
				};

				irq_handler {
					gpio_irq = <&gpio25 1 0>;
					/* 0x0 IRQF_TRIGGER_NONE, 0x1 IRQF_TRIGGER_RISING, 0x2 IRQF_TRIGGER_FALLING, 0x4 IRQF_TRIGGER_HIGH, 0x8 IRQF_TRIGGER_LOW*/
					irq_flags = <2>;
					/* whether or not need reset chip*/
					need_reset;
					rw_sequence = <
						0xd00020 1          0
						0xd00024 1          0
						0xd00028 1          0
						0xd0002c 1          0
						0xd00000 0xffffffff 1
						0xd00004 0xffffffff 1
						0xd00008 0xffffffff 1
						0xd0000c 0xffffffff 1
					>;
				};

				regmap_cfg {
					reg_bits = <32>;
					val_bits = <32>;
					/* 0 REGCACHE_NONE, 1 REGCACHE_RBTREE, 2 REGCACHE_COMPRESSED, 3 REGCACHE_FLAT */
					cache_type = <0>;
					max_register = <0xe0ffff>;
				};
			};

			smartpa@52{
				compatible = "huawei,smartpakit_i2c";
				reg = <0x52>;
				/* 0 MAXIM, 1 NXP, 2 TI, 3 OTHER, 4:huawei customize */
				chip_vendor = <4>;
				/* refer to smartpakit.out_device prop */
				chip_id = <1>;
				chip_model = "cs35l36o";
				status = "ok";

				/* reg_ctl node: a node contains three data<addr value ctl_type>
				* ctl_type: 0 read reg(default), 1 write reg, 2 only time delay
				* value:
				*     read:  reg number(num >= 1)
				*     write: reg value
				*     delay: time delay
				* time delay unit: msecs */
				version_regs = <0x0 1 0>;
				dump_regs = <
					0x000000 1          0
					0x000008 1          0
					0x002014 0x21       0
					0x002400 1          0
					0x002c04 0xd        0
					0x003800 0x31       0
					0x004004 1          0
					0x004220 1          0
					0x004300 1          0
					0x004800 0x3d       0
					0x004C00 1          0
					0x004C20 0x15       0
					0x006000 1          0
					0x006404 0x11       0
					0x006450 1          0
					0x006800 0x9        0
					0x006C04 1          0
					0xd00000 0x4d       0
					0xe02800 1          0>;

				hw_reset {
					gpio_reset = <&gpio32 1 0>;
					/* gpio_state node: a node contains two data<state delay>
					* time delay unit: msecs */
					ctl_sequence = <1 1 0 1>;
				};

				irq_handler {
					gpio_irq = <&gpio30 2 0>;
					/* 0x0 IRQF_TRIGGER_NONE, 0x1 IRQF_TRIGGER_RISING, 0x2 IRQF_TRIGGER_FALLING, 0x4 IRQF_TRIGGER_HIGH, 0x8 IRQF_TRIGGER_LOW*/
					irq_flags = <2>;
					/* whether or not need reset chip*/
					need_reset;
					rw_sequence = <
						0xd00020 1          0
						0xd00024 1          0
						0xd00028 1          0
						0xd0002c 1          0
						0xd00000 0xffffffff 1
						0xd00004 0xffffffff 1
						0xd00008 0xffffffff 1
						0xd0000c 0xffffffff 1
					>;
				};

				regmap_cfg {
					reg_bits = <32>;
					val_bits = <32>;
					/* 0 REGCACHE_NONE, 1 REGCACHE_RBTREE, 2 REGCACHE_COMPRESSED, 3 REGCACHE_FLAT */
					cache_type = <0>;
					max_register = <0xe0ffff>;
				};
			};

			smartpa@4C {
				compatible = "huawei,smartpakit_i2c";
				reg = <0x4C>;
				/* 0 MAXIM, 1 NXP, 2 TI, 3 OTHER, 4:huawei customize */
				chip_vendor = <4>;
				/* refer to smartpakit.out_device prop */
				chip_id = <0>;
				chip_model = "tas2562";
				/* maybe trigger one irq after some chip reset, ext. tas2560
				* debounce wait time unit: msecs */
				reset_debounce_wait_time = <100>;
				status = "ok";

				/* reg_ctl node: a node contains three data<addr value ctl_type>
				* ctl_type: 0 read reg(default), 1 write reg, 2 only time delay
				* value:
				*     read:  reg number(num >= 1)
				*     write: reg value
				*     delay: time delay
				* time delay unit: msecs */
				version_regs = <
					0	0	1
					125	1	0
					>;
				dump_regs = <
					0	0	1
					0	128	0
					0	50	1
					0	128	0
					0	51	1
					0	128	0
					0	52	1
					0	128	0
				>;
				hw_reset {
					gpio_reset = <&gpio30 5 0>;
					/* gpio_state node: a node contains two data<state delay>
					* time delay unit: msecs */
					ctl_sequence = <0 3 1 2>;
				};

				irq_handler {
					gpio_irq = <&gpio25 1 0>;
					/* 0x0 IRQF_TRIGGER_NONE, 0x1 IRQF_TRIGGER_RISING, 0x2 IRQF_TRIGGER_FALLING, 0x4 IRQF_TRIGGER_HIGH, 0x8 IRQF_TRIGGER_LOW*/
					irq_flags = <2>;
					/* whether or not need reset chip*/
					need_reset;
					rw_sequence = <
						0	20	2
						0	0	1
						26	1	0
						27	1	0
						31	1	0
						32	1	0
						36	1	0
						37	1	0
						2	1	0
						120	1	0
					>;
				};

				regmap_cfg {
					reg_bits = <8>;
					val_bits = <8>;
					/* 0 REGCACHE_NONE, 1 REGCACHE_RBTREE, 2 REGCACHE_COMPRESSED, 3 REGCACHE_FLAT */
					cache_type = <0>;
					max_register = <128>;
				};
			};

			smartpa@4E {
				compatible = "huawei,smartpakit_i2c";
				reg = <0x4E>;
				/* 0 MAXIM, 1 NXP, 2 TI, 3 OTHER, 4:huawei customize */
				chip_vendor = <4>;
				/* refer to smartpakit.out_device prop */
				chip_id = <1>;
				chip_model = "tas2562";
				/* maybe trigger one irq after some chip reset, ext. tas2560
				* debounce wait time unit: msecs */
				reset_debounce_wait_time = <100>;
				status = "ok";

				/* reg_ctl node: a node contains three data<addr value ctl_type>
				* ctl_type: 0 read reg(default), 1 write reg, 2 only time delay
				* value:
				*     read:  reg number(num >= 1)
				*     write: reg value
				*     delay: time delay
				* time delay unit: msecs */
				version_regs = <
					0	0	1
					125	1	0
					>;
				dump_regs = <
					0	0	1
					0	128	0
					0	50	1
					0	128	0
					0	51	1
					0	128	0
					0	52	1
					0	128	0
				>;
				hw_reset {
					gpio_reset = <&gpio32 1 0>;
					/* gpio_state node: a node contains two data<state delay>
					* time delay unit: msecs */
					ctl_sequence = <0 3 1 2>;
				};

				irq_handler {
					gpio_irq = <&gpio30 2 0>;
					/* 0x0 IRQF_TRIGGER_NONE, 0x1 IRQF_TRIGGER_RISING, 0x2 IRQF_TRIGGER_FALLING, 0x4 IRQF_TRIGGER_HIGH, 0x8 IRQF_TRIGGER_LOW*/
					irq_flags = <2>;
					/* whether or not need reset chip*/
					need_reset;
					rw_sequence = <
						0	20	2
						0	0	1
						26	1	0
						27	1	0
						31	1	0
						32	1	0
						36	1	0
						37	1	0
						2	1	0
						120	1	0
					>;
				};

				regmap_cfg {
					reg_bits = <8>;
					val_bits = <8>;
					/* 0 REGCACHE_NONE, 1 REGCACHE_RBTREE, 2 REGCACHE_COMPRESSED, 3 REGCACHE_FLAT */
					cache_type = <0>;
					max_register = <128>;
				};
			};

			nfc@28{
				status = "ok";
				reg = <0x28>;
				compatible = "hisilicon,pn547_nfc";
				nfc_on_type = "hi6421v700_pmic";
				nfc_brcm_conf_name = "libnfc-brcm.conf";
				nfc_nxp_name = "libnfc-nxp.conf";
				nfc_card_num = <0x2>;
				clk_status ="pmu_hi6421v700";
				pn547,dload = <&gpio31 2 0>;
				pn547,irq = <&gpio27 3 0>;
				pn547,ven = <>;
				pinctrl-1 = <&gpio250_pmx_idle &gpio219_pmx_idle>;
				pinctrl-0 = <&gpio250_pmx_func &gpio219_pmx_func>;
				pinctrl-names = "default","idle";
				clock-names = "clk_out0";
				clocks = <&clk_gate_out0>;
				nfc_chip_type = "pn80t";
				nfc_single_channel = "true";
				nfc_ese_type = "p61";
			};

			hw_lm3642@63{
				compatible = "huawei,lm3642";
				reg = <0x63>;
				huawei,flash-name = "lm3642";
				huawei,flash-index = <0>;
				huawei,flash-type = <0>;
				huawei,need-wakelock = <0>;
				huawei,slave-address = <0x63>;
				huawei,flash-pin = <013 999 999>;
				huawei,led-type = <0>; /* 1, dual tempature; 0, dual white */
				huawei,flash-chipid = <0x00>;
				huawei,flash_current = <7>;
				huawei,torch_current = <2>;
				status = "ok";
			};

			hw_mp3331@67{
				compatible = "huawei,mp3331";
				reg = <0x67>;
				huawei,flash-name = "mp3331";
				huawei,flash-index = <0>;
				huawei,flash-type = <0>;
				huawei,need-wakelock = <0>;
				huawei,slave-address = <0x67>;
				huawei,flash-pin = <013 999 999>;
				huawei,led-type = <0>;
				huawei,flash_current = <24>;
				huawei,torch_current = <5>;
				huawei,flash-chipid = <0x18>;
				status = "ok";
			};

			huawei,mp3336@27{
				compatible = "huawei,mp3336";
				reg = <0x27>;
				huawei,need-wakelock = <0>;
				huawei,flash-pin = <231 999 999>;
				huawei,led-type = <0>;
				huawei,flash-current = <0 18 0>;
				status = "ok";
			};

			huawei,vl53l0@29{
				compatible = "huawei,vl53l0_970";
				huawei,laser_name = "vl53l0_970";
				reg = <0x29>;
				product_name = "LAYA_LASER";
				/*avdd-supply = <&ldo34>;*/
				/*#huawei,ldo-names = "avdd";*/
				gpios = <&gpio4 3 0 &gpio30 1 0>;
				huawei,gpio-ctrl-types = "xsdn", "intr";
				/*pinctrl-names = "default", "idle";
				pinctrl-0 = <&gpio035_pmx_func &gpio035_cfg_func>;
				pinctrl-1 = <&gpio035_pmx_idle &gpio035_cfg_idle>;
				*/
				status = "ok";
			};

			rt5112@20 {
				compatible = "hisi,rt5112";
				reg = <0x20>;
				hisi,pmic_name = "rt5112";
				hisi,pmic_index = <0>;
				hisi,slave_address = <0x20>;
				hisi,pmic-pin = <75>;
				hisi,pmic-intr = <256>;
				fastboot_i2c_bus = <4>;
				fastboot_support = <1>;
				pinctrl-names = "default", "idle";
				pinctrl-0 = <&gpio256_pmx_func &gpio075_cfg_func &gpio256_cfg_func &gpio075_cfg_func>;
				pinctrl-1 = <&gpio256_pmx_idle &gpio075_cfg_idle &gpio256_cfg_idle &gpio075_cfg_idle>;
				status = "ok";
			};

			rohm_bh1749@38{
				status = "ok";
				reg = <0x38>;
				compatible = "rohm,bh1749";
			};

			ina321_0@40{
				status = "ok";
				reg = <0x40>;
				compatible = "huawei,ina231_0";
			};

			fan53880@35 {
				compatible = "hisi,fan53880";
				reg = <0x35>;
				hisi,pmic_name = "fan53880";
				hisi,pmic_index = <0>;
				hisi,slave_address = <0x35>;
				hisi,pmic-pin = <75>;
				hisi,pmic-intr = <256>;
				fastboot_i2c_bus = <4>;
				fastboot_support = <1>;
				pinctrl-names = "default", "idle";
				pinctrl-0 = <&gpio256_pmx_func &gpio075_cfg_func &gpio256_cfg_func &gpio075_cfg_func>;
				pinctrl-1 = <&gpio256_pmx_idle &gpio075_cfg_idle &gpio256_cfg_idle &gpio075_cfg_idle>;
				status = "ok";
			};

		};

		i2c@FDF0A000 {
			status = "ok";

			hi6523_charger_i2c6@6B{
				status = "ok";
				fcp_support = <1>;
				scp_support = <1>;
				vclamp = <150>;
				bat_comp = <30>;
				gpio_int = <&gpio27 2 0>;
				ico_current_mode = <0>;
			};
			wireless_idtp9221_i2c6@61 {
				gpio_int = <&gpio28 5 0>;
				gpio_en = <&gpio2 0 0>;
				gpio_sleep_en = <&gpio1 1 0>;
				rx_fod_5v =  <0x14c0 0x109c 0x1096 0x1096 0x1098 0x1098 0x1414 0>;
				rx_fod_9v =  <0x2d96 0x2d88 0x2888 0x2886 0x2387 0x2387 0 0>;
				rx_fod_12v = <0x2d96 0x2d88 0x2888 0x2886 0x1986 0x1986 0 0>;
				latest_otp_version = "0x88 0x66 0x03 0x0f";
				tx_fod_th_5v = <1500>;
				status = "ok";
			};
		};

		i2c@FDF0B000 {
			status = "ok";
		};
	};
	/* end amba */

	/*ts kit*/
	&ts_kit {
		status = "ok";
		compatible = "huawei,ts_kit";
		bus_type = "i2c";
		product = "laya";
		bus_id = <7>;
		has_virtualkey = <0>;
		fpga_flag = <0>;
		irq_gpio = <&gpio26 4 0>;
		reset_gpio = <&gpio1 7 0>;
		aft_enable = <1>;
		drv_stop_width = <0>;
		lcd_width = <0>;
		lcd_height = <0>;
		need_i2c_hwlock = <1>;

		synaptics: touchscreen@70 {
			compatible = "synaptics";
			need_wd_check_status = <0>;
			x_max = <1440>;
			y_max = <3120>;
			x_max_mt = <1440>;
			y_max_mt = <3120>;
			irq_config = <0>;
			producer = "BOE";
			projectid_len = <10>;
			ic_type = <6>;
			is_multi_protocal = <2>;
			delay_for_fw_update = <1>;
			vci_gpio_type = <0>;
			vci_regulator_type = <1>;
			vddio_gpio_type = <0>;
			vddio_regulator_type = <1>;
			slave_address = <0x70>;
			unite_cap_test_interface =<1>;
			pinctrl-1 = <&gpio212_cfg_idle>;
			pinctrl-0 = <&gpio212_cfg_func>;
			pinctrl-names = "default", "idle";

			ts-kit-iovdd-type = <1>; /* 0-unused 1-ldo 2-gpio */
			// ts-kit-iovdd-gpio = <>;
			ts-kit-iovdd-supply = <&ldo29>;
			ts-kit-iovdd-value = <1850000>;

			ts-kit-vcc-type = <1>; /* 0-unused 1-ldo 2-gpio */
			// ts-kit-vcc-gpio = <>;
			ts-kit-vcc-supply = <&ldo17>;
			ts-kit-vcc-value = <3300000>;

			synaptics3718_fw_updata_flag = <1>;
			synaptics3718_Tp_Pressure_flag = <1>;
			vddio_default_on = <0>;
			rawdata_newformatflag = <1>;
			boot_detection_addr = <0x405>;
			boot_detection_threshold = <0x0018>;
			boot_detection_flag = <1>;
			need_disable_hover = <1>;
			hover_switch_addr = <0x20>;
			hover_switch_bit = <0>;
			roi_supported = <1>;
			holster_supported = <1>;
			glove_supported = <1>;
			diff_data_report_supported = <1>;
			diff_data_len = <60>;
			diff_data_control_addr = <0x403>;
			LAYA171300{
				producer = "BOE";
				compatible = "synaptics-LAYA171300";
				supported_func_indicater = <0x10>;
				roi_data_addr = <0x0404>;
				roi_control_bit = <0>;
				roi_control_addr = <0x0407>;
				glove_switch_bit = <0>;
				glove_switch_addr = <0x0022>;
				holster_switch_bit = <1>;
				holster_switch_addr = <0x0022>;
				touch_game_reg = <0x0412>;
				game_control_bit = <0x07>;
				//charger_supported = <0>;
				//charger_switch_bit = <5>;
				//charger_switch_addr = <0x000D>;
				screenoff_status_support = <1>;
				screenoff_status_reg = <0x411>;
				screenoff_status_switch = <2>;
				sensitivity_adjust_support = <1>;
				sensitivity_adjust_reg = <0x001C>;
				//adv_width and is_multi_protocal is a couple for new_wx_wy fuk
				adv_width = "000";
				//raw_data_limit = "9999", "-9999", "9999", "-9999", "9999", "-9999", "9999", "-9999";
				capacitance_test_config = <1>;
				report_rate_test = <0>;
				ic_type = <6>;
				raw_test_type = <0>;
				rawdata_arrange_type = <2>;
				tp_test_type = "Normalize_type:judge_different_reslut:33";//33 for 0f&5f
				noise_state_reg = <0x0108>;
				//ic_status_reg = <0x0006>;
				touch_switch_flag = <2>;
				touch_switch_reg = <0x000D>;
				//touch switch bit = <2> write code to not changed
				touch_switch_hold_off_reg = <0x0011>;
				test_enhance_raw_data_capacitance = <0>;
				huawei,test_capacitance_via_csvfile = <1>;
				//csv file at /product mark 1 at /odm mark 2
				huawei,csvfile_use_product_system = <2>;
				huawei,trx_delta_test_support = <1>;
				self_cap_test = <1>;
				huawei,support_ext_trex_short_test = <1>;
				huawei,support_forcekey_cap_value_test = <1>;
				huawei,ext_trex_short_test_wait_report_delay_flag = <1>;
				huawei,support_2dbarcode_info = <1>;
				huawei,support_gammadata_in_tp = <1>;
				huawei,read_2dbarcode_oem_type = <0>;//0 for standard type
			};
			LAYA171000{
				producer = "LG";
				compatible = "synaptics-LAYA171000";
				supported_func_indicater = <0x10>;
				roi_data_addr = <0x0404>;
				roi_control_bit = <0>;
				roi_control_addr = <0x0407>;
				glove_switch_bit = <0>;
				glove_switch_addr = <0x0022>;
				holster_switch_bit = <1>;
				holster_switch_addr = <0x0022>;
				touch_game_reg = <0x0412>;
				game_control_bit = <0x07>;
				//charger_supported = <0>;
				//charger_switch_bit = <5>;
				//charger_switch_addr = <0x000D>;
				screenoff_status_support = <1>;
				screenoff_status_reg = <0x411>;
				screenoff_status_switch = <2>;
				sensitivity_adjust_support = <1>;
				sensitivity_adjust_reg = <0x001C>;
				//adv_width and is_multi_protocal is a couple for new_wx_wy fuk
				adv_width = "000";
				//raw_data_limit = "9999", "-9999", "9999", "-9999", "9999", "-9999", "9999", "-9999";
				capacitance_test_config = <1>;
				report_rate_test = <0>;
				ic_type = <6>;
				raw_test_type = <0>;
				rawdata_arrange_type = <2>;
				tp_test_type = "Normalize_type:judge_different_reslut:33";//33 for 0f&5f
				noise_state_reg = <0x0108>;
				//ic_status_reg = <0x0006>;
				touch_switch_flag = <2>;
				touch_switch_reg = <0x000D>;
				//touch switch bit = <2> write code to not changed
				touch_switch_hold_off_reg = <0x0011>;
				test_enhance_raw_data_capacitance = <0>;
				huawei,test_capacitance_via_csvfile = <1>;
				//csv file at /product mark 1 at /odm mark 2
				huawei,csvfile_use_product_system = <2>;
				huawei,trx_delta_test_support = <1>;
				self_cap_test = <1>;
				huawei,support_ext_trex_short_test = <1>;
				huawei,support_forcekey_cap_value_test = <1>;
				huawei,ext_trex_short_test_wait_report_delay_flag = <1>;
				huawei,support_2dbarcode_info = <1>;
				huawei,read_2dbarcode_oem_type = <1>;
			};
			LAYA171010{
				producer = "LG";
				compatible = "synaptics-LAYA171010";
				supported_func_indicater = <0x10>;
				roi_data_addr = <0x0404>;
				roi_control_bit = <0>;
				roi_control_addr = <0x0407>;
				glove_switch_bit = <0>;
				glove_switch_addr = <0x0022>;
				holster_switch_bit = <1>;
				holster_switch_addr = <0x0022>;
				touch_game_reg = <0x0412>;
				game_control_bit = <0x07>;
				//charger_supported = <0>;
				//charger_switch_bit = <5>;
				//charger_switch_addr = <0x000D>;
				screenoff_status_support = <1>;
				screenoff_status_reg = <0x411>;
				screenoff_status_switch = <2>;
				sensitivity_adjust_support = <1>;
				sensitivity_adjust_reg = <0x001C>;
				//adv_width and is_multi_protocal is a couple for new_wx_wy fuk
				adv_width = "000";
				//raw_data_limit = "9999", "-9999", "9999", "-9999", "9999", "-9999", "9999", "-9999";
				capacitance_test_config = <1>;
				report_rate_test = <0>;
				ic_type = <6>;
				raw_test_type = <0>;
				rawdata_arrange_type = <2>;
				tp_test_type = "Normalize_type:judge_different_reslut:33";//33 for 0f&5f
				noise_state_reg = <0x0108>;
				//ic_status_reg = <0x0006>;
				touch_switch_flag = <2>;
				touch_switch_reg = <0x000D>;
				//touch switch bit = <2> write code to not changed
				touch_switch_hold_off_reg = <0x0011>;
				test_enhance_raw_data_capacitance = <0>;
				huawei,test_capacitance_via_csvfile = <1>;
				//csv file at /product mark 1 at /odm mark 2
				huawei,csvfile_use_product_system = <2>;
				huawei,trx_delta_test_support = <1>;
				self_cap_test = <1>;
				huawei,support_ext_trex_short_test = <1>;
				huawei,support_forcekey_cap_value_test = <1>;
				huawei,ext_trex_short_test_wait_report_delay_flag = <1>;
				huawei,support_2dbarcode_info = <1>;
				huawei,read_2dbarcode_oem_type = <1>;
			};
			LAYA171020{
				producer = "LG";
				compatible = "synaptics-LAYA171020";
				supported_func_indicater = <0x10>;
				roi_data_addr = <0x0404>;
				roi_control_bit = <0>;
				roi_control_addr = <0x0407>;
				glove_switch_bit = <0>;
				glove_switch_addr = <0x0022>;
				holster_switch_bit = <1>;
				holster_switch_addr = <0x0022>;
				touch_game_reg = <0x0412>;
				game_control_bit = <0x07>;
				//charger_supported = <0>;
				//charger_switch_bit = <5>;
				//charger_switch_addr = <0x000D>;
				screenoff_status_support = <1>;
				screenoff_status_reg = <0x411>;
				screenoff_status_switch = <2>;
				sensitivity_adjust_support = <1>;
				sensitivity_adjust_reg = <0x001C>;
				//adv_width and is_multi_protocal is a couple for new_wx_wy fuk
				adv_width = "000";
				//raw_data_limit = "9999", "-9999", "9999", "-9999", "9999", "-9999", "9999", "-9999";
				capacitance_test_config = <1>;
				report_rate_test = <0>;
				ic_type = <6>;
				raw_test_type = <0>;
				rawdata_arrange_type = <2>;
				tp_test_type = "Normalize_type:judge_different_reslut:33";//33 for 0f&5f
				noise_state_reg = <0x0108>;
				//ic_status_reg = <0x0006>;
				touch_switch_flag = <2>;
				touch_switch_reg = <0x000D>;
				//touch switch bit = <2> write code to not changed
				touch_switch_hold_off_reg = <0x0011>;
				test_enhance_raw_data_capacitance = <0>;
				huawei,test_capacitance_via_csvfile = <1>;
				//csv file at /product mark 1 at /odm mark 2
				huawei,csvfile_use_product_system = <2>;
				huawei,trx_delta_test_support = <1>;
				self_cap_test = <1>;
				huawei,support_ext_trex_short_test = <1>;
				huawei,support_forcekey_cap_value_test = <1>;
				huawei,ext_trex_short_test_wait_report_delay_flag = <1>;
				huawei,support_2dbarcode_info = <1>;
				huawei,read_2dbarcode_oem_type = <1>;
			};
		};
	};
	&hisi_gpio_key {
		compatible = "hisilicon,gpio-key";
		pinctrl-names = "default", "idle";
		pinctrl-0 = <&gpio213_cfg_func &gpio210_cfg_func>;
		pinctrl-1 = <&gpio213_cfg_idle &gpio210_cfg_idle>;
		gpio-keyup,gpio-irq = <&gpio26 5 0>;
		gpio-keydown,gpio-irq = <&gpio26 2 0>;
		status = "ok";
	};

	/* display start */
	&framebuffer {
		fpga_flag = <0>;
		//FB_ACCEL_KIRIN980
		dss_version_tag = <0x100>;
	};

	&panel_pwm {
		#address-cells = <2>;
		#size-cells = <2>;
		compatible = "hisilicon,hisipwm";
		reg = <0 0xE8A04000 0 0x1000>;
		clocks = <&clk_gate_pwm>;
		clock-names = "clk_pwm";
		//pinctrl-names = "default","idle";
		//pinctrl-0 = <&gpio182_pmx_func &gpio182_cfg_func>;
		//pinctrl-1 = <&gpio182_pmx_idle &gpio182_cfg_idle>;
		fpga_flag = <0>;
		status = "disabled";
	};

	&panel_blpwm {
		#address-cells = <2>;
		#size-cells = <2>;
		compatible = "hisilicon,hisiblpwm";
		reg = <0 0xFFD75000 0 0x1000>;
		clocks = <&clk_gate_blpwm>;
		clock-names = "clk_blpwm";
		pinctrl-names = "default","idle";
		pinctrl-0 = <&gpio185_pmx_func &gpio186_pmx_func &gpio185_cfg_func &gpio186_cfg_func>;
		pinctrl-1 = <&gpio185_pmx_idle &gpio186_pmx_idle &gpio185_cfg_idle &gpio186_cfg_idle>;
		fpga_flag = <0>;
		status = "ok";
	};

	&panel_lcdc_fake {
		#address-cells = <2>;
		#size-cells = <2>;
		compatible = "hisilicon,lcdc_fake_panel";
		fpga_flag = <0>;
		status = "disabled";
	};

	&panel_mipi_fake {
		#address-cells = <2>;
		#size-cells = <2>;
		compatible = "hisilicon,mipi_fake_panel";
		fpga_flag = <0>;
		status = "disabled";
	};

	&huawei_lcd_panel {
		compatible = "huawei,lcd_panel_type";
		product_id = <2000>;
		detect_type = <2>; /*0:DETECT_GPIOID  1:DETECT_CHIPID  2:DETECT_LCD_TYPE */
		gpio_id = <181 182>; /*ID0 ID1*/
		support_lcd_type = "LCD_KIT";
		lcd_panel_type = "auo_otm1901a_5p2_1080p_video";
	};

	&huawei_aod {
		compatible = "huawei,aod";
		memory-region = <&fastboot_cma>;
		x_res = <1440>;
		y_res = <3120>;
		bpp = <0x10>;
		status = "ok";
	};

	&huawei_lcd_config {
		compatible = "simple-bus";
	};

	&panel_lcd_cmi_NT35521 {
		#address-cells = <2>;
		#size-cells = <2>;
		compatible = "hisilicon,mipi_cmi_NT35521";
		//2:PWM,  4:BLPWM,  8:MIPI
		lcd-bl-type = <8>;
		//8:PANEL_MIPI_VIDEO,  16:PANEL_MIPI_CMD
		lcd-display-type = <8>;
		//0:IFBC_TYPE_NONE
		lcd-ifbc-type = <0>;
		//gpio_lcd_vcc1v8, gpio_lcd_p5v5_enable, gpio_lcd_n5v5_enable, gpio_lcd_reset, gpio_lcd_bl_enable
		gpios = <&gpio16 2 0>, <&gpio16 0 0>,  <&gpio20 7 0>, <&gpio17 3 0>, <&gpio20 6 0>;
		gpio_nums = <130 128 167 139 166>;
		//lcdio-vcc-supply = <&ldo4>;
		//lcdanalog-vcc-supply = <&ldo17>;
		//pinctrl-names = "default", "idle";
		//pinctrl-0 = <&gpio021_pmx_func &gpio021_cfg_func &gpio009_cfg_func &gpio010_cfg_func &gpio015_cfg_func &gpio020_cfg_func>;
		//pinctrl-1 = <&gpio021_pmx_idle &gpio021_cfg_idle &gpio009_cfg_idle &gpio010_cfg_idle &gpio015_cfg_idle &gpio020_cfg_idle>;
		fpga_flag = <1>;
		status = "disabled";
	};

	&panel_lcd_jdi_R63452 {
		#address-cells = <2>;
		#size-cells = <2>;
		compatible = "hisilicon,mipi_jdi_R63452";
		//2:PWM,  4:BLPWM,  8:MIPI
		lcd-bl-type = <4>;
		//8:PANEL_MIPI_VIDEO,  16:PANEL_MIPI_CMD ,32:PANEL_DUAL_MIPI_VIDEO, 64:PANEL_DUAL_MIPI_CMD
		lcd-display-type = <16>;
		//0:IFBC_TYPE_NONE 7:IFBC_TYPE_VESA3X_SINGLE 9:IFBC_TYPE_VESA3X_DUAL
		lcd-ifbc-type = <0>;
		//vsp, vsn, lcd_reset, bl_enable, ID0,ID1,TE0
		/*vsp, vsn, rst, bl_en, id0, id1, te0*/
		//GPIO_011, GPIO_008, GPIO_189, GPIO_010, GPIO_016, GPIO_009, GPIO_003
		gpios = <&gpio1 3 0>, <&gpio1 0 0>,  <&gpio23 5 0>, <&gpio1 2 0>, <&gpio2 0 0>, <&gpio1 1 0>, <&gpio0 3 0>;
		gpio_nums = <11 8 189 10 16 9 3>;
		lcdio-vcc-supply = <&ldo4>;
		lcdanalog-vcc-supply = <&ldo17>;
		pinctrl-names = "default", "idle";

		pinctrl-0 = <&gpio011_pmx_func &gpio008_pmx_func &gpio189_pmx_func &gpio010_pmx_func &gpio011_cfg_func &gpio008_cfg_func &gpio189_cfg_func &gpio010_cfg_func &gpio016_cfg_func &gpio009_cfg_func>;
		pinctrl-1 = <&gpio011_pmx_idle &gpio008_pmx_idle &gpio189_pmx_idle &gpio010_pmx_idle &gpio011_cfg_idle &gpio008_cfg_idle &gpio189_cfg_idle &gpio010_cfg_idle &gpio016_cfg_idle &gpio009_cfg_idle>;
		fpga_flag = <0>;
		status = "disabled";
	};
	&panel_lcd_lg_TD4322 {
		compatible = "hisilicon,mipi_lg_TD4322";
		//2:PWM,  4:BLPWM,  8:MIPI
		lcd-bl-type = <4>;
		//8:PANEL_MIPI_VIDEO,  16:PANEL_MIPI_CMD ,32:PANEL_DUAL_MIPI_VIDEO, 64:PANEL_DUAL_MIPI_CMD
		lcd-display-type = <16>;
		//0:IFBC_TYPE_NONE 7:IFBC_TYPE_VESA3X_SINGLE 9:IFBC_TYPE_VESA3X_DUAL
		lcd-ifbc-type = <0>;
		//vsp, vsn, lcd_reset, bl_enable, ID0,ID1,TE0
		/*vsp, vsn, rst, bl_en, id0, id1, te0*/
		//GPIO_011, GPIO_008, GPIO_189, GPIO_010, GPIO_016, GPIO_009, GPIO_003
		gpios = <&gpio1 3 0>, <&gpio1 0 0>,  <&gpio23 5 0>, <&gpio1 2 0>, <&gpio2 0 0>, <&gpio1 1 0>, <&gpio0 3 0>;
		gpio_nums = <11 8 189 10 16 9 3>;
		lcdio-vcc-supply = <&ldo4>;
		lcdanalog-vcc-supply = <&ldo17>;
		pinctrl-names = "default", "idle";

		pinctrl-0 = <&gpio011_pmx_func &gpio008_pmx_func &gpio189_pmx_func &gpio010_pmx_func &gpio011_cfg_func &gpio008_cfg_func &gpio189_cfg_func &gpio010_cfg_func &gpio016_cfg_func &gpio009_cfg_func>;
		pinctrl-1 = <&gpio011_pmx_idle &gpio008_pmx_idle &gpio189_pmx_idle &gpio010_pmx_idle &gpio011_cfg_idle &gpio008_cfg_idle &gpio189_cfg_idle &gpio010_cfg_idle &gpio016_cfg_idle &gpio009_cfg_idle>;
		fpga_flag = <0>;
		status = "disabled";
	};
	&panel_lcd_sharp_NT36870 {
		compatible = "hisilicon,mipi_sharp_NT36870";
		//2:PWM,  4:BLPWM,  8:MIPI
		lcd-bl-type = <4>;
		//8:PANEL_MIPI_VIDEO,  16:PANEL_MIPI_CMD ,32:PANEL_DUAL_MIPI_VIDEO, 64:PANEL_DUAL_MIPI_CMD
		lcd-display-type = <16>;
		//0:IFBC_TYPE_NONE 7:IFBC_TYPE_VESA3X_SINGLE 9:IFBC_TYPE_VESA3X_DUAL
		lcd-ifbc-type = <0>;
		//vsp, vsn, lcd_reset, bl_enable, ID0,ID1,TE0
		/*vsp, vsn, rst, bl_en, id0, id1, te0*/
		//GPIO_011, GPIO_008, GPIO_189, GPIO_010, GPIO_016, GPIO_009, GPIO_003
		gpios = <&gpio1 3 0>, <&gpio1 0 0>,  <&gpio23 5 0>, <&gpio1 2 0>, <&gpio2 0 0>, <&gpio1 1 0>, <&gpio0 3 0>;
		gpio_nums = <11 8 189 10 16 9 3>;
		lcdio-vcc-supply = <&ldo4>;
		lcdanalog-vcc-supply = <&ldo17>;
		pinctrl-names = "default", "idle";

		pinctrl-0 = <&gpio011_pmx_func &gpio008_pmx_func &gpio189_pmx_func &gpio010_pmx_func &gpio011_cfg_func &gpio008_cfg_func &gpio189_cfg_func &gpio010_cfg_func &gpio016_cfg_func &gpio009_cfg_func>;
		pinctrl-1 = <&gpio011_pmx_idle &gpio008_pmx_idle &gpio189_pmx_idle &gpio010_pmx_idle &gpio011_cfg_idle &gpio008_cfg_idle &gpio189_cfg_idle &gpio010_cfg_idle &gpio016_cfg_idle &gpio009_cfg_idle>;
		fpga_flag = <0>;
		status = "disabled";
	};

	&panel_lcd_jdi_NT36860 {
		#address-cells = <2>;
		#size-cells = <2>;
		compatible = "hisilicon,mipi_jdi_NT36860";
		//2:PWM,  4:BLPWM,  8:MIPI
		lcd-bl-type = <8>;
		//8:PANEL_MIPI_VIDEO,  16:PANEL_MIPI_CMD
		lcd-display-type = <16>;
		//0:IFBC_TYPE_NONE 7:IFBC_TYPE_VESA3X_SINGLE 9:IFBC_TYPE_VESA3X_DUAL
		lcd-ifbc-type = <0>;
		//gpio_lcd_vcc1v8, gpio_lcd_p5v5_enable, gpio_lcd_n5v5_enable, gpio_lcd_reset, gpio_lcd_bl_enable, gpio_lcd_tp2v85 ,gpio_lcd_tp1v8
		gpios = <&gpio16 2 0>, <&gpio16 0 0>,  <&gpio20 7 0>, <&gpio17 3 0>, <&gpio20 6 0>, <&gpio17 1 0>, <&gpio16 1 0>;
		gpio_nums = <130 128 167 139 166 137 129>;
		//lcdio-vcc-supply = <&ldo4>;
		//lcdanalog-vcc-supply = <&ldo17>;
		//pinctrl-names = "default", "idle";
		//pinctrl-0 = <&gpio021_pmx_func &gpio021_cfg_func &gpio009_cfg_func &gpio010_cfg_func &gpio015_cfg_func &gpio020_cfg_func>;
		//pinctrl-1 = <&gpio021_pmx_idle &gpio021_cfg_idle &gpio009_cfg_idle &gpio010_cfg_idle &gpio015_cfg_idle &gpio020_cfg_idle>;
		fpga_flag = <0>;
		status = "disabled";
	};

	&panel_lcd_sharp_NT36860 {
		#address-cells = <2>;
		#size-cells = <2>;
		compatible = "hisilicon,mipi_sharp_NT36860";
		//2:PWM,  4:BLPWM,  8:MIPI
		lcd-bl-type = <8>;
		//8:PANEL_MIPI_VIDEO,  16:PANEL_MIPI_CMD
		lcd-display-type = <16>;
		//0:IFBC_TYPE_NONE 7:IFBC_TYPE_VESA3X_SINGLE 9:IFBC_TYPE_VESA3X_DUAL
		lcd-ifbc-type = <0>;
		//gpio_lcd_vcc1v8, gpio_lcd_p5v5_enable, gpio_lcd_n5v5_enable, gpio_lcd_reset, gpio_lcd_bl_enable, gpio_lcd_tp2v85 ,gpio_lcd_tp1v8
		gpios = <&gpio16 2 0>, <&gpio16 0 0>,  <&gpio20 7 0>, <&gpio17 3 0>, <&gpio20 6 0>, <&gpio17 1 0>, <&gpio16 1 0>;
		gpio_nums = <130 128 167 139 166 137 129>;
		//lcdio-vcc-supply = <&ldo4>;
		//lcdanalog-vcc-supply = <&ldo17>;
		//pinctrl-names = "default", "idle";
		//pinctrl-0 = <&gpio021_pmx_func &gpio021_cfg_func &gpio009_cfg_func &gpio010_cfg_func &gpio015_cfg_func &gpio020_cfg_func>;
		//pinctrl-1 = <&gpio021_pmx_idle &gpio021_cfg_idle &gpio009_cfg_idle &gpio010_cfg_idle &gpio015_cfg_idle &gpio020_cfg_idle>;
		fpga_flag = <0>;
		status = "disabled";
	};

	&panel_mipi_lcd_external {
		#address-cells = <2>;
		#size-cells = <2>;
		compatible = "hisilicon,mipi_lcd_external_panel";
		//2:PWM,  4:BLPWM,  8:MIPI
		lcd-bl-type = <8>;
		//8:PANEL_MIPI_VIDEO,  16:PANEL_MIPI_CMD
		lcd-display-type = <8>;
		//0:IFBC_TYPE_NONE
		lcd-ifbc-type = <0>;
		//gpio_lcd_vcc1v8, gpio_lcd_p5v5_enable, gpio_lcd_n5v5_enable, gpio_lcd_reset, gpio_lcd_bl_enable, gpio_TP_2V85_EN_B, gpio_TP_1V8_EN_B
		gpios = <&gpio16 3 0>, <&gpio17 0 0>,  <&gpio20 1 0>, <&gpio17 7 0>, <&gpio20 0 0>, <&gpio17 5 0>, <&gpio16 4 0>;
		gpio_nums = <131 136 161 143 160 141 132>;
		//lcdio-vcc-supply = <&ldo4>;
		//lcdanalog-vcc-supply = <&ldo17>;
		//pinctrl-names = "default", "idle";
		//pinctrl-0 = <&gpio021_pmx_func &gpio021_cfg_func &gpio009_cfg_func &gpio010_cfg_func &gpio015_cfg_func &gpio020_cfg_func>;
		//pinctrl-1 = <&gpio021_pmx_idle &gpio021_cfg_idle &gpio009_cfg_idle &gpio010_cfg_idle &gpio015_cfg_idle &gpio020_cfg_idle>;
		fpga_flag = <0>;
		status = "disabled";
	};
	&panel_hdmi_fake {
		#address-cells = <2>;
		#size-cells = <2>;
		compatible = "hisilicon,hdmi_fake_panel";
		fake_hdmi = <1>;
		status = "disabled";
	};
	&panel_dp_fake {
		#address-cells = <2>;
		#size-cells = <2>;
		compatible = "hisilicon,dp_fake_panel";
		fake_dp = <1>;
		status = "ok";
	};
	&hisi_dp {
		preemphasis_swing = <0xB0>, <0x598>, <0x2040>, <0x5D8>, <0x22C0>, <0x638>, <0x25C0>, <0x6B8>, <0x29C0>,
			<0x638>, <0x2040>, <0x698>, <0x23C0>, <0x6F8>, <0x27C0>, <0x728>, <0x2140>, <0x748>, <0x2540>, <0x7E8>, <0x2040>;
		status = "ok";
	};
	&dp_aux_switch {
		compatible = "huawei,dp_aux_switch";
		aux_switch_from_fsa4476;
		aux_switch_with_uart;
		aux_uart-gpio = <&gpio26 0 0>;
		status = "ok";
	};

	/*set dp source default mode*/
	&dp_source_switch {
		compatible = "huawei,dp_source_switch";
		dp_default_source_mode = <0>; /*0:diff mode 1:same mode*/
		status = "ok";
	};

	&huawei_usbvbus {
		support_pd = <1>;
		support_dp = <1>;
		pmic_vbus_attach_enable = <0>;
		status = "ok";
	};
	/* display end */

	/* audio device beg */
	&codec_controller {
		gpios = <&gpio26 3 0>; /* GPIO_211 */
		gpio_reset = <74>; /* GPIO_74*/
		gpio_codec_ssi = <204>;
		gpio_codec_ssi_func = <1>;
		gpio_ssi_mux = <16>; /* Chicago only */
		slimbusclk_io_driver = <0x2>;
		slimbusdata_io_driver = <0x2>;
		pm_runtime_support;
		status = "ok";

		hi64xx_irq: hi64xx_irq@0 {
			status = "ok";

			hi6402_codec: hi6402_codec@0{
				hisilicon,mic_num = <2>;
				status = "disabled";
			};

			hi6403_codec: hi6403_codec@0{
				hisilicon,mic_num = <3>;
				hisilicon,hs_extern_cable_min_voltage = <2651>;
				hisilicon,hs_extern_cable_max_voltage = <2700>;
				hs_detect_extern_cable = <1>;
				fm_enable = <1>;
				status = "ok";
			};

			pmx4: hi6402_pinctrl {
				status = "disabled";
			};
		};
	};

	&sound_hi6403 {
		compatible = "hisilicon,hi3xxx-hi6403";
		status = "ok";
	};

	&hi6210_hifi {
		compatible = "hi6210-hifi";
		status = "ok";
	};

	&hisi_dp_machine {
		compatible = "hisilicon,hisi-dp-audio-machine";
		status = "ok";
	};

	&asp_irq {
		compatible = "hisilicon,hi3630-asp-irq";
		reg = <0x0 0xe804e000 0x0 0xa000>;
		#interrupt-cells = <0x2>;
		asp-irq-supply = <&asp>;
		interrupt-controller;
		interrupts = <0x0 0x88 0x4>;
		interrupt-names = "asp_irq";

		asp_common@0 {
			compatible = "hisilicon,hi3630-asp-common";
		};

		asp_srcup_normal@0 {
			compatible = "hisilicon,hi3630-srcup-normal";
			asp-srcup-normal-supply = <&asp>;
			interrupt-parent = <&asp_irq>;
			interrupts = <0x1 0x0>;
			interrupt-names = "asp_srcup_normal";
		};

		asp_srcup_dsp@0 {
			compatible = "hisilicon,hi3630-srcup-dsp";
		};

		asp_srcdown@0 {
			compatible = "hisilicon,hi3630-srcdown";
			interrupt-parent = <&asp_irq>;
		};

		asp_hdmi@0 {
			compatible = "hisilicon,hi3630-pcm-hdmi";
			interrupt-parent = <&asp_irq>;
			interrupts = <0x0 0x0>;
			interrupt-names = "asp_irq_hdmi";
		};
	};
	&slimbusmisc {
		compatible = "candance,slimbus";
		reg = <0x0 0xe8050000 0x0 0xb00>,
			<0x0 0xe804e000 0x0 0xa000>,
			<0x0 0xfff0a000 0x0 0x1000>;
		interrupts = <0x0 0x96 0x4>;
		interrupt-names = "asp_irq_slimbus";
		slimbus-reg-supply = <&asp>;
		pinctrl-names = "default", "idle";
		pinctrl-0 = <&gpio193_pmx_func
				&gpio194_pmx_func
				&gpio193_cfg_func
				&gpio194_cfg_func>;
		pinctrl-1 = <&gpio193_pmx_idle
				&gpio194_pmx_idle
				&gpio193_cfg_idle
				&gpio194_cfg_idle>;
		slimbus-ssi-sel = "slimbus";
		asp_power_state_offset = <0x06c>;
		slimbusclk_io_driver = <0xa8>;
		slimbusdata_io_driver = <0xa3>;
		slimbusclk_offset = <0x034>;
		slimbusdata_offset = <0x038>;
		slimbusclk_cfg_offset = <0x85C>;
		slimbusdata_cfg_offset = <0x860>;
		platform-type   = "UDP";
		codec-type = "slimbus-6403cs";
		clk_asp_subsys = <415000>;
		slimbus_dynamic_freq= "true";
		pm_runtime_support;
		status = "ok";
	};
	&slimbus_dai {
		compatible = "hisilicon,slimbus-dai";
		status = "ok";
	};

	&sio1 {
		compatible = "hisilicon,hi3630-sio";
		reg = <0x0 0xE804F000 0x0 0x400>;
		sio-audio-supply = <&asp>;
		/* wbd
		pinctrl-names = "default", "idle";
		pinctrl-0 = <&gpio183_pmx_func
				    &gpio184_pmx_func
				    &gpio185_pmx_func
				    &gpio186_pmx_func
				    &gpio183_cfg_func
				    &gpio184_cfg_func
				    &gpio185_cfg_func
				     &gpio186_cfg_func>;
		pinctrl-1 = <&gpio183_pmx_idle
				    &gpio184_pmx_idle
				    &gpio185_pmx_idle
				    &gpio186_pmx_idle
				    &gpio183_cfg_idle
				    &gpio184_cfg_idle
				    &gpio185_cfg_idle
				    &gpio186_cfg_idle>;
		*/
		status = "disabled";
	};

	&sio2 {
		compatible = "hisilicon,hi3630-sio";
		reg = <0x0 0xE804F400 0x0 0x400>;
		sio-voice-supply = <&asp>;
		/* wbd
		pinctrl-names = "default", "idle";
		pinctrl-0 = <&gpio043_pmx_func
				     &gpio044_pmx_func
				     &gpio045_pmx_func
				     &gpio046_pmx_func
				     &gpio043_cfg_func
				     &gpio044_cfg_func
				     &gpio045_cfg_func
				     &gpio046_cfg_func>;
			pinctrl-1 = <&gpio043_pmx_idle
				     &gpio044_pmx_idle
				     &gpio045_pmx_idle
				     &gpio046_pmx_idle
				     &gpio043_cfg_idle
				     &gpio044_cfg_idle
				     &gpio045_cfg_idle
				     &gpio046_cfg_idle>;
		*/
		status = "disabled";
	};

	&sio3 {
		compatible = "hisilicon,hi3630-sio";
		reg = <0x0 0xE804F800 0x0 0x400>;
		status = "disabled";
	};

	&sio4 {
		compatible = "hisilicon,hi3630-sio";
		reg = <0x0 0xE804FC00 0x0 0x400>;
		status = "disabled";
	};

	&soundtrigger {
		compatible = "hisilicon,soundtrigger_dma_drv";
		reg = <0x0 0xe804b000 0x0 0x1000>;
		asp-dmac-supply = <&asp>;
		status = "ok";
	};

	&hi64xx_asp_dmac {
		compatible = "hisilicon,hi64xx-asp-dma";
		reg = <0x0 0xe804b000 0x0 0x1000>;
		asp-dmac-supply = <&asp>;
		interrupts = <0 216 4>;
		interrupt-names = "asp_dma_irq";
		status = "ok";
	};

	&asp_hdmi_dmac {
		compatible = "hisilicon,asp-hdmi-dma";
		reg = <0x0 0xe804e400 0x0 0x1000>;
		status = "ok";
	};

	&asp_cfg {
		compatible = "hisilicon,asp-cfg";
		reg = <0x0 0xe804e000 0x0 0xa000>;
		asp-supply = <&asp>;
		status = "ok";
	};

	&dp_i2s {
		compatible = "hisilicon,hisi-dp-i2s";
		status = "ok";
        };

	&dp_audio {
		compatible = "hisilicon,dp-audio";
		status = "ok";
        };

	&hisi_pcm_dp {
		compatible = "hisilicon,hisi-pcm-dp";
		interrupts = <0x0 0x96 0x4>;
		interrupt-names = "asp_hdmi_dma";
		dp-pcm-supply = <&asp>;
		status = "ok";
	};

	&hifidsp {
			compatible = "hisilicon,k3hifidsp";
			status = "ok";
			platform-type = "ASIC";
	};

	&sochifi_watchdog {
		compatible = "hisilicon,sochifi-watchdog";
		interrupts = <0 213 4>;
		status = "ok";
	};

	&asp_dmac {
		compatible = "hisilicon,hi3xxx-pcm-asp-dma";
		reg = <0x0 0xe804b000 0x0 0x1000>;
		asp-dmac-supply = <&asp>;
		status = "ok";
	};

	&usbaudio_dsp {
		compatible = "hisilicon,usbaudiodsp";
		status = "ok";
	};

	&deviceboxID {
		check_mode = "gpio";
		box_num = <2>;
		enable_boxID = <1 1 0 0>;
		gpio_num = <1 1 0 0>;
		gpio_speakerID = <&gpio22 3 0>;
		gpio_receiverID = <&gpio22 2 0>;
		speaker_map = <1 2>;/*1 means AAC, 2 means GEER*/
		receiver_map = <1 2>;/*1 means AAC, 2 means GEER*/
		pinctrl-names = "default", "idle";
		pinctrl-0 = <&gpio179_pmx_func &gpio179_cfg_func &gpio178_pmx_func &gpio178_cfg_func>;
		pinctrl-1 = <&gpio179_pmx_idle &gpio179_cfg_idle &gpio178_pmx_idle &gpio178_cfg_idle>;
		deviceboxID_limit = <500>;
		status = "ok";
	};

	&smartpakit {
		compatible = "huawei,smartpakit";
		/* 0 hisi, 1 qcom */
		soc_platform = <0>;
		/* algo running on: 0 codec_dsp, 1 soc_dsp, 2 smartpa_dsp, 3 simple pa(not smpartpa), 4 simple pa(with i2c) */
		algo_in = <0>;
		/* algo_in params need match out_device for smartpa.
		* Now, up to only support four pa, so out_device = <0 0 0 0>;
		* 1. This array is arranged in the following order:
		*    <0 1 2 3>
		*    <pril prir secl secr>
		* 2. This array element value is 0 or 1:
		*    smartpa: 0 speaker, 1 receiver
		*    simple pa: out_device not applicable, only set 0 to indicate pa_num
		* 3. The length of this array is variable, for example:
		*    single pa: out_device = <0>;
		*    two pa: out_device = <0 0>;
		*    four pa: out_device = <1 1 0 0>; */
		out_device = <0 1>;
		dsp_img_name = "hifi_6403_imedia150_devkit.img";
		status = "ok";
	};
	&usb_analog_hs_interface {
		compatible = "huawei,usb_analog_hs_interface";
		status = "ok";
	};

	&usb_ana_hs_fsa4476 {
		compatible = "huawei,usb_ana_hs_fsa4476";
		gpio_type = <0>;
		swtich_enn = <&gpio4 0 0>;
		swtich_en1 = <&gpio1 3 0>;
		swtich_en2 = <&gpio17 1 0>;
		mic_switch_delay = <150>;
		pd_unlock_enable = <1>; /* 0: disable; 1: enable */
		sd_gpio_used = <1>;
		support_cc = <1>;
		status = "ok";
	};

	&usb_audio_power {
		compatible = "huawei,usb_audio_power";
		gpio_type = <0>;
		gpio_chg_vbst_ctrl = <&gpio33 0 0>;
		gpio_ear_power_en = <&gpio3 7 0>;
		status = "ok";
	};

	&usb_audio_common {
		compatible = "huawei,usb_audio_common";
		status = "ok";
	};

	&anc_hs_default {
		compatible = "huawei,anc_hs_default";
		status = "ok";
	};

	&audio_hw_config {
		product_name = "LAYAPRE";
		multi_mic_enable = "true";
		vqm_enable = "true";
		spk_pa_name = "smartpakit";
		cust_name = "audio_custom";
		soc_name = "hi363x";
		codec_name = "hi6403";
		codec_dsp_algo = "mad";
		modem_sio_master = "false";
		asr_enable = "true";
		ear_pa_name = "smartpakit";
		analog_earpiece_enable = "false";
		status = "ok";
		audio_sar_support = "true";
		record_algo_version = "record5_0";
		karaoke_mic_conf_support = "true";/*use specific mic path to enhance karaoke UE*/
		hifi_info {
			dsp_voice_vol_control = "1";/* 1 :need socdsp control volume; 0:platform codec */
		};

		hardware_info {
			mic_num = "3";
			mic_type = "000b";/*0001 deputy mic   0002 main mic   0004 deputy mic2   0008 main mic2*/
			status = "ok";
		};

		audio_capability {
			bwe_ui_support = "true";
			bwe_support = "true";
			swb_support = "true";
			wnr_support = "false";
			nv_evs_support = "true";
			lvm_support = "false";
			dhf_support = "true";
			voice_anc_support = "false";
			dual_smartpa_support = "true";
			stereo_handfree_support = "true";
			spk_rcv_stereo_support = "real";
			dual_smartpa_version = "2.0";
			earphone_multi_eq_support = "true";
			vdr_ui_support = "false";
			asr_vibrate_support = "true";
			mmi_capture_enable = "false";
			irda_support = "false";
			/* show warning to user when use a Type C analog headset */
			usb_analog_hs_report = "true";
			visualizer_support = "true";
			visualizer_frame = "Medium";
			/*
				sound trigger feature.
				false: this product doesn't support soundtrigger feature.
				2.0: this product supports the twice wakeup feature.
			*/
			soundtrigger_version = "2.0";
			soundtrigger_enhance_enable = "true";
			soundtrigger_mic_info = "3";
			/*
				max stream volume to replace Android default volume.
			*/
			max_stream_volume = "15";
			/*
				usb compatibility report feature.
				true: this product needs usb compatibility report.
				false: this product doesn't need usb compatibility report.
			*/
			usb_compatibility_report = "true";
			/*
				use hisilicon wakeup engine.
				true: use hisilicon wakeup engine.
				false: DO NOT use hisilicon wakeup engine.
			*/
			wakeup_hisiengine = "true";
			asr_enhance_mic_choose = "1";
			usb_speaker_support = "true";
		};
	};

	&hw_soundtrigger_event {
		status = "ok";
	};

	/* audio device end */

	/* UFS */
	&ufs {
		status = "ok";
	};

	/* rename eMMC,SD,SDIO */
	&aliases {
	};

	/* eMMC 4.5
	&dwmmc0 {
		status = "ok";
	};
	*/

	/* SD */
	/*
	while set mux-sdsim as 1,driver_strength for clk,cmd,data must be specified in dts,check config table below to make sure right value

	2MA_0   0x00
	4MA_0   0x10
	6MA_0   0x20
	8MA_0   0x30
	10MA_0  0x40
	12MA_0  0x50
	14MA_0  0x60
	16MA_0  0x70
	5MA_1   0x00
	7MA_1   0x10
	9MA_1   0x20
	11MA_1  0x30
	14MA_1  0x40
	16MA_1  0x50
	18MA_1  0x60
	20MA_1  0x70
	22MA_1  0x80
	25MA_1  0x90
	27MA_1  0xA0
	29MA_1  0xB0
	32MA_1  0xC0
	34MA_1  0xD0
	36MA_1  0xE0
	38MA_1  0xF0
	*/
	&dwmmc1 {
		caps2-mmc-hs200-1_8v;
		caps2-mmc-cache-ctrl;
		vmmc-supply = <&ldo16>;
		vqmmc-supply = <&ldo9>;
		cs_sd_timing_config_cancer;
		use_samdly_range = <5 8>;
		mux-sdsim = <1>;
		/*14MA_1 for sd clk*/
		driverstrength_clk = <0x40>;
		/*25MA_1 for sd cmd*/
		driverstrength_cmd = <0x90>;
		/*11MA_1 for sd data*/
		driverstrength_data = <0x30>;
		enable_shift_range = <4 8>;
		cd-vol = <1>;
		cd-gpio = <&gpio22 7 0>;
		shared-irq = <1>;
		status = "ok";
	};

	/* sdio */

	&dwmmc2 {
		status = "ok";
	};

	&pddevice {
		update_combophy_firmware = <1>;
		combophy_resistor = <0xee>;
	};

	&hisi_usb {
		eye_diagram_host_param = <0x37DE7E7>;
		host-maximum-speed = "super-speed-plus";
		usb_support_dp = <1>;
		quirk_enable_hst_imm_retry;
		quirk_disable_rx_thres_cfg;
		quirk_disable_usb2phy_suspend;
		quirk_clear_svc_opp_per_hs;
		quirk_set_svc_opp_per_hs_sep;
		quirk_adjust_dtout;
		quirk_force_disable_host_lpm;
		quirk_enable_p4_gate;
	};


	&sensorhub_status{
		compatible = "huawei,sensorhub_status";
		status= "ok";
	};

	&sensorhub_nmi{
		compatible = "huawei,sensorhub_nmi";
		nmi_reg=<0x588>;
	};

	&sensorhub{
		#address-cells=<1>;
		#size-cells=<0>;
		als_sensor:light{
			als1{
				compatible="huawei,avago_apds9253";
				bus_number = <0x0>;
				reg=<0x52>;
				chip_id_register = <0x06>;
				chip_id_value = <0xC2>;
				file_id = <41>;
				sensor_list_info_id = <0x03>;
				sensor_type = "als";
				poll_interval = <350>;
				threshold_value = <0x1>;
				GA1 = <0x1046>;
				GA2 = <0xf3c>;
				GA3 = <0x1194>;
				tp_color = <0x0>;
				again = <0x1>;
				gpio_int1 = <0x38 0x6 0x0>;
				atime = <0xdb>;
				init_time = <0x96>;
				status = "ok";
				als_phone_type = <37>;
				als_phone_version = <10>;
				als_extend_data = <0x0 0x0 0x0 0x0 0x0 0x0 0x0 0x0 0x0 0x0 0x0 0x0>;
				sensorlist_name="als-apds9253";
				vendor="avago";
			};
		};
		proximity{
			ps1{
				compatible="huawei,txc-pa224";
				reg=<0x1e>;
				replace_by_tof=<1>;
				chip_id_register=<0x7F>;
				chip_id_value=<0x11>;
				file_id=<39>;
				sensor_list_info_id = <0x04>;
				min_proximity_value=<220>;
				pwindows_value=<14>;
				pwave_value=<12>;
				threshold_value=<25>;
				ps_calib_20cm_threshold=<150>;
				ps_calib_5cm_threshold=<200>;
				ps_calib_3cm_threshold=<250>;
				gpio_int1=<&gpio27 1 0>;
				poll_interval = <80>;
				ps_oily_threshold = <2>;
				oily_max_near_pdata=<210>;
				max_oily_add_pdata=<50>;
				max_near_pdata_loop=<4>;
				oily_count_size=<12>;
				status = "ok";
				sensorlist_name="proximity-pa224";
				vendor="txc";
				fifoReservedEventCount=<100>;
				fifoMaxEventCount=<100>;
				maxDelay=<200000>;
				support_absolute_threshold = <0>;
			};
		};
		gsensor{
			acc1{
				compatible ="huawei,st-lsm6dsm";
				bus_number =<1>;
				reg =<0x6a>;
				chip_id_register =<0x0f>;
				chip_id_value =<0x6a>;
				file_id =<34>;
				sensor_list_info_id =<0>;
				sensor_type ="acc";
				axis_map_x =<1>;
				axis_map_y =<0>;
				axis_map_z =<2>;
				negate_x =<1>;
				negate_y =<0>;
				negate_z =<0>;
				offset_x =<0>;
				offset_y =<0>;
				offset_z =<0>;
				sensitivity_x =<1>;
				sensitivity_y =<1>;
				sensitivity_z =<1>;
				poll_interval =<10>;
				gpio_int1 =<&gpio26 0 0>;
				gpio_int2=<&gpio25 7 0>;
				gpio_int2_sh=<1013>;
				used_int_pin =<1>;
				calibrate_style =<0>;
				x_calibrate_thredhold = <250>;
				y_calibrate_thredhold = <250>;
				z_calibrate_thredhold = <320>;
				sensorlist_name="accelerometer-lsm6dsm";
				vendor="st";
				maxRange=<8>;
				power=<230>;
				minDelay=<2000>;
				fifoReservedEventCount=<0>;
				fifoMaxEventCount=<0>;
				maxDelay=<200000>;
				calibrate_way=<1>;
				status = "ok";
			};
			acc2{
				compatible ="huawei,invensense-icm20690";
				bus_number =<1>;
				reg =<0x68>;
				chip_id_register =<0x75>;
				chip_id_value =<0x20>;
				file_id =<53>;
				sensor_list_info_id =<0>;
				sensor_type ="acc";
				axis_map_x =<1>;
				axis_map_y =<0>;
				axis_map_z =<2>;
				negate_x =<1>;
				negate_y =<0>;
				negate_z =<0>;
				offset_x =<0>;
				offset_y =<0>;
				offset_z =<0>;
				sensitivity_x =<1>;
				sensitivity_y =<1>;
				sensitivity_z =<1>;
				poll_interval =<10>;
				gpio_int1 =<&gpio26 0 0>;
				gpio_int2=<&gpio25 7 0>;
				gpio_int2_sh=<1013>;
				calibrate_style =<0>;
				used_int_pin =<1>;
				x_calibrate_thredhold = <250>;
				y_calibrate_thredhold = <250>;
				z_calibrate_thredhold = <320>;
				sensorlist_name="accelerometer-icm20690";
				vendor="invensense";
				maxRange=<8>;
				power=<230>;
				minDelay=<2000>;
				fifoReservedEventCount=<0>;
				fifoMaxEventCount=<0>;
				maxDelay=<200000>;
				calibrate_way=<1>;
				status = "ok";
			};
		};

		gyroscope{
			gyro1{
				compatible ="huawei,st-lsm6dsm";
				bus_number =<1>;
				reg =<0x6a>;
				chip_id_register =<0x0f>;
				chip_id_value =<0x6a>;
				file_id =<36>;
				sensor_list_info_id =<5>;
				sensor_type ="gyro";
				position = <2>;
				axis_map_x =<1>;
				axis_map_y =<0>;
				axis_map_z =<2>;
				negate_x =<1>;
				negate_y =<0>;
				negate_z =<0>;
				poll_interval =<10>;
				gpio_int1 =<&gpio26 2 0>;
				gpio_int2=<&gpio25 7 0>;
				gpio_int2_sh=<1013>;
				calibrate_thredhold = <572>;
				sensorlist_name="gyroscope-lsm6dsm";
				vendor="st";
				minDelay=<2000>;
				maxDelay=<200000>;
				calibrate_way=<1>;
				status = "ok";
			};
			gyro2{
				compatible ="huawei,inv-icm20690";
				bus_number =<1>;
				reg =<0x68>;
				chip_id_register =<0x75>;
				chip_id_value =<0x20>;
				file_id =<54>;
				sensor_list_info_id =<5>;
				sensor_type ="gyro";
				position = <2>;
				axis_map_x =<1>;
				axis_map_y =<0>;
				axis_map_z =<2>;
				negate_x =<1>;
				negate_y =<0>;
				negate_z =<0>;
				poll_interval =<10>;
				gpio_int1 =<&gpio26 2 0>;
				gpio_int2=<&gpio25 7 0>;
				gpio_int2_sh=<1013>;
				sensorlist_name="gyroscope-icm20690";
				vendor="invensense";
				minDelay=<2000>;
				maxDelay=<200000>;
				calibrate_way=<1>;
				status = "ok";
			};
		};
		compass{
			mag1{
				compatible="huawei,akm-akm09911";
				bus_number=<0>;
				reg=<0x0D>;
				chip_id_register=<0x00>;
				chip_id_value=<0x48>;
				file_id=<37>;
				sensor_list_info_id=<1>;
				sensor_type="mag";
				/*sensor-vdd-supply = <&ldo24>;*/
				outbit=<0>;
				softfilter = <2>;
				calibrate_method=<2>;
				axis_map_x=<1>;
				axis_map_y=<0>;
				axis_map_z=<2>;
				negate_x=<0>;
				negate_y=<0>;
				negate_z=<1>;
				poll_interval=<10>;
				gpio_int1=<&gpio0 0 0>;
				gpio_reset=<&gpio0 0 0>;
				softiron_parameter = <16 39 0 0 0 0 0 0 16 39 0 0 0 0 0 0 16 39 0 0 0 0 0 0 0 0 0>;
				sensorlist_name="mag-akm09911";
				vendor="akm";
				minDelay=<10000>;
				fifoReservedEventCount=<0>;
				fifoMaxEventCount=<0>;
				status = "ok";
			};
			mag2 {
				compatible="huawei,yamaha-yas537";
				bus_number=<0>;
				reg=<0x2E>;
				chip_id_register=<0x80>;
				chip_id_value=<0x07>;
				file_id=<66>;
				sensor_list_info_id=<1>;
				sensor_type="mag";
				/*sensor-vdd-supply = <&ldo24>;*/
				outbit=<0>;
				softfilter = <2>;
				calibrate_method=<2>;
				axis_map_x=<1>;
				axis_map_y=<0>;
				axis_map_z=<2>;
				negate_x=<0>;
				negate_y=<0>;
				negate_z=<1>;
				poll_interval=<10>;
				gpio_int1=<&gpio0 0 0>;
				gpio_reset=<&gpio0 0 0>;
				softiron_parameter = <16 39 0 0 0 0 0 0 16 39 0 0 0 0 0 0 16 39 0 0 0 0 0 0 0 0 0>;
				sensorlist_name="mag-yas537";
				vendor="yamaha";
				minDelay=<10000>;
				fifoReservedEventCount=<0>;
				fifoMaxEventCount=<0>;
				status = "ok";
			};
			mag3 {
				compatible="huawei,akm-akm09918";
				bus_number=<0>;
				reg=<0x0C>;
				chip_id_register=<0x00>;
				chip_id_value=<0x48>;
				file_id=<67>;
				sensor_list_info_id=<1>;
				sensor_type="mag";
				/*sensor-vdd-supply = <&ldo24>;*/
				outbit=<0>;
				calibrate_method=<2>;
				axis_map_x=<1>;
				axis_map_y=<0>;
				axis_map_z=<2>;
				negate_x=<0>;
				negate_y=<0>;
				negate_z=<1>;
				poll_interval=<10>;
				gpio_int1=<&gpio0 0 0>;
				gpio_reset=<&gpio0 0 0>;
				softiron_parameter = <55 37 41 2 172 255 41 2 117 38 236 255 172 255 236 255 6 42 0 0 0 0 0 0 0 0 0>;
				sensorlist_name="akm-akm09918";
				vendor="akm";
				minDelay=<10000>;
				fifoReservedEventCount=<0>;
				fifoMaxEventCount=<0>;
				status = "ok";
			};
		};
		airpress{
			airpress1{
				compatible="huawei,st_lps22bh";
				bus_number=<0>;
				reg=<0x5d>;
				chip_id_register=<0x0F>;
				chip_id_value=<0xB1>;
				file_id=<48>;
				sensor_list_info_id=<0x9>;
				sensor_type="airpress";
				poll_interval = <500>;
				sensorlist_name="airpress-lps22bh";
				vendor="st";
				fifoReservedEventCount=<300>;
				fifoMaxEventCount=<300>;
				isSupportTouch=<0>;// 1: support  0: not support
				airpress_touch_calibrate_order=<3>;//bit0: calibrate; bit1: test
				touch_fac_wait_time=<0>;
				tp_touch_coordinate_threshold = /bits/ 16 <614 826 1991 2203>;
				status = "ok";
			};
			airpress2 {
				compatible="huawei,bosch_bmp380";
				bus_number=<0>;
				reg=<0x77>;
				chip_id_register=<0x0>;
				chip_id_value=<0x50>;
				file_id=<82>;
				sensor_list_info_id=<0x9>;
				sensor_type="airpress";
				poll_interval = <500>;
				sensorlist_name="airpress-bmp380";
				vendor="bosch";
				fifoReservedEventCount=<300>;
				fifoMaxEventCount=<300>;
				isSupportTouch=<0>;// 1: support  0: not support
				airpress_touch_calibrate_order=<3>;//bit0: calibrate; bit1: test
				touch_fac_wait_time=<0>;
				tp_touch_coordinate_threshold = /bits/ 16 <614 826 1991 2203>;
				status = "ok";
			};
		};
		tof_sensor:tof{
			tof1{
				compatible="huawei,ams_tmf8701";
				bus_number=<0>;
				reg=<0x41>;
				chip_id_register=<0xe3>;
				chip_id_value=<0x07 0x47 0x87 0xC7>;
				file_id=<99>;
				sensor_list_info_id=<0x1C>;
				sensor_type="tof";
				poll_interval = <500>;
				sensorlist_name="ams-tmf8701";
				tof_calib_zero_threshold=<10000>;
				tof_calib_6cm_threshold=<10000>;
				tof_calib_10cm_threshold=<10000>;
				tof_calib_60cm_threshold=<10000>;
				vendor="ams";
				status = "ok";
			};
			tof2{
				compatible="huawei,sharp_gp2ap02";
				bus_number=<0>;
				reg=<0x29>;
				chip_id_register=<0x41>;
				chip_id_value=<0x1f 0x2f>;
				file_id=<109>;
				sensor_list_info_id=<0x1C>;
				sensor_type="tof";
				poll_interval = <500>;
				sensorlist_name="sharp-gp2ap02";
				tof_calib_zero_threshold=<10000>;
				tof_calib_6cm_threshold=<10000>;
				tof_calib_10cm_threshold=<10000>;
				tof_calib_60cm_threshold=<10000>;
				vendor="sharp";
				status = "ok";
			 };
		};
		sar {
			sar1 {
				compatible="huawei,semtech-sx9323";
				bus_number=<0>;
				reg=<0x28>;
				chip_id_register=<0xFA>;
				chip_id_value=<0x23 0x20>;
				file_id=<62>;
				sensor_type="cap_prox";
				sensor_list_info_id=<20>;
				poll_interval=<200>;
				calibrate_type=<6>;	//bit config 101(b) adapt to the param calibrate calibrate order
				calibrate_order = "999 2 1";// 0:free  1:near  2:far  3:other
				shared_flag=<0>;
				status = "disabled";
				phone_type = /bits/ 16 <0x04>;// 1:ALPS  2:BLANC  3:EMILY  4:NEO  5:CHARLOTTE
				to_ap_threshold = /bits/ 16 <0xc8>;
				to_modem_threshold = /bits/ 16 <0x74CC 0x7FFF 0x3E8 0x23F0 0xDAC 0x514 0x00 0x00>;
				init_reg_val = <0x00000014 0x23012447 0x281F2A37 0x2B102C12 0x2D0B301B 0x340B3500 0x36273708 0x10164219 0x43304462 0x293D2600 0x273F2080 0x00000000>;
				ph = <0x2f>;
				calibrate_thred = /bits/ 16 <8000 13200 6500 18000>;//for the factory far and near calibrate
				sensorlist_name="CAP_PROX sensor-sx9323";
				vendor="semtech";
			};
			sar2 {
				compatible="huawei,adi-adux1050";
				bus_number=<0>;
				reg=<0x2c>;
				chip_id_register=<0x0>;
				flag_for_threshold_config= /bits/ 16 <1>;
				to_modem_threshold = /bits/ 16 <0x1388 0x190 0x00 0x00 0x00 0x00 0x00 0x00>;
				chip_id_value=<0xa0 0x50>;
				chip_reg_bit16=<1>;
				file_id=<58>;
				sensor_type="cap_prox";
				sensor_list_info_id=<20>;
				sensor-vdd-supply = <&ldo24>;
				init_reg_val = <0x00010101 0x00020532 0x000301ee 0x00050f55 0x00063902 0x0007012c 0x00080200 0x00097aff 0x000a210c 0x00798000>;
				poll_interval=<100>;
				calibrate_type=<5>;
				calibrate_order = "0"; // 0:free  1:near  2:far  3:other
				shared_flag=<0>;
				status = "disabled";
				vendor="ADI";
				sensorlist_name="cap_prox-adux1050";
			};
		};
		 rpc{
			 rpc{
				compatible = "huawei,rpc";
				file_id = <0x18>;
				sensor_list_info_id = <24>;
				sensor_type = "rpc";
				sensorlist_name = "rpc";
				mask = <0xFFFF 0x630 0x630 0x630 0x200 0xFFFF 0xFFFF 0xFFFF
						0xFFFF 0xFFFF 0xFFFF 0xFFFF 0xFFFF 0xFFFF 0xFFFF 0xFFFF
						0xFFFF 0xFFFF 0xFFFF 0xFFFF 0xFFFF 0xFFFF 0xFFFF 0xFFFF
						0xFFFF 0xFFFF 0xFFFF 0xFFFF 0xFFFF 0xFFFF 0xFFFF 0xFFFF>;
				table = <0xFFFF 0x210 0x220 0x200 0x0 0xFFFF 0xFFFF 0xFFFF
						 0xFFFF 0xFFFF 0xFFFF 0xFFFF 0xFFFF 0xFFFF 0xFFFF 0xFFFF
						 0xFFFF 0xFFFF 0xFFFF 0xFFFF 0xFFFF 0xFFFF 0xFFFF 0xFFFF
						 0xFFFF 0xFFFF 0xFFFF 0xFFFF 0xFFFF 0xFFFF 0xFFFF 0xFFFF>;
				default_value = <0x1D>;
				mask_enable = <0x0000>;
				status = "ok";
			};
		 };
		fingerprint {
		};

		fingerprint_ud {
			finger1 {
				compatible="goodix,goodixBaikal";
				combo_bus_type = "spi";
				combo_bus_num = <2>;
				combo_data = <217>;
				combo_tx = /bits/ 8 <0xF1>;
				combo_rx_mask = /bits/ 8 <0xFF 0xFF>;
				combo_rx_exp = /bits/ 8 <0x04 0x0A>;

				bus_type=<1>;
				bus_number=<2>;
				reg=<0x0>;
				chip_id_register=<0xF1>;
				chip_id_value=<0x1204>;
				product_id_value=<42>;
				file_id=<88>;
				sensor_list_info_id = <0x12>;
				sensor_type ="fingerprint_ud";
				poll_interval = <500>;
				gpio_irq = <226>;
				gpio_irq_sh = <1005>;
				gpio_reset = <238>;
				gpio_cs = <217>;
				tp_hover_support = <1>;
				status = "ok";
			};

			finger2 {
				compatible="syna,steller";
				combo_bus_type = "spi";
				combo_bus_num = <2>;
				combo_data = <217>;
				combo_tx = /bits/ 8 <0x61>;
				combo_rx_mask = /bits/ 8 <0xFF 0xFF 0xFF 0xFF 0xFF 0xFF>;
				combo_rx_exp = /bits/ 8 <0x0FF 0x01 0x00 0x00 0x68 0x00>;

				bus_type=<1>;
				bus_number=<2>;
				reg=<0x0>;
				chip_id_register=<0x61>;
				chip_id_value=<0x10f>;
				product_id_value=<42>;
				file_id=<104>;
				sensor_list_info_id = <0x12>;
				sensor_type ="fingerprint_ud";
				poll_interval = <500>;
				gpio_irq = <226>;
				gpio_irq_sh = <1005>;
				gpio_reset = <238>;
				gpio_cs = <217>;
				tp_hover_support = <1>;
				status = "ok";
			};
		};
		tp_ud {
			tp1 {
				compatible="tp,synaptics";
				status="ok";
				sensor_type="tp_ud";
				vendor_name="synaptics";
				bus_type = "i3c";
				bus_number=<0>;
				i2c_address=<0x70>;
				file_id=<108>;
				pressure_support=<1>;
				gpio_irq=<198>;
				gpio_irq_sh=<1005>;
			};
		};
		connectivity_sensor:connectivity{
			connectivity1{
				compatible="huawei,connectivity-vs";
				bus_type = <145>;
				bus_number = <1>;
				i2c_address = <0x6e>;
				reg=<0x6e>;
				chip_id_register=<0x91>;
				chip_id_value=<0x00>;
				file_id=<47>;
				sensor_list_info_id=<0x23>;
				sensor_type="connectivity";
				gpio1_gps_cmd_ap = <227>;
				gpio1_gps_cmd_sh = <1027>;
				gpio2_gps_ready_ap = <225>;
				gpio2_gps_ready_sh = <1025>;
				gpio3_wakeup_gps_ap = <199>;
				gpio3_wakeup_gps_sh = <1006>;
				status = "ok";
			};
		};
		magn_bracket{
			magn_bracket{
				compatible="huawei,magn_bracket";
				sensor_type="hw_magn_bracket";
				file_id=<21>;
				sensor_list_info_id = <23>;
				mag_axis_change = <0xfffffe0c 0x32 0x28 0x3e8 0xfffff254 0xffffff83>;
				sensorlist_name="magn_bracket";
				vendor="hw";
				status = "ok";
			};
		};
	};

	&gps_power {
		status = "ok";
		batching,channel_type = "sensorhub";
	};

	&sensorhub_ext_config {
		compatible = "huawei,sensorhub";
		akm_need_current = "no";
		invensense_exist = "no";
		isensor_version = "no";
		adapt_sensor_list_id = <2 6 7 8 11 12 13 14 15 16 17 18 21 25 26 27 29>;
		adapt_file_id = <8 9 14 15 18 28 107>;
	};

	&sensorhub_io_power{
		compatible = "huawei,sensorhub_io";
		sensor-io-supply = <&ldo24>;
		status="ok";
	};

	&hall {
		compatible = "huawei,hall_sensor,ak8789";
		status = "ok";
		huawei,hall_0{
			huawei,single-n-pole = <&gpio24 3 0>;
			huawei,type = <0x01>;
			huawei,default-state = "on";
			huawei,int-delay-time = <100>;
		};
	};
	/*
		device check : the 0 means that it don't need to check;
			the 1 means that it check at board check and running test;
			the 2 means that it check at running test
	*/
	&devcheck {
		touch_panel = <2>;
		compass = <1>;
		g_sensor = <1>;
		gyroscope = <1>;
		nfc = <1>;
		dc_dc = <0>;
		tps = <0>;
		l_sensor = <2>;
		charge = <1>;
		usb_switch = <0>;
		charge_loadswitch = <1>;
		charge_switchcap = <1>;
		wifi = <1>;
		bt = <1>;
		gps = <1>;
		antenna_ctl = <0>;
		airpress = <2>;
		vibrator_lra = <0>;
		laser = <0>;
		camera_pmic = <1>;
		status = "ok";
	};

	&huawei_hisi_isp200 {
		hisi,is_fpga = <0>;
	pinctrl-names = "default", "idle";
	pinctrl-0 = <
		&gpio020_pmx_func
		&gpio021_pmx_func
		&gpio022_pmx_func
		&gpio023_pmx_func
		&gpio024_pmx_func
		&gpio025_pmx_func
		&gpio026_pmx_func
		&gpio027_pmx_func
		&gpio028_pmx_func
		&gpio012_pmx_func
		&gpio136_pmx_func
		&gpio014_pmx_func

		&gpio020_cfg_func
		&gpio021_cfg_func
		&gpio022_cfg_func
		&gpio023_cfg_func
		&gpio024_cfg_func
		&gpio025_cfg_func
		&gpio026_cfg_func
		&gpio027_cfg_func
		&gpio028_cfg_func
		&gpio012_cfg_func
		&gpio136_cfg_func
		&gpio014_cfg_func

		>;
	pinctrl-1 = <
		&gpio020_pmx_idle
		&gpio021_pmx_idle
		&gpio022_pmx_idle
		&gpio023_pmx_idle
		&gpio024_pmx_idle
		&gpio025_pmx_idle
		&gpio026_pmx_idle
		&gpio027_pmx_idle
		&gpio028_pmx_idle
		&gpio012_pmx_idle
		&gpio136_pmx_idle
		&gpio014_pmx_idle

		&gpio020_cfg_idle
		&gpio021_cfg_idle
		&gpio022_cfg_idle
		&gpio023_cfg_idle
		&gpio024_cfg_idle
		&gpio025_cfg_idle
		&gpio026_cfg_idle
		&gpio027_cfg_idle
		&gpio028_cfg_idle
		&gpio012_cfg_idle
		&gpio136_cfg_idle
		&gpio014_cfg_idle
		>;
	status = "ok";
	};

	&hisi_camera {
		hisi,is_fpga = <0>;
	};

	&huawei_hisi_fd {
		compatible = "hisilicon,hisi-fd";
		reg = <0x0 0xE8340000 0x0 0x20000>,    //FD reg
		      <0x0 0xE8320000 0x0 0x20000>,    //smmu reg
		      <0x0 0xE8303000 0x0 0x1000>;     //smmu master reg
		      huawei,top-base = <0xE8304000 0x1000>;
		hisi-fd-supply = <&ispsubsys>;
		hisi-media-supply = <&media1_subsys>;
		clocks = <&clk_gate_fd_func &clk_gate_jpg_func>;
		clock-names = "clk_fd_func", "clk_jpg_func";
		clock-value = <384000000>;
		clock-low-frequency = <277000000>;
		interrupts = <0 307 4>;
		huawei,smmu-flag = <1>;
		huawei,ram-config = <1>;
		smmu_offset_list = <0x10 0x1c 0x20 0x204 0x20c 0x220 0x224>;
		mstr_offset_list = <0x28 0x34 0x100 0x260 0x3c0>;
		fd_offset_list = <0x418 0x40c 0x410 0x414 0x464 0xFD 0x7A 0x9F 0x58 0x31c 0x470>;
		status = "ok";
	};

	&huawei_imx386hybrid {
		status = "disabled";
	};

	&huawei_imx600hybrid {
		compatible = "huawei,imx600hybrid_laya";
		huawei,sensor_name = "IMX600HYBRID";
		huawei,sensor_index = <0>;
		huawei,is_fpga = <0>;
		huawei,pd_valid = <1>;
		huawei,reset_valid = <1>;
		huawei,vcmpd_valid = <0>;
		huawei,csi_index = <0 2>;
		huawei,i2c_index = <0 2>;
		/*cdphy-csi2*/
		huawei,phyinfo_valid = <2>;
		huawei,is_master_sensor = <1 0>;
		huawei,phy_id = <0 2>;
		huawei,phy_mode = <1 0>;
		huawei,phy_freq_mode = <1 0>;
		huawei,phy_freq = <80000000 80000000>;
		huawei,phy_work_mode = <0 0>;
        clock-names = "clk_rxdphy0_cfg", "clk_rxdphy2_cfg", "clk_isp_snclk0", "clk_isp_snclk2";
		clocks = <&clk_gate_rxdphy0_cfg &clk_gate_rxdphy2_cfg &clk_gate_isp_snclk0 &clk_gate_isp_snclk2 >;

		huawei,phyclk = <80000000>;
		phy-clock-num = <2>;
		huawei,mclk = <19200000>;
		iovdd-supply = <&ldo21>;
		huawei,ldo-names = "iovdd";

		gpios = <&gpio0 7 0 &gpio1 4 0 &gpio17 0 0 &gpio4 3 0>;
		huawei,gpio-ctrl-types = "reset2", "reset", "vcm_pwdn","laser_xshut";  /*laser_xshut need to configed to avoid i2c conflict with pmic. need to take carefully*/
		module_type = <0>;/*bit0=enable ,other bits=type*/
		status = "ok";
};

	&huawei_ov08a10 {
		compatible = "huawei,ov08a10";
		huawei,sensor_name = "OV08A10";
		huawei,is_fpga = <0>;
		huawei,pd_valid = <1>;
		huawei,sensor_index = <4>;
		huawei,csi_index = <1>;
		huawei,i2c_index = <2>;
		huawei,reset_valid = <1>;
		/*cdphy-csi2*/
		huawei,phyinfo_valid = <1>;
		huawei,is_master_sensor = <1>;
		huawei,phy_id = <3>;
		huawei,phy_mode = <0>;
		huawei,phy_freq_mode = <0>;
		huawei,phy_freq = <80000000>;
		huawei,phy_work_mode = <2>;
		clock-names = "clk_rxdphy3_cfg", "clk_isp_snclk2";
		clocks = <&clk_gate_rxdphy3_cfg &clk_gate_isp_snclk2 >;
		huawei,mclk = <19200000>;
		huawei,rxdphyclk = <80000000>;
		huawei,phyclk = <80000000>;
		phy-clock-num = <1>;
		huawei,vcmpd_valid = <0>;
		dvdd-supply = <&ldo38>;
		iovdd-supply = <&ldo21>;
		huawei,ldo-names = "dvdd","iovdd";

		gpios = <&gpio1 6 0 &gpio17 0 0>;
		huawei,gpio-ctrl-types = "reset", "vcm_pwdn";
};

	&huawei_ov9282 {
		compatible = "huawei,ov9282";
		huawei,sensor_name = "OV9282";
		huawei,is_fpga = <0>;
		huawei,pd_valid = <1>;
		huawei,sensor_index = <10>;//HWSENSOR_POSITION_IR4STRUCTURELIGHT = 10
		huawei,csi_index = <1>;
		huawei,i2c_index = <0>;
		huawei,reset_valid = <1>;
		huawei,vcmpd_valid = <0>;
		/*cdphy-csi2*/
		huawei,phyinfo_valid = <1>;
		huawei,is_master_sensor = <1>;
		huawei,phy_id = <3>;
		huawei,phy_mode = <0>;
		huawei,phy_freq_mode = <0>;
		huawei,phy_freq = <80000000>;
		huawei,phy_work_mode = <1>;
		clocks = <&clk_gate_rxdphy0_cfg &clk_gate_rxdphy1_cfg &clk_gate_rxdphy2_cfg &clk_gate_rxdphy3_cfg &clk_gate_isp_snclk0>;
		clock-names = "clk_rxdphy0_cfg", "clk_rxdphy1_cfg", "clk_rxdphy2_cfg", "clk_rxdphy3_cfg", "clk_isp_snclk0";
		huawei,mclk = <19200000>;
		huawei,rxdphyclk = <80000000>;
		huawei,phyclk = <80000000>;
		phy-clock-num = <4>;
		dvdd-supply = <&ldo32>;
		iovdd-supply = <&ldo21>;
		huawei,ldo-names = "dvdd", "iovdd";
		gpios = <&gpio21 1 0>;
		huawei,gpio-ctrl-types = "reset";
		module_type = <0>;/*bit0=enable ,other bits=type*/
		huawei,topology_type = <0>;
		status = "ok";
	};

	&huawei_ov9286 {
		compatible = "huawei,ov9286";
		huawei,sensor_name = "OV9286";
		huawei,is_fpga = <0>;
		huawei,pd_valid = <1>;
		huawei,sensor_index = <10>;//HWSENSOR_POSITION_IR4STRUCTURELIGHT = 10
		huawei,csi_index = <1>;
		huawei,i2c_index = <0>;
		huawei,reset_valid = <1>;
		huawei,vcmpd_valid = <0>;
		/*cdphy-csi2*/
		huawei,phyinfo_valid = <1>;
		huawei,is_master_sensor = <1>;
		huawei,phy_id = <3>;
		huawei,phy_mode = <0>;
		huawei,phy_freq_mode = <0>;
		huawei,phy_freq = <80000000>;
		huawei,phy_work_mode = <1>;
		clocks = <&clk_gate_rxdphy0_cfg &clk_gate_rxdphy1_cfg &clk_gate_rxdphy2_cfg &clk_gate_rxdphy3_cfg &clk_gate_isp_snclk0>;
		clock-names = "clk_rxdphy0_cfg", "clk_rxdphy1_cfg", "clk_rxdphy2_cfg", "clk_rxdphy3_cfg", "clk_isp_snclk0";
		huawei,mclk = <19200000>;
		huawei,rxdphyclk = <80000000>;
		huawei,phyclk = <80000000>;
		phy-clock-num = <4>;
		dvdd-supply = <&ldo32>;
		iovdd-supply = <&ldo21>;
		huawei,ldo-names = "dvdd", "iovdd";
		gpios = <&gpio21 1 0>;
		huawei,gpio-ctrl-types = "reset";
		module_type = <0>;/*bit0=enable ,other bits=type*/
		huawei,topology_type = <0>;
		status = "ok";
	};

	&huawei_drvic_mp3336{
		compatible = "huawei,drv_ic_mp3336";
		huawei,driveric_name = "DRVIC_MP3336";
		huawei,position  = <0>;//0 for driver ic 1, 1 for driver ic 2
		huawei,i2c_index = <0>;
		huawei,gpio_pin = <10 8>;
		status = "ok";
	};

	&huawei_drvic_mp3331{
		compatible = "huawei,drv_ic_mp3331";
		huawei,driveric_name = "DRVIC_MP3331";
		huawei,position  = <1>;//0 for driver ic 1, 1 for driver ic 2
		huawei,i2c_index = <0>;
		huawei,gpio_pin = <10>;
		status = "ok";
	};

	&huawei_drvic_lm3644_1{
		compatible = "huawei,drv_ic_lm3644_1";
		huawei,driveric_name = "DRVIC_LM3644";
		huawei,position  = <0>;//0 for driver ic 1, 1 for driver ic 2
		huawei,i2c_index = <0>;
		huawei,gpio_pin = <10 8>;
		status = "ok";
	};

	&huawei_drvic_lm3644_2{
		compatible = "huawei,drv_ic_lm3644_2";
		huawei,driveric_name = "DRVIC_LM3644";
		huawei,position  = <1>;//0 for driver ic 1, 1 for driver ic 2
		huawei,i2c_index = <2>;
		huawei,gpio_pin = <10 8>;
		status = "ok";
	};

	&huawei_dot_cyc8 {
		compatible = "huawei,dot_cyc8";
		huawei,dot_name = "CYC8";
		huawei,i2c_index = <0>;
		huawei,gpio_pin = <185>;
		status = "ok";
	};

        &huawei_fpga_ice40 {
                compatible = "huawei,fpga_ice40";
                huawei,fpga_name = "ICE40";
                status = "ok";
        };

	&huawei_imx319 {
		status = "disabled";
	};

	&huawei_imx576 {
		compatible = "huawei,imx576_laya";
		huawei,sensor_name = "IMX576";
		huawei,is_fpga = <0>;
		huawei,pd_valid = <1>;
		huawei,sensor_index = <1>;
		huawei,csi_index = <0>;
		huawei,i2c_index = <1>;
		huawei,reset_valid = <1>;
		/*cdphy-csi2*/
		huawei,phyinfo_valid = <1>;
		huawei,is_master_sensor = <1>;
		huawei,phy_id = <1>;
		huawei,phy_mode = <0>;
		huawei,phy_freq_mode = <0>;
		huawei,phy_freq = <80000000>;
		huawei,phy_work_mode = <0>;
		clocks = <&clk_gate_isp_snclk0 &clk_gate_rxdphy0_cfg &clk_gate_rxdphy1_cfg &clk_gate_rxdphy2_cfg &clk_gate_rxdphy3_cfg>;
		clock-names = "clk_isp_snclk0", "clk_rxdphy0_cfg", "clk_rxdphy1_cfg", "clk_rxdphy2_cfg", "clk_rxdphy3_cfg";
		huawei,mclk = <19200000>;
		huawei,rxdphyclk = <80000000>;
		huawei,phyclk = <80000000>;
		phy-clock-num = <4>;
		huawei,vcmpd_valid = <0>;
		iovdd-supply = <&ldo21>;
		huawei,ldo-names = "iovdd";
		gpios = < &gpio2 1 0>;
		huawei,gpio-ctrl-types = "reset";
		status = "ok";
	};

	&rsvmem {
		supersonic {
			status = "ok";
		};
	};

	&fingerprint {
		compatible = "fpc,fingerprint";
		spi-max-frequency = <5000000>;
		fingerprint,product = "laya";

		fingerprint,navigation_adjust1 = <0>;
		fingerprint,navigation_adjust2 = <0>;

		fingerprint,reset_gpio_ud = <238>;
		fingerprint,irq_gpio_ud = <198>;
		fingerprint,cs_gpio_ud = <217>;

		fingerprint,reset_gpio = <238>;
		fingerprint,irq_gpio = <226>;
		fingerprint,cs_gpio = <217>;
		fingerprint,spi_num = <2>;
		fingerprint,force_storage_type = <1>;

		fingerprint,sensor_type = <516>;

		fingerprint,top_left_corner_x = <459>; /*only for UD*/
		fingerprint,top_left_corner_y = <653>; /*only for UD*/
		fingerprint,bottom_right_corner_x = <541>; /*only for UD*/
		fingerprint,bottom_right_corner_y = <692>; /*only for UD*/
		fingerprint,tp_hover_support = <1>;

		fingerprint,extern_ldo_name = "EXTERN_LDO";
		fingerprint,extern_ldo_num = <34>;
		fingreprint_ldo-supply = <&ldo34>;
		fingerprint,extern_vol = <3300000>;
		fingerprint,custom_timing_scheme = <2>; /*1:vdd->1ms->rst/cs; 2:vdd->10ms->rst/cs; 3:vdd->10ms->cs->600us->rst; 4:vdd->rst1/cs1/rst/cs0*/
	};

    /*hisi power*/
    &hi110x {
        hi110x,subchip_type="hi1103";
        hi110x,gpio_power_on = <&gpio32 2 0>;                /*GPIO_258*/
        hi110x,gpio_bfgx_power_on = <&gpio25 2 0>;           /*GPIO_202*/
        hi110x,gpio_wlan_power_on = <&gpio25 0 0>;           /*GPIO_200*/

        hi110x,gpio_ssi_clk  = <&gpio33 1 0>;                /*GPIO_265*/
        hi110x,gpio_ssi_data = <&gpio33 2 0>;                /*GPIO_266*/

        huawei,pmu_clk32b = "clk_pmu32kb";
        hi110x,asic_version;
    };

    /*hisi wifi*/
    &hisi_wifi {
        hi110x,gpio_wlan_wakeup_host =  <&gpio31 4 0>;       /*GPIO_252*/
        hi110x,gpio_host_wakeup_wlan =  <&gpio32 7 0>;       /*GPIO_263*/
    };

    /*hisi bfgx*/
    &hisi_bfgx {
        hi110x,gpio_bfgx_wakeup_host = <&gpio25 6 0>;        /*GPIO_206*/
        hi110x,uart_port = "/dev/ttyAMA4";
        hi110x,uart_pclk_normal;
    };

    /*hisi customize*/
    &hisi_cust_cfg {
        ini_file_name = "/vendor/etc/cfg_laya_tugl_va.ini";
    };

    /*hisi gps*/
    &hisi_gps {
        clocks = <&clk_gate_gps_ref>, <&clk_mux_gps_ref>, <&clk_gate_mdm2gps0>, <&clk_gate_mdm2gps1>, <&clk_gate_mdm2gps2>;
        clock-names = "ref_clk", "mux_clk", "mdm_clk0", "mdm_clk1", "mdm_clk2";
        /*hisi gps iomux config*/
        pinctrl-names = "default", "idle";
        pinctrl-0 = <&gpio248_pmx_func &gpio248_cfg_func>;
        pinctrl-1 = <&gpio248_pmx_idle &gpio248_cfg_idle>;
    };

    /*hisi gps sync*/
    &hisi_gps_sync {
        version = <1>;
        /*sync register configuration*/
        addr_base = <0xfff11000>;
        addr_offset = <0x0b8>;
    };

	/*nfc*/
	&nfc_exist {
		nfc_exist_flag = "1";
		hisee_exist_flag = "1";
		status = "ok";
	};

    /*irda*/
    &irda {
        compatible = "irda,config";
        irda,chiptype = <2>; /*hi110x*/
    };

    &irda_maxim {
        compatible = "huawei,irda_maxim";
        irda,power_type = <3>;
        status = "ok";
    };


&spmi {
    pmic@0 {
        sim0 {
            status = "ok";
            det_normal_direction = "closed";
            allocate_gpio = <0>;
            shared_det_irq = <1>;
            card_tray_style = <1>;
            det_high_debounce_wait_time = <400>;
            det_low_debounce_wait_time = <300>;
            factory_send_msg_to_cp = <1>;
            mux_sdsim = <0>;
        };

        sim1 {
            status = "ok";
            det_normal_direction = "closed";
            allocate_gpio = <0>;
            shared_det_irq = <1>;
            card_tray_style = <1>;
            det_high_debounce_wait_time = <400>;
            det_low_debounce_wait_time = <300>;
            factory_send_msg_to_cp = <1>;
            mux_sdsim = <1>;
        };
    };
};

&secfacedetect {
    status = "ok";
};
&hisi_iris_static_cma {
    status = "ok";
};
&hisi_algo_static_cma {
    status = "ok";
};
&vibrator_hw_config {
	compatible = "huawei,hw_vibrator";
	status = "ok";
};
