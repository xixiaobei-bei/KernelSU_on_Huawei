/* DO NOT EDIT - Automatically generated by python */
		&desayatl_3900_39k_4400_16 {
			fcc = <3900>;
			default_rbatt_mohm = <100>;
			identify_type = "id_volt";
			id_identify_min = <1235>;
			id_identify_max = <1759>;
			id_voltage_min = <1420>;
			id_voltage_max = <1562>;
			vbat_max = <4400>;
			temp_para = 
						"-32767","0","-1","0","4100","0",
						"0","5","-1","390","4400","0",
						"5","10","-1","1170","4400","3",
						"10","45","-1","-1","4400","3",
						"45","50","-1","1365","4100","3",
						"50","32767","-1","0","4100","0";
			vbat_para = 
						"-32767","3400","-1","820","0",
						"3400","32767","-1","-1","0";
			segment_para = 
						"-32767","4150","3900","4208","50",
						"4150","4450","2730","4400","0";
			batt_brand = "desayatl";
			fcc_temp = <3838 3835 3840 3848 3842 3812>;
			fcc_sf_x = <0 100 200 300 400 500 600 700 800 1000 1500>;
			fcc_sf_y = <100 96 94 92 90 88 87 84 81 75 50>;
			fcc_sf_cols = <11>;
			pc_sf_rows = <1>;
			pc_sf_cols = <1>;
			pc_sf_row_entries = <0>;
			pc_sf_percent = <100>;
			pc_sf_sf = <100>;
			rbatt_sf_rows = <28>;
			rbatt_sf_cols = <6>;
			rbatt_sf_percent = <100 95 90 85 80 75 70 65 60 55 50 45 40 35 30 25 20 15 10 9 8 7 6 5 4 3 2 1>;
			rbatt_sf_sf = <
			               1741 1021 403 118 98 91
			               1720 1017 403 118 98 91
			               1592 993 403 120 99 91
			               1497 966 401 122 101 92
			               1453 952 407 126 104 94
			               1342 928 438 132 107 96
			               1287 850 404 139 112 99
			               1271 849 392 148 119 102
			               1255 831 372 146 123 107
			               1243 818 355 118 100 93
			               1262 832 354 116 98 92
			               1294 865 357 118 100 92
			               1332 906 375 122 103 95
			               1381 949 406 127 107 99
			               1442 1003 448 128 108 96
			               1512 1070 493 120 99 93
			               1604 1151 551 121 100 95
			               1726 1245 624 123 101 95
			               1911 1375 749 127 103 96
			               2185 1291 598 129 106 99
			               2627 1247 571 130 106 102
			               2895 1377 630 128 106 100
			               3148 1551 704 127 104 97
			               3392 1689 774 124 102 94
			               3648 1773 820 127 102 96
			               3928 1947 909 132 104 97
			               4297 2203 1037 139 108 97
			               4900 2619 1232 338 129 104
			              >;
			pc_temp_ocv_rows = <29>;
			pc_temp_ocv_cols = <6>;
			pc_temp_ocv_percent = <100 95 90 85 80 75 70 65 60 55 50 45 40 35 30 25 20 15 10 9 8 7 6 5 4 3 2 1>;
			pc_temp_ocv_ocv = <
			                   4340 4338 4336 4331 4325 4320
			                   4249 4258 4266 4273 4268 4263
			                   4182 4194 4208 4217 4212 4208
			                   4126 4139 4153 4163 4159 4155
			                   4081 4091 4103 4112 4107 4104
			                   4008 4037 4060 4063 4059 4056
			                   3952 3968 3996 4016 4013 4011
			                   3913 3928 3951 3972 3972 3970
			                   3877 3886 3906 3928 3929 3928
			                   3845 3849 3865 3878 3878 3878
			                   3825 3825 3835 3849 3848 3848
			                   3810 3810 3812 3825 3826 3825
			                   3797 3800 3797 3806 3807 3805
			                   3785 3790 3787 3790 3790 3789
			                   3772 3781 3779 3774 3773 3766
			                   3757 3768 3768 3755 3749 3738
			                   3742 3749 3750 3736 3729 3717
			                   3725 3722 3721 3708 3703 3689
			                   3703 3702 3695 3688 3681 3671
			                   3697 3697 3690 3686 3680 3668
			                   3689 3691 3685 3684 3678 3666
			                   3680 3685 3682 3680 3675 3663
			                   3667 3678 3674 3669 3667 3653
			                   3647 3662 3657 3640 3643 3628
			                   3615 3628 3622 3595 3602 3588
			                   3566 3578 3571 3537 3550 3536
			                   3498 3508 3502 3457 3480 3470
			                   3397 3406 3401 3345 3380 3373
			                   3200 3200 3200 3200 3200 3200
			                  >;
		};
