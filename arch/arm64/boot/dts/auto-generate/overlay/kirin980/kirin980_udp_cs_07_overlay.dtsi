/**
 * Copyright (C) 2014 Hisilicon Ltd.
 *
 *  This program is free software; you can redistribute it and/or modify
 *  it under the terms of the GNU General Public License version 2 as
 *  publishhed by the Free Software Foundation.
 */

/include/ "kirin980_udp_default_cs_overlay.dtsi"

/ {
    board_id = <8017>;
};

	&rootparam{
		hisi,boardid = <8 0 1 7>;
		hisi,boardname = "kirin980_udp_cs_07";
		hisi,product_id = <0x37F5FC17>;
	};
