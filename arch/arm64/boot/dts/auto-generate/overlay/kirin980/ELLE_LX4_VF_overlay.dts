/**
 * Copyright (C) 2014 Hisilicon Ltd.
 *
 *  This program is free software; you can redistribute it and/or modify
 *  it under the terms of the GNU General Public License version 2 as
 *  publishhed by the Free Software Foundation.
 */

/dts-v1/;
/plugin/;
/include/ "ELLE_LX4_VD_overlay.dtsi"
/include/ "ELLE_LX4_VF_pin.dtsi"
/include/ "ELLE_LX4_VF_modem_pin.dtsi"

/ {
    board_id = <8554>;
};
    &rootparam{
		compatible = "hisilicon,vendor";
		hisi,boardid = <8 5 5 4>;
		hisi,boardname = "ELLE_LX4_VF";
		hisi,modem_id = <0x3704D000>;
		hisi,product_id = <0x3704D000>;
		hisi,product_name = "ELE-LX4";
	};
