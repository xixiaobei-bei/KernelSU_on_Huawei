/**
 * Copyright (C) 2014 Hisilicon Ltd.
 *
 *  This program is free software; you can redistribute it and/or modify
 *  it under the terms of the GNU General Public License version 2 as
 *  publishhed by the Free Software Foundation.
 */

/include/ "kirin980_fpga_cs_060_overlay.dtsi"

/ {
    board_id = <8042>;
};

	&rootparam{
		hisi,boardid = <8 0 4 2>;
		hisi,boardname = "kirin980_fpga_cs_070";
		hisi,product_id = <0x37F5FC12>;
	};

	&hisi_isp{
        compatible = "hisilicon,isplogic";
        hisi,isplogic = <1>;
    };
