/* DO NOT EDIT - Automatically generated by python */
		&scudmurata_4100_snCZ_4400_64 {
			fcc = <4100>;
			default_rbatt_mohm = <100>;
			identify_type = "id_sn";
			id_sn = "CZ";
			vbat_max = <4400>;
			temp_para = 
						"-32767","0","-1","0","4100","0",
						"0","5","-1","410","4400","0",
						"5","10","-1","1230","4400","3",
						"10","45","-1","-1","4400","3",
						"45","50","-1","1435","4100","3",
						"50","32767","-1","0","4100","0";
			vbat_para = 
						"-32767","3400","-1","820","0",
						"3400","32767","-1","-1","0";
			segment_para = 
						"-32767","4150","4100","4208","50",
						"4150","4450","2870","4400","0";
			batt_brand = "scudmurata";
			fcc_temp = <4060 4059 4051 4083 4064 4020>;
			fcc_sf_x = <0 100 200 300 400 500 600 700 800 1000 1500>;
			fcc_sf_y = <100 96 94 92 90 88 87 84 81 75 50>;
			fcc_sf_cols = <11>;
			pc_sf_rows = <1>;
			pc_sf_cols = <1>;
			pc_sf_row_entries = <0>;
			pc_sf_percent = <100>;
			pc_sf_sf = <100>;
			rbatt_sf_rows = <28>;
			rbatt_sf_cols = <6>;
			rbatt_sf_percent = <100 95 90 85 80 75 70 65 60 55 50 45 40 35 30 25 20 15 10 9 8 7 6 5 4 3 2 1>;
			rbatt_sf_sf = <
			               1697 921 441 141 101 84
			               1669 930 446 143 102 86
			               1626 927 447 146 103 87
			               1597 926 453 149 105 88
			               1568 927 456 155 107 90
			               1540 921 465 162 112 92
			               1526 911 452 171 119 95
			               1521 909 442 175 127 102
			               1518 915 437 161 121 97
			               1524 921 438 147 106 89
			               1544 933 444 143 102 88
			               1578 958 451 145 103 88
			               1621 994 464 149 105 89
			               1677 1039 485 154 111 94
			               1749 1095 512 155 107 90
			               1845 1168 545 149 105 88
			               1981 1267 595 152 108 92
			               2189 1439 662 156 109 91
			               4270 1923 664 165 115 97
			               4541 2037 684 165 115 97
			               4977 2207 714 169 114 98
			               5341 2371 761 174 119 100
			               5894 2652 822 181 116 98
			               6736 3080 878 184 120 104
			               7776 3492 966 198 128 104
			               10117 4255 1137 219 140 106
			               13748 4932 1478 248 157 117
			               23742 7256 2146 335 182 139
			              >;
			pc_temp_ocv_rows = <29>;
			pc_temp_ocv_cols = <6>;
			pc_temp_ocv_percent = <100 95 90 85 80 75 70 65 60 55 50 45 40 35 30 25 20 15 10 9 8 7 6 5 4 3 2 1>;
			pc_temp_ocv_ocv = <
			                   4334 4332 4330 4327 4321 4315
			                   4251 4264 4268 4268 4263 4257
			                   4183 4203 4209 4210 4205 4200
			                   4123 4143 4153 4153 4150 4146
			                   4061 4086 4098 4100 4097 4093
			                   4002 4031 4047 4050 4048 4045
			                   3951 3976 3991 4004 4002 4000
			                   3908 3926 3941 3959 3960 3959
			                   3868 3885 3899 3911 3913 3911
			                   3835 3850 3863 3871 3871 3870
			                   3810 3822 3834 3841 3841 3841
			                   3789 3800 3810 3818 3819 3818
			                   3769 3783 3792 3800 3801 3799
			                   3750 3767 3777 3785 3786 3783
			                   3732 3749 3764 3770 3765 3757
			                   3712 3730 3747 3750 3743 3731
			                   3690 3704 3725 3730 3724 3711
			                   3661 3675 3692 3702 3697 3684
			                   3631 3645 3664 3676 3670 3659
			                   3618 3637 3659 3672 3666 3655
			                   3610 3628 3653 3666 3661 3651
			                   3590 3615 3646 3658 3654 3644
			                   3570 3605 3635 3644 3640 3629
			                   3555 3590 3618 3616 3611 3598
			                   3522 3557 3584 3572 3568 3556
			                   3484 3505 3528 3516 3514 3503
			                   3426 3442 3454 3443 3445 3435
			                   3331 3342 3347 3348 3347 3340
			                   3200 3200 3200 3200 3200 3200
			                  >;
		};
