/**
 * Copyright (C) 2014 Hisilicon Ltd.
 *
 *  This program is free software; you can redistribute it and/or modify
 *  it under the terms of the GNU General Public License version 2 as
 *  publishhed by the Free Software Foundation.
 */

/include/ "ELLE_TUGL_VF_overlay.dtsi"

/ {
    board_id = <8546>;
};
    &rootparam{
		compatible = "hisilicon,vendor";
		hisi,boardid = <8 5 4 6>;
		hisi,boardname = "ELLE_TUGL_DIV_VA";
		hisi,modem_id = <0x37045400>;
		hisi,product_id = <0x37045400>;
		hisi,product_name = "ELE-AL00";
	};
