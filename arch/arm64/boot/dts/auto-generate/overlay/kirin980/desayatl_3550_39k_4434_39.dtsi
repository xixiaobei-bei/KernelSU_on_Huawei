/* DO NOT EDIT - Automatically generated by python */
		&desayatl_3550_39k_4434_39 {
			fcc = <3550>;
			default_rbatt_mohm = <100>;
			identify_type = "id_volt";
			id_identify_min = <1235>;
			id_identify_max = <1759>;
			id_voltage_min = <1420>;
			id_voltage_max = <1562>;
			vbat_max = <4434>;
			temp_para = 
						"-32767","0","-1","0","4100","0",
						"0","5","-1","355","4434","0",
						"5","10","-1","1065","4434","3",
						"10","45","-1","-1","4434","3",
						"45","50","-1","1242","4100","3",
						"50","32767","-1","0","4100","0";
			vbat_para = 
						"-32767","3400","-1","820","0",
						"3400","32767","-1","-1","0";
			segment_para = 
						"-32767","4150","3550","4208","50",
						"4150","4450","2485","4434","0";
			batt_brand = "desayatl";
			fcc_temp = <3535 3539 3536 3545 3491 3503>;
			fcc_sf_x = <0 100 200 300 400 500 600 700 800 1000 1500>;
			fcc_sf_y = <100 96 94 92 90 88 87 84 81 75 50>;
			fcc_sf_cols = <11>;
			pc_sf_rows = <1>;
			pc_sf_cols = <1>;
			pc_sf_row_entries = <0>;
			pc_sf_percent = <100>;
			pc_sf_sf = <100>;
			rbatt_sf_rows = <28>;
			rbatt_sf_cols = <6>;
			rbatt_sf_percent = <100 95 90 85 80 75 70 65 60 55 50 45 40 35 30 25 20 15 10 9 8 7 6 5 4 3 2 1>;
			rbatt_sf_sf = <
			               1489 1181 523 153 128 113
			               1477 1173 529 153 128 113
			               1448 1135 526 152 129 114
			               1414 1091 511 153 129 115
			               1376 1059 498 155 131 117
			               1355 1030 505 158 133 117
			               1318 996 513 165 137 119
			               1255 960 504 177 144 123
			               1241 937 474 180 146 124
			               1234 904 442 160 134 118
			               1250 895 426 149 128 114
			               1299 935 417 150 128 115
			               1377 1023 429 152 131 116
			               1482 1149 479 157 135 119
			               1595 1287 562 157 133 118
			               1699 1396 680 149 128 114
			               1803 1475 827 146 127 116
			               1962 1551 1020 149 127 114
			               3131 1714 782 147 133 116
			               3495 1974 878 149 135 120
			               3964 2268 996 149 134 118
			               4486 2626 1144 149 134 124
			               5157 3059 1374 155 136 120
			               6206 3659 1689 154 129 117
			               7930 4634 2095 152 134 120
			               13175 6487 2821 156 134 123
			               27573 12452 4417 166 135 125
			               55210 34821 8347 193 142 135
			              >;
			pc_temp_ocv_rows = <29>;
			pc_temp_ocv_cols = <6>;
			pc_temp_ocv_percent = <100 95 90 85 80 75 70 65 60 55 50 45 40 35 30 25 20 15 10 9 8 7 6 5 4 3 2 1>;
			pc_temp_ocv_ocv = <
			                   4389 4386 4384 4382 4375 4373
			                   4309 4313 4322 4324 4317 4315
			                   4244 4250 4264 4268 4261 4259
			                   4184 4190 4205 4210 4203 4202
			                   4123 4131 4146 4153 4147 4146
			                   4070 4076 4093 4099 4094 4093
			                   4013 4020 4043 4048 4044 4044
			                   3948 3965 3992 4003 3999 3999
			                   3902 3918 3939 3953 3951 3952
			                   3860 3869 3889 3903 3902 3904
			                   3829 3831 3850 3865 3866 3868
			                   3812 3810 3819 3839 3840 3841
			                   3799 3799 3799 3817 3819 3819
			                   3785 3788 3789 3800 3801 3801
			                   3770 3777 3778 3783 3781 3777
			                   3750 3762 3765 3762 3757 3747
			                   3728 3742 3744 3741 3734 3723
			                   3707 3713 3712 3713 3708 3696
			                   3683 3679 3680 3691 3686 3675
			                   3676 3673 3677 3690 3684 3673
			                   3671 3670 3673 3688 3682 3671
			                   3663 3667 3667 3685 3679 3668
			                   3654 3660 3658 3678 3671 3658
			                   3639 3646 3640 3657 3646 3631
			                   3606 3616 3603 3616 3606 3590
			                   3566 3565 3548 3561 3555 3538
			                   3498 3497 3475 3489 3485 3469
			                   3389 3394 3373 3384 3383 3370
			                   3200 3200 3200 3200 3200 3200
			                  >;
		};
