/* DO NOT EDIT - Automatically generated by python */
		&desayatl_3400_snYT_4400_25 {
			fcc = <3400>;
			default_rbatt_mohm = <100>;
			identify_type = "id_sn";
			id_sn = "YT";
			vbat_max = <4400>;
			temp_para = 
						"-32767","0","-1","0","4100","0",
						"0","5","-1","340","4400","0",
						"5","10","-1","1020","4400","3",
						"10","45","-1","-1","4400","3",
						"45","50","-1","1190","4100","3",
						"50","32767","-1","0","4100","0";
			vbat_para = 
						"-32767","3400","-1","820","0",
						"3400","32767","-1","-1","0";
			segment_para = 
						"-32767","4150","3400","4208","50",
						"4150","4450","2380","4400","0";
			batt_brand = "desayatl";
			fcc_temp = <3420 3387 3387 3369 3363 3328>;
			fcc_sf_x = <0 100 200 300 400 500 600 700 800 1000 1500>;
			fcc_sf_y = <100 96 94 92 90 88 87 84 81 75 50>;
			fcc_sf_cols = <11>;
			pc_sf_rows = <1>;
			pc_sf_cols = <1>;
			pc_sf_row_entries = <0>;
			pc_sf_percent = <100>;
			pc_sf_sf = <100>;
			rbatt_sf_rows = <28>;
			rbatt_sf_cols = <6>;
			rbatt_sf_percent = <100 95 90 85 80 75 70 65 60 55 50 45 40 35 30 25 20 15 10 9 8 7 6 5 4 3 2 1>;
			rbatt_sf_sf = <
			               1474 1040 437 85 58 45
			               1460 1034 431 85 58 45
			               1418 1008 417 84 59 47
			               1382 978 410 85 60 48
			               1353 967 407 88 62 49
			               1341 966 424 92 64 51
			               1231 921 443 98 68 52
			               1191 865 408 111 74 57
			               1195 851 384 114 77 58
			               1183 837 365 95 65 48
			               1195 839 356 84 59 48
			               1254 872 357 85 61 50
			               1322 937 366 88 63 50
			               1405 1011 397 93 67 53
			               1504 1098 439 96 68 54
			               1618 1204 489 88 60 48
			               1750 1322 549 84 59 49
			               1907 1451 637 87 59 49
			               2463 1424 545 101 75 55
			               2694 1567 579 103 75 67
			               2970 1724 620 104 78 64
			               3205 1925 681 106 76 63
			               3536 2129 768 106 78 64
			               3877 2295 808 111 84 73
			               4268 2491 852 122 96 85
			               4774 2806 967 134 114 89
			               5619 3267 1125 143 129 97
			               6555 3412 1425 164 157 124
			              >;
			pc_temp_ocv_rows = <29>;
			pc_temp_ocv_cols = <6>;
			pc_temp_ocv_percent = <100 95 90 85 80 75 70 65 60 55 50 45 40 35 30 25 20 15 10 9 8 7 6 5 4 3 2 1>;
			pc_temp_ocv_ocv = <
			                   4377 4371 4371 4367 4364 4358
			                   4292 4297 4305 4309 4307 4301
			                   4225 4234 4244 4251 4251 4245
			                   4166 4175 4188 4195 4195 4190
			                   4112 4122 4134 4140 4140 4136
			                   4061 4073 4085 4089 4088 4084
			                   3982 4011 4033 4039 4039 4036
			                   3929 3951 3972 3993 3994 3992
			                   3893 3908 3926 3947 3948 3947
			                   3855 3866 3883 3897 3897 3895
			                   3825 3833 3848 3861 3862 3862
			                   3810 3812 3821 3835 3837 3836
			                   3798 3800 3801 3815 3815 3814
			                   3786 3790 3790 3798 3798 3796
			                   3774 3780 3781 3782 3779 3775
			                   3757 3768 3769 3762 3753 3742
			                   3738 3748 3749 3740 3730 3719
			                   3718 3721 3720 3715 3705 3693
			                   3697 3693 3692 3691 3683 3672
			                   3689 3688 3689 3690 3682 3670
			                   3681 3682 3685 3688 3680 3668
			                   3672 3678 3681 3685 3676 3664
			                   3657 3670 3673 3678 3666 3652
			                   3633 3652 3653 3655 3641 3625
			                   3595 3617 3614 3616 3599 3584
			                   3539 3563 3559 3563 3547 3532
			                   3470 3490 3484 3493 3478 3462
			                   3369 3387 3380 3387 3375 3363
			                   3200 3200 3200 3200 3200 3200
			                  >;
		};
