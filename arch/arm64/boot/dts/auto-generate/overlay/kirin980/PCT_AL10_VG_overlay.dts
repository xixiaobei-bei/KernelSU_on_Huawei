/**
 * Copyright (C) 2014 Hisilicon Ltd.
 *
 *  This program is free software; you can redistribute it and/or modify
 *  it under the terms of the GNU General Public License version 2 as
 *  publishhed by the Free Software Foundation.
 */

/dts-v1/;
/plugin/;
/include/ "PCT_AL10_VF_overlay.dtsi"
/include/ "PCT_AL10_VG_pin.dtsi"
/include/ "PCT_AL10_VG_modem_pin.dtsi"

/ {
    board_id = <8941>;
};

	&rootparam{
		hisi,boardid = <8 9 4 1>;
		hisi,boardname = "PCT_AL10_VG";
		hisi,modem_id = <0x37615000>;
	};

	&huawei_imx316{
		huawei,ext_type = <2>;
		huawei,ext_name = "oflim_lumentum_no_coating", "sunny_lumentum_no_coating", "ofilm_vertilite_no_coating", "sunny_ams_no_coating";
		status = "ok";
	};