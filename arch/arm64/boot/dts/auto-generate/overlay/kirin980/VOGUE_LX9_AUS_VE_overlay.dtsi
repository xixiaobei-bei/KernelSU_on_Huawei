/**
 * Copyright (C) 2014 Hisilicon Ltd.
 *
 *  This program is free software; you can redistribute it and/or modify
 *  it under the terms of the GNU General Public License version 2 as
 *  publishhed by the Free Software Foundation.
 */

/include/ "VOGUE_LX9_VE_overlay.dtsi"

/ {
    board_id = <8547>;
};
    &rootparam{
		compatible = "hisilicon,vendor";
		hisi,boardid = <8 5 4 7>;
		hisi,boardname = "VOGUE_LX9_AUS_VE";
		hisi,modem_id = <0x3705E000>;
		hisi,product_id = <0x3705E000>;
		hisi,product_name = "VOG-LX9";
	};

