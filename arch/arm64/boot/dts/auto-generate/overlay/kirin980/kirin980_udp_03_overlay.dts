/**
 * Copyright (C) 2014 Hisilicon Ltd.
 *
 *  This program is free software; you can redistribute it and/or modify
 *  it under the terms of the GNU General Public License version 2 as
 *  publishhed by the Free Software Foundation.
 */

/dts-v1/;
/plugin/;
/include/ "kirin980_udp_default_overlay.dtsi"
/include/ "kirin980_udp_03_pin.dtsi"
/include/ "kirin980_udp_03_modem_pin.dtsi"

/ {
    board_id = <8003>;
};

	&rootparam{
		hisi,boardid = <8 0 0 3>;
		hisi,boardname = "kirin980_udp_03";
		hisi,product_id = <0x37F5FC03>;
	};