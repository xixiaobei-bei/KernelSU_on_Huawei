/**
 * Copyright (C) 2014 Hisilicon Ltd.
 *
 *  This program is free software; you can redistribute it and/or modify
 *  it under the terms of the GNU General Public License version 2 as
 *  publishhed by the Free Software Foundation.
 */

/include/ "EVER_TUGL_VH_overlay.dtsi"

/  {
    board_id = <8466>;
};

	&rootparam{
		hisi,boardid = <8 4 6 6>;
		hisi,boardname = "EVER_TUGL_VJ";
		hisi,modem_id = <0x37021000>;
	};
	&huawei_lcd_panel {
		compatible = "huawei,lcd_panel_type";
		board_version = <1000>;
	};