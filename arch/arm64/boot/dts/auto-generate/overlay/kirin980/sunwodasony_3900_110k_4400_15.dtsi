/* DO NOT EDIT - Automatically generated by python */
		&sunwodasony_3900_110k_4400_15 {
			fcc = <3900>;
			default_rbatt_mohm = <100>;
			identify_type = "id_volt";
			id_identify_min = <2281>;
			id_identify_max = <2786>;
			id_voltage_min = <2426>;
			id_voltage_max = <2631>;
			vbat_max = <4400>;
			temp_para = 
						"-32767","0","-1","0","4100","0",
						"0","5","-1","390","4400","0",
						"5","10","-1","1170","4400","3",
						"10","45","-1","-1","4400","3",
						"45","50","-1","1365","4100","3",
						"50","32767","-1","0","4100","0";
			vbat_para = 
						"-32767","3400","-1","820","0",
						"3400","32767","-1","-1","0";
			segment_para = 
						"-32767","4150","3900","4208","50",
						"4150","4450","2730","4400","0";
			batt_brand = "sunwodasony";
			fcc_temp = <3826 3839 3851 3895 3871 3854>;
			fcc_sf_x = <0 100 200 300 400 500 600 700 800 1000 1500>;
			fcc_sf_y = <100 96 94 92 90 88 87 84 81 75 50>;
			fcc_sf_cols = <11>;
			pc_sf_rows = <1>;
			pc_sf_cols = <1>;
			pc_sf_row_entries = <0>;
			pc_sf_percent = <100>;
			pc_sf_sf = <100>;
			rbatt_sf_rows = <28>;
			rbatt_sf_cols = <6>;
			rbatt_sf_percent = <100 95 90 85 80 75 70 65 60 55 50 45 40 35 30 25 20 15 10 9 8 7 6 5 4 3 2 1>;
			rbatt_sf_sf = <
			               1354 673 331 126 100 90
			               1353 676 333 126 100 90
			               1341 689 343 130 102 90
			               1314 693 351 134 105 91
			               1319 690 357 139 107 93
			               1296 704 368 146 111 95
			               1266 675 358 153 116 98
			               1266 683 348 156 120 102
			               1269 686 339 144 117 102
			               1264 686 334 129 103 91
			               1286 697 336 128 100 90
			               1330 721 342 130 101 90
			               1376 761 352 135 105 92
			               1438 802 368 140 108 95
			               1518 853 400 140 109 93
			               1612 909 422 136 103 91
			               1754 995 455 136 104 94
			               2005 1170 507 136 105 94
			               3210 1640 658 141 106 95
			               3548 1561 545 142 106 95
			               4177 1584 533 142 106 96
			               5305 1811 599 144 108 97
			               6967 2277 692 146 108 96
			               9757 2851 810 146 107 94
			               16528 3739 931 149 108 96
			               30120 5566 1193 155 111 97
			               52237 10447 1623 228 117 102
			               76148 22158 2607 606 193 137
			              >;
			pc_temp_ocv_rows = <29>;
			pc_temp_ocv_cols = <6>;
			pc_temp_ocv_percent = <100 95 90 85 80 75 70 65 60 55 50 45 40 35 30 25 20 15 10 9 8 7 6 5 4 3 2 1>;
			pc_temp_ocv_ocv = <
			                   4339 4338 4335 4331 4322 4316
			                   4251 4262 4266 4269 4260 4255
			                   4181 4199 4206 4210 4202 4197
			                   4115 4140 4147 4153 4146 4142
			                   4066 4082 4092 4099 4093 4089
			                   4010 4032 4042 4049 4044 4040
			                   3951 3973 3989 4002 3999 3996
			                   3905 3926 3940 3956 3955 3953
			                   3866 3884 3897 3909 3911 3909
			                   3828 3846 3859 3868 3868 3865
			                   3799 3815 3829 3839 3838 3836
			                   3776 3791 3805 3816 3816 3813
			                   3755 3774 3785 3797 3797 3795
			                   3736 3758 3769 3781 3781 3778
			                   3720 3744 3758 3764 3764 3756
			                   3701 3725 3742 3745 3740 3727
			                   3683 3700 3720 3723 3719 3706
			                   3660 3668 3686 3693 3690 3678
			                   3623 3633 3643 3663 3660 3649
			                   3614 3626 3638 3658 3655 3645
			                   3598 3614 3629 3651 3650 3640
			                   3579 3600 3621 3643 3643 3633
			                   3557 3586 3610 3628 3630 3619
			                   3530 3567 3593 3598 3603 3590
			                   3497 3532 3560 3551 3562 3547
			                   3453 3478 3507 3492 3507 3495
			                   3394 3402 3434 3417 3437 3427
			                   3314 3309 3330 3333 3343 3335
			                   3200 3200 3200 3200 3200 3200
			                  >;
		};
