/**
 * Copyright (C) 2014 Hisilicon Ltd.
 *
 *  This program is free software; you can redistribute it and/or modify
 *  it under the terms of the GNU General Public License version 2 as
 *  publishhed by the Free Software Foundation.
 */

/dts-v1/;
/plugin/;
/include/ "LAYA_TUGL_VD_overlay.dtsi"
/include/ "LAYA_TUGL_VF_pin.dtsi"
/include/ "LAYA_TUGL_VF_modem_pin.dtsi"

/ {
    board_id = <8436>;
};

	&rootparam{
		hisi,boardid = <8 4 3 6>;
		hisi,boardname = "LAYA_TUGL_VF";
		hisi,modem_id = <0x37011800>;
	};
