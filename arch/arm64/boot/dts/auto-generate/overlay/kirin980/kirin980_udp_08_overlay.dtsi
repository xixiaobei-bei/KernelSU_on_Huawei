/**
 * Copyright (C) 2014 Hisilicon Ltd.
 *
 *  This program is free software; you can redistribute it and/or modify
 *  it under the terms of the GNU General Public License version 2 as
 *  publishhed by the Free Software Foundation.
 */

/include/ "kirin980_udp_default_overlay.dtsi"

/ {
    board_id = <8008>;
};

	&rootparam{
		hisi,boardid = <8 0 0 8>;
		hisi,boardname = "kirin980_udp_08";
		hisi,product_id = <0x37F5FC08>;
	};