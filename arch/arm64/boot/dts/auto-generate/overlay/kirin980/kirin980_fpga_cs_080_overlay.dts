/**
 * Copyright (C) 2014 Hisilicon Ltd.
 *
 *  This program is free software; you can redistribute it and/or modify
 *  it under the terms of the GNU General Public License version 2 as
 *  publishhed by the Free Software Foundation.
 */

/dts-v1/;
/plugin/;
/include/ "kirin980_fpga_cs_060_overlay.dtsi"
/include/ "kirin980_fpga_cs_080_pin.dtsi"
/include/ "kirin980_fpga_cs_080_modem_pin.dtsi"

/ {
    board_id = <8044>;
};

	&rootparam{
		hisi,boardid = <8 0 4 4>;
		hisi,boardname = "kirin980_fpga_cs_080";
		hisi,product_id = <0x37F5FC14>;
	};

	&hisi_isp{
        compatible = "hisilicon,isplogic";
        hisi,isplogic = <1>;
    };
