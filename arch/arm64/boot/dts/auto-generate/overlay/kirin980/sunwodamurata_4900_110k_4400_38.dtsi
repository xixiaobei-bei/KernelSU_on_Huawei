/* DO NOT EDIT - Automatically generated by python */
		&sunwodamurata_4900_110k_4400_38 {
			fcc = <4900>;
			default_rbatt_mohm = <100>;
			identify_type = "id_volt";
			id_identify_min = <2281>;
			id_identify_max = <2786>;
			id_voltage_min = <2426>;
			id_voltage_max = <2631>;
			vbat_max = <4400>;
			temp_para = 
						"-32767","0","-1","0","4100","0",
						"0","5","-1","490","4400","0",
						"5","10","-1","1470","4400","3",
						"10","45","-1","-1","4400","3",
						"45","50","-1","1715","4100","3",
						"50","32767","-1","0","4100","0";
			vbat_para = 
						"-32767","3400","-1","820","0",
						"3400","32767","-1","-1","0";
			segment_para = 
						"-32767","4150","4900","4208","50",
						"4150","4450","3430","4400","0";
			batt_brand = "sunwodamurata";
			fcc_temp = <4849 4862 4910 4899 4890 4847>;
			fcc_sf_x = <0 100 200 300 400 500 600 700 800 1000 1500>;
			fcc_sf_y = <100 96 94 92 90 88 87 84 81 75 50>;
			fcc_sf_cols = <11>;
			pc_sf_rows = <1>;
			pc_sf_cols = <1>;
			pc_sf_row_entries = <0>;
			pc_sf_percent = <100>;
			pc_sf_sf = <100>;
			rbatt_sf_rows = <28>;
			rbatt_sf_cols = <6>;
			rbatt_sf_percent = <100 95 90 85 80 75 70 65 60 55 50 45 40 35 30 25 20 15 10 9 8 7 6 5 4 3 2 1>;
			rbatt_sf_sf = <
			               1084 561 299 101 84 78
			               1086 568 303 102 84 78
			               1088 578 312 104 86 80
			               1078 579 317 107 88 80
			               1063 579 317 111 90 81
			               1053 581 316 116 92 82
			               1044 577 312 122 97 85
			               1041 576 308 125 102 88
			               1045 586 306 116 97 86
			               1053 596 306 106 88 81
			               1071 608 309 103 85 79
			               1107 630 315 104 85 79
			               1150 666 323 107 87 80
			               1204 709 340 110 90 82
			               1274 763 364 111 89 83
			               1361 827 390 109 86 80
			               1491 920 430 108 88 81
			               1722 1096 492 109 88 82
			               2664 1243 472 109 88 82
			               3046 1365 496 108 89 83
			               3551 1560 537 111 90 84
			               4255 1808 597 112 90 84
			               5358 2142 668 115 90 84
			               6611 2653 801 117 90 83
			               9893 3494 924 119 89 83
			               19273 4909 1124 121 93 84
			               37313 8754 1530 127 95 86
			               67528 20648 2416 149 107 92
			              >;
			pc_temp_ocv_rows = <29>;
			pc_temp_ocv_cols = <6>;
			pc_temp_ocv_percent = <100 95 90 85 80 75 70 65 60 55 50 45 40 35 30 25 20 15 10 9 8 7 6 5 4 3 2 1>;
			pc_temp_ocv_ocv = <
			                   4346 4344 4344 4335 4331 4324
			                   4259 4267 4272 4271 4269 4261
			                   4189 4203 4212 4212 4211 4204
			                   4126 4140 4153 4155 4155 4148
			                   4065 4080 4095 4101 4101 4095
			                   4008 4024 4039 4050 4050 4045
			                   3956 3970 3985 4003 4004 4000
			                   3908 3922 3937 3958 3961 3958
			                   3867 3881 3895 3912 3915 3914
			                   3830 3846 3859 3871 3873 3871
			                   3800 3816 3829 3840 3841 3839
			                   3778 3792 3804 3817 3818 3816
			                   3758 3773 3783 3798 3799 3796
			                   3739 3757 3767 3782 3783 3780
			                   3722 3742 3754 3767 3764 3758
			                   3704 3724 3736 3749 3742 3730
			                   3686 3699 3714 3727 3721 3708
			                   3661 3669 3684 3698 3692 3681
			                   3627 3638 3651 3668 3663 3652
			                   3612 3627 3642 3663 3659 3648
			                   3595 3616 3634 3657 3654 3644
			                   3575 3605 3626 3650 3647 3637
			                   3563 3590 3613 3639 3635 3625
			                   3537 3570 3597 3617 3611 3598
			                   3505 3540 3568 3577 3569 3557
			                   3458 3489 3518 3523 3516 3505
			                   3398 3412 3448 3453 3447 3439
			                   3315 3318 3344 3356 3352 3347
			                   3200 3200 3200 3200 3200 3200
			                  >;
		};
