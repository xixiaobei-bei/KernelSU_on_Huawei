/* Copyright (c) 2013, The Linux Foundation. All rights reserved.
 *
 * This program is free software; you can redistribute it and/or modify
 * it under the terms of the GNU General Public License version 2 and
 * only version 2 as published by the Free Software Foundation.
 *
 * This program is distributed in the hope that it will be useful,
 * but WITHOUT ANY WARRANTY; without even the implied warranty of
 * MERCHANTABILITY or FITNESS FOR A PARTICULAR PURPOSE.  See the
 * GNU General Public License for more details.
 */

/*-------------------------------------------------------------------------
 * This file is autogenerated file using gcdb parser. Please do not edit it.
 * Update input XML file to add a new entry or update variable in this file
 * VERSION = 1.1
 *-----------------------------------------------------------------------*/
&huawei_lcd_config {
	dsi_hma_tugl_samsung_ea8074_6p01_1080plus_cmd: lcd_kit_hma_tugl_samsung_ea8074_6p01_1080plus_cmd {
		compatible = "samsung_ea8074_6p01_1080plus_cmd";
		lcd-kit,panel-name = "SAMSUNG_EA8074 6.01' CMD TFT 1080 x 2160";
		lcd-kit,panel-type = <0x02>;
		lcd-kit,panel-xres = <1080>;
		lcd-kit,panel-yres = <2160>;
		lcd-kit,panel-width = <68>;
		lcd-kit,panel-height = <136>;
		lcd-kit,panel-enter-aod-cmds = <0x39 0x01 0x00 0x00 0x64 0x01 0x03 0xF0 0x5A 0x5A
			       0x15 0x01 0x00 0x00 0x0a 0x00 0x02 0x53 0x22
			       0x39 0x01 0x00 0x00 0x11 0x01 0x03 0xF0 0xA5 0xA5>;
		lcd-kit,panel-exit-aod-cmds = <0x39 0x01 0x00 0x00 0x0a 0x00 0x03 0xF0 0x5A 0x5A
			       0x15 0x01 0x00 0x00 0x11 0x01 0x02 0x53 0x20
			       0x15 0x01 0x00 0x00 0x0a 0x00 0x02 0xF7 0x03
			       0x39 0x01 0x00 0x00 0x0a 0x00 0x03 0xF0 0xA5 0xA5>;
		lcd-kit,panel-aod-low-brightness-cmds = <0x39 0x01 0x00 0x00 0x64 0x01 0x03 0xF0 0x5A 0x5A
			       0x15 0x01 0x00 0x00 0x0a 0x00 0x02 0x53 0x23
			       0x39 0x01 0x00 0x00 0x11 0x01 0x03 0xF0 0xA5 0xA5>;
		lcd-kit,panel-on-cmds = <0x05 0x01 0x00 0x00 0x0a 0x01 0x02 0x11 0x00
			0x39 0x01 0x00 0x00 0x0a 0x00 0x05 0x2A 0x00 0x00 0x04 0x37
			0x39 0x01 0x00 0x00 0x0a 0x00 0x05 0x2B 0x00 0x00 0x08 0x6f
			0x15 0x01 0x00 0x00 0x0a 0x00 0x02 0x35 0x00
			0x15 0x01 0x00 0x00 0x0a 0x00 0x02 0x53 0x20
			0x39 0x01 0x00 0x00 0x0a 0x00 0x03 0x51 0x00 0x00
			0x15 0x01 0x00 0x00 0x0a 0x00 0x02 0x55 0x00
			0x39 0x01 0x00 0x00 0x0a 0x00 0x03 0xF0 0x5A 0x5A
			0x15 0x01 0x00 0x00 0x0a 0x00 0x02 0xB0 0x06
			0x15 0x01 0x00 0x00 0x0a 0x00 0x02 0xEF 0x35
			0x39 0x01 0x00 0x00 0x0a 0x00 0x03 0xCC 0x55 0x12
			0x39 0x01 0x00 0x00 0x0a 0x00 0x03 0xFC 0x5A 0x5A
                        0x15 0x01 0x00 0x00 0x0a 0x00 0x02 0xB0 0x05
                        0x15 0x01 0x00 0x00 0x0a 0x00 0x02 0xD2 0x40
			0x39 0x01 0x00 0x00 0x0a 0x00 0x03 0xFC 0xA5 0xA5
			0x39 0x01 0x00 0x00 0x6e 0x01 0x03 0xF0 0xA5 0xA5
			0x05 0x01 0x00 0x00 0x0a 0x00 0x02 0x2C 0x00
			0x05 0x01 0x00 0x00 0x0a 0x00 0x02 0x29 0x00>;
		lcd-kit,panel-on-cmds-state = "dsi_lp_mode";
		lcd-kit,panel-off-cmds = <0x05 0x01 0x00 0x00 0x01 0x01 0x02 0x28 0x00
			0x05 0x01 0x00 0x00 0x78 0x01 0x02 0x10 0x00>;
		lcd-kit,panel-off-cmds-state = "dsi_lp_mode";
		lcd-kit,panel-aod-on-cmds-state = "dsi_lp_mode";
		lcd-kit,panel-aod-low-brightness-cmds-state = "dsi_lp_mode";
		lcd-kit,panel-aod-off-cmds-state = "dsi_lp_mode";
		lcd-kit,backlight-cmds = <0x39 0x01 0x00 0x00 0x00 0x00 0x03 0x51 0x00 0x00>;
		lcd-kit,backlight-cmds-state = "dsi_lp_mode";
		lcd-kit,tp-color-cmds = <0x14 0x01 0x00 0x00 0x0a 0x00 0x01 0xdc>;
		lcd-kit,effect-on-cmds = <0x15 0x01 0x00 0x00 0x0a 0x00 0x02 0xFF 0x23
			0x15 0x01 0x00 0x00 0x0a 0x00 0x02 0xFB 0x01
			0x15 0x01 0x00 0x00 0x0a 0x00 0x02 0x00 0x02
			0x15 0x01 0x00 0x00 0x0a 0x00 0x02 0x01 0x84
			0x15 0x01 0x00 0x00 0x0a 0x00 0x02 0x05 0x24
			0x15 0x01 0x00 0x00 0x0a 0x00 0x02 0x19 0x00
			0x15 0x01 0x00 0x00 0x0a 0x00 0x02 0x1A 0x04
			0x15 0x01 0x00 0x00 0x0a 0x00 0x02 0x1B 0x08
			0x15 0x01 0x00 0x00 0x0a 0x00 0x02 0x1C 0x0C
			0x15 0x01 0x00 0x00 0x0a 0x00 0x02 0x1D 0x10
			0x15 0x01 0x00 0x00 0x0a 0x00 0x02 0x1E 0x14
			0x15 0x01 0x00 0x00 0x0a 0x00 0x02 0x1F 0x18
			0x15 0x01 0x00 0x00 0x0a 0x00 0x02 0x20 0x1C
			0x15 0x01 0x00 0x00 0x0a 0x00 0x02 0x21 0x20
			0x15 0x01 0x00 0x00 0x0a 0x00 0x02 0x22 0x24
			0x15 0x01 0x00 0x00 0x0a 0x00 0x02 0x23 0x28
			0x15 0x01 0x00 0x00 0x0a 0x00 0x02 0x24 0x2C
			0x15 0x01 0x00 0x00 0x0a 0x00 0x02 0x25 0x30
			0x15 0x01 0x00 0x00 0x0a 0x00 0x02 0x26 0x34
			0x15 0x01 0x00 0x00 0x0a 0x00 0x02 0x27 0x38
			0x15 0x01 0x00 0x00 0x0a 0x00 0x02 0x28 0x3C
			0x15 0x01 0x00 0x00 0x0a 0x00 0x02 0x29 0x24
			0x15 0x01 0x00 0x00 0x0a 0x00 0x02 0x2B 0x3D
			0x15 0x01 0x00 0x00 0x0a 0x00 0x02 0x30 0xFF
			0x15 0x01 0x00 0x00 0x0a 0x00 0x02 0x31 0xFD
			0x15 0x01 0x00 0x00 0x0a 0x00 0x02 0x32 0xFB
			0x15 0x01 0x00 0x00 0x0a 0x00 0x02 0x33 0xF9
			0x15 0x01 0x00 0x00 0x0a 0x00 0x02 0x34 0xF7
			0x15 0x01 0x00 0x00 0x0a 0x00 0x02 0x35 0xF5
			0x15 0x01 0x00 0x00 0x0a 0x00 0x02 0x36 0xF3
			0x15 0x01 0x00 0x00 0x0a 0x00 0x02 0x37 0xF1
			0x15 0x01 0x00 0x00 0x0a 0x00 0x02 0x38 0xEF
			0x15 0x01 0x00 0x00 0x0a 0x00 0x02 0x39 0xED
			0x15 0x01 0x00 0x00 0x0a 0x00 0x02 0x3A 0xEB
			0x15 0x01 0x00 0x00 0x0a 0x00 0x02 0x3B 0xE9
			0x15 0x01 0x00 0x00 0x0a 0x00 0x02 0x3D 0xE7
			0x15 0x01 0x00 0x00 0x0a 0x00 0x02 0x3F 0xE5
			0x15 0x01 0x00 0x00 0x0a 0x00 0x02 0x40 0xE3
			0x15 0x01 0x00 0x00 0x0a 0x00 0x02 0x41 0xE0
			0x15 0x01 0x00 0x00 0x0a 0x00 0x02 0x45 0xFF
			0x15 0x01 0x00 0x00 0x0a 0x00 0x02 0x46 0xFD
			0x15 0x01 0x00 0x00 0x0a 0x00 0x02 0x47 0xFB
			0x15 0x01 0x00 0x00 0x0a 0x00 0x02 0x48 0xF9
			0x15 0x01 0x00 0x00 0x0a 0x00 0x02 0x49 0xF7
			0x15 0x01 0x00 0x00 0x0a 0x00 0x02 0x4A 0xF5
			0x15 0x01 0x00 0x00 0x0a 0x00 0x02 0x4B 0xF3
			0x15 0x01 0x00 0x00 0x0a 0x00 0x02 0x4C 0xF1
			0x15 0x01 0x00 0x00 0x0a 0x00 0x02 0x4D 0xEF
			0x15 0x01 0x00 0x00 0x0a 0x00 0x02 0x4E 0xED
			0x15 0x01 0x00 0x00 0x0a 0x00 0x02 0x4F 0xEB
			0x15 0x01 0x00 0x00 0x0a 0x00 0x02 0x50 0xE9
			0x15 0x01 0x00 0x00 0x0a 0x00 0x02 0x51 0xE7
			0x15 0x01 0x00 0x00 0x0a 0x00 0x02 0x52 0xE5
			0x15 0x01 0x00 0x00 0x0a 0x00 0x02 0x53 0xE3
			0x15 0x01 0x00 0x00 0x0a 0x00 0x02 0x54 0xE0
			0x15 0x01 0x00 0x00 0x0a 0x00 0x02 0x58 0xFF
			0x15 0x01 0x00 0x00 0x0a 0x00 0x02 0x59 0xF8
			0x15 0x01 0x00 0x00 0x0a 0x00 0x02 0x5A 0xF1
			0x15 0x01 0x00 0x00 0x0a 0x00 0x02 0x5B 0xEA
			0x15 0x01 0x00 0x00 0x0a 0x00 0x02 0x5C 0xE3
			0x15 0x01 0x00 0x00 0x0a 0x00 0x02 0x5D 0xDC
			0x15 0x01 0x00 0x00 0x0a 0x00 0x02 0x5E 0xD5
			0x15 0x01 0x00 0x00 0x0a 0x00 0x02 0x5F 0xCE
			0x15 0x01 0x00 0x00 0x0a 0x00 0x02 0x60 0xC7
			0x15 0x01 0x00 0x00 0x0a 0x00 0x02 0x61 0xC0
			0x15 0x01 0x00 0x00 0x0a 0x00 0x02 0x62 0xB9
			0x15 0x01 0x00 0x00 0x0a 0x00 0x02 0x63 0xB2
			0x15 0x01 0x00 0x00 0x0a 0x00 0x02 0x64 0xAB
			0x15 0x01 0x00 0x00 0x0a 0x00 0x02 0x65 0xA4
			0x15 0x01 0x00 0x00 0x0a 0x00 0x02 0x66 0x9D
			0x15 0x01 0x00 0x00 0x0a 0x00 0x02 0x67 0x96
			0x15 0x01 0x00 0x00 0x0a 0x00 0x02 0xFF 0x10
			0x15 0x01 0x00 0x00 0x0a 0x00 0x02 0xFF 0x22
			0x15 0x01 0x00 0x00 0x0a 0x00 0x02 0xFB 0x01
			0x15 0x01 0x00 0x00 0x0a 0x00 0x02 0x00 0x40
			0x15 0x01 0x00 0x00 0x0a 0x00 0x02 0x01 0x54
			0x15 0x01 0x00 0x00 0x0a 0x00 0x02 0x02 0x5A
			0x15 0x01 0x00 0x00 0x0a 0x00 0x02 0x03 0x60
			0x15 0x01 0x00 0x00 0x0a 0x00 0x02 0x04 0x66
			0x15 0x01 0x00 0x00 0x0a 0x00 0x02 0x05 0x6A
			0x15 0x01 0x00 0x00 0x0a 0x00 0x02 0x06 0x6C
			0x15 0x01 0x00 0x00 0x0a 0x00 0x02 0x07 0x6C
			0x15 0x01 0x00 0x00 0x0a 0x00 0x02 0x08 0x68
			0x15 0x01 0x00 0x00 0x0a 0x00 0x02 0x09 0x62
			0x15 0x01 0x00 0x00 0x0a 0x00 0x02 0x0A 0x5B
			0x15 0x01 0x00 0x00 0x0a 0x00 0x02 0x0B 0x53
			0x15 0x01 0x00 0x00 0x0a 0x00 0x02 0x0C 0x4D
			0x15 0x01 0x00 0x00 0x0a 0x00 0x02 0x0D 0x43
			0x15 0x01 0x00 0x00 0x0a 0x00 0x02 0x0E 0x44
			0x15 0x01 0x00 0x00 0x0a 0x00 0x02 0x0F 0x41
			0x15 0x01 0x00 0x00 0x0a 0x00 0x02 0x10 0x40
			0x15 0x01 0x00 0x00 0x0a 0x00 0x02 0x11 0x50
			0x15 0x01 0x00 0x00 0x0a 0x00 0x02 0x12 0x60
			0x15 0x01 0x00 0x00 0x0a 0x00 0x02 0x13 0x70
			0x15 0x01 0x00 0x00 0x0a 0x00 0x02 0x14 0x58
			0x15 0x01 0x00 0x00 0x0a 0x00 0x02 0x15 0x68
			0x15 0x01 0x00 0x00 0x0a 0x00 0x02 0x16 0x78
			0x15 0x01 0x00 0x00 0x0a 0x00 0x02 0x17 0x00
			0x15 0x01 0x00 0x00 0x0a 0x00 0x02 0x18 0x40
			0x15 0x01 0x00 0x00 0x0a 0x00 0x02 0x19 0x40
			0x15 0x01 0x00 0x00 0x0a 0x00 0x02 0x1A 0x40
			0x15 0x01 0x00 0x00 0x0a 0x00 0x02 0x1B 0x40
			0x15 0x01 0x00 0x00 0x0a 0x00 0x02 0x1C 0x40
			0x15 0x01 0x00 0x00 0x0a 0x00 0x02 0x1D 0x40
			0x15 0x01 0x00 0x00 0x0a 0x00 0x02 0x1E 0x40
			0x15 0x01 0x00 0x00 0x0a 0x00 0x02 0x1F 0x40
			0x15 0x01 0x00 0x00 0x0a 0x00 0x02 0x20 0x40
			0x15 0x01 0x00 0x00 0x0a 0x00 0x02 0x21 0x45
			0x15 0x01 0x00 0x00 0x0a 0x00 0x02 0x22 0x49
			0x15 0x01 0x00 0x00 0x0a 0x00 0x02 0x23 0x4C
			0x15 0x01 0x00 0x00 0x0a 0x00 0x02 0x24 0x4B
			0x15 0x01 0x00 0x00 0x0a 0x00 0x02 0x25 0x48
			0x15 0x01 0x00 0x00 0x0a 0x00 0x02 0x26 0x44
			0x15 0x01 0x00 0x00 0x0a 0x00 0x02 0x27 0x41
			0x15 0x01 0x00 0x00 0x0a 0x00 0x02 0x28 0x40
			0x15 0x01 0x00 0x00 0x0a 0x00 0x02 0x2D 0x00
			0x15 0x01 0x00 0x00 0x0a 0x00 0x02 0x2F 0x40
			0x15 0x01 0x00 0x00 0x0a 0x00 0x02 0x30 0x40
			0x15 0x01 0x00 0x00 0x0a 0x00 0x02 0x31 0x3E
			0x15 0x01 0x00 0x00 0x0a 0x00 0x02 0x32 0x3E
			0x15 0x01 0x00 0x00 0x0a 0x00 0x02 0x33 0x3B
			0x15 0x01 0x00 0x00 0x0a 0x00 0x02 0x34 0x3A
			0x15 0x01 0x00 0x00 0x0a 0x00 0x02 0x35 0x3A
			0x15 0x01 0x00 0x00 0x0a 0x00 0x02 0x36 0x3A
			0x15 0x01 0x00 0x00 0x0a 0x00 0x02 0x37 0x3A
			0x15 0x01 0x00 0x00 0x0a 0x00 0x02 0x38 0x3B
			0x15 0x01 0x00 0x00 0x0a 0x00 0x02 0x39 0x3C
			0x15 0x01 0x00 0x00 0x0a 0x00 0x02 0x3A 0x3E
			0x15 0x01 0x00 0x00 0x0a 0x00 0x02 0x3B 0x3F
			0x15 0x01 0x00 0x00 0x0a 0x00 0x02 0x3D 0x40
			0x15 0x01 0x00 0x00 0x0a 0x00 0x02 0x3F 0x40
			0x15 0x01 0x00 0x00 0x0a 0x00 0x02 0x40 0x40
			0x15 0x01 0x00 0x00 0x0a 0x00 0x02 0x41 0x40
			0x15 0x01 0x00 0x00 0x0a 0x00 0x02 0x42 0x40
			0x15 0x01 0x00 0x00 0x0a 0x00 0x02 0x43 0x40
			0x15 0x01 0x00 0x00 0x0a 0x00 0x02 0x44 0x3E
			0x15 0x01 0x00 0x00 0x0a 0x00 0x02 0x45 0x3E
			0x15 0x01 0x00 0x00 0x0a 0x00 0x02 0x46 0x3B
			0x15 0x01 0x00 0x00 0x0a 0x00 0x02 0x47 0x3A
			0x15 0x01 0x00 0x00 0x0a 0x00 0x02 0x48 0x3A
			0x15 0x01 0x00 0x00 0x0a 0x00 0x02 0x49 0x3A
			0x15 0x01 0x00 0x00 0x0a 0x00 0x02 0x4A 0x3A
			0x15 0x01 0x00 0x00 0x0a 0x00 0x02 0x4B 0x3A
			0x15 0x01 0x00 0x00 0x0a 0x00 0x02 0x4C 0x3A
			0x15 0x01 0x00 0x00 0x0a 0x00 0x02 0x4D 0x3A
			0x15 0x01 0x00 0x00 0x0a 0x00 0x02 0x4E 0x3A
			0x15 0x01 0x00 0x00 0x0a 0x00 0x02 0x4F 0x3B
			0x15 0x01 0x00 0x00 0x0a 0x00 0x02 0x50 0x3D
			0x15 0x01 0x00 0x00 0x0a 0x00 0x02 0x51 0x3F
			0x15 0x01 0x00 0x00 0x0a 0x00 0x02 0x52 0x40
			0x15 0x01 0x00 0x00 0x0a 0x00 0x02 0x53 0x77
			0x15 0x01 0x00 0x00 0x0a 0x00 0x02 0x54 0x00
			0x15 0x01 0x00 0x00 0x0a 0x00 0x02 0x55 0x88
			0x15 0x01 0x00 0x00 0x0a 0x00 0x02 0x56 0x77
			0x15 0x01 0x00 0x00 0x0a 0x00 0x02 0x58 0xC0
			0x15 0x01 0x00 0x00 0x0a 0x00 0x02 0x59 0xC0
			0x15 0x01 0x00 0x00 0x0a 0x00 0x02 0x5A 0x40
			0x15 0x01 0x00 0x00 0x0a 0x00 0x02 0x5B 0x40
			0x15 0x01 0x00 0x00 0x0a 0x00 0x02 0x5C 0x40
			0x15 0x01 0x00 0x00 0x0a 0x00 0x02 0x5D 0x40
			0x15 0x01 0x00 0x00 0x0a 0x00 0x02 0x5E 0x40
			0x15 0x01 0x00 0x00 0x0a 0x00 0x02 0x5F 0x40
			0x15 0x01 0x00 0x00 0x0a 0x00 0x02 0x60 0x40
			0x15 0x01 0x00 0x00 0x0a 0x00 0x02 0x61 0x40
			0x15 0x01 0x00 0x00 0x0a 0x00 0x02 0x62 0x40
			0x15 0x01 0x00 0x00 0x0a 0x00 0x02 0x63 0x40
			0x15 0x01 0x00 0x00 0x0a 0x00 0x02 0x64 0x40
			0x15 0x01 0x00 0x00 0x0a 0x00 0x02 0x65 0x40
			0x15 0x01 0x00 0x00 0x0a 0x00 0x02 0x66 0x40
			0x15 0x01 0x00 0x00 0x0a 0x00 0x02 0x67 0x40
			0x15 0x01 0x00 0x00 0x0a 0x00 0x02 0x68 0x40
			0x15 0x01 0x00 0x00 0x0a 0x00 0x02 0x69 0x40
			0x15 0x01 0x00 0x00 0x0a 0x00 0x02 0x6A 0x40
			0x15 0x01 0x00 0x00 0x0a 0x00 0x02 0x6B 0x40
			0x15 0x01 0x00 0x00 0x0a 0x00 0x02 0x6C 0x40
			0x15 0x01 0x00 0x00 0x0a 0x00 0x02 0x6D 0x40
			0x15 0x01 0x00 0x00 0x0a 0x00 0x02 0x6E 0x40
			0x15 0x01 0x00 0x00 0x0a 0x00 0x02 0x6F 0x40
			0x15 0x01 0x00 0x00 0x0a 0x00 0x02 0x70 0x0C
			0x15 0x01 0x00 0x00 0x0a 0x00 0x02 0x71 0x00
			0x15 0x01 0x00 0x00 0x0a 0x00 0x02 0x72 0x00
			0x15 0x01 0x00 0x00 0x0a 0x00 0x02 0x73 0x00
			0x15 0x01 0x00 0x00 0x0a 0x00 0x02 0x74 0x03
			0x15 0x01 0x00 0x00 0x0a 0x00 0x02 0x75 0x0C
			0x15 0x01 0x00 0x00 0x0a 0x00 0x02 0x76 0x03
			0x15 0x01 0x00 0x00 0x0a 0x00 0x02 0x77 0x09
			0x15 0x01 0x00 0x00 0x0a 0x00 0x02 0x78 0x0F
			0x15 0x01 0x00 0x00 0x0a 0x00 0x02 0x79 0x68
			0x15 0x01 0x00 0x00 0x0a 0x00 0x02 0x7A 0x88
			0x15 0x01 0x00 0x00 0x0a 0x00 0x02 0x83 0x00
			0x15 0x01 0x00 0x00 0x0a 0x00 0x02 0x84 0x28
			0x15 0x01 0x00 0x00 0x0a 0x00 0x02 0x85 0x5F
			0x15 0x01 0x00 0x00 0x0a 0x00 0x02 0x86 0x50
			0x15 0x01 0x00 0x00 0x0a 0x00 0x02 0x87 0x22
			0x15 0x01 0x00 0x00 0x0a 0x00 0x02 0x88 0x40
			0x15 0x01 0x00 0x00 0x0a 0x00 0x02 0x89 0x4E
			0x15 0x01 0x00 0x00 0x0a 0x00 0x02 0x8A 0x4F
			0x15 0x01 0x00 0x00 0x0a 0x00 0x02 0x8B 0x50
			0x15 0x01 0x00 0x00 0x0a 0x00 0x02 0x8C 0x50
			0x15 0x01 0x00 0x00 0x0a 0x00 0x02 0x8D 0x40
			0x15 0x01 0x00 0x00 0x0a 0x00 0x02 0x8E 0x40
			0x15 0x01 0x00 0x00 0x0a 0x00 0x02 0x8F 0x00
			0x15 0x01 0x00 0x00 0x0a 0x00 0x02 0x90 0x1E
			0x15 0x01 0x00 0x00 0x0a 0x00 0x02 0x91 0x23
			0x15 0x01 0x00 0x00 0x0a 0x00 0x02 0x92 0x3A
			0x15 0x01 0x00 0x00 0x0a 0x00 0x02 0x93 0x40
			0x15 0x01 0x00 0x00 0x0a 0x00 0x02 0x94 0x40
			0x15 0x01 0x00 0x00 0x0a 0x00 0x02 0x95 0x40
			0x15 0x01 0x00 0x00 0x0a 0x00 0x02 0x96 0x49
			0x15 0x01 0x00 0x00 0x0a 0x00 0x02 0x97 0x49
			0x15 0x01 0x00 0x00 0x0a 0x00 0x02 0x98 0x43
			0x15 0x01 0x00 0x00 0x0a 0x00 0x02 0x99 0x43
			0x15 0x01 0x00 0x00 0x0a 0x00 0x02 0x9A 0x3C
			0x15 0x01 0x00 0x00 0x0a 0x00 0x02 0x9B 0x40
			0x15 0x01 0x00 0x00 0x0a 0x00 0x02 0x9C 0x40
			0x15 0x01 0x00 0x00 0x0a 0x00 0x02 0x9D 0x40
			0x15 0x01 0x00 0x00 0x0a 0x00 0x02 0x9E 0x4C
			0x15 0x01 0x00 0x00 0x0a 0x00 0x02 0x9F 0x4D
			0x15 0x01 0x00 0x00 0x0a 0x00 0x02 0xA0 0x4E
			0x15 0x01 0x00 0x00 0x0a 0x00 0x02 0xA2 0x20
			0x15 0x01 0x00 0x00 0x0a 0x00 0x02 0xB3 0x00
			0x15 0x01 0x00 0x00 0x0a 0x00 0x02 0xB7 0x00
			0x15 0x01 0x00 0x00 0x0a 0x00 0x02 0xB8 0x00
			0x15 0x01 0x00 0x00 0x0a 0x00 0x02 0xFF 0x10
			0x15 0x01 0x00 0x00 0x0a 0x00 0x02 0x53 0x24
			0x15 0x01 0x00 0x00 0x0a 0x00 0x02 0x55 0x81>;
		lcd-kit,ce-off-cmds = <>;
		lcd-kit,ce-srgb-cmds = <>;
		lcd-kit,ce-user-cmds = <>;
		lcd-kit,ce-vivid-cmds = <>;
		lcd-kit,esd-reg-cmds = <0x06 0x01 0x00 0x00 0x0a 0x00 0x01 0x0a>;
		lcd-kit,esd-reg-cmds-state = "dsi_lp_mode";
		lcd-kit,esd-value = <0x9c>;
		lcd-kit,check-reg-cmds = <0x06 0x01 0x00 0x00 0x0a 0x00 0x01 0x0a>;
		lcd-kit,check-reg-cmds-state = "dsi_lp_mode";
		lcd-kit,check-reg-value = <0x9c>;
		lcd-kit,pcd-errflag-check-support = <0>;
		lcd-kit,gpio-pcd = <0>;
		lcd-kit,gpio-errflag = <0>;
		lcd-kit,bkl-open-short-support = <>;
		lcd-kit,hbm-enter-cmds = <0x39 0x01 0x00 0x00 0x0a 0x00 0x03 0xF0 0x5A 0x5A
			0x15 0x01 0x00 0x00 0x0a 0x00 0x02 0x53 0xE0
			0x15 0x01 0x00 0x00 0x0a 0x00 0x02 0xB0 0x04
			0x15 0x01 0x00 0x00 0x0a 0x00 0x02 0xB2 0x80
			0x39 0x01 0x00 0x00 0x0a 0x00 0x03 0xB2 0x00 0x40
			0x15 0x01 0x00 0x00 0x0a 0x00 0x02 0xF7 0x03
			0x39 0x01 0x00 0x00 0x0a 0x00 0x03 0xF0 0xA5 0xA5>;
		lcd-kit,hbm-enter-cmds-state = "dsi_lp_mode";
		lcd-kit,hbm-exit-cmds = <0x39 0x01 0x00 0x00 0x0a 0x00 0x03 0xF0 0x5A 0x5A
			0x15 0x01 0x00 0x00 0x0a 0x00 0x02 0x53 0x20
			0x39 0x01 0x00 0x00 0x0a 0x00 0x03 0xB2 0x00 0x40
			0x39 0x01 0x00 0x00 0x0a 0x00 0x03 0x51 0x03 0xFF
			0x15 0x01 0x00 0x00 0x0a 0x00 0x02 0xF7 0x03
			0x39 0x01 0x00 0x00 0x0a 0x00 0x03 0xF0 0xA5 0xA5>;
		lcd-kit,hbm-exit-cmds-state = "dsi_lp_mode";
		lcd-kit,panel-orientation = <1>;
		lcd-kit,panel-bpp = <0>;
		lcd-kit,panel-bgr-fmt = <0>;
		lcd-kit,panel-cmd-type = <16>;
		lcd-kit,panel-pxl-clk = <166>;
		lcd-kit,panel-pxl-clk-div = <1>;
		lcd-kit,panel-vsyn-ctr-type = <0>;
		lcd-kit,panel-ifbc-type = <0>;
		lcd-kit,vesa-slice-width = <0>;
		lcd-kit,vesa-slice-height = <0>;
		lcd-kit,panel-frc-enable = <0>;
		lcd-kit,panel-esd-skip-mipi-check = <1>;
		lcd-kit,sensorhub-aod-support = <0>;
		lcd-kit,mask-delay-time-before-fp = <16666>;
		lcd-kit,mask-delay-time-after-fp = <16666>;
		lcd-kit,bl-delay-frame = <0>;
		lcd-kit,panel-version-support = <0>;
		lcd-kit,fps-support = <0>;
		lcd-kit,backlight-order = <0>;
		lcd-kit,backlight-precision = <0>;
		lcd-kit,quickly-sleep-out-support = <0>;
		lcd-kit,quickly-sleep-out-interval = <0>;
		lcd-kit,esd-support = <0>;
		lcd-kit,project-id-support = <0>;
		lcd-kit,oem-info-support = <0>;
		lcd-kit,oem-barcode-2d-support = <0>;
		lcd-kit,dirty-region-support = <0>;
		lcd-kit,dirty-left-align = <0xffff>;
		lcd-kit,dirty-right-align = <0xffff>;
		lcd-kit,dirty-top-align = <8>;
		lcd-kit,dirty-bott-align = <0xffff>;
		lcd-kit,dirty-width-align = <0xffff>;
		lcd-kit,dirty-height-align = <8>;
		lcd-kit,dirty-width-min = <1440>;
		lcd-kit,dirty-height-min = <8>;
		lcd-kit,dirty-top-start = <0xffff>;
		lcd-kit,dirty-bott-start = <0xffff>;
		lcd-kit,panel-bl-type = <8>;
		lcd-kit,panel-bl-min = <12>;
		lcd-kit,panel-bl-max = <1023>;
		lcd-kit,panel-bl-def = <410>;
		lcd-kit,panel-bl-pwm-preci-type = <2>;
		lcd-kit,panel-bl-ic-ctrl-type = <1>;
		lcd-kit,h-back-porch = <10>;
		lcd-kit,h-front-porch = <32>;
		lcd-kit,h-pulse-width = <10>;
		lcd-kit,v-back-porch = <60>;
		lcd-kit,v-front-porch = <14>;
		lcd-kit,v-pulse-width = <30>;
		lcd-kit,ldi-hsync-plr = <0>;
		lcd-kit,ldi-vsync-plr = <0>;
		lcd-kit,ldi-pixel-clk-plr = <0>;
		lcd-kit,ldi-data-en-plr = <0>;
		lcd-kit,ldi-dpi-a-overlap-size = <0>;
		lcd-kit,ldi-dpi-b-overlap-size = <0>;
		lcd-kit,mipi-dsi-upt-support = <1>;
		lcd-kit,mipi-lane-nums = <3>;
		lcd-kit,mipi-color-mode = <5>;
		lcd-kit,mipi-vc = <0>;
		lcd-kit,mipi-dsi-bit-clk = <500>;
		lcd-kit,mipi-burst-mode = <0>;
		lcd-kit,mipi-max-tx-esc-clk = <10>;
		lcd-kit,mipi-dsi-bit-clk-val1 = <500>;
		lcd-kit,mipi-dsi-bit-clk-val2 = <0>;
		lcd-kit,mipi-dsi-bit-clk-val3 = <0>;
		lcd-kit,mipi-dsi-bit-clk-val4 = <0>;
		lcd-kit,mipi-dsi-bit-clk-val5 = <0>;
		lcd-kit,mipi-rg-vrefsel-vcm-adjust = <0>;
		lcd-kit,mipi-non-continue-enable = <1>;
		lcd-kit,mipi-clk-post-adjust = <0>;
		lcd-kit,mipi-lp11-flag = <0>;
		lcd-kit,mipi-phy-update = <1>;
		lcd-kit,mipi-clk-pre-adjust = <0>;
		lcd-kit,mipi-data-t-lpx-adjust = <0>;
		lcd-kit,mipi-phy-mode = <0>;
		lcd-kit,inversion-support = <0>;
		lcd-kit,scan-support = <0>;
		lcd-kit,check-reg-support = <0>;
		lcd-kit,checksum-support = <0>;
		lcd-kit,current-det-support = <0>;
		lcd-kit,lv-det-support = <0>;
		lcd-kit,pt-support = <0>;
		lcd-kit,hkadc-support = <0>;
		lcd-kit,ldo-check-support = <0>;
		lcd-kit,Does-lcd-poweron-tp = <1>;
		lcd-kit,ldo-check-name = "ldo4";
		lcd-kit,ldo-check-channel = <0>;
		lcd-kit,ldo-check-threshold = <0>;
		status = "disabled";
		iovcc-supply = <&ldo4>;
		vdd-supply = <&ldo25>;
		vci-supply = <&ldo17>;
		lcd-kit,lcd-vci = <1 17 3100000>;
		lcd-kit,lcd-iovcc = <1 4 1850000>;
		lcd-kit,lcd-vdd = <1 0 0>;
		lcd-kit,lcd-vsp = <0 12 5500000>;
		lcd-kit,lcd-vsn = <0 34 5500000>;
		lcd-kit,lcd-reset = <2 189 0>;
		lcd-kit,tp-reset = <0 15 0>;
		lcd-kit,lcd-te0 = <0 16 0>;
		lcd-kit,lcd-backlight = <0 11 0>;
		lcd-kit,power-on-stage = <2 1 2
				1 1 2>;
		lcd-kit,lp-on-stage = <5 1 5
				6 1 0
				7 1 0>;
		lcd-kit,hs-on-stage = <0 0 0>;
		lcd-kit,hs-off-stage = <6 0 0>;
		lcd-kit,lp-off-stage = <0 0 0>;
		lcd-kit,power-off-stage = <7 0 0
				5 0 0
				2 0 2
				1 0 2>;
		lcd-kit,tp-color-support = <1>;
		lcd-kit,panel-bl-max-nit = <530>;
		lcd-kit,cabc-support = <0>;
		lcd-kit,rgbw-support = <0>;
		lcd-kit,blpwm-disable = <0>;
		lcd-kit,blpwm-div = <0>;
		lcd-kit,acl-support = <0>;
		lcd-kit,hbm-support = <0>;
		lcd-kit,hbm-fp-support = <0>;
		lcd-kit,hbm-level-max = <0>;
		lcd-kit,vr-support = <0>;
		lcd-kit,gamma-cal-support = <0>;
		lcd-kit,sbl-support = <0>;
		lcd-kit,sbl-stren-limit = <128>;
		lcd-kit,sbl-cal-a = <60>;
		lcd-kit,sbl-cal-b = <95>;
		lcd-kit,sbl-cal-c = <5>;
		lcd-kit,sbl-cal-d = <1>;
		lcd-kit,sbl-tf-ctl = <5>;
		lcd-kit,sbl-bl-min = <480>;
		lcd-kit,sbl-bl-max = <4096>;
		lcd-kit,sbl-bl-scale = <0xff>;
		lcd-kit,sbl-am-light-min = <14>;
		lcd-kit,sbl-filter-a = <1738>;
		lcd-kit,sbl-filter-b = <6>;
		lcd-kit,sbl-logo-left = <0>;
		lcd-kit,sbl-logo-top = <0>;
		lcd-kit,sbl-variance-intensity-space = <145>;
		lcd-kit,sbl-slope-max = <54>;
		lcd-kit,sbl-slope-min = <160>;
		lcd-kit,brightness-color-uniform-support = <0>;
		lcd-kit,dbv-curve-mapped-support = <0>;
		lcd-kit,gamma-support = <0>;
		lcd-kit,otp-gamma-support = <0>;
		lcd-kit,ce-support = <0>;
		lcd-kit,effect-on-support = <0>;
		lcd-kit,gmp-support = <0>;
		lcd-kit,color-temp-support = <0>;
		lcd-kit,color-temp-rectify-support = <0>;
		lcd-kit,hiace-support = <0>;
		lcd-kit,iglobal-hist-black-pos = <16>;
		lcd-kit,iglobal-hist-white-pos = <240>;
		lcd-kit,iglobal-hist-black-weight = <51>;
		lcd-kit,iglobal-hist-white-weight = <51>;
		lcd-kit,iglobal-hist-zero-cut-ratio = <486>;
		lcd-kit,iglobal-hist-slope-cut-ratio = <410>;
		lcd-kit,imax-lcd-luminance = <500>;
		lcd-kit,imin-lcd-luminance = <3>;
		lcd-kit,xcc-support = <0>;
		lcd-kit,comform-mode-support = <0>;
		lcd-kit,cinema-mode-support = <0>;
		lcd-kit,effect-color-support = <0>;
		lcd-kit,effect-color-mode = <0>;
		lcd-kit,prefix-ce-support = <0>;
		lcd-kit,arsr1p-sharpness-support = <0>;
		lcd-kit,prefix-sharp-1D-support = <0>;
		lcd-kit,prefix-sharp-2D-support = <0>;
		lcd-kit,smart-color-mode-support = <0>;
		lcd-kit,color-temp-rectify-r = <32768>;
		lcd-kit,color-temp-rectify-g = <32768>;
		lcd-kit,color-temp-rectify-b = <32768>;
		lcd-kit,acm-support = <0>;
		lcd-kit,acm-ce-support = <0>;
		lcd-kit,acm-valid-num = <7>;
		lcd-kit,r_hh0 = <0x7f>;
		lcd-kit,r_lh0 = <0xe>;
		lcd-kit,r_hh1 = <0xbe>;
		lcd-kit,r_lh1 = <0x80>;
		lcd-kit,r_hh2 = <0xff>;
		lcd-kit,r_lh2 = <0xbf>;
		lcd-kit,r_hh3 = <0x1c0>;
		lcd-kit,r_lh3 = <0x100>;
		lcd-kit,r_hh4 = <0x27f>;
		lcd-kit,r_lh4 = <0x1c1>;
		lcd-kit,r_hh5 = <0x323>;
		lcd-kit,r_lh5 = <0x280>;
		lcd-kit,r_hh6 = <0x381>;
		lcd-kit,r_lh6 = <0x324>;
		lcd-kit,r_video_hh0 = <0x7f>;
		lcd-kit,r_video_lh0 = <0xe>;
		lcd-kit,r_video_hh1 = <0xbe>;
		lcd-kit,r_video_lh1 = <0x80>;
		lcd-kit,r_video_hh2 = <0xff>;
		lcd-kit,r_video_lh2 = <0xbf>;
		lcd-kit,r_video_hh3 = <0x1c0>;
		lcd-kit,r_video_lh3 = <0x100>;
		lcd-kit,r_video_hh4 = <0x27f>;
		lcd-kit,r_video_lh4 = <0x1c1>;
		lcd-kit,r_video_hh5 = <0x323>;
		lcd-kit,r_video_lh5 = <0x280>;
		lcd-kit,r_video_hh6 = <0x381>;
		lcd-kit,r_video_lh6 = <0x324>;
		lcd-kit,check-thread-enable = <0>;
		lcd-kit,check-bl-support = <0>;
		lcd-kit,vss-support = <0>;
    };
};