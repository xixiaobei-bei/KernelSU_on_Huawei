/*---------------------------------------------------------------------------
 * This file is autogenerated file using huawei LCD parser. Please do not edit it.
 * Update input XML file to add a new entry or update variable in this file
 * Parser location: vendor/huawei/chipset_common/devkit/lcdkit/tools 
 *---------------------------------------------------------------------------*/


/include/ "yal_auo_otm1901a_5p2_1080p_video_default.dtsi"
/include/ "yal_ctc_ft8719_6p26_1080p_video.dtsi"
/include/ "yal_ctc_nt36672a_6p26_1080p_video.dtsi"
/include/ "yal_lg_td4320_6p26_1080p_video.dtsi"
/include/ "yal_tm_nt36672a_6p26_1080p_video.dtsi"
/include/ "yal_tm_td4320_6p26_1080p_video.dtsi"
/include/ "yal_tm_td4330_6p26_1080p_video.dtsi"