/*---------------------------------------------------------------------------
 * This file is autogenerated file using huawei LCD parser. Please do not edit it.
 * Update input XML file to add a new entry or update variable in this file
 * Parser location: vendor/huawei/chipset_common/devkit/lcdkit/tools 
 *---------------------------------------------------------------------------*/


/include/ "pct_auo_nt36672a_6p4_1080p_video.dtsi"
/include/ "pct_auo_nt36672a_pct_al10_6p4_1080p_video.dtsi"
/include/ "pct_auo_otm1901a_5p2_1080p_video_default.dtsi"
/include/ "pct_auo_td4320_6p4_1080p_video.dtsi"
/include/ "pct_auo_td4320_pct_al10_6p4_1080p_video.dtsi"
/include/ "pct_boe_nt36672a_6p4_1080p_video.dtsi"
/include/ "pct_boe_nt36672a_pct_al10_6p4_1080p_video.dtsi"
/include/ "pct_boe_td4320_6p4_1080p_video.dtsi"
/include/ "pct_boe_td4320_pct_al10_6p4_1080p_video.dtsi"
/include/ "pct_ctc_nt36672a_6p4_1080p_video.dtsi"
/include/ "pct_ctc_nt36672a_pct_al10_6p4_1080p_video.dtsi"
/include/ "pct_lg_td4320_6p4_1080p_video.dtsi"
/include/ "pct_lg_td4320_pct_al10_6p4_1080p_video.dtsi"