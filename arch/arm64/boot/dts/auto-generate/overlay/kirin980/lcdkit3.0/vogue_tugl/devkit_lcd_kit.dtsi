/*---------------------------------------------------------------------------
 * This file is autogenerated file using huawei LCD parser. Please do not edit it.
 * Update input XML file to add a new entry or update variable in this file
 * Parser location: vendor/huawei/chipset_common/devkit/lcdkit/tools 
 *---------------------------------------------------------------------------*/


/include/ "vogue_tugl_auo_otm1901a_5p2_1080p_video_default.dtsi"
/include/ "vogue_tugl_boe_nt37700f_vogue_6p47_1080plus_cmd.dtsi"
/include/ "vogue_tugl_lg_nt37280_vogue_6p47_1080plus_cmd.dtsi"