/* Copyright (c) 2013, The Linux Foundation. All rights reserved.
 *
 * This program is free software; you can redistribute it and/or modify
 * it under the terms of the GNU General Public License version 2 and
 * only version 2 as published by the Free Software Foundation.
 *
 * This program is distributed in the hope that it will be useful,
 * but WITHOUT ANY WARRANTY; without even the implied warranty of
 * MERCHANTABILITY or FITNESS FOR A PARTICULAR PURPOSE.  See the
 * GNU General Public License for more details.
 */

/*-------------------------------------------------------------------------
 * This file is autogenerated file using gcdb parser. Please do not edit it.
 * Update input XML file to add a new entry or update variable in this file
 * VERSION = 1.1
 *-----------------------------------------------------------------------*/
&huawei_lcd_config {
	dsi_hma_tugl_sharp_td4336_hma_v2_6p53_1080plus_cmd: lcd_kit_hma_tugl_sharp_td4336_hma_v2_6p53_1080plus_cmd {
		compatible = "sharp_td4336_hma_v2_6p53_1080plus_cmd";
		lcd-kit,panel-name = "SHARP_TD4336_HMA_V2 6.53' CMD TFT 1080 x 2244";
		lcd-kit,panel-type = <0x01>;
		lcd-kit,panel-xres = <1080>;
		lcd-kit,panel-yres = <2244>;
		lcd-kit,panel-width = <72>;
		lcd-kit,panel-height = <149>;
		lcd-kit,panel-on-cmds = <0x29 0x01 0x00 0x00 0x0a 0x00 0x02 0xB0 0x04
			0x29 0x01 0x00 0x00 0x0a 0x00 0x04 0xF0 0xC4 0x36 0x08
			0x29 0x01 0x00 0x00 0x0a 0x00 0x04 0xF0 0xC4 0x39 0x08
			0x29 0x01 0x00 0x00 0x0a 0x00 0x04 0xF0 0xDF 0x0F 0xFF
			0x29 0x01 0x00 0x00 0x0a 0x00 0x04 0xF0 0xDF 0x10 0xFF
			0x29 0x01 0x00 0x00 0x0a 0x00 0x04 0xF0 0xDF 0x11 0xFF
			0x29 0x01 0x00 0x00 0x0a 0x00 0x04 0xF0 0xDF 0x12 0xFF
			0x29 0x01 0x00 0x00 0x0a 0x00 0x04 0xF0 0xDF 0x13 0xFF
			0x29 0x01 0x00 0x00 0x0a 0x00 0x04 0xF0 0xC4 0x03 0x4D
			0x29 0x01 0x00 0x00 0x0a 0x00 0x04 0xF0 0xC4 0x1B 0x4D
			0x29 0x01 0x00 0x00 0x0a 0x00 0x04 0xF0 0xEE 0x01 0x0C
			0x29 0x01 0x00 0x00 0x0a 0x00 0x04 0xF0 0xEE 0x05 0xC0
			0x29 0x01 0x00 0x00 0x0a 0x00 0x04 0xF0 0xEE 0x28 0x01
			0x29 0x01 0x00 0x00 0x0a 0x00 0x04 0xF0 0xEE 0x37 0x0C
			0x29 0x01 0x00 0x00 0x0a 0x00 0x04 0xF0 0xED 0x05 0x03
			0x29 0x01 0x00 0x00 0x0a 0x00 0x04 0xF0 0xED 0x07 0x04
			0x29 0x01 0x00 0x00 0x0a 0x00 0x04 0xF0 0xED 0x0C 0x0A
			0x29 0x01 0x00 0x00 0x0a 0x00 0x04 0xF0 0xED 0x1D 0xD0
			0x29 0x01 0x00 0x00 0x0a 0x00 0x04 0xF0 0xC4 0x37 0x80
			0x29 0x01 0x00 0x00 0x0a 0x00 0x04 0xF0 0xC4 0x38 0x03
			0x29 0x01 0x00 0x00 0x0a 0x00 0x04 0xF0 0xC4 0x3A 0x80
			0x29 0x01 0x00 0x00 0x0a 0x00 0x04 0xF0 0xC4 0x3B 0x03
			0x29 0x01 0x00 0x00 0x0a 0x00 0x04 0xF0 0xEE 0x01 0x0F
			0x29 0x01 0x00 0x00 0x0a 0x00 0x04 0xF0 0xEE 0x05 0xF0
			0x29 0x01 0x00 0x00 0x0a 0x00 0x04 0xF0 0xEE 0x37 0x1F
			0x39 0x01 0x00 0x00 0x0a 0x00 0x03 0x51 0xFF 0xFF
			0x15 0x01 0x00 0x00 0x0a 0x00 0x02 0x53 0x24
			0x15 0x01 0x00 0x00 0x0a 0x00 0x02 0x55 0x00
			0x29 0x01 0x00 0x00 0x0a 0x00 0x24 0xCE 0x5D 0x40 0x49 0x53 0x59 0x5E 0x63 0x68 0x6E 0x74 0x7E 0x8A 0x98 0xA8 0xBB 0xD0 0xE7 0xFF 0x04 0x00 0x04 0x04 0x42 0x04 0x69 0x5A 0x40 0x11 0xF4 0x00 0x00 0x04 0xFA 0x00 0x04
			0x15 0x01 0x00 0x00 0x0a 0x00 0x02 0x35 0x00
			0x15 0x01 0x00 0x00 0x0a 0x00 0x02 0x50 0xFF
			0x15 0x01 0x00 0x00 0x0a 0x00 0x02 0x5E 0x00
			0x39 0x01 0x00 0x00 0x0a 0x00 0x03 0x61 0x00 0x06
			0x15 0x01 0x00 0x00 0x0a 0x00 0x02 0x63 0x24
			0x15 0x01 0x00 0x00 0x0a 0x00 0x02 0x65 0x02
			0x15 0x01 0x00 0x00 0x0a 0x00 0x02 0x6A 0x54
			0x15 0x01 0x00 0x00 0x0a 0x00 0x02 0x6C 0xFF
			0x15 0x01 0x00 0x00 0x0a 0x00 0x02 0x6E 0x00
			0x15 0x01 0x00 0x00 0x0a 0x00 0x02 0xD6 0x00
			0x39 0x01 0x00 0x00 0x0a 0x00 0x0b 0xE7 0x50 0x04 0x00 0x00 0xFF 0xFF 0x00 0x00 0xFF 0xFF
			0x39 0x01 0x00 0x00 0x0a 0x00 0x05 0x2A 0x00 0x00 0x04 0x37
			0x39 0x01 0x00 0x00 0x0a 0x00 0x05 0x2B 0x00 0x00 0x08 0xC3
			0x05 0x01 0x00 0x00 0x0a 0x00 0x02 0x29 0x00
			0x05 0x01 0x00 0x00 0x46 0x01 0x02 0x11 0x00>;
		lcd-kit,panel-on-cmds-state = "dsi_lp_mode";
		lcd-kit,panel-off-cmds = <0x05 0x01 0x00 0x00 0x14 0x01 0x02 0x28 0x00
			0x05 0x01 0x00 0x00 0x50 0x01 0x02 0x10 0x00>;
		lcd-kit,panel-off-cmds-state = "dsi_lp_mode";
		lcd-kit,backlight-cmds = <0x39 0x01 0x00 0x00 0x00 0x00 0x03 0x51 0x00 0x00>;
		lcd-kit,backlight-cmds-state = "dsi_lp_mode";
		lcd-kit,tp-color-cmds = <0x06 0x01 0x00 0x00 0x0a 0x00 0x01 0xda>;
		lcd-kit,effect-on-cmds = <0x29 0x01 0x00 0x00 0x0a 0x00 0x02 0xB0 0x04
			0x29 0x01 0x00 0x00 0x0a 0x00 0x04 0xF0 0xDF 0x0F 0x00
			0x29 0x01 0x00 0x00 0x0a 0x00 0x04 0xF0 0xDF 0x10 0x00
			0x29 0x01 0x00 0x00 0x0a 0x00 0x04 0xF0 0xDF 0x11 0x00
			0x29 0x01 0x00 0x00 0x0a 0x00 0x04 0xF0 0xDF 0x12 0x00
			0x29 0x01 0x00 0x00 0x0a 0x00 0x04 0xF0 0xDF 0x13 0x00
			0x29 0x01 0x00 0x00 0x0a 0x00 0x02 0xB0 0x03>;
		lcd-kit,cabc-off-cmds = <0x15 0x01 0x00 0x00 0x0a 0x00 0x02 0x55 0x00>;
		lcd-kit,cabc-off-cmds-state = "dsi_lp_mode";
		lcd-kit,cabc-ui-cmds = <0x15 0x01 0x00 0x00 0x0a 0x00 0x02 0x55 0x01
			0x15 0x01 0x00 0x00 0x0a 0x00 0x02 0x53 0x24>;
		lcd-kit,cabc-ui-cmds-state = "dsi_lp_mode";
		lcd-kit,cabc-still-cmds = <0x15 0x01 0x00 0x00 0x0a 0x00 0x02 0x55 0x02
			0x15 0x01 0x00 0x00 0x0a 0x00 0x02 0x53 0x24>;
		lcd-kit,cabc-still-cmds-state = "dsi_lp_mode";
		lcd-kit,cabc-moving-cmds = <0x15 0x01 0x00 0x00 0x0a 0x00 0x02 0x55 0x03
			0x15 0x01 0x00 0x00 0x0a 0x00 0x02 0x53 0x2C>;
		lcd-kit,cabc-moving-cmds-state = "dsi_lp_mode";
		lcd-kit,rgbw-bl-max = <4095>;
		lcd-kit,rgbw-mode1-cmds = <0x15 0x01 0x00 0x00 0x0a 0x00 0x02 0x65 0x01>;
		lcd-kit,rgbw-mode1-cmds-state = "dsi_lp_mode";
		lcd-kit,rgbw-mode2-cmds = <0x15 0x01 0x00 0x00 0x0a 0x00 0x02 0x65 0x02>;
		lcd-kit,rgbw-mode2-cmds-state = "dsi_lp_mode";
		lcd-kit,rgbw-mode3-cmds = <0x15 0x01 0x00 0x00 0x0a 0x00 0x02 0x65 0x03>;
		lcd-kit,rgbw-mode3-cmds-state = "dsi_lp_mode";
		lcd-kit,rgbw-mode4-cmds = <0x15 0x01 0x00 0x00 0x0a 0x00 0x02 0x65 0x04>;
		lcd-kit,rgbw-mode4-cmds-state = "dsi_lp_mode";
		lcd-kit,rgbw-backlight-cmds = <0x39 0x01 0x00 0x00 0x0a 0x00 0x03 0x61 0x00 0x00>;
		lcd-kit,rgbw-backlight-cmds-state = "dsi_lp_mode";
		lcd-kit,rgbw-pixel-gain-limit-cmds = <0x15 0x01 0x00 0x00 0x0a 0x00 0x02 0x6A 0x00>;
		lcd-kit,rgbw-pixel-gain-limit-cmds-state = "dsi_lp_mode";
		lcd-kit,ce-off-cmds = <>;
		lcd-kit,ce-srgb-cmds = <>;
		lcd-kit,ce-user-cmds = <>;
		lcd-kit,ce-vivid-cmds = <>;
		lcd-kit,esd-reg-cmds = <0x06 0x01 0x00 0x00 0x0a 0x00 0x01 0x0a
				0x06 0x01 0x00 0x00 0x0a 0x00 0x01 0x0e>;
		lcd-kit,esd-reg-cmds-state = "dsi_lp_mode";
		lcd-kit,esd-value = <0x1c 0x80>;
		lcd-kit,check-reg-cmds = <0x06 0x01 0x00 0x00 0x0a 0x00 0x01 0x0a>;
		lcd-kit,check-reg-cmds-state = "dsi_lp_mode";
		lcd-kit,check-reg-value = <0x9c>;
		lcd-kit,barcode-2d-cmds = <0x06 0x01 0x00 0x00 0x0a 0x00 0x32 0xBF 0x05 0x00 0x00 0x00 0x00 0x00 0x00 0x00 0x00 0x00 0x00 0x00 0x00 0x00 0x00 0x00 0x00 0x00 0x00 0x00 0x00 0x00 0x00 0x00 0x00 0x00 0x00 0x00 0x00 0x00 0x00 0x00 0x00 0x00 0x00 0x00 0x00 0x00 0x00 0x00 0x00 0x00 0x00 0x00 0x00 0x00 0x00 0x00 0x00>;
		lcd-kit,project-id-cmds = <0x06 0x01 0x00 0x00 0x0a 0x00 0x40 0xBF 0x37 0x00 0x00 0x00 0x00 0x00 0x00 0x00 0x00 0x00 0x00 0x00 0x00 0x00 0x00 0x00 0x00 0x00 0x00 0x00 0x00 0x00 0x00 0x00 0x00 0x00 0x00 0x00 0x00 0x00 0x00 0x00 0x00 0x00 0x00 0x00 0x00 0x00 0x00 0x00 0x00 0x00 0x00 0x00 0x00 0x00 0x00 0x00 0x00 0x00 0x00 0x00 0x00 0x00 0x00 0x00 0x00 0x00 0x00 0x00 0x00 0x00 0x00>;
		lcd-kit,brightness-color-cmds = <0x06 0x01 0x00 0x00 0x0a 0x00 0x46 0xBF 0x41 0x00 0x00 0x00 0x00 0x00 0x00 0x00 0x00 0x00 0x00 0x00 0x00 0x00 0x00 0x00 0x00 0x00 0x00 0x00 0x00 0x00 0x00 0x00 0x00 0x00 0x00 0x00 0x00 0x00 0x00 0x00 0x00 0x00 0x00 0x00 0x00 0x00 0x00 0x00 0x00 0x00 0x00 0x00 0x00 0x00 0x00 0x00 0x00 0x00 0x00 0x00 0x00 0x00 0x00 0x00 0x00 0x00 0x00 0x00 0x00 0x00 0x00 0x00 0x00 0x00 0x00 0x00 0x00>;
		lcd-kit,module-sn-cmds = <0x14 0x01 0x00 0x00 0x32 0x01 0x16 0xBF 0x13 0x00 0x00 0x00 0x00 0x00 0x00 0x00 0x00 0x00 0x00 0x00 0x00 0x00 0x00 0x00 0x00 0x00 0x00 0x00 0x00>;
		lcd-kit,equip-id-cmds = <0x14 0x01 0x00 0x00 0x0a 0x00 0x0F 0xBF 0x0F 0x00 0x00 0x00 0x00 0x00 0x00 0x00 0x00 0x00 0x00 0x00 0x00 0x00>;
		lcd-kit,module-manufact-cmds = <0x14 0x01 0x00 0x00 0x0a 0x00 0x12 0xBF 0x10 0x00 0x00 0x00 0x00 0x00 0x00 0x00 0x00 0x00 0x00 0x00 0x00 0x00 0x00 0x00 0x00>;
		lcd-kit,vendor-id-cmds = <0x14 0x01 0x00 0x00 0x0a 0x00 0x0D 0xBF 0x0D 0x00 0x00 0x00 0x00 0x00 0x00 0x00 0x00 0x00 0x00 0x00>;
		lcd-kit,pcd-errflag-check-support = <0>;
		lcd-kit,gpio-pcd = <0>;
		lcd-kit,gpio-errflag = <0>;
		lcd-kit,bkl-open-short-support = <>;
		lcd-kit,checksum-enable-cmds = <0x15 0x01 0x00 0x00 0x0a 0x00 0x02 0xFF 0xF0
					0x15 0x01 0x00 0x00 0x0a 0x00 0x02 0x92 0x01>;
		lcd-kit,checksum-disable-cmds = <0x15 0x01 0x00 0x00 0x0a 0x00 0x02 0xFF 0xF0
					0x15 0x01 0x00 0x00 0x0a 0x00 0x02 0x92 0x00
					0x15 0x01 0x00 0x00 0x0a 0x00 0x02 0x7B 0x00
					0x15 0x01 0x00 0x00 0x0a 0x00 0x02 0xFF 0x10>;
		lcd-kit,checksum-cmds = <0x06 0x01 0x00 0x00 0x14 0x00 0x01 0x73>;
		lcd-kit,dirty-region-cmds = <0x39 0x01 0x00 0x00 0x05 0x00 0x05 0x2A 0x00 0x00 0x04 0x37
				0x39 0x01 0x00 0x00 0x05 0x00 0x05 0x2B 0x00 0x00 0x08 0xC3>;
		lcd-kit,fps-to-30-cmds = <0x29 0x01 0x00 0x00 0x0a 0x00 0x02 0xB0 0x04
				0x29 0x01 0x00 0x00 0x0a 0x00 0x02 0xF4 0x17>;
		lcd-kit,fps-to-60-cmds = <0x29 0x01 0x00 0x00 0x0a 0x00 0x02 0xB0 0x04
				0x29 0x01 0x00 0x00 0x0a 0x00 0x02 0xF4 0x16>;
		lcd-kit,fps-dfr-enable-cmds = <0x29 0x01 0x00 0x00 0x0a 0x00 0x02 0xB0 0x04
				0x29 0x01 0x00 0x00 0x0a 0x00 0x02 0xF4 0x19>;
		lcd-kit,panel-orientation = <1>;
		lcd-kit,panel-bpp = <0>;
		lcd-kit,panel-bgr-fmt = <0>;
		lcd-kit,panel-cmd-type = <16>;
		lcd-kit,panel-pxl-clk = <166>;
		lcd-kit,panel-pxl-clk-div = <1>;
		lcd-kit,panel-vsyn-ctr-type = <7>;
		lcd-kit,panel-ifbc-type = <0>;
		lcd-kit,vesa-slice-width = <0>;
		lcd-kit,vesa-slice-height = <0>;
		lcd-kit,panel-frc-enable = <0>;
		lcd-kit,panel-esd-skip-mipi-check = <1>;
		lcd-kit,sensorhub-aod-support = <0>;
		lcd-kit,mask-delay-time-before-fp = <16666>;
		lcd-kit,mask-delay-time-after-fp = <16666>;
		lcd-kit,bl-delay-frame = <0>;
		lcd-kit,panel-version-support = <0>;
		lcd-kit,fps-support = <1>;
		lcd-kit,backlight-order = <0>;
		lcd-kit,backlight-precision = <0>;
		lcd-kit,quickly-sleep-out-support = <0>;
		lcd-kit,quickly-sleep-out-interval = <0>;
		lcd-kit,esd-support = <1>;
		lcd-kit,project-id-support = <1>;
		lcd-kit,oem-info-support = <1>;
		lcd-kit,oem-barcode-2d-support = <1>;
		lcd-kit,dirty-region-support = <1>;
		lcd-kit,dirty-left-align = <0xffff>;
		lcd-kit,dirty-right-align = <0xffff>;
		lcd-kit,dirty-top-align = <8>;
		lcd-kit,dirty-bott-align = <0xffff>;
		lcd-kit,dirty-width-align = <0xffff>;
		lcd-kit,dirty-height-align = <8>;
		lcd-kit,dirty-width-min = <1080>;
		lcd-kit,dirty-height-min = <8>;
		lcd-kit,dirty-top-start = <0xffff>;
		lcd-kit,dirty-bott-start = <0xffff>;
		lcd-kit,panel-bl-type = <4>;
		lcd-kit,panel-bl-min = <9>;
		lcd-kit,panel-bl-max = <4095>;
		lcd-kit,panel-bl-def = <1638>;
		lcd-kit,panel-bl-ic-ctrl-type = <1>;
		lcd-kit,h-back-porch = <16>;
		lcd-kit,h-front-porch = <8>;
		lcd-kit,h-pulse-width = <16>;
		lcd-kit,v-back-porch = <36>;
		lcd-kit,v-front-porch = <6>;
		lcd-kit,v-pulse-width = <30>;
		lcd-kit,ldi-hsync-plr = <0>;
		lcd-kit,ldi-vsync-plr = <0>;
		lcd-kit,ldi-pixel-clk-plr = <0>;
		lcd-kit,ldi-data-en-plr = <0>;
		lcd-kit,ldi-dpi-a-overlap-size = <0>;
		lcd-kit,ldi-dpi-b-overlap-size = <0>;
		lcd-kit,mipi-dsi-upt-support = <1>;
		lcd-kit,mipi-lane-nums = <3>;
		lcd-kit,mipi-color-mode = <5>;
		lcd-kit,mipi-vc = <0>;
		lcd-kit,mipi-dsi-bit-clk = <500>;
		lcd-kit,mipi-burst-mode = <0>;
		lcd-kit,mipi-max-tx-esc-clk = <10>;
		lcd-kit,mipi-dsi-bit-clk-val1 = <500>;
		lcd-kit,mipi-dsi-bit-clk-val2 = <0>;
		lcd-kit,mipi-dsi-bit-clk-val3 = <0>;
		lcd-kit,mipi-dsi-bit-clk-val4 = <0>;
		lcd-kit,mipi-dsi-bit-clk-val5 = <0>;
		lcd-kit,mipi-rg-vrefsel-vcm-adjust = <0>;
		lcd-kit,mipi-non-continue-enable = <1>;
		lcd-kit,mipi-clk-post-adjust = <230>;
		lcd-kit,mipi-lp11-flag = <0>;
		lcd-kit,mipi-phy-update = <1>;
		lcd-kit,mipi-clk-pre-adjust = <0>;
		lcd-kit,mipi-clk-t-lpx-adjust = <4294967232>;
		lcd-kit,mipi-data-t-lpx-adjust = <4294967232>;
		lcd-kit,mipi-phy-mode = <0>;
		lcd-kit,inversion-support = <0>;
		lcd-kit,scan-support = <0>;
		lcd-kit,check-reg-support = <0>;
		lcd-kit,checksum-support = <1>;
		lcd-kit,current-det-support = <0>;
		lcd-kit,lv-det-support = <0>;
		lcd-kit,pt-support = <1>;
		lcd-kit,hkadc-support = <0>;
		lcd-kit,ldo-check-support = <1>;
		lcd-kit,Does-lcd-poweron-tp = <1>;
		lcd-kit,ldo-check-name = "ldo4";
		lcd-kit,ldo-check-channel = <2>;
		lcd-kit,ldo-check-threshold = <250>;
		status = "disabled";
		iovcc-supply = <&ldo4>;
		vdd-supply = <&ldo25>;
		vci-supply = <&ldo17>;
		lcd-kit,lcd-vci = <0 17 3100000>;
		lcd-kit,lcd-iovcc = <1 4 1850000>;
		lcd-kit,lcd-vdd = <1 25 1200000>;
		lcd-kit,lcd-vsp = <2 11 5500000>;
		lcd-kit,lcd-vsn = <2 8 5500000>;
		lcd-kit,lcd-reset = <2 228 0>;
		lcd-kit,tp-reset = <2 15 0>;
		lcd-kit,lcd-te0 = <2 0 0>;
		lcd-kit,lcd-backlight = <2 10 0>;
		lcd-kit,power-on-stage = <2 1 4
				7 1 1>;
		lcd-kit,lp-on-stage = <3 1 3
				4 1 5
				5 1 3
				9 1 5
				6 1 0>;
		lcd-kit,hs-on-stage = <8 1 0>;
		lcd-kit,hs-off-stage = <7 0 0
				6 0 5
				5 0 0
				9 0 1>;
		lcd-kit,lp-off-stage = <0 0 0>;
		lcd-kit,power-off-stage = <8 0 0
				0 0 5
				4 0 3
				3 0 5
				2 0 1>;
		lcd-kit,tp-color-support = <1>;
		lcd-kit,panel-bl-max-nit = <820>;
		lcd-kit,cabc-support = <1>;
		lcd-kit,rgbw-support = <1>;
		lcd-kit,blpwm-disable = <0>;
		lcd-kit,blpwm-div = <0>;
		lcd-kit,acl-support = <0>;
		lcd-kit,hbm-support = <0>;
		lcd-kit,hbm-fp-support = <0>;
		lcd-kit,hbm-level-max = <0>;
		lcd-kit,vr-support = <0>;
		lcd-kit,gamma-cal-support = <0>;
		lcd-kit,sbl-support = <0>;
		lcd-kit,sbl-stren-limit = <128>;
		lcd-kit,sbl-cal-a = <60>;
		lcd-kit,sbl-cal-b = <95>;
		lcd-kit,sbl-cal-c = <5>;
		lcd-kit,sbl-cal-d = <1>;
		lcd-kit,sbl-tf-ctl = <5>;
		lcd-kit,sbl-bl-min = <480>;
		lcd-kit,sbl-bl-max = <4096>;
		lcd-kit,sbl-bl-scale = <0xff>;
		lcd-kit,sbl-am-light-min = <14>;
		lcd-kit,sbl-filter-a = <1738>;
		lcd-kit,sbl-filter-b = <6>;
		lcd-kit,sbl-logo-left = <0>;
		lcd-kit,sbl-logo-top = <0>;
		lcd-kit,sbl-variance-intensity-space = <145>;
		lcd-kit,sbl-slope-max = <54>;
		lcd-kit,sbl-slope-min = <160>;
		lcd-kit,brightness-color-uniform-support = <1>;
		lcd-kit,dbv-curve-mapped-support = <0>;
		lcd-kit,gamma-support = <1>;
		lcd-kit,otp-gamma-support = <0>;
		lcd-kit,ce-support = <0>;
		lcd-kit,effect-on-support = <1>;
		lcd-kit,gmp-support = <1>;
		lcd-kit,color-temp-support = <0>;
		lcd-kit,color-temp-rectify-support = <0>;
		lcd-kit,hiace-support = <1>;
		lcd-kit,iglobal-hist-black-pos = <16>;
		lcd-kit,iglobal-hist-white-pos = <240>;
		lcd-kit,iglobal-hist-black-weight = <51>;
		lcd-kit,iglobal-hist-white-weight = <51>;
		lcd-kit,iglobal-hist-zero-cut-ratio = <486>;
		lcd-kit,iglobal-hist-slope-cut-ratio = <410>;
		lcd-kit,imax-lcd-luminance = <500>;
		lcd-kit,imin-lcd-luminance = <3>;
		lcd-kit,xcc-support = <1>;
		lcd-kit,comform-mode-support = <0>;
		lcd-kit,cinema-mode-support = <0>;
		lcd-kit,effect-color-support = <0>;
		lcd-kit,effect-color-mode = <0>;
		lcd-kit,prefix-ce-support = <0>;
		lcd-kit,arsr1p-sharpness-support = <1>;
		lcd-kit,prefix-sharp-1D-support = <0>;
		lcd-kit,prefix-sharp-2D-support = <1>;
		lcd-kit,smart-color-mode-support = <0>;
		lcd-kit,color-temp-rectify-r = <32768>;
		lcd-kit,color-temp-rectify-g = <32768>;
		lcd-kit,color-temp-rectify-b = <32768>;
		lcd-kit,acm-support = <0>;
		lcd-kit,acm-ce-support = <0>;
		lcd-kit,acm-valid-num = <7>;
		lcd-kit,r_hh0 = <0x7f>;
		lcd-kit,r_lh0 = <0xe>;
		lcd-kit,r_hh1 = <0xbe>;
		lcd-kit,r_lh1 = <0x80>;
		lcd-kit,r_hh2 = <0xff>;
		lcd-kit,r_lh2 = <0xbf>;
		lcd-kit,r_hh3 = <0x1c0>;
		lcd-kit,r_lh3 = <0x100>;
		lcd-kit,r_hh4 = <0x27f>;
		lcd-kit,r_lh4 = <0x1c1>;
		lcd-kit,r_hh5 = <0x323>;
		lcd-kit,r_lh5 = <0x280>;
		lcd-kit,r_hh6 = <0x381>;
		lcd-kit,r_lh6 = <0x324>;
		lcd-kit,r_video_hh0 = <0x7f>;
		lcd-kit,r_video_lh0 = <0xe>;
		lcd-kit,r_video_hh1 = <0xbe>;
		lcd-kit,r_video_lh1 = <0x80>;
		lcd-kit,r_video_hh2 = <0xff>;
		lcd-kit,r_video_lh2 = <0xbf>;
		lcd-kit,r_video_hh3 = <0x1c0>;
		lcd-kit,r_video_lh3 = <0x100>;
		lcd-kit,r_video_hh4 = <0x27f>;
		lcd-kit,r_video_lh4 = <0x1c1>;
		lcd-kit,r_video_hh5 = <0x323>;
		lcd-kit,r_video_lh5 = <0x280>;
		lcd-kit,r_video_hh6 = <0x381>;
		lcd-kit,r_video_lh6 = <0x324>;
		lcd-kit,check-thread-enable = <1>;
		lcd-kit,check-bl-support = <1>;
		lcd-kit,vss-support = <0>;
    };
};