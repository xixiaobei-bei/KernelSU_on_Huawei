/*---------------------------------------------------------------------------
 * This file is autogenerated file using huawei LCD parser. Please do not edit it.
 * Update input XML file to add a new entry or update variable in this file
 * Parser location: vendor/huawei/chipset_common/devkit/lcdkit/tools 
 *---------------------------------------------------------------------------*/


/include/ "elle_tugl_auo_otm1901a_5p2_1080p_video_default.dtsi"
/include/ "elle_tugl_samsung_ea8074_elle_6p10_1080plus_cmd.dtsi"
/include/ "elle_tugl_samsung_ea8076_elle_6p11_1080plus_cmd.dtsi"
/include/ "elle_tugl_samsung_ea8076_elle_v2_6p11_1080plus_cmd.dtsi"