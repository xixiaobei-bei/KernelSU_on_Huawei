/*---------------------------------------------------------------------------
 * This file is autogenerated file using huawei LCD parser. Please do not edit it.
 * Update input XML file to add a new entry or update variable in this file
 * Parser location: vendor/huawei/chipset_common/devkit/lcdkit/tools 
 *---------------------------------------------------------------------------*/


/include/ "laya_tugl_auo_otm1901a_5p2_1080p_video_default.dtsi"
/include/ "laya_tugl_boe_r66451_6p39_1440plus_cmd.dtsi"
/include/ "laya_tugl_lg_ea9151_6p39_1440plus_cmd.dtsi"