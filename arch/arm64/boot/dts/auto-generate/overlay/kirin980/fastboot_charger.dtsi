/ {
	fastboot_charger: fastboot_charger{
		compatible = "fastboot,charger";
		ichrg_pre_limit = <200>;
		hw_charger_type = <4>;
		chip_i2c_num = <6>;
		status = "disabled";
	};
	fastboot_charge_vibrate: fastboot_charge_vibrate {
		compatible = "huawei,charge_vibrate";
		vibrator_delay = <0>;
	};
};
