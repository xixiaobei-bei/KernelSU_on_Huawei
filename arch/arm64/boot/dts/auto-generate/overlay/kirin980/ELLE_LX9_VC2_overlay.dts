/**
 * Copyright (C) 2014 Hisilicon Ltd.
 *
 *  This program is free software; you can redistribute it and/or modify
 *  it under the terms of the GNU General Public License version 2 as
 *  publishhed by the Free Software Foundation.
 */

/dts-v1/;
/plugin/;
/include/ "ELLE_LX9_VC_overlay.dtsi"
/include/ "ELLE_LX9_VC2_pin.dtsi"
/include/ "ELLE_LX9_VC2_modem_pin.dtsi"

/ {
    board_id = <8488>;
};
    &rootparam{
		compatible = "hisilicon,vendor";
		hisi,boardid = <8 4 8 8>;
		hisi,boardname = "ELLE_LX9_VC2";
		hisi,modem_id = <0x37042000>;
		hisi,product_id = <0x37042000>;
		hisi,product_name = "ELE-LX9";
	};
