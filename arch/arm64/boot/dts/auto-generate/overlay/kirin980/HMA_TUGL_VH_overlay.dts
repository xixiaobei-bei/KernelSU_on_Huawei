/**
 * Copyright (C) 2014 Hisilicon Ltd.
 *
 *  This program is free software; you can redistribute it and/or modify
 *  it under the terms of the GNU General Public License version 2 as
 *  publishhed by the Free Software Foundation.
 */

/dts-v1/;
/plugin/;
/include/ "HMA_TUGL_VG_overlay.dtsi"
/include/ "HMA_TUGL_VH_pin.dtsi"
/include/ "HMA_TUGL_VH_modem_pin.dtsi"

/ {
    board_id = <8412>;
};
	&rootparam{
		hisi,boardid = <8 4 1 2>;
		hisi,boardname = "HMA_TUGL_VH";
		hisi,modem_id = <0x37002C00>;
	};