/**
 * Copyright (C) 2014 Hisilicon Ltd.
 *
 *  This program is free software; you can redistribute it and/or modify
 *  it under the terms of the GNU General Public License version 2 as
 *  publishhed by the Free Software Foundation.
 */

/dts-v1/;
/plugin/;
/include/ "SEA_AL10_VA_overlay.dtsi"
/include/ "SEA_AL10_VB_pin.dtsi"
/include/ "SEA_AL10_VB_modem_pin.dtsi"

/ {
	board_id = <8852>;
};

	&rootparam{
		hisi,boardid = <8 8 5 2>;
		hisi,boardname = "SEA_AL10_VB";
		hisi,modem_id = <0x37400800>;
	};
