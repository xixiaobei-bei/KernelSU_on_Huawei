/**
 * Copyright (C) 2014 Hisilicon Ltd.
 *
 *  This program is free software; you can redistribute it and/or modify
 *  it under the terms of the GNU General Public License version 2 as
 *  publishhed by the Free Software Foundation.
 */

/dts-v1/;
/plugin/;
/include/ "LAYA_TUGL_VE_overlay.dtsi"
/include/ "LAYA_TUGL_VG_pin.dtsi"
/include/ "LAYA_TUGL_VG_modem_pin.dtsi"

/ {
    board_id = <8437>;
};

	&rootparam{
		hisi,boardid = <8 4 3 7>;
		hisi,boardname = "LAYA_TUGL_VG";
		hisi,modem_id = <0x37011C00>;
	};
	&hisi_usb {
		usb_firmware_es = <0>;
	};
