/**
 * Copyright (C) 2014 Hisilicon Ltd.
 *
 *  This program is free software; you can redistribute it and/or modify
 *  it under the terms of the GNU General Public License version 2 as
 *  publishhed by the Free Software Foundation.
 */

/include/ "YAL_LX1_VB_overlay.dtsi"

/ {
	board_id = <8817>;
};

	&rootparam{
		hisi,boardid = <8 8 1 7>;
		hisi,boardname = "YAL_LX1_VC";
		hisi,modem_id = <0x37634800>;
		hisi,product_id = <0x37634800>;
		hisi,product_name = "YAL-LX1";
	};
