/**
 * Copyright (C) 2014 Hisilicon Ltd.
 *
 *  This program is free software; you can redistribute it and/or modify
 *  it under the terms of the GNU General Public License version 2 as
 *  publishhed by the Free Software Foundation.
 */

/include/ "YALZX_AL10_VB_overlay.dtsi"

/ {
	board_id = <8821>;
};

	&rootparam{
		hisi,boardid = <8 8 2 1>;
		hisi,boardname = "YALZX_AL10_VD";
		hisi,modem_id = <0x37662400>;
		hisi,product_id = <0x37662400>;
		hisi,product_name = "YALZX-AL10";
	};
