/**
 * Copyright (C) 2014 Hisilicon Ltd.
 *
 *  This program is free software; you can redistribute it and/or modify
 *  it under the terms of the GNU General Public License version 2 as
 *  publishhed by the Free Software Foundation.
 */

/include/ "YALZX_LX1_VA_overlay.dtsi"

/ {
	board_id = <8814>;
};

	&rootparam{
		hisi,boardid = <8 8 1 4>;
		hisi,boardname = "YALZX_LX1_VB";
		hisi,modem_id = <0x37660C00>;
		hisi,product_id = <0x37660C00>;
		hisi,product_name = "YALZX-LX1";
	};
