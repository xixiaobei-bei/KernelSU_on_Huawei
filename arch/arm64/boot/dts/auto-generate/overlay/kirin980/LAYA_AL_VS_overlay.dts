/**
 * Copyright (C) 2014 Hisilicon Ltd.
 *
 *  This program is free software; you can redistribute it and/or modify
 *  it under the terms of the GNU General Public License version 2 as
 *  publishhed by the Free Software Foundation.
 */

/dts-v1/;
/plugin/;
/include/ "LAYA_AL_VQ_overlay.dtsi"
/include/ "LAYA_AL_VS_pin.dtsi"
/include/ "LAYA_AL_VS_modem_pin.dtsi"

/ {
    board_id = <8424>;
};

	&rootparam{
		hisi,boardid = <8 4 2 4>;
		hisi,boardname = "LAYA_AL_VS";
		hisi,modem_id = <0x37014800>;
	};
