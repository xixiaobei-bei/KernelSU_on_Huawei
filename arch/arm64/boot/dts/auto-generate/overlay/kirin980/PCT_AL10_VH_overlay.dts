/**
 * Copyright (C) 2014 Hisilicon Ltd.
 *
 *  This program is free software; you can redistribute it and/or modify
 *  it under the terms of the GNU General Public License version 2 as
 *  publishhed by the Free Software Foundation.
 */

/dts-v1/;
/plugin/;
/include/ "PCT_AL10_VG_overlay.dtsi"
/include/ "PCT_AL10_VH_pin.dtsi"
/include/ "PCT_AL10_VH_modem_pin.dtsi"

/ {
    board_id = <8909>;
};

	&rootparam{
		hisi,boardid = <8 9 0 9>;
		hisi,boardname = "PCT_AL10_VH";
		hisi,modem_id = <0x37614000>;
	};

	&antenna_board_adc_match{
		antenna_board_match_range = <1700 1875>;
	};
