/* DO NOT EDIT - Automatically generated by python */
		&desaysony_3650_68k_4400_25 {
			fcc = <3650>;
			default_rbatt_mohm = <100>;
			identify_type = "id_volt";
			id_identify_min = <1759>;
			id_identify_max = <2281>;
			id_voltage_min = <1956>;
			id_voltage_max = <2135>;
			vbat_max = <4400>;
			temp_para = 
						"-32767","0","-1","0","4100","0",
						"0","5","-1","365","4400","0",
						"5","10","-1","1095","4400","3",
						"10","45","-1","-1","4400","3",
						"45","50","-1","1277","4100","3",
						"50","32767","-1","0","4100","0";
			vbat_para = 
						"-32767","3400","-1","820","0",
						"3400","32767","-1","-1","0";
			segment_para = 
						"-32767","4150","3650","4208","50",
						"4150","4450","2555","4400","0";
			batt_brand = "desaysony";
			fcc_temp = <3559 3561 3576 3612 3599 3582>;
			fcc_sf_x = <0 100 200 300 400 500 600 700 800 1000 1500>;
			fcc_sf_y = <100 96 94 92 90 88 87 84 81 75 50>;
			fcc_sf_cols = <11>;
			pc_sf_rows = <1>;
			pc_sf_cols = <1>;
			pc_sf_row_entries = <0>;
			pc_sf_percent = <100>;
			pc_sf_sf = <100>;
			rbatt_sf_rows = <28>;
			rbatt_sf_cols = <6>;
			rbatt_sf_percent = <100 95 90 85 80 75 70 65 60 55 50 45 40 35 30 25 20 15 10 9 8 7 6 5 4 3 2 1>;
			rbatt_sf_sf = <
			               1407 701 343 141 111 101
			               1410 706 346 143 112 101
			               1414 720 357 147 114 102
			               1398 724 366 151 117 103
			               1395 737 375 157 120 105
			               1370 741 388 163 123 107
			               1358 707 381 172 129 110
			               1345 710 368 172 134 114
			               1333 715 357 156 128 112
			               1347 715 351 142 113 102
			               1373 719 349 141 112 102
			               1430 740 352 143 113 103
			               1500 779 360 148 117 104
			               1564 824 375 153 121 107
			               1646 878 398 152 119 105
			               1763 944 426 148 115 103
			               1915 1033 453 147 116 105
			               2198 1239 507 148 116 106
			               3758 1759 677 150 119 107
			               4172 1747 548 150 119 109
			               4905 1677 561 151 119 108
			               6238 1915 617 155 122 109
			               8318 2336 675 155 121 109
			               12151 3045 794 154 119 119
			               21412 4138 962 157 119 148
			               38649 6241 1227 171 121 111
			               61015 12396 1744 349 175 135
			               105078 27906 3084 477 329 201
			              >;
			pc_temp_ocv_rows = <29>;
			pc_temp_ocv_cols = <6>;
			pc_temp_ocv_percent = <100 95 90 85 80 75 70 65 60 55 50 45 40 35 30 25 20 15 10 9 8 7 6 5 4 3 2 1>;
			pc_temp_ocv_ocv = <
			                   4325 4324 4323 4316 4310 4303
			                   4241 4252 4256 4255 4249 4244
			                   4173 4190 4197 4197 4192 4188
			                   4111 4131 4141 4142 4138 4133
			                   4057 4079 4086 4090 4086 4082
			                   3999 4029 4037 4041 4038 4034
			                   3947 3968 3985 3995 3993 3990
			                   3901 3921 3936 3949 3950 3948
			                   3858 3882 3894 3903 3905 3903
			                   3826 3845 3858 3864 3864 3862
			                   3797 3813 3828 3836 3836 3834
			                   3776 3790 3804 3814 3814 3812
			                   3759 3773 3785 3796 3797 3794
			                   3740 3758 3771 3781 3781 3778
			                   3720 3745 3759 3764 3762 3755
			                   3703 3728 3745 3745 3739 3727
			                   3682 3703 3721 3723 3719 3707
			                   3657 3672 3686 3695 3691 3679
			                   3615 3631 3644 3664 3660 3650
			                   3606 3623 3637 3659 3656 3645
			                   3594 3614 3631 3653 3650 3640
			                   3575 3600 3624 3645 3643 3633
			                   3554 3584 3611 3633 3630 3620
			                   3526 3564 3592 3605 3603 3593
			                   3491 3534 3561 3561 3561 3554
			                   3446 3477 3509 3505 3506 3501
			                   3389 3405 3437 3444 3439 3434
			                   3301 3320 3346 3362 3353 3346
			                   3200 3200 3200 3200 3200 3200
			                  >;
		};
