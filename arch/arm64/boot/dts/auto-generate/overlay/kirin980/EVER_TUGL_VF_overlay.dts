/**
 * Copyright (C) 2014 Hisilicon Ltd.
 *
 *  This program is free software; you can redistribute it and/or modify
 *  it under the terms of the GNU General Public License version 2 as
 *  publishhed by the Free Software Foundation.
 */

/dts-v1/;
/plugin/;

/include/ "EVER_TUGL_VE_overlay.dtsi"
/include/ "EVER_TUGL_VF_pin.dtsi"
/include/ "EVER_TUGL_VF_modem_pin.dtsi"

/ {
    board_id = <8458>;
};
	&rootparam{
		hisi,boardid = <8 4 5 8>;
		hisi,boardname = "EVER_TUGL_VF";
		hisi,modem_id = <0x37020800>;
	};
