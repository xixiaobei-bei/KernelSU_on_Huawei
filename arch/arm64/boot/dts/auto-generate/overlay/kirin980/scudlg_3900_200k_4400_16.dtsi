/* DO NOT EDIT - Automatically generated by python */
		&scudlg_3900_200k_4400_16 {
			fcc = <3900>;
			default_rbatt_mohm = <100>;
			identify_type = "id_volt";
			id_identify_min = <2786>;
			id_identify_max = <3312>;
			id_voltage_min = <2941>;
			id_voltage_max = <3167>;
			vbat_max = <4400>;
			temp_para = 
						"-32767","0","-1","0","4100","0",
						"0","5","-1","390","4400","0",
						"5","10","-1","1170","4400","3",
						"10","45","-1","-1","4400","3",
						"45","50","-1","1365","4100","3",
						"50","32767","-1","0","4100","0";
			vbat_para = 
						"-32767","3400","-1","820","0",
						"3400","32767","-1","-1","0";
			segment_para = 
						"-32767","4150","3900","4208","50",
						"4150","4450","2730","4400","0";
			batt_brand = "scudlg";
			fcc_temp = <3907 3904 3917 3947 3893 3866>;
			fcc_sf_x = <0 100 200 300 400 500 600 700 800 1000 1500>;
			fcc_sf_y = <100 96 94 92 90 88 87 84 81 75 50>;
			fcc_sf_cols = <11>;
			pc_sf_rows = <1>;
			pc_sf_cols = <1>;
			pc_sf_row_entries = <0>;
			pc_sf_percent = <100>;
			pc_sf_sf = <100>;
			rbatt_sf_rows = <28>;
			rbatt_sf_cols = <6>;
			rbatt_sf_percent = <100 95 90 85 80 75 70 65 60 55 50 45 40 35 30 25 20 15 10 9 8 7 6 5 4 3 2 1>;
			rbatt_sf_sf = <
			               1680 794 329 92 71 60
			               1656 794 330 93 71 60
			               1515 794 339 95 71 61
			               1420 791 345 98 74 62
			               1389 797 357 104 77 64
			               1267 773 382 111 82 66
			               1234 697 338 119 85 68
			               1236 711 331 131 91 72
			               1225 700 319 122 95 74
			               1217 688 308 96 76 63
			               1244 690 305 91 70 61
			               1293 710 305 93 72 62
			               1358 747 309 97 75 65
			               1440 796 322 100 78 67
			               1540 863 348 98 78 67
			               1655 959 378 96 70 61
			               1797 1104 422 96 71 61
			               1986 1321 501 95 72 62
			               2597 1115 424 97 74 64
			               3115 1225 451 97 73 64
			               3694 1397 502 99 73 63
			               4325 1659 567 101 74 64
			               5057 1854 638 102 76 63
			               5828 2201 736 104 71 63
			               6574 2642 835 115 73 65
			               7328 3221 982 342 80 69
			               8055 4056 1388 601 114 69
			               9314 5088 1922 702 282 150
			              >;
			pc_temp_ocv_rows = <29>;
			pc_temp_ocv_cols = <6>;
			pc_temp_ocv_percent = <100 95 90 85 80 75 70 65 60 55 50 45 40 35 30 25 20 15 10 9 8 7 6 5 4 3 2 1>;
			pc_temp_ocv_ocv = <
			                   4332 4331 4329 4329 4314 4307
			                   4239 4250 4256 4265 4251 4245
			                   4173 4189 4198 4207 4194 4189
			                   4114 4134 4143 4153 4140 4135
			                   4070 4083 4093 4102 4089 4084
			                   3984 4020 4043 4052 4042 4036
			                   3929 3947 3966 3995 3991 3991
			                   3894 3915 3929 3959 3955 3951
			                   3859 3878 3893 3914 3913 3911
			                   3827 3843 3858 3867 3865 3864
			                   3807 3816 3829 3837 3835 3834
			                   3793 3798 3807 3815 3814 3812
			                   3781 3787 3790 3798 3796 3794
			                   3771 3777 3779 3783 3782 3779
			                   3760 3767 3772 3770 3767 3762
			                   3748 3755 3760 3755 3748 3735
			                   3735 3741 3744 3735 3728 3715
			                   3717 3724 3721 3707 3703 3690
			                   3692 3704 3697 3689 3681 3669
			                   3683 3696 3693 3687 3680 3668
			                   3673 3689 3689 3685 3678 3666
			                   3661 3685 3685 3680 3675 3663
			                   3646 3674 3675 3665 3668 3655
			                   3627 3657 3657 3632 3647 3633
			                   3596 3628 3622 3582 3607 3595
			                   3553 3581 3566 3533 3553 3546
			                   3493 3516 3491 3478 3482 3478
			                   3404 3416 3360 3382 3383 3382
			                   3200 3200 3200 3200 3200 3200
			                  >;
		};
