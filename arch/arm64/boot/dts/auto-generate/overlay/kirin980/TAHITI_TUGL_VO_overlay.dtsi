/**
 * Copyright (C) 2014 Hisilicon Ltd.
 *
 *  This program is free software; you can redistribute it and/or modify
 *  it under the terms of the GNU General Public License version 2 as
 *  publishhed by the Free Software Foundation.
 */

/include/ "TAHITI_TUGL_VN_overlay.dtsi"

/ {
    board_id = <8532>;
};
    &rootparam{
		compatible = "hisilicon,vendor";
		hisi,boardid = <8 5 3 2>;
		hisi,boardname = "TAHITI_TUGL_VO";
		hisi,modem_id = <0x37030C00>;
		hisi,product_id = <0x37030C00>;
		hisi,product_name = "TAH-AL00";
	};
