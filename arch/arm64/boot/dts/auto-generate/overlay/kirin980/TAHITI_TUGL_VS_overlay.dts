/**
 * Copyright (C) 2014 Hisilicon Ltd.
 *
 *  This program is free software; you can redistribute it and/or modify
 *  it under the terms of the GNU General Public License version 2 as
 *  publishhed by the Free Software Foundation.
 */

/dts-v1/;
/plugin/;
/include/ "TAHITI_TUGL_VR_overlay.dtsi"
/include/ "TAHITI_TUGL_VS_pin.dtsi"
/include/ "TAHITI_TUGL_VS_modem_pin.dtsi"

/ {
    board_id = <8536>;
};
    &rootparam{
		compatible = "hisilicon,vendor";
		hisi,boardid = <8 5 3 6>;
		hisi,boardname = "TAHITI_TUGL_VS";
		hisi,modem_id = <0x37030800>;
		hisi,product_id = <0x37030800>;
		hisi,product_name = "TAH-AL00";
	};
