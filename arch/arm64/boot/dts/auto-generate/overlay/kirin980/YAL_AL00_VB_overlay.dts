/**
 * Copyright (C) 2014 Hisilicon Ltd.
 *
 *  This program is free software; you can redistribute it and/or modify
 *  it under the terms of the GNU General Public License version 2 as
 *  publishhed by the Free Software Foundation.
 */

/dts-v1/;
/plugin/;
/include/ "YAL_AL00_VA_overlay.dtsi"
/include/ "YAL_AL00_VB_pin.dtsi"
/include/ "YAL_AL00_VB_modem_pin.dtsi"

/ {
	board_id = <8803>;
};

	&rootparam{
		hisi,boardid = <8 8 0 3>;
		hisi,boardname = "YAL_AL00_VB";
		hisi,modem_id = <0x37631000>;
		hisi,product_id = <0x37631000>;
		hisi,product_name = "YAL-AL00";
	};
