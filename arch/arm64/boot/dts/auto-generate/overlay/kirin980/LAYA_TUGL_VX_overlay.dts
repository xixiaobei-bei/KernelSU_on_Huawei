/**
 * Copyright (C) 2014 Hisilicon Ltd.
 *
 *  This program is free software; you can redistribute it and/or modify
 *  it under the terms of the GNU General Public License version 2 as
 *  publishhed by the Free Software Foundation.
 */

/dts-v1/;
/plugin/;
/include/ "LAYA_TUGL_VT_overlay.dtsi"
/include/ "LAYA_TUGL_VX_pin.dtsi"
/include/ "LAYA_TUGL_VX_modem_pin.dtsi"

/ {
    board_id = <8416>;
};

	&rootparam{
		hisi,boardid = <8 4 1 6>;
		hisi,boardname = "LAYA_TUGL_VX";
		hisi,modem_id = <0x37014C00>;
	};
