/**
 * Copyright (C) 2014 Hisilicon Ltd.
 *
 *  This program is free software; you can redistribute it and/or modify
 *  it under the terms of the GNU General Public License version 2 as
 *  publishhed by the Free Software Foundation.
 */

/dts-v1/;
/plugin/;
/include/ "LAYA_LX9_VF_overlay.dtsi"
/include/ "LAYA_LX9_VH_pin.dtsi"
/include/ "LAYA_LX9_VH_modem_pin.dtsi"

/ {
    board_id = <8417>;
};

	&rootparam{
		hisi,boardid = <8 4 1 7>;
		hisi,boardname = "LAYA_LX9_VH";
		hisi,modem_id = <0x37015000>;
	};
