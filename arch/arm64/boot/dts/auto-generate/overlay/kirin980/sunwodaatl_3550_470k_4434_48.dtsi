/* DO NOT EDIT - Automatically generated by python */
		&sunwodaatl_3550_470k_4434_48 {
			fcc = <3550>;
			default_rbatt_mohm = <100>;
			identify_type = "id_volt";
			id_identify_min = <3312>;
			id_identify_max = <3767>;
			id_voltage_min = <3407>;
			id_voltage_max = <3696>;
			vbat_max = <4434>;
			temp_para = 
						"-32767","0","-1","0","4100","0",
						"0","5","-1","355","4434","0",
						"5","10","-1","1065","4434","3",
						"10","45","-1","-1","4434","3",
						"45","50","-1","1242","4100","3",
						"50","32767","-1","0","4100","0";
			vbat_para = 
						"-32767","3400","-1","820","0",
						"3400","32767","-1","-1","0";
			segment_para = 
						"-32767","4150","3550","4208","50",
						"4150","4450","2485","4434","0";
			batt_brand = "sunwodaatl";
			fcc_temp = <3517 3519 3514 3520 3465 3478>;
			fcc_sf_x = <0 100 200 300 400 500 600 700 800 1000 1500>;
			fcc_sf_y = <100 96 94 92 90 88 87 84 81 75 50>;
			fcc_sf_cols = <11>;
			pc_sf_rows = <1>;
			pc_sf_cols = <1>;
			pc_sf_row_entries = <0>;
			pc_sf_percent = <100>;
			pc_sf_sf = <100>;
			rbatt_sf_rows = <28>;
			rbatt_sf_cols = <6>;
			rbatt_sf_percent = <100 95 90 85 80 75 70 65 60 55 50 45 40 35 30 25 20 15 10 9 8 7 6 5 4 3 2 1>;
			rbatt_sf_sf = <
			               1493 1185 526 155 130 115
			               1479 1175 534 155 130 115
			               1449 1133 528 154 130 115
			               1414 1093 512 155 131 117
			               1376 1059 501 157 133 118
			               1359 1032 510 160 135 119
			               1315 995 516 167 139 121
			               1258 962 506 180 146 125
			               1244 938 474 181 148 125
			               1238 906 444 160 135 119
			               1256 899 429 150 129 116
			               1306 942 420 152 130 117
			               1385 1031 434 154 133 118
			               1489 1158 485 159 137 121
			               1602 1295 569 159 135 119
			               1705 1403 688 151 130 116
			               1809 1481 835 148 129 117
			               1969 1556 1028 151 129 115
			               3151 1732 790 149 135 118
			               3519 1991 888 151 137 121
			               3987 2287 1005 150 136 120
			               4511 2645 1156 151 135 125
			               5186 3080 1388 156 138 121
			               6245 3686 1703 156 131 119
			               7993 4668 2110 154 136 122
			               13332 6544 2842 158 136 124
			               27736 12599 4448 168 137 127
			               55476 35074 8385 195 144 137
			              >;
			pc_temp_ocv_rows = <29>;
			pc_temp_ocv_cols = <6>;
			pc_temp_ocv_percent = <100 95 90 85 80 75 70 65 60 55 50 45 40 35 30 25 20 15 10 9 8 7 6 5 4 3 2 1>;
			pc_temp_ocv_ocv = <
			                   4380 4377 4375 4373 4366 4364
			                   4302 4306 4315 4317 4310 4307
			                   4238 4243 4257 4260 4253 4251
			                   4179 4184 4198 4202 4196 4195
			                   4118 4125 4141 4146 4141 4140
			                   4067 4072 4088 4093 4088 4088
			                   4007 4015 4038 4044 4039 4039
			                   3945 3961 3988 3998 3995 3995
			                   3900 3914 3934 3949 3947 3947
			                   3858 3866 3886 3899 3898 3901
			                   3828 3830 3848 3863 3864 3865
			                   3811 3809 3818 3838 3839 3840
			                   3798 3798 3798 3816 3818 3818
			                   3784 3788 3788 3799 3800 3800
			                   3769 3777 3778 3782 3780 3775
			                   3749 3762 3764 3761 3756 3746
			                   3727 3741 3743 3740 3733 3723
			                   3706 3712 3712 3713 3707 3696
			                   3683 3678 3680 3691 3686 3675
			                   3676 3673 3676 3690 3684 3673
			                   3670 3670 3672 3688 3682 3671
			                   3662 3666 3666 3685 3679 3668
			                   3653 3659 3658 3677 3670 3658
			                   3639 3645 3639 3656 3645 3630
			                   3605 3615 3602 3614 3604 3589
			                   3565 3564 3547 3559 3553 3537
			                   3497 3496 3474 3488 3484 3468
			                   3388 3393 3372 3383 3382 3369
			                   3200 3200 3200 3200 3200 3200
			                  >;
		};
