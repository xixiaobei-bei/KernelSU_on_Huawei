    &pinmuxfc182000 {
		gpio128_pmx_func {
                     pinctrl-single,pins = <0x000    0x1>;
		};
		gpio128_pmx_idle {
                     pinctrl-single,pins = <0x000    0x0>;
		};

		gpio129_pmx_func {
                     pinctrl-single,pins = <0x004    0x0>;
		};
		gpio129_pmx_idle {
                     pinctrl-single,pins = <0x004    0x0>;
		};

		gpio130_pmx_func {
                     pinctrl-single,pins = <0x008    0x1>;
		};
		gpio130_pmx_idle {
                     pinctrl-single,pins = <0x008    0x0>;
		};

		gpio131_pmx_func {
                     pinctrl-single,pins = <0x00C    0x0>;
		};
		gpio131_pmx_idle {
                     pinctrl-single,pins = <0x00C    0x0>;
		};

		gpio132_pmx_func {
                     pinctrl-single,pins = <0x010    0x1>;
		};
		gpio132_pmx_idle {
                     pinctrl-single,pins = <0x010    0x0>;
		};

		gpio133_pmx_func {
                     pinctrl-single,pins = <0x014    0x0>;
		};
		gpio133_pmx_idle {
                     pinctrl-single,pins = <0x014    0x0>;
		};

		gpio134_pmx_func {
                     pinctrl-single,pins = <0x018    0x0>;
		};
		gpio134_pmx_idle {
                     pinctrl-single,pins = <0x018    0x0>;
		};

		gpio135_pmx_func {
                     pinctrl-single,pins = <0x01C    0x0>;
		};
		gpio135_pmx_idle {
                     pinctrl-single,pins = <0x01C    0x0>;
		};

		gpio136_pmx_func {
                     pinctrl-single,pins = <0x020    0x0>;
		};
		gpio136_pmx_idle {
                     pinctrl-single,pins = <0x020    0x0>;
		};

		gpio137_pmx_func {
                     pinctrl-single,pins = <0x024    0x0>;
		};
		gpio137_pmx_idle {
                     pinctrl-single,pins = <0x024    0x0>;
		};

    };

    &pinmuxff37e000 {
		gpio160_pmx_func {
                     pinctrl-single,pins = <0x000    0x1>;
		};
		gpio160_pmx_idle {
                     pinctrl-single,pins = <0x000    0x0>;
		};

		gpio161_pmx_func {
                     pinctrl-single,pins = <0x004    0x1>;
		};
		gpio161_pmx_idle {
                     pinctrl-single,pins = <0x004    0x0>;
		};

		gpio162_pmx_func {
                     pinctrl-single,pins = <0x008    0x1>;
		};
		gpio162_pmx_idle {
                     pinctrl-single,pins = <0x008    0x0>;
		};

		gpio163_pmx_func {
                     pinctrl-single,pins = <0x00C    0x1>;
		};
		gpio163_pmx_idle {
                     pinctrl-single,pins = <0x00C    0x0>;
		};

		gpio164_pmx_func {
                     pinctrl-single,pins = <0x010    0x1>;
		};
		gpio164_pmx_idle {
                     pinctrl-single,pins = <0x010    0x0>;
		};

		gpio165_pmx_func {
                     pinctrl-single,pins = <0x014    0x1>;
		};
		gpio165_pmx_idle {
                     pinctrl-single,pins = <0x014    0x0>;
		};

		gpio166_pmx_func {
                     pinctrl-single,pins = <0x018    0x1>;
		};
		gpio166_pmx_idle {
                     pinctrl-single,pins = <0x018    0x1>;
		};

		gpio167_pmx_func {
                     pinctrl-single,pins = <0x01C    0x1>;
		};
		gpio167_pmx_idle {
                     pinctrl-single,pins = <0x01C    0x1>;
		};

		gpio168_pmx_func {
                     pinctrl-single,pins = <0x020    0x1>;
		};
		gpio168_pmx_idle {
                     pinctrl-single,pins = <0x020    0x1>;
		};

		gpio169_pmx_func {
                     pinctrl-single,pins = <0x024    0x1>;
		};
		gpio169_pmx_idle {
                     pinctrl-single,pins = <0x024    0x1>;
		};

		gpio170_pmx_func {
                     pinctrl-single,pins = <0x028    0x1>;
		};
		gpio170_pmx_idle {
                     pinctrl-single,pins = <0x028    0x1>;
		};

		gpio171_pmx_func {
                     pinctrl-single,pins = <0x02C    0x1>;
		};
		gpio171_pmx_idle {
                     pinctrl-single,pins = <0x02C    0x1>;
		};

    };

    &pinmuxe896c000 {
		gpio001_pmx_func {
                     pinctrl-single,pins = <0x000    0x0>;
		};
		gpio001_pmx_idle {
                     pinctrl-single,pins = <0x000    0x0>;
		};

		gpio003_pmx_func {
                     pinctrl-single,pins = <0x008    0x1>;
		};
		gpio003_pmx_idle {
                     pinctrl-single,pins = <0x008    0x0>;
		};

		gpio004_pmx_func {
                     pinctrl-single,pins = <0x00C    0x1>;
		};
		gpio004_pmx_idle {
                     pinctrl-single,pins = <0x00C    0x0>;
		};

		gpio005_pmx_func {
                     pinctrl-single,pins = <0x010    0x1>;
		};
		gpio005_pmx_idle {
                     pinctrl-single,pins = <0x010    0x1>;
		};

		gpio006_pmx_func {
                     pinctrl-single,pins = <0x014    0x0>;
		};
		gpio006_pmx_idle {
                     pinctrl-single,pins = <0x014    0x0>;
		};

		gpio007_pmx_func {
                     pinctrl-single,pins = <0x018    0x0>;
		};
		gpio007_pmx_idle {
                     pinctrl-single,pins = <0x018    0x0>;
		};

		gpio017_pmx_func {
                     pinctrl-single,pins = <0x040    0x1>;
		};
		gpio017_pmx_idle {
                     pinctrl-single,pins = <0x040    0x1>;
		};

		gpio018_pmx_func {
                     pinctrl-single,pins = <0x044    0x1>;
		};
		gpio018_pmx_idle {
                     pinctrl-single,pins = <0x044    0x1>;
		};

		gpio019_pmx_func {
                     pinctrl-single,pins = <0x048    0x1>;
		};
		gpio019_pmx_idle {
                     pinctrl-single,pins = <0x048    0x1>;
		};

		gpio020_pmx_func {
                     pinctrl-single,pins = <0x04C    0x1>;
		};
		gpio020_pmx_idle {
                     pinctrl-single,pins = <0x04C    0x1>;
		};

		gpio021_pmx_func {
                     pinctrl-single,pins = <0x050    0x1>;
		};
		gpio021_pmx_idle {
                     pinctrl-single,pins = <0x050    0x1>;
		};

		gpio022_pmx_func {
                     pinctrl-single,pins = <0x054    0x1>;
		};
		gpio022_pmx_idle {
                     pinctrl-single,pins = <0x054    0x1>;
		};

		gpio023_pmx_func {
                     pinctrl-single,pins = <0x058    0x1>;
		};
		gpio023_pmx_idle {
                     pinctrl-single,pins = <0x058    0x1>;
		};

		gpio024_pmx_func {
                     pinctrl-single,pins = <0x05C    0x1>;
		};
		gpio024_pmx_idle {
                     pinctrl-single,pins = <0x05C    0x1>;
		};

		gpio025_pmx_func {
                     pinctrl-single,pins = <0x060    0x1>;
		};
		gpio025_pmx_idle {
                     pinctrl-single,pins = <0x060    0x1>;
		};

		gpio026_pmx_func {
                     pinctrl-single,pins = <0x064    0x1>;
		};
		gpio026_pmx_idle {
                     pinctrl-single,pins = <0x064    0x0>;
		};

		gpio027_pmx_func {
                     pinctrl-single,pins = <0x068    0x1>;
		};
		gpio027_pmx_idle {
                     pinctrl-single,pins = <0x068    0x0>;
		};

		gpio031_pmx_func {
                     pinctrl-single,pins = <0x078    0x0>;
		};
		gpio031_pmx_idle {
                     pinctrl-single,pins = <0x078    0x0>;
		};

		gpio032_pmx_func {
                     pinctrl-single,pins = <0x07C    0x0>;
		};
		gpio032_pmx_idle {
                     pinctrl-single,pins = <0x07C    0x0>;
		};

		gpio033_pmx_func {
                     pinctrl-single,pins = <0x080    0x0>;
		};
		gpio033_pmx_idle {
                     pinctrl-single,pins = <0x080    0x0>;
		};

		gpio034_pmx_func {
                     pinctrl-single,pins = <0x084    0x0>;
		};
		gpio034_pmx_idle {
                     pinctrl-single,pins = <0x084    0x0>;
		};

		gpio035_pmx_func {
                     pinctrl-single,pins = <0x088    0x2>;
		};
		gpio035_pmx_idle {
                     pinctrl-single,pins = <0x088    0x2>;
		};

		gpio036_pmx_func {
                     pinctrl-single,pins = <0x08C    0x2>;
		};
		gpio036_pmx_idle {
                     pinctrl-single,pins = <0x08C    0x2>;
		};

		gpio037_pmx_func {
                     pinctrl-single,pins = <0x090    0x1>;
		};
		gpio037_pmx_idle {
                     pinctrl-single,pins = <0x090    0x1>;
		};

		gpio038_pmx_func {
                     pinctrl-single,pins = <0x094    0x1>;
		};
		gpio038_pmx_idle {
                     pinctrl-single,pins = <0x094    0x1>;
		};

		gpio039_pmx_func {
                     pinctrl-single,pins = <0x098    0x1>;
		};
		gpio039_pmx_idle {
                     pinctrl-single,pins = <0x098    0x1>;
		};

		gpio040_pmx_func {
                     pinctrl-single,pins = <0x09C    0x1>;
		};
		gpio040_pmx_idle {
                     pinctrl-single,pins = <0x09C    0x1>;
		};

		gpio041_pmx_func {
                     pinctrl-single,pins = <0x0A0    0x1>;
		};
		gpio041_pmx_idle {
                     pinctrl-single,pins = <0x0A0    0x1>;
		};

		gpio042_pmx_func {
                     pinctrl-single,pins = <0x0A4    0x1>;
		};
		gpio042_pmx_idle {
                     pinctrl-single,pins = <0x0A4    0x1>;
		};

		gpio043_pmx_func {
                     pinctrl-single,pins = <0x0A8    0x1>;
		};
		gpio043_pmx_idle {
                     pinctrl-single,pins = <0x0A8    0x1>;
		};

		gpio044_pmx_func {
                     pinctrl-single,pins = <0x0AC    0x1>;
		};
		gpio044_pmx_idle {
                     pinctrl-single,pins = <0x0AC    0x1>;
		};

		gpio045_pmx_func {
                     pinctrl-single,pins = <0x0B0    0x1>;
		};
		gpio045_pmx_idle {
                     pinctrl-single,pins = <0x0B0    0x1>;
		};

		gpio046_pmx_func {
                     pinctrl-single,pins = <0x0B4    0x1>;
		};
		gpio046_pmx_idle {
                     pinctrl-single,pins = <0x0B4    0x1>;
		};

		gpio047_pmx_func {
                     pinctrl-single,pins = <0x0B8    0x0>;
		};
		gpio047_pmx_idle {
                     pinctrl-single,pins = <0x0B8    0x0>;
		};

		gpio049_pmx_func {
                     pinctrl-single,pins = <0x0C0    0x1>;
		};
		gpio049_pmx_idle {
                     pinctrl-single,pins = <0x0C0    0x1>;
		};

		gpio050_pmx_func {
                     pinctrl-single,pins = <0x0C4    0x1>;
		};
		gpio050_pmx_idle {
                     pinctrl-single,pins = <0x0C4    0x1>;
		};

		gpio051_pmx_func {
                     pinctrl-single,pins = <0x0C8    0x0>;
		};
		gpio051_pmx_idle {
                     pinctrl-single,pins = <0x0C8    0x0>;
		};

		gpio054_pmx_func {
                     pinctrl-single,pins = <0x0D4    0x0>;
		};
		gpio054_pmx_idle {
                     pinctrl-single,pins = <0x0D4    0x0>;
		};

		gpio055_pmx_func {
                     pinctrl-single,pins = <0x0D8    0x0>;
		};
		gpio055_pmx_idle {
                     pinctrl-single,pins = <0x0D8    0x0>;
		};

		gpio056_pmx_func {
                     pinctrl-single,pins = <0x0DC    0x0>;
		};
		gpio056_pmx_idle {
                     pinctrl-single,pins = <0x0DC    0x0>;
		};

		gpio057_pmx_func {
                     pinctrl-single,pins = <0x0E0    0x0>;
		};
		gpio057_pmx_idle {
                     pinctrl-single,pins = <0x0E0    0x0>;
		};

    };

    &pinmuxfff11000 {
		gpio148_pmx_func {
                     pinctrl-single,pins = <0x0E4    0x0>;
		};
		gpio148_pmx_idle {
                     pinctrl-single,pins = <0x0E4    0x0>;
		};

		gpio150_pmx_func {
                     pinctrl-single,pins = <0x0EC    0x1>;
		};
		gpio150_pmx_idle {
                     pinctrl-single,pins = <0x0EC    0x1>;
		};

		gpio151_pmx_func {
                     pinctrl-single,pins = <0x0F0    0x1>;
		};
		gpio151_pmx_idle {
                     pinctrl-single,pins = <0x0F0    0x1>;
		};

		gpio152_pmx_func {
                     pinctrl-single,pins = <0x0F4    0x0>;
		};
		gpio152_pmx_idle {
                     pinctrl-single,pins = <0x0F4    0x0>;
		};

		gpio153_pmx_func {
                     pinctrl-single,pins = <0x0F8    0x4>;
		};
		gpio153_pmx_idle {
                     pinctrl-single,pins = <0x0F8    0x4>;
		};

		gpio178_pmx_func {
		};
		gpio178_pmx_idle {
		};

		gpio179_pmx_func {
		};
		gpio179_pmx_idle {
		};

		gpio180_pmx_func {
		};
		gpio180_pmx_idle {
		};

		gpio181_pmx_func {
		};
		gpio181_pmx_idle {
		};

		gpio182_pmx_func {
                     pinctrl-single,pins = <0x010    0x0>;
		};
		gpio182_pmx_idle {
                     pinctrl-single,pins = <0x010    0x0>;
		};

		gpio183_pmx_func {
                     pinctrl-single,pins = <0x014    0x0>;
		};
		gpio183_pmx_idle {
                     pinctrl-single,pins = <0x014    0x0>;
		};

		gpio184_pmx_func {
                     pinctrl-single,pins = <0x018    0x1>;
		};
		gpio184_pmx_idle {
                     pinctrl-single,pins = <0x018    0x0>;
		};

		gpio185_pmx_func {
                     pinctrl-single,pins = <0x01C    0x1>;
		};
		gpio185_pmx_idle {
                     pinctrl-single,pins = <0x01C    0x0>;
		};

		gpio186_pmx_func {
                     pinctrl-single,pins = <0x020    0x1>;
		};
		gpio186_pmx_idle {
                     pinctrl-single,pins = <0x020    0x1>;
		};

		gpio187_pmx_func {
                     pinctrl-single,pins = <0x024    0x1>;
		};
		gpio187_pmx_idle {
                     pinctrl-single,pins = <0x024    0x1>;
		};

		gpio188_pmx_func {
                     pinctrl-single,pins = <0x028    0x0>;
		};
		gpio188_pmx_idle {
                     pinctrl-single,pins = <0x028    0x0>;
		};

		gpio189_pmx_func {
                     pinctrl-single,pins = <0x02C    0x0>;
		};
		gpio189_pmx_idle {
                     pinctrl-single,pins = <0x02C    0x0>;
		};

		gpio190_pmx_func {
                     pinctrl-single,pins = <0x030    0x3>;
		};
		gpio190_pmx_idle {
                     pinctrl-single,pins = <0x030    0x0>;
		};

		gpio191_pmx_func {
                     pinctrl-single,pins = <0x700    0x2>;
		};
		gpio191_pmx_idle {
                     pinctrl-single,pins = <0x700    0x0>;
		};

		gpio192_pmx_func {
                     pinctrl-single,pins = <0x704    0x2>;
		};
		gpio192_pmx_idle {
                     pinctrl-single,pins = <0x704    0x0>;
		};

		gpio193_pmx_func {
                     pinctrl-single,pins = <0x03C    0x1>;
		};
		gpio193_pmx_idle {
                     pinctrl-single,pins = <0x03C    0x1>;
		};

		gpio194_pmx_func {
                     pinctrl-single,pins = <0x040    0x0>;
		};
		gpio194_pmx_idle {
                     pinctrl-single,pins = <0x040    0x0>;
		};

		gpio195_pmx_func {
                     pinctrl-single,pins = <0x044    0x0>;
		};
		gpio195_pmx_idle {
                     pinctrl-single,pins = <0x044    0x0>;
		};

		gpio196_pmx_func {
                     pinctrl-single,pins = <0x048    0x0>;
		};
		gpio196_pmx_idle {
                     pinctrl-single,pins = <0x048    0x0>;
		};

		gpio197_pmx_func {
                     pinctrl-single,pins = <0x04C    0x0>;
		};
		gpio197_pmx_idle {
                     pinctrl-single,pins = <0x04C    0x0>;
		};

		gpio198_pmx_func {
                     pinctrl-single,pins = <0x050    0x4>;
		};
		gpio198_pmx_idle {
                     pinctrl-single,pins = <0x050    0x4>;
		};

		gpio199_pmx_func {
                     pinctrl-single,pins = <0x054    0x4>;
		};
		gpio199_pmx_idle {
                     pinctrl-single,pins = <0x054    0x4>;
		};

		gpio201_pmx_func {
                     pinctrl-single,pins = <0x05C    0x0>;
		};
		gpio201_pmx_idle {
                     pinctrl-single,pins = <0x05C    0x0>;
		};

		gpio202_pmx_func {
                     pinctrl-single,pins = <0x060    0x0>;
		};
		gpio202_pmx_idle {
                     pinctrl-single,pins = <0x060    0x0>;
		};

		gpio203_pmx_func {
                     pinctrl-single,pins = <0x064    0x1>;
		};
		gpio203_pmx_idle {
                     pinctrl-single,pins = <0x064    0x1>;
		};

		gpio204_pmx_func {
                     pinctrl-single,pins = <0x068    0x0>;
		};
		gpio204_pmx_idle {
                     pinctrl-single,pins = <0x068    0x0>;
		};

		gpio205_pmx_func {
                     pinctrl-single,pins = <0x06C    0x0>;
		};
		gpio205_pmx_idle {
                     pinctrl-single,pins = <0x06C    0x0>;
		};

		gpio207_pmx_func {
                     pinctrl-single,pins = <0x074    0x2>;
		};
		gpio207_pmx_idle {
                     pinctrl-single,pins = <0x074    0x2>;
		};

		gpio208_pmx_func {
                     pinctrl-single,pins = <0x078    0x0>;
		};
		gpio208_pmx_idle {
                     pinctrl-single,pins = <0x078    0x0>;
		};

		gpio220_pmx_func {
                     pinctrl-single,pins = <0x0A8    0x2>;
		};
		gpio220_pmx_idle {
                     pinctrl-single,pins = <0x0A8    0x2>;
		};

		gpio222_pmx_func {
                     pinctrl-single,pins = <0x0B0    0x1>;
		};
		gpio222_pmx_idle {
                     pinctrl-single,pins = <0x0B0    0x1>;
		};

		gpio223_pmx_func {
                     pinctrl-single,pins = <0x0B4    0x1>;
		};
		gpio223_pmx_idle {
                     pinctrl-single,pins = <0x0B4    0x1>;
		};

		gpio225_pmx_func {
                     pinctrl-single,pins = <0x0B8    0x1>;
		};
		gpio225_pmx_idle {
                     pinctrl-single,pins = <0x0B8    0x1>;
		};

		gpio226_pmx_func {
                     pinctrl-single,pins = <0x0BC    0x1>;
		};
		gpio226_pmx_idle {
                     pinctrl-single,pins = <0x0BC    0x1>;
		};

		gpio227_pmx_func {
		};
		gpio227_pmx_idle {
		};

		gpio228_pmx_func {
		};
		gpio228_pmx_idle {
		};

		gpio229_pmx_func {
		};
		gpio229_pmx_idle {
		};

		gpio230_pmx_func {
		};
		gpio230_pmx_idle {
		};

		gpio231_pmx_func {
                     pinctrl-single,pins = <0x0D0    0x0>;
		};
		gpio231_pmx_idle {
                     pinctrl-single,pins = <0x0D0    0x0>;
		};

    };

    &pinmuxfff118dc {
		gpio220_cfg_func {
                     pinctrl-single,pins = <0x000  0>;
                     pinctrl-single,bias-pulldown = <0 2 0 2>;
                     pinctrl-single,bias-pullup = <1 1 0 1>;
                     pinctrl-single,drive-strength = <0x00 0x70>;
                     pinctrl-single,slew-rate = <0x0 0x80>;
		};
		gpio220_cfg_idle {
                     pinctrl-single,pins = <0x000  0>;
                     pinctrl-single,bias-pulldown = <0 2 0 2>;
                     pinctrl-single,bias-pullup = <1 1 0 1>;
                     pinctrl-single,drive-strength = <0x00 0x70>;
                     pinctrl-single,slew-rate = <0x0 0x80>;
		};

		gpio222_cfg_func {
                     pinctrl-single,pins = <0x008  0>;
                     pinctrl-single,bias-pulldown = <0 2 0 2>;
                     pinctrl-single,bias-pullup = <0 1 0 1>;
                     pinctrl-single,drive-strength = <0x00 0x70>;
                     pinctrl-single,slew-rate = <0x0 0x80>;
		};
		gpio222_cfg_idle {
                     pinctrl-single,pins = <0x008  0>;
                     pinctrl-single,bias-pulldown = <0 2 0 2>;
                     pinctrl-single,bias-pullup = <0 1 0 1>;
                     pinctrl-single,drive-strength = <0x00 0x70>;
                     pinctrl-single,slew-rate = <0x0 0x80>;
		};

		gpio223_cfg_func {
                     pinctrl-single,pins = <0x00C  0>;
                     pinctrl-single,bias-pulldown = <0 2 0 2>;
                     pinctrl-single,bias-pullup = <0 1 0 1>;
                     pinctrl-single,drive-strength = <0x00 0x70>;
                     pinctrl-single,slew-rate = <0x0 0x80>;
		};
		gpio223_cfg_idle {
                     pinctrl-single,pins = <0x00C  0>;
                     pinctrl-single,bias-pulldown = <0 2 0 2>;
                     pinctrl-single,bias-pullup = <0 1 0 1>;
                     pinctrl-single,drive-strength = <0x00 0x70>;
                     pinctrl-single,slew-rate = <0x0 0x80>;
		};

		gpio224_cfg_func {
                     pinctrl-single,pins = <0x010  0>;
                     pinctrl-single,bias-pulldown = <0 2 0 2>;
                     pinctrl-single,bias-pullup = <1 1 0 1>;
                     pinctrl-single,drive-strength = <0x00 0x70>;
                     pinctrl-single,slew-rate = <0x0 0x80>;
		};
		gpio224_cfg_idle {
                     pinctrl-single,pins = <0x010  0>;
                     pinctrl-single,bias-pulldown = <0 2 0 2>;
                     pinctrl-single,bias-pullup = <1 1 0 1>;
                     pinctrl-single,drive-strength = <0x00 0x70>;
                     pinctrl-single,slew-rate = <0x0 0x80>;
		};

		gpio225_cfg_func {
                     pinctrl-single,pins = <0x014  0>;
                     pinctrl-single,bias-pulldown = <0 2 0 2>;
                     pinctrl-single,bias-pullup = <0 1 0 1>;
                     pinctrl-single,drive-strength = <0x30 0x70>;
                     pinctrl-single,slew-rate = <0x0 0x80>;
		};
		gpio225_cfg_idle {
                     pinctrl-single,pins = <0x014  0>;
                     pinctrl-single,bias-pulldown = <0 2 0 2>;
                     pinctrl-single,bias-pullup = <0 1 0 1>;
                     pinctrl-single,drive-strength = <0x30 0x70>;
                     pinctrl-single,slew-rate = <0x0 0x80>;
		};

		gpio226_cfg_func {
                     pinctrl-single,pins = <0x018  0>;
                     pinctrl-single,bias-pulldown = <0 2 0 2>;
                     pinctrl-single,bias-pullup = <0 1 0 1>;
                     pinctrl-single,drive-strength = <0x30 0x70>;
                     pinctrl-single,slew-rate = <0x0 0x80>;
		};
		gpio226_cfg_idle {
                     pinctrl-single,pins = <0x018  0>;
                     pinctrl-single,bias-pulldown = <0 2 0 2>;
                     pinctrl-single,bias-pullup = <0 1 0 1>;
                     pinctrl-single,drive-strength = <0x30 0x70>;
                     pinctrl-single,slew-rate = <0x0 0x80>;
		};

		gpio227_cfg_func {
		};
		gpio227_cfg_idle {
		};

		gpio228_cfg_func {
		};
		gpio228_cfg_idle {
		};

		gpio229_cfg_func {
		};
		gpio229_cfg_idle {
		};

		gpio230_cfg_func {
		};
		gpio230_cfg_idle {
		};

		gpio231_cfg_func {
                     pinctrl-single,pins = <0x02C  0>;
                     pinctrl-single,bias-pulldown = <2 2 0 2>;
                     pinctrl-single,bias-pullup = <0 1 0 1>;
                     pinctrl-single,drive-strength = <0x00 0x70>;
                     pinctrl-single,slew-rate = <0x0 0x80>;
		};
		gpio231_cfg_idle {
                     pinctrl-single,pins = <0x02C  0>;
                     pinctrl-single,bias-pulldown = <2 2 0 2>;
                     pinctrl-single,bias-pullup = <0 1 0 1>;
                     pinctrl-single,drive-strength = <0x00 0x70>;
                     pinctrl-single,slew-rate = <0x0 0x80>;
		};

    };

    &pinmuxfc182800 {
		gpio128_cfg_func {
                     pinctrl-single,pins = <0x000  0>;
                     pinctrl-single,bias-pulldown = <0 2 0 2>;
                     pinctrl-single,bias-pullup = <0 1 0 1>;
                     pinctrl-single,drive-strength = <0x20 0x70>;
		};
		gpio128_cfg_idle {
                     pinctrl-single,pins = <0x000  0>;
                     pinctrl-single,bias-pulldown = <0 2 0 2>;
                     pinctrl-single,bias-pullup = <0 1 0 1>;
                     pinctrl-single,drive-strength = <0x00 0x70>;
                     pinctrl-single,slew-rate = <0x0 0x80>;
		};

		gpio129_cfg_func {
                     pinctrl-single,pins = <0x004  0>;
                     pinctrl-single,bias-pulldown = <0 2 0 2>;
                     pinctrl-single,bias-pullup = <0 1 0 1>;
                     pinctrl-single,drive-strength = <0x00 0x70>;
                     pinctrl-single,slew-rate = <0x0 0x80>;
		};
		gpio129_cfg_idle {
                     pinctrl-single,pins = <0x004  0>;
                     pinctrl-single,bias-pulldown = <0 2 0 2>;
                     pinctrl-single,bias-pullup = <0 1 0 1>;
                     pinctrl-single,drive-strength = <0x00 0x70>;
                     pinctrl-single,slew-rate = <0x0 0x80>;
		};

		gpio130_cfg_func {
                     pinctrl-single,pins = <0x008  0>;
                     pinctrl-single,bias-pulldown = <0 2 0 2>;
                     pinctrl-single,bias-pullup = <0 1 0 1>;
                     pinctrl-single,drive-strength = <0x20 0x70>;
		};
		gpio130_cfg_idle {
                     pinctrl-single,pins = <0x008  0>;
                     pinctrl-single,bias-pulldown = <0 2 0 2>;
                     pinctrl-single,bias-pullup = <0 1 0 1>;
                     pinctrl-single,drive-strength = <0x00 0x70>;
                     pinctrl-single,slew-rate = <0x0 0x80>;
		};

		gpio131_cfg_func {
                     pinctrl-single,pins = <0x00C  0>;
                     pinctrl-single,bias-pulldown = <0 2 0 2>;
                     pinctrl-single,bias-pullup = <0 1 0 1>;
                     pinctrl-single,drive-strength = <0x00 0x70>;
                     pinctrl-single,slew-rate = <0x0 0x80>;
		};
		gpio131_cfg_idle {
                     pinctrl-single,pins = <0x00C  0>;
                     pinctrl-single,bias-pulldown = <0 2 0 2>;
                     pinctrl-single,bias-pullup = <0 1 0 1>;
                     pinctrl-single,drive-strength = <0x00 0x70>;
                     pinctrl-single,slew-rate = <0x0 0x80>;
		};

		gpio132_cfg_func {
                     pinctrl-single,pins = <0x010  0>;
                     pinctrl-single,bias-pulldown = <0 2 0 2>;
                     pinctrl-single,bias-pullup = <0 1 0 1>;
                     pinctrl-single,drive-strength = <0x20 0x70>;
		};
		gpio132_cfg_idle {
                     pinctrl-single,pins = <0x010  0>;
                     pinctrl-single,bias-pulldown = <0 2 0 2>;
                     pinctrl-single,bias-pullup = <0 1 0 1>;
                     pinctrl-single,drive-strength = <0x00 0x70>;
                     pinctrl-single,slew-rate = <0x0 0x80>;
		};

		gpio133_cfg_func {
                     pinctrl-single,pins = <0x014  0>;
                     pinctrl-single,bias-pulldown = <0 2 0 2>;
                     pinctrl-single,bias-pullup = <0 1 0 1>;
                     pinctrl-single,drive-strength = <0x00 0x70>;
                     pinctrl-single,slew-rate = <0x0 0x80>;
		};
		gpio133_cfg_idle {
                     pinctrl-single,pins = <0x014  0>;
                     pinctrl-single,bias-pulldown = <0 2 0 2>;
                     pinctrl-single,bias-pullup = <0 1 0 1>;
                     pinctrl-single,drive-strength = <0x00 0x70>;
                     pinctrl-single,slew-rate = <0x0 0x80>;
		};

		gpio134_cfg_func {
                     pinctrl-single,pins = <0x018  0>;
                     pinctrl-single,bias-pulldown = <0 2 0 2>;
                     pinctrl-single,bias-pullup = <0 1 0 1>;
                     pinctrl-single,drive-strength = <0x00 0x70>;
                     pinctrl-single,slew-rate = <0x0 0x80>;
		};
		gpio134_cfg_idle {
                     pinctrl-single,pins = <0x018  0>;
                     pinctrl-single,bias-pulldown = <0 2 0 2>;
                     pinctrl-single,bias-pullup = <0 1 0 1>;
                     pinctrl-single,drive-strength = <0x00 0x70>;
                     pinctrl-single,slew-rate = <0x0 0x80>;
		};

		gpio135_cfg_func {
                     pinctrl-single,pins = <0x01C  0>;
                     pinctrl-single,bias-pulldown = <0 2 0 2>;
                     pinctrl-single,bias-pullup = <0 1 0 1>;
                     pinctrl-single,drive-strength = <0x00 0x70>;
                     pinctrl-single,slew-rate = <0x0 0x80>;
		};
		gpio135_cfg_idle {
                     pinctrl-single,pins = <0x01C  0>;
                     pinctrl-single,bias-pulldown = <0 2 0 2>;
                     pinctrl-single,bias-pullup = <0 1 0 1>;
                     pinctrl-single,drive-strength = <0x00 0x70>;
                     pinctrl-single,slew-rate = <0x0 0x80>;
		};

		gpio136_cfg_func {
                     pinctrl-single,pins = <0x020  0>;
                     pinctrl-single,bias-pulldown = <0 2 0 2>;
                     pinctrl-single,bias-pullup = <0 1 0 1>;
                     pinctrl-single,drive-strength = <0x00 0x70>;
                     pinctrl-single,slew-rate = <0x0 0x80>;
		};
		gpio136_cfg_idle {
                     pinctrl-single,pins = <0x020  0>;
                     pinctrl-single,bias-pulldown = <0 2 0 2>;
                     pinctrl-single,bias-pullup = <0 1 0 1>;
                     pinctrl-single,drive-strength = <0x00 0x70>;
                     pinctrl-single,slew-rate = <0x0 0x80>;
		};

		gpio137_cfg_func {
                     pinctrl-single,pins = <0x024  0>;
                     pinctrl-single,bias-pulldown = <0 2 0 2>;
                     pinctrl-single,bias-pullup = <0 1 0 1>;
                     pinctrl-single,drive-strength = <0x00 0x70>;
                     pinctrl-single,slew-rate = <0x0 0x80>;
		};
		gpio137_cfg_idle {
                     pinctrl-single,pins = <0x024  0>;
                     pinctrl-single,bias-pulldown = <0 2 0 2>;
                     pinctrl-single,bias-pullup = <0 1 0 1>;
                     pinctrl-single,drive-strength = <0x00 0x70>;
                     pinctrl-single,slew-rate = <0x0 0x80>;
		};

    };

    &pinmuxfff1191c {
		gpio148_cfg_func {
                     pinctrl-single,pins = <0x000  0>;
                     pinctrl-single,bias-pulldown = <0 2 0 2>;
                     pinctrl-single,bias-pullup = <0 1 0 1>;
                     pinctrl-single,drive-strength = <0x00 0x70>;
                     pinctrl-single,slew-rate = <0x0 0x80>;
		};
		gpio148_cfg_idle {
                     pinctrl-single,pins = <0x000  0>;
                     pinctrl-single,bias-pulldown = <0 2 0 2>;
                     pinctrl-single,bias-pullup = <0 1 0 1>;
                     pinctrl-single,drive-strength = <0x00 0x70>;
                     pinctrl-single,slew-rate = <0x0 0x80>;
		};

		gpio150_cfg_func {
                     pinctrl-single,pins = <0x008  0>;
                     pinctrl-single,bias-pulldown = <0 2 0 2>;
                     pinctrl-single,bias-pullup = <0 1 0 1>;
                     pinctrl-single,drive-strength = <0x40 0x70>;
                     pinctrl-single,slew-rate = <0x0 0x80>;
		};
		gpio150_cfg_idle {
                     pinctrl-single,pins = <0x008  0>;
                     pinctrl-single,bias-pulldown = <0 2 0 2>;
                     pinctrl-single,bias-pullup = <0 1 0 1>;
                     pinctrl-single,drive-strength = <0x40 0x70>;
                     pinctrl-single,slew-rate = <0x0 0x80>;
		};

		gpio151_cfg_func {
                     pinctrl-single,pins = <0x00C  0>;
                     pinctrl-single,bias-pulldown = <0 2 0 2>;
                     pinctrl-single,bias-pullup = <0 1 0 1>;
                     pinctrl-single,drive-strength = <0x00 0x70>;
                     pinctrl-single,slew-rate = <0x0 0x80>;
		};
		gpio151_cfg_idle {
                     pinctrl-single,pins = <0x00C  0>;
                     pinctrl-single,bias-pulldown = <0 2 0 2>;
                     pinctrl-single,bias-pullup = <0 1 0 1>;
                     pinctrl-single,drive-strength = <0x00 0x70>;
                     pinctrl-single,slew-rate = <0x0 0x80>;
		};

		gpio152_cfg_func {
                     pinctrl-single,pins = <0x010  0>;
                     pinctrl-single,bias-pulldown = <0 2 0 2>;
                     pinctrl-single,bias-pullup = <1 1 0 1>;
                     pinctrl-single,drive-strength = <0x00 0x70>;
                     pinctrl-single,slew-rate = <0x0 0x80>;
		};
		gpio152_cfg_idle {
                     pinctrl-single,pins = <0x010  0>;
                     pinctrl-single,bias-pulldown = <0 2 0 2>;
                     pinctrl-single,bias-pullup = <1 1 0 1>;
                     pinctrl-single,drive-strength = <0x00 0x70>;
                     pinctrl-single,slew-rate = <0x0 0x80>;
		};

		gpio153_cfg_func {
                     pinctrl-single,pins = <0x014  0>;
                     pinctrl-single,bias-pulldown = <0 2 0 2>;
                     pinctrl-single,bias-pullup = <0 1 0 1>;
                     pinctrl-single,drive-strength = <0x00 0x70>;
                     pinctrl-single,slew-rate = <0x0 0x80>;
		};
		gpio153_cfg_idle {
                     pinctrl-single,pins = <0x014  0>;
                     pinctrl-single,bias-pulldown = <0 2 0 2>;
                     pinctrl-single,bias-pullup = <0 1 0 1>;
                     pinctrl-single,drive-strength = <0x00 0x70>;
                     pinctrl-single,slew-rate = <0x0 0x80>;
		};

    };

    &pinmuxe896c880 {
		gpio031_cfg_func {
                     pinctrl-single,pins = <0x000  0>;
                     pinctrl-single,bias-pulldown = <0 2 0 2>;
                     pinctrl-single,bias-pullup = <0 1 0 1>;
                     pinctrl-single,drive-strength = <0x00 0x70>;
                     pinctrl-single,slew-rate = <0x0 0x80>;
		};
		gpio031_cfg_idle {
                     pinctrl-single,pins = <0x000  0>;
                     pinctrl-single,bias-pulldown = <0 2 0 2>;
                     pinctrl-single,bias-pullup = <0 1 0 1>;
                     pinctrl-single,drive-strength = <0x00 0x70>;
                     pinctrl-single,slew-rate = <0x0 0x80>;
		};

		gpio032_cfg_func {
                     pinctrl-single,pins = <0x004  0>;
                     pinctrl-single,bias-pulldown = <0 2 0 2>;
                     pinctrl-single,bias-pullup = <0 1 0 1>;
                     pinctrl-single,drive-strength = <0x00 0x70>;
                     pinctrl-single,slew-rate = <0x0 0x80>;
		};
		gpio032_cfg_idle {
                     pinctrl-single,pins = <0x004  0>;
                     pinctrl-single,bias-pulldown = <2 2 0 2>;
                     pinctrl-single,bias-pullup = <0 1 0 1>;
                     pinctrl-single,drive-strength = <0x00 0x70>;
                     pinctrl-single,slew-rate = <0x0 0x80>;
		};

		gpio033_cfg_func {
                     pinctrl-single,pins = <0x008  0>;
                     pinctrl-single,bias-pulldown = <0 2 0 2>;
                     pinctrl-single,bias-pullup = <0 1 0 1>;
                     pinctrl-single,drive-strength = <0x00 0x70>;
                     pinctrl-single,slew-rate = <0x0 0x80>;
		};
		gpio033_cfg_idle {
                     pinctrl-single,pins = <0x008  0>;
                     pinctrl-single,bias-pulldown = <0 2 0 2>;
                     pinctrl-single,bias-pullup = <0 1 0 1>;
                     pinctrl-single,drive-strength = <0x00 0x70>;
                     pinctrl-single,slew-rate = <0x0 0x80>;
		};

		gpio034_cfg_func {
                     pinctrl-single,pins = <0x00C  0>;
                     pinctrl-single,bias-pulldown = <0 2 0 2>;
                     pinctrl-single,bias-pullup = <0 1 0 1>;
                     pinctrl-single,drive-strength = <0x00 0x70>;
                     pinctrl-single,slew-rate = <0x0 0x80>;
		};
		gpio034_cfg_idle {
                     pinctrl-single,pins = <0x00C  0>;
                     pinctrl-single,bias-pulldown = <0 2 0 2>;
                     pinctrl-single,bias-pullup = <0 1 0 1>;
                     pinctrl-single,drive-strength = <0x00 0x70>;
                     pinctrl-single,slew-rate = <0x0 0x80>;
		};

		gpio035_cfg_func {
                     pinctrl-single,pins = <0x010  0>;
                     pinctrl-single,bias-pulldown = <0 2 0 2>;
                     pinctrl-single,bias-pullup = <1 1 0 1>;
                     pinctrl-single,drive-strength = <0x00 0x70>;
                     pinctrl-single,slew-rate = <0x0 0x80>;
		};
		gpio035_cfg_idle {
                     pinctrl-single,pins = <0x010  0>;
                     pinctrl-single,bias-pulldown = <0 2 0 2>;
                     pinctrl-single,bias-pullup = <1 1 0 1>;
                     pinctrl-single,drive-strength = <0x00 0x70>;
                     pinctrl-single,slew-rate = <0x0 0x80>;
		};

		gpio036_cfg_func {
                     pinctrl-single,pins = <0x014  0>;
                     pinctrl-single,bias-pulldown = <0 2 0 2>;
                     pinctrl-single,bias-pullup = <0 1 0 1>;
                     pinctrl-single,drive-strength = <0x00 0x70>;
                     pinctrl-single,slew-rate = <0x0 0x80>;
		};
		gpio036_cfg_idle {
                     pinctrl-single,pins = <0x014  0>;
                     pinctrl-single,bias-pulldown = <0 2 0 2>;
                     pinctrl-single,bias-pullup = <0 1 0 1>;
                     pinctrl-single,drive-strength = <0x00 0x70>;
                     pinctrl-single,slew-rate = <0x0 0x80>;
		};

		gpio037_cfg_func {
                     pinctrl-single,pins = <0x018  0>;
                     pinctrl-single,bias-pulldown = <0 2 0 2>;
                     pinctrl-single,bias-pullup = <1 1 0 1>;
                     pinctrl-single,drive-strength = <0x00 0x70>;
                     pinctrl-single,slew-rate = <0x0 0x80>;
		};
		gpio037_cfg_idle {
                     pinctrl-single,pins = <0x018  0>;
                     pinctrl-single,bias-pulldown = <0 2 0 2>;
                     pinctrl-single,bias-pullup = <1 1 0 1>;
                     pinctrl-single,drive-strength = <0x00 0x70>;
                     pinctrl-single,slew-rate = <0x0 0x80>;
		};

		gpio038_cfg_func {
                     pinctrl-single,pins = <0x01C  0>;
                     pinctrl-single,bias-pulldown = <0 2 0 2>;
                     pinctrl-single,bias-pullup = <0 1 0 1>;
                     pinctrl-single,drive-strength = <0x00 0x70>;
                     pinctrl-single,slew-rate = <0x0 0x80>;
		};
		gpio038_cfg_idle {
                     pinctrl-single,pins = <0x01C  0>;
                     pinctrl-single,bias-pulldown = <0 2 0 2>;
                     pinctrl-single,bias-pullup = <0 1 0 1>;
                     pinctrl-single,drive-strength = <0x00 0x70>;
                     pinctrl-single,slew-rate = <0x0 0x80>;
		};

		gpio039_cfg_func {
                     pinctrl-single,pins = <0x020  0>;
                     pinctrl-single,bias-pulldown = <0 2 0 2>;
                     pinctrl-single,bias-pullup = <0 1 0 1>;
                     pinctrl-single,drive-strength = <0x00 0x70>;
                     pinctrl-single,slew-rate = <0x0 0x80>;
		};
		gpio039_cfg_idle {
                     pinctrl-single,pins = <0x020  0>;
                     pinctrl-single,bias-pulldown = <0 2 0 2>;
                     pinctrl-single,bias-pullup = <0 1 0 1>;
                     pinctrl-single,drive-strength = <0x00 0x70>;
                     pinctrl-single,slew-rate = <0x0 0x80>;
		};

		gpio040_cfg_func {
                     pinctrl-single,pins = <0x024  0>;
                     pinctrl-single,bias-pulldown = <0 2 0 2>;
                     pinctrl-single,bias-pullup = <0 1 0 1>;
                     pinctrl-single,drive-strength = <0x00 0x70>;
                     pinctrl-single,slew-rate = <0x0 0x80>;
		};
		gpio040_cfg_idle {
                     pinctrl-single,pins = <0x024  0>;
                     pinctrl-single,bias-pulldown = <0 2 0 2>;
                     pinctrl-single,bias-pullup = <0 1 0 1>;
                     pinctrl-single,drive-strength = <0x00 0x70>;
                     pinctrl-single,slew-rate = <0x0 0x80>;
		};

		gpio041_cfg_func {
                     pinctrl-single,pins = <0x028  0>;
                     pinctrl-single,bias-pulldown = <0 2 0 2>;
                     pinctrl-single,bias-pullup = <1 1 0 1>;
                     pinctrl-single,drive-strength = <0x00 0x70>;
                     pinctrl-single,slew-rate = <0x0 0x80>;
		};
		gpio041_cfg_idle {
                     pinctrl-single,pins = <0x028  0>;
                     pinctrl-single,bias-pulldown = <0 2 0 2>;
                     pinctrl-single,bias-pullup = <1 1 0 1>;
                     pinctrl-single,drive-strength = <0x00 0x70>;
                     pinctrl-single,slew-rate = <0x0 0x80>;
		};

		gpio042_cfg_func {
                     pinctrl-single,pins = <0x02C  0>;
                     pinctrl-single,bias-pulldown = <0 2 0 2>;
                     pinctrl-single,bias-pullup = <0 1 0 1>;
                     pinctrl-single,drive-strength = <0x00 0x70>;
                     pinctrl-single,slew-rate = <0x0 0x80>;
		};
		gpio042_cfg_idle {
                     pinctrl-single,pins = <0x02C  0>;
                     pinctrl-single,bias-pulldown = <0 2 0 2>;
                     pinctrl-single,bias-pullup = <0 1 0 1>;
                     pinctrl-single,drive-strength = <0x00 0x70>;
                     pinctrl-single,slew-rate = <0x0 0x80>;
		};

		gpio043_cfg_func {
                     pinctrl-single,pins = <0x030  0>;
                     pinctrl-single,bias-pulldown = <0 2 0 2>;
                     pinctrl-single,bias-pullup = <1 1 0 1>;
                     pinctrl-single,drive-strength = <0x00 0x70>;
                     pinctrl-single,slew-rate = <0x0 0x80>;
		};
		gpio043_cfg_idle {
                     pinctrl-single,pins = <0x030  0>;
                     pinctrl-single,bias-pulldown = <0 2 0 2>;
                     pinctrl-single,bias-pullup = <1 1 0 1>;
                     pinctrl-single,drive-strength = <0x00 0x70>;
                     pinctrl-single,slew-rate = <0x0 0x80>;
		};

		gpio044_cfg_func {
                     pinctrl-single,pins = <0x034  0>;
                     pinctrl-single,bias-pulldown = <0 2 0 2>;
                     pinctrl-single,bias-pullup = <0 1 0 1>;
                     pinctrl-single,drive-strength = <0x00 0x70>;
                     pinctrl-single,slew-rate = <0x0 0x80>;
		};
		gpio044_cfg_idle {
                     pinctrl-single,pins = <0x034  0>;
                     pinctrl-single,bias-pulldown = <0 2 0 2>;
                     pinctrl-single,bias-pullup = <0 1 0 1>;
                     pinctrl-single,drive-strength = <0x00 0x70>;
                     pinctrl-single,slew-rate = <0x0 0x80>;
		};

		gpio045_cfg_func {
                     pinctrl-single,pins = <0x038  0>;
                     pinctrl-single,bias-pulldown = <0 2 0 2>;
                     pinctrl-single,bias-pullup = <1 1 0 1>;
                     pinctrl-single,drive-strength = <0x00 0x70>;
                     pinctrl-single,slew-rate = <0x0 0x80>;
		};
		gpio045_cfg_idle {
                     pinctrl-single,pins = <0x038  0>;
                     pinctrl-single,bias-pulldown = <0 2 0 2>;
                     pinctrl-single,bias-pullup = <1 1 0 1>;
                     pinctrl-single,drive-strength = <0x00 0x70>;
                     pinctrl-single,slew-rate = <0x0 0x80>;
		};

		gpio046_cfg_func {
                     pinctrl-single,pins = <0x03C  0>;
                     pinctrl-single,bias-pulldown = <0 2 0 2>;
                     pinctrl-single,bias-pullup = <0 1 0 1>;
                     pinctrl-single,drive-strength = <0x00 0x70>;
                     pinctrl-single,slew-rate = <0x0 0x80>;
		};
		gpio046_cfg_idle {
                     pinctrl-single,pins = <0x03C  0>;
                     pinctrl-single,bias-pulldown = <0 2 0 2>;
                     pinctrl-single,bias-pullup = <0 1 0 1>;
                     pinctrl-single,drive-strength = <0x00 0x70>;
                     pinctrl-single,slew-rate = <0x0 0x80>;
		};

		gpio047_cfg_func {
                     pinctrl-single,pins = <0x040  0>;
                     pinctrl-single,bias-pulldown = <0 2 0 2>;
                     pinctrl-single,bias-pullup = <0 1 0 1>;
                     pinctrl-single,drive-strength = <0x00 0x70>;
                     pinctrl-single,slew-rate = <0x0 0x80>;
		};
		gpio047_cfg_idle {
                     pinctrl-single,pins = <0x040  0>;
                     pinctrl-single,bias-pulldown = <0 2 0 2>;
                     pinctrl-single,bias-pullup = <0 1 0 1>;
                     pinctrl-single,drive-strength = <0x00 0x70>;
                     pinctrl-single,slew-rate = <0x0 0x80>;
		};

		gpio049_cfg_func {
                     pinctrl-single,pins = <0x048  0>;
                     pinctrl-single,bias-pulldown = <0 2 0 2>;
                     pinctrl-single,bias-pullup = <0 1 0 1>;
                     pinctrl-single,drive-strength = <0x00 0x70>;
                     pinctrl-single,slew-rate = <0x0 0x80>;
		};
		gpio049_cfg_idle {
                     pinctrl-single,pins = <0x048  0>;
                     pinctrl-single,bias-pulldown = <0 2 0 2>;
                     pinctrl-single,bias-pullup = <0 1 0 1>;
                     pinctrl-single,drive-strength = <0x00 0x70>;
                     pinctrl-single,slew-rate = <0x0 0x80>;
		};

		gpio050_cfg_func {
                     pinctrl-single,pins = <0x04C  0>;
                     pinctrl-single,bias-pulldown = <0 2 0 2>;
                     pinctrl-single,bias-pullup = <0 1 0 1>;
                     pinctrl-single,drive-strength = <0x00 0x70>;
                     pinctrl-single,slew-rate = <0x0 0x80>;
		};
		gpio050_cfg_idle {
                     pinctrl-single,pins = <0x04C  0>;
                     pinctrl-single,bias-pulldown = <0 2 0 2>;
                     pinctrl-single,bias-pullup = <0 1 0 1>;
                     pinctrl-single,drive-strength = <0x00 0x70>;
                     pinctrl-single,slew-rate = <0x0 0x80>;
		};

		gpio051_cfg_func {
                     pinctrl-single,pins = <0x050  0>;
                     pinctrl-single,bias-pulldown = <0 2 0 2>;
                     pinctrl-single,bias-pullup = <0 1 0 1>;
                     pinctrl-single,drive-strength = <0x00 0x70>;
                     pinctrl-single,slew-rate = <0x0 0x80>;
		};
		gpio051_cfg_idle {
                     pinctrl-single,pins = <0x050  0>;
                     pinctrl-single,bias-pulldown = <0 2 0 2>;
                     pinctrl-single,bias-pullup = <0 1 0 1>;
                     pinctrl-single,drive-strength = <0x00 0x70>;
                     pinctrl-single,slew-rate = <0x0 0x80>;
		};

		gpio054_cfg_func {
                     pinctrl-single,pins = <0x05C  0>;
                     pinctrl-single,bias-pulldown = <0 2 0 2>;
                     pinctrl-single,bias-pullup = <0 1 0 1>;
                     pinctrl-single,drive-strength = <0x00 0x70>;
                     pinctrl-single,slew-rate = <0x0 0x80>;
		};
		gpio054_cfg_idle {
                     pinctrl-single,pins = <0x05C  0>;
                     pinctrl-single,bias-pulldown = <0 2 0 2>;
                     pinctrl-single,bias-pullup = <0 1 0 1>;
                     pinctrl-single,drive-strength = <0x00 0x70>;
                     pinctrl-single,slew-rate = <0x0 0x80>;
		};

		gpio055_cfg_func {
                     pinctrl-single,pins = <0x060  0>;
                     pinctrl-single,bias-pulldown = <0 2 0 2>;
                     pinctrl-single,bias-pullup = <0 1 0 1>;
                     pinctrl-single,slew-rate = <0x0 0x80>;
		};
		gpio055_cfg_idle {
                     pinctrl-single,pins = <0x060  0>;
                     pinctrl-single,bias-pulldown = <0 2 0 2>;
                     pinctrl-single,bias-pullup = <0 1 0 1>;
                     pinctrl-single,drive-strength = <0x00 0x70>;
                     pinctrl-single,slew-rate = <0x0 0x80>;
		};

		gpio056_cfg_func {
                     pinctrl-single,pins = <0x064  0>;
                     pinctrl-single,bias-pulldown = <0 2 0 2>;
                     pinctrl-single,bias-pullup = <0 1 0 1>;
                     pinctrl-single,drive-strength = <0x00 0x70>;
                     pinctrl-single,slew-rate = <0x0 0x80>;
		};
		gpio056_cfg_idle {
                     pinctrl-single,pins = <0x064  0>;
                     pinctrl-single,bias-pulldown = <0 2 0 2>;
                     pinctrl-single,bias-pullup = <0 1 0 1>;
                     pinctrl-single,drive-strength = <0x00 0x70>;
                     pinctrl-single,slew-rate = <0x0 0x80>;
		};

		gpio057_cfg_func {
                     pinctrl-single,pins = <0x068  0>;
                     pinctrl-single,bias-pulldown = <0 2 0 2>;
                     pinctrl-single,bias-pullup = <0 1 0 1>;
                     pinctrl-single,drive-strength = <0x00 0x70>;
                     pinctrl-single,slew-rate = <0x0 0x80>;
		};
		gpio057_cfg_idle {
                     pinctrl-single,pins = <0x068  0>;
                     pinctrl-single,bias-pulldown = <0 2 0 2>;
                     pinctrl-single,bias-pullup = <0 1 0 1>;
                     pinctrl-single,drive-strength = <0x00 0x70>;
                     pinctrl-single,slew-rate = <0x0 0x80>;
		};

    };

    &pinmuxe896c800 {
		gpio001_cfg_func {
                     pinctrl-single,pins = <0x008  0>;
                     pinctrl-single,bias-pulldown = <2 2 0 2>;
                     pinctrl-single,bias-pullup = <0 1 0 1>;
                     pinctrl-single,drive-strength = <0x00 0x70>;
                     pinctrl-single,slew-rate = <0x0 0x80>;
		};
		gpio001_cfg_idle {
                     pinctrl-single,pins = <0x008  0>;
                     pinctrl-single,bias-pulldown = <2 2 0 2>;
                     pinctrl-single,bias-pullup = <0 1 0 1>;
                     pinctrl-single,drive-strength = <0x00 0x70>;
                     pinctrl-single,slew-rate = <0x0 0x80>;
		};

		gpio003_cfg_func {
                     pinctrl-single,pins = <0x010  0>;
                     pinctrl-single,bias-pulldown = <0 2 0 2>;
                     pinctrl-single,bias-pullup = <0 1 0 1>;
                     pinctrl-single,drive-strength = <0x00 0x70>;
                     pinctrl-single,slew-rate = <0x0 0x80>;
		};
		gpio003_cfg_idle {
                     pinctrl-single,pins = <0x010  0>;
                     pinctrl-single,bias-pulldown = <0 2 0 2>;
                     pinctrl-single,bias-pullup = <0 1 0 1>;
                     pinctrl-single,drive-strength = <0x00 0x70>;
                     pinctrl-single,slew-rate = <0x0 0x80>;
		};

		gpio004_cfg_func {
                     pinctrl-single,pins = <0x014  0>;
                     pinctrl-single,bias-pulldown = <0 2 0 2>;
                     pinctrl-single,bias-pullup = <0 1 0 1>;
                     pinctrl-single,drive-strength = <0x00 0x70>;
                     pinctrl-single,slew-rate = <0x0 0x80>;
		};
		gpio004_cfg_idle {
                     pinctrl-single,pins = <0x014  0>;
                     pinctrl-single,bias-pulldown = <0 2 0 2>;
                     pinctrl-single,bias-pullup = <0 1 0 1>;
                     pinctrl-single,drive-strength = <0x00 0x70>;
                     pinctrl-single,slew-rate = <0x0 0x80>;
		};

		gpio005_cfg_func {
                     pinctrl-single,pins = <0x018  0>;
                     pinctrl-single,bias-pulldown = <0 2 0 2>;
                     pinctrl-single,bias-pullup = <0 1 0 1>;
                     pinctrl-single,drive-strength = <0x00 0x70>;
                     pinctrl-single,slew-rate = <0x0 0x80>;
		};
		gpio005_cfg_idle {
                     pinctrl-single,pins = <0x018  0>;
                     pinctrl-single,bias-pulldown = <0 2 0 2>;
                     pinctrl-single,bias-pullup = <0 1 0 1>;
                     pinctrl-single,drive-strength = <0x00 0x70>;
                     pinctrl-single,slew-rate = <0x0 0x80>;
		};

		gpio006_cfg_func {
                     pinctrl-single,pins = <0x01C  0>;
                     pinctrl-single,bias-pulldown = <0 2 0 2>;
                     pinctrl-single,bias-pullup = <0 1 0 1>;
                     pinctrl-single,drive-strength = <0x00 0x70>;
                     pinctrl-single,slew-rate = <0x0 0x80>;
		};
		gpio006_cfg_idle {
                     pinctrl-single,pins = <0x01C  0>;
                     pinctrl-single,bias-pulldown = <0 2 0 2>;
                     pinctrl-single,bias-pullup = <0 1 0 1>;
                     pinctrl-single,drive-strength = <0x00 0x70>;
                     pinctrl-single,slew-rate = <0x0 0x80>;
		};

		gpio007_cfg_func {
                     pinctrl-single,pins = <0x020  0>;
                     pinctrl-single,bias-pulldown = <0 2 0 2>;
                     pinctrl-single,bias-pullup = <0 1 0 1>;
                     pinctrl-single,drive-strength = <0x00 0x70>;
                     pinctrl-single,slew-rate = <0x0 0x80>;
		};
		gpio007_cfg_idle {
                     pinctrl-single,pins = <0x020  0>;
                     pinctrl-single,bias-pulldown = <0 2 0 2>;
                     pinctrl-single,bias-pullup = <0 1 0 1>;
                     pinctrl-single,drive-strength = <0x00 0x70>;
                     pinctrl-single,slew-rate = <0x0 0x80>;
		};

    };

    &pinmuxff37e800 {
		gpio160_cfg_func {
                     pinctrl-single,pins = <0x000  0>;
                     pinctrl-single,bias-pulldown = <0 2 0 2>;
                     pinctrl-single,bias-pullup = <0 1 0 1>;
                     pinctrl-single,drive-strength = <0xF0 0xF0>;
		};
		gpio160_cfg_idle {
                     pinctrl-single,pins = <0x000  0>;
                     pinctrl-single,bias-pulldown = <0 2 0 2>;
                     pinctrl-single,bias-pullup = <0 1 0 1>;
                     pinctrl-single,drive-strength = <0x00 0xF0>;
		};

		gpio161_cfg_func {
                     pinctrl-single,pins = <0x004  0>;
                     pinctrl-single,bias-pulldown = <0 2 0 2>;
                     pinctrl-single,bias-pullup = <1 1 0 1>;
                     pinctrl-single,drive-strength = <0x40 0xF0>;
		};
		gpio161_cfg_idle {
                     pinctrl-single,pins = <0x004  0>;
                     pinctrl-single,bias-pulldown = <0 2 0 2>;
                     pinctrl-single,bias-pullup = <0 1 0 1>;
                     pinctrl-single,drive-strength = <0x00 0xF0>;
		};

		gpio162_cfg_func {
                     pinctrl-single,pins = <0x008  0>;
                     pinctrl-single,bias-pulldown = <0 2 0 2>;
                     pinctrl-single,bias-pullup = <1 1 0 1>;
                     pinctrl-single,drive-strength = <0x40 0xF0>;
		};
		gpio162_cfg_idle {
                     pinctrl-single,pins = <0x008  0>;
                     pinctrl-single,bias-pulldown = <0 2 0 2>;
                     pinctrl-single,bias-pullup = <0 1 0 1>;
                     pinctrl-single,drive-strength = <0x00 0xF0>;
		};

		gpio163_cfg_func {
                     pinctrl-single,pins = <0x00C  0>;
                     pinctrl-single,bias-pulldown = <0 2 0 2>;
                     pinctrl-single,bias-pullup = <1 1 0 1>;
                     pinctrl-single,drive-strength = <0x40 0xF0>;
		};
		gpio163_cfg_idle {
                     pinctrl-single,pins = <0x00C  0>;
                     pinctrl-single,bias-pulldown = <0 2 0 2>;
                     pinctrl-single,bias-pullup = <0 1 0 1>;
                     pinctrl-single,drive-strength = <0x00 0xF0>;
		};

		gpio164_cfg_func {
                     pinctrl-single,pins = <0x010  0>;
                     pinctrl-single,bias-pulldown = <0 2 0 2>;
                     pinctrl-single,bias-pullup = <1 1 0 1>;
                     pinctrl-single,drive-strength = <0x40 0xF0>;
		};
		gpio164_cfg_idle {
                     pinctrl-single,pins = <0x010  0>;
                     pinctrl-single,bias-pulldown = <0 2 0 2>;
                     pinctrl-single,bias-pullup = <0 1 0 1>;
                     pinctrl-single,drive-strength = <0x00 0xF0>;
		};

		gpio165_cfg_func {
                     pinctrl-single,pins = <0x014  0>;
                     pinctrl-single,bias-pulldown = <0 2 0 2>;
                     pinctrl-single,bias-pullup = <1 1 0 1>;
                     pinctrl-single,drive-strength = <0x40 0xF0>;
		};
		gpio165_cfg_idle {
                     pinctrl-single,pins = <0x014  0>;
                     pinctrl-single,bias-pulldown = <0 2 0 2>;
                     pinctrl-single,bias-pullup = <0 1 0 1>;
                     pinctrl-single,drive-strength = <0x00 0xF0>;
		};

		gpio166_cfg_func {
                     pinctrl-single,pins = <0x018  0>;
                     pinctrl-single,bias-pulldown = <0 2 0 2>;
                     pinctrl-single,bias-pullup = <0 1 0 1>;
                     pinctrl-single,drive-strength = <0x00 0x70>;
                     pinctrl-single,slew-rate = <0x0 0x80>;
		};
		gpio166_cfg_idle {
                     pinctrl-single,pins = <0x018  0>;
                     pinctrl-single,bias-pulldown = <0 2 0 2>;
                     pinctrl-single,bias-pullup = <0 1 0 1>;
                     pinctrl-single,drive-strength = <0x00 0x70>;
                     pinctrl-single,slew-rate = <0x0 0x80>;
		};

		gpio167_cfg_func {
                     pinctrl-single,pins = <0x01C  0>;
                     pinctrl-single,bias-pulldown = <0 2 0 2>;
                     pinctrl-single,bias-pullup = <0 1 0 1>;
                     pinctrl-single,drive-strength = <0x00 0x70>;
                     pinctrl-single,slew-rate = <0x0 0x80>;
		};
		gpio167_cfg_idle {
                     pinctrl-single,pins = <0x01C  0>;
                     pinctrl-single,bias-pulldown = <0 2 0 2>;
                     pinctrl-single,bias-pullup = <0 1 0 1>;
                     pinctrl-single,drive-strength = <0x00 0x70>;
                     pinctrl-single,slew-rate = <0x0 0x80>;
		};

		gpio168_cfg_func {
                     pinctrl-single,pins = <0x020  0>;
                     pinctrl-single,bias-pulldown = <0 2 0 2>;
                     pinctrl-single,bias-pullup = <0 1 0 1>;
                     pinctrl-single,drive-strength = <0x00 0x70>;
                     pinctrl-single,slew-rate = <0x0 0x80>;
		};
		gpio168_cfg_idle {
                     pinctrl-single,pins = <0x020  0>;
                     pinctrl-single,bias-pulldown = <0 2 0 2>;
                     pinctrl-single,bias-pullup = <0 1 0 1>;
                     pinctrl-single,drive-strength = <0x00 0x70>;
                     pinctrl-single,slew-rate = <0x0 0x80>;
		};

		gpio169_cfg_func {
                     pinctrl-single,pins = <0x024  0>;
                     pinctrl-single,bias-pulldown = <0 2 0 2>;
                     pinctrl-single,bias-pullup = <0 1 0 1>;
                     pinctrl-single,drive-strength = <0x00 0x70>;
                     pinctrl-single,slew-rate = <0x0 0x80>;
		};
		gpio169_cfg_idle {
                     pinctrl-single,pins = <0x024  0>;
                     pinctrl-single,bias-pulldown = <0 2 0 2>;
                     pinctrl-single,bias-pullup = <0 1 0 1>;
                     pinctrl-single,drive-strength = <0x00 0x70>;
                     pinctrl-single,slew-rate = <0x0 0x80>;
		};

		gpio170_cfg_func {
                     pinctrl-single,pins = <0x028  0>;
                     pinctrl-single,bias-pulldown = <0 2 0 2>;
                     pinctrl-single,bias-pullup = <0 1 0 1>;
                     pinctrl-single,drive-strength = <0x00 0x70>;
                     pinctrl-single,slew-rate = <0x0 0x80>;
		};
		gpio170_cfg_idle {
                     pinctrl-single,pins = <0x028  0>;
                     pinctrl-single,bias-pulldown = <0 2 0 2>;
                     pinctrl-single,bias-pullup = <0 1 0 1>;
                     pinctrl-single,drive-strength = <0x00 0x70>;
                     pinctrl-single,slew-rate = <0x0 0x80>;
		};

		gpio171_cfg_func {
                     pinctrl-single,pins = <0x02C  0>;
                     pinctrl-single,bias-pulldown = <0 2 0 2>;
                     pinctrl-single,bias-pullup = <0 1 0 1>;
                     pinctrl-single,drive-strength = <0x00 0x70>;
                     pinctrl-single,slew-rate = <0x0 0x80>;
		};
		gpio171_cfg_idle {
                     pinctrl-single,pins = <0x02C  0>;
                     pinctrl-single,bias-pulldown = <0 2 0 2>;
                     pinctrl-single,bias-pullup = <0 1 0 1>;
                     pinctrl-single,drive-strength = <0x00 0x70>;
                     pinctrl-single,slew-rate = <0x0 0x80>;
		};

    };

    &pinmuxfff11000 {
		gpio191_cfg_func {
                     pinctrl-single,pins = <0xF00  0>;
                     pinctrl-single,bias-pulldown = <0 2 0 2>;
                     pinctrl-single,bias-pullup = <0 1 0 1>;
                     pinctrl-single,drive-strength = <0x00 0x70>;
                     pinctrl-single,slew-rate = <0x0 0x80>;
		};
		gpio191_cfg_idle {
                     pinctrl-single,pins = <0xF00  0>;
                     pinctrl-single,bias-pulldown = <0 2 0 2>;
                     pinctrl-single,bias-pullup = <0 1 0 1>;
                     pinctrl-single,drive-strength = <0x00 0x70>;
                     pinctrl-single,slew-rate = <0x0 0x80>;
		};

		gpio192_cfg_func {
                     pinctrl-single,pins = <0xF04  0>;
                     pinctrl-single,bias-pulldown = <0 2 0 2>;
                     pinctrl-single,bias-pullup = <0 1 0 1>;
                     pinctrl-single,drive-strength = <0x00 0x70>;
                     pinctrl-single,slew-rate = <0x0 0x80>;
		};
		gpio192_cfg_idle {
                     pinctrl-single,pins = <0xF04  0>;
                     pinctrl-single,bias-pulldown = <2 2 0 2>;
                     pinctrl-single,bias-pullup = <0 1 0 1>;
                     pinctrl-single,drive-strength = <0x00 0x70>;
                     pinctrl-single,slew-rate = <0x0 0x80>;
		};

    };

    &pinmuxe896c848 {
		gpio017_cfg_func {
                     pinctrl-single,pins = <0x000  0>;
                     pinctrl-single,bias-pulldown = <0 2 0 2>;
                     pinctrl-single,bias-pullup = <0 1 0 1>;
                     pinctrl-single,drive-strength = <0x20 0x70>;
                     pinctrl-single,slew-rate = <0x0 0x80>;
		};
		gpio017_cfg_idle {
                     pinctrl-single,pins = <0x000  0>;
                     pinctrl-single,bias-pulldown = <0 2 0 2>;
                     pinctrl-single,bias-pullup = <0 1 0 1>;
                     pinctrl-single,drive-strength = <0x20 0x70>;
                     pinctrl-single,slew-rate = <0x0 0x80>;
		};

		gpio018_cfg_func {
                     pinctrl-single,pins = <0x004  0>;
                     pinctrl-single,bias-pulldown = <0 2 0 2>;
                     pinctrl-single,bias-pullup = <0 1 0 1>;
                     pinctrl-single,drive-strength = <0x20 0x70>;
                     pinctrl-single,slew-rate = <0x0 0x80>;
		};
		gpio018_cfg_idle {
                     pinctrl-single,pins = <0x004  0>;
                     pinctrl-single,bias-pulldown = <0 2 0 2>;
                     pinctrl-single,bias-pullup = <0 1 0 1>;
                     pinctrl-single,drive-strength = <0x20 0x70>;
                     pinctrl-single,slew-rate = <0x0 0x80>;
		};

		gpio019_cfg_func {
                     pinctrl-single,pins = <0x008  0>;
                     pinctrl-single,bias-pulldown = <0 2 0 2>;
                     pinctrl-single,bias-pullup = <0 1 0 1>;
                     pinctrl-single,drive-strength = <0x20 0x70>;
                     pinctrl-single,slew-rate = <0x0 0x80>;
		};
		gpio019_cfg_idle {
                     pinctrl-single,pins = <0x008  0>;
                     pinctrl-single,bias-pulldown = <0 2 0 2>;
                     pinctrl-single,bias-pullup = <0 1 0 1>;
                     pinctrl-single,drive-strength = <0x20 0x70>;
                     pinctrl-single,slew-rate = <0x0 0x80>;
		};

		gpio020_cfg_func {
                     pinctrl-single,pins = <0x00C  0>;
                     pinctrl-single,bias-pulldown = <0 2 0 2>;
                     pinctrl-single,bias-pullup = <0 1 0 1>;
                     pinctrl-single,drive-strength = <0x00 0x70>;
                     pinctrl-single,slew-rate = <0x0 0x80>;
		};
		gpio020_cfg_idle {
                     pinctrl-single,pins = <0x00C  0>;
                     pinctrl-single,bias-pulldown = <0 2 0 2>;
                     pinctrl-single,bias-pullup = <0 1 0 1>;
                     pinctrl-single,drive-strength = <0x00 0x70>;
                     pinctrl-single,slew-rate = <0x0 0x80>;
		};

		gpio021_cfg_func {
                     pinctrl-single,pins = <0x010  0>;
                     pinctrl-single,bias-pulldown = <0 2 0 2>;
                     pinctrl-single,bias-pullup = <0 1 0 1>;
                     pinctrl-single,drive-strength = <0x00 0x70>;
                     pinctrl-single,slew-rate = <0x0 0x80>;
		};
		gpio021_cfg_idle {
                     pinctrl-single,pins = <0x010  0>;
                     pinctrl-single,bias-pulldown = <0 2 0 2>;
                     pinctrl-single,bias-pullup = <0 1 0 1>;
                     pinctrl-single,drive-strength = <0x00 0x70>;
                     pinctrl-single,slew-rate = <0x0 0x80>;
		};

		gpio022_cfg_func {
                     pinctrl-single,pins = <0x014  0>;
                     pinctrl-single,bias-pulldown = <0 2 0 2>;
                     pinctrl-single,bias-pullup = <0 1 0 1>;
                     pinctrl-single,drive-strength = <0x00 0x70>;
                     pinctrl-single,slew-rate = <0x0 0x80>;
		};
		gpio022_cfg_idle {
                     pinctrl-single,pins = <0x014  0>;
                     pinctrl-single,bias-pulldown = <0 2 0 2>;
                     pinctrl-single,bias-pullup = <0 1 0 1>;
                     pinctrl-single,drive-strength = <0x00 0x70>;
                     pinctrl-single,slew-rate = <0x0 0x80>;
		};

		gpio023_cfg_func {
                     pinctrl-single,pins = <0x018  0>;
                     pinctrl-single,bias-pulldown = <0 2 0 2>;
                     pinctrl-single,bias-pullup = <0 1 0 1>;
                     pinctrl-single,drive-strength = <0x00 0x70>;
                     pinctrl-single,slew-rate = <0x0 0x80>;
		};
		gpio023_cfg_idle {
                     pinctrl-single,pins = <0x018  0>;
                     pinctrl-single,bias-pulldown = <0 2 0 2>;
                     pinctrl-single,bias-pullup = <0 1 0 1>;
                     pinctrl-single,drive-strength = <0x00 0x70>;
                     pinctrl-single,slew-rate = <0x0 0x80>;
		};

		gpio024_cfg_func {
                     pinctrl-single,pins = <0x01C  0>;
                     pinctrl-single,bias-pulldown = <0 2 0 2>;
                     pinctrl-single,bias-pullup = <0 1 0 1>;
                     pinctrl-single,drive-strength = <0x00 0x70>;
                     pinctrl-single,slew-rate = <0x0 0x80>;
		};
		gpio024_cfg_idle {
                     pinctrl-single,pins = <0x01C  0>;
                     pinctrl-single,bias-pulldown = <0 2 0 2>;
                     pinctrl-single,bias-pullup = <0 1 0 1>;
                     pinctrl-single,drive-strength = <0x00 0x70>;
                     pinctrl-single,slew-rate = <0x0 0x80>;
		};

		gpio025_cfg_func {
                     pinctrl-single,pins = <0x020  0>;
                     pinctrl-single,bias-pulldown = <0 2 0 2>;
                     pinctrl-single,bias-pullup = <0 1 0 1>;
                     pinctrl-single,drive-strength = <0x00 0x70>;
                     pinctrl-single,slew-rate = <0x0 0x80>;
		};
		gpio025_cfg_idle {
                     pinctrl-single,pins = <0x020  0>;
                     pinctrl-single,bias-pulldown = <0 2 0 2>;
                     pinctrl-single,bias-pullup = <0 1 0 1>;
                     pinctrl-single,drive-strength = <0x00 0x70>;
                     pinctrl-single,slew-rate = <0x0 0x80>;
		};

		gpio026_cfg_func {
                     pinctrl-single,pins = <0x024  0>;
                     pinctrl-single,bias-pulldown = <0 2 0 2>;
                     pinctrl-single,bias-pullup = <0 1 0 1>;
                     pinctrl-single,drive-strength = <0x00 0x70>;
                     pinctrl-single,slew-rate = <0x0 0x80>;
		};
		gpio026_cfg_idle {
                     pinctrl-single,pins = <0x024  0>;
                     pinctrl-single,bias-pulldown = <0 2 0 2>;
                     pinctrl-single,bias-pullup = <0 1 0 1>;
                     pinctrl-single,drive-strength = <0x00 0x70>;
                     pinctrl-single,slew-rate = <0x0 0x80>;
		};

		gpio027_cfg_func {
                     pinctrl-single,pins = <0x028  0>;
                     pinctrl-single,bias-pulldown = <0 2 0 2>;
                     pinctrl-single,bias-pullup = <0 1 0 1>;
                     pinctrl-single,drive-strength = <0x00 0x70>;
                     pinctrl-single,slew-rate = <0x0 0x80>;
		};
		gpio027_cfg_idle {
                     pinctrl-single,pins = <0x028  0>;
                     pinctrl-single,bias-pulldown = <0 2 0 2>;
                     pinctrl-single,bias-pullup = <0 1 0 1>;
                     pinctrl-single,drive-strength = <0x00 0x70>;
                     pinctrl-single,slew-rate = <0x0 0x80>;
		};

    };

    &pinmuxfff11800 {
		gpio177_cfg_func {
                     pinctrl-single,pins = <0x01C  0>;
                     pinctrl-single,bias-pulldown = <2 2 0 2>;
                     pinctrl-single,bias-pullup = <0 1 0 1>;
                     pinctrl-single,drive-strength = <0x00 0x70>;
                     pinctrl-single,slew-rate = <0x0 0x80>;
		};
		gpio177_cfg_idle {
                     pinctrl-single,pins = <0x01C  0>;
                     pinctrl-single,bias-pulldown = <2 2 0 2>;
                     pinctrl-single,bias-pullup = <0 1 0 1>;
                     pinctrl-single,drive-strength = <0x00 0x70>;
                     pinctrl-single,slew-rate = <0x0 0x80>;
		};

		gpio178_cfg_func {
                     pinctrl-single,slew-rate = <0x0 0x80>;
		};
		gpio178_cfg_idle {
                     pinctrl-single,slew-rate = <0x0 0x80>;
		};

		gpio179_cfg_func {
                     pinctrl-single,slew-rate = <0x0 0x80>;
		};
		gpio179_cfg_idle {
                     pinctrl-single,slew-rate = <0x0 0x80>;
		};

		gpio180_cfg_func {
                     pinctrl-single,slew-rate = <0x0 0x80>;
		};
		gpio180_cfg_idle {
                     pinctrl-single,slew-rate = <0x0 0x80>;
		};

		gpio181_cfg_func {
                     pinctrl-single,slew-rate = <0x0 0x80>;
		};
		gpio181_cfg_idle {
                     pinctrl-single,slew-rate = <0x0 0x80>;
		};

		gpio182_cfg_func {
                     pinctrl-single,pins = <0x044  0>;
                     pinctrl-single,bias-pulldown = <0 2 0 2>;
                     pinctrl-single,bias-pullup = <0 1 0 1>;
                     pinctrl-single,drive-strength = <0x00 0x70>;
                     pinctrl-single,slew-rate = <0x0 0x80>;
		};
		gpio182_cfg_idle {
                     pinctrl-single,pins = <0x044  0>;
                     pinctrl-single,bias-pulldown = <0 2 0 2>;
                     pinctrl-single,bias-pullup = <0 1 0 1>;
                     pinctrl-single,drive-strength = <0x00 0x70>;
                     pinctrl-single,slew-rate = <0x0 0x80>;
		};

		gpio183_cfg_func {
                     pinctrl-single,pins = <0x048  0>;
                     pinctrl-single,bias-pulldown = <0 2 0 2>;
                     pinctrl-single,bias-pullup = <0 1 0 1>;
                     pinctrl-single,drive-strength = <0x00 0x70>;
                     pinctrl-single,slew-rate = <0x0 0x80>;
		};
		gpio183_cfg_idle {
                     pinctrl-single,pins = <0x048  0>;
                     pinctrl-single,bias-pulldown = <0 2 0 2>;
                     pinctrl-single,bias-pullup = <0 1 0 1>;
                     pinctrl-single,drive-strength = <0x00 0x70>;
                     pinctrl-single,slew-rate = <0x0 0x80>;
		};

		gpio184_cfg_func {
                     pinctrl-single,pins = <0x04C  0>;
                     pinctrl-single,bias-pulldown = <0 2 0 2>;
                     pinctrl-single,bias-pullup = <0 1 0 1>;
                     pinctrl-single,drive-strength = <0x00 0x70>;
                     pinctrl-single,slew-rate = <0x0 0x80>;
		};
		gpio184_cfg_idle {
                     pinctrl-single,pins = <0x04C  0>;
                     pinctrl-single,bias-pulldown = <2 2 0 2>;
                     pinctrl-single,bias-pullup = <0 1 0 1>;
                     pinctrl-single,drive-strength = <0x00 0x70>;
                     pinctrl-single,slew-rate = <0x0 0x80>;
		};

		gpio185_cfg_func {
                     pinctrl-single,pins = <0x050  0>;
                     pinctrl-single,bias-pulldown = <0 2 0 2>;
                     pinctrl-single,bias-pullup = <0 1 0 1>;
                     pinctrl-single,drive-strength = <0x00 0x70>;
                     pinctrl-single,slew-rate = <0x0 0x80>;
		};
		gpio185_cfg_idle {
                     pinctrl-single,pins = <0x050  0>;
                     pinctrl-single,bias-pulldown = <2 2 0 2>;
                     pinctrl-single,bias-pullup = <0 1 0 1>;
                     pinctrl-single,drive-strength = <0x00 0x70>;
                     pinctrl-single,slew-rate = <0x0 0x80>;
		};

		gpio186_cfg_func {
                     pinctrl-single,pins = <0x054  0>;
                     pinctrl-single,bias-pulldown = <0 2 0 2>;
                     pinctrl-single,bias-pullup = <0 1 0 1>;
                     pinctrl-single,drive-strength = <0x00 0x70>;
                     pinctrl-single,slew-rate = <0x0 0x80>;
		};
		gpio186_cfg_idle {
                     pinctrl-single,pins = <0x054  0>;
                     pinctrl-single,bias-pulldown = <0 2 0 2>;
                     pinctrl-single,bias-pullup = <0 1 0 1>;
                     pinctrl-single,drive-strength = <0x00 0x70>;
                     pinctrl-single,slew-rate = <0x0 0x80>;
		};

		gpio187_cfg_func {
                     pinctrl-single,pins = <0x058  0>;
                     pinctrl-single,bias-pulldown = <0 2 0 2>;
                     pinctrl-single,bias-pullup = <0 1 0 1>;
                     pinctrl-single,drive-strength = <0x00 0x70>;
                     pinctrl-single,slew-rate = <0x0 0x80>;
		};
		gpio187_cfg_idle {
                     pinctrl-single,pins = <0x058  0>;
                     pinctrl-single,bias-pulldown = <0 2 0 2>;
                     pinctrl-single,bias-pullup = <0 1 0 1>;
                     pinctrl-single,drive-strength = <0x00 0x70>;
                     pinctrl-single,slew-rate = <0x0 0x80>;
		};

		gpio188_cfg_func {
                     pinctrl-single,pins = <0x05C  0>;
                     pinctrl-single,bias-pulldown = <0 2 0 2>;
                     pinctrl-single,bias-pullup = <0 1 0 1>;
                     pinctrl-single,drive-strength = <0x00 0x70>;
                     pinctrl-single,slew-rate = <0x0 0x80>;
		};
		gpio188_cfg_idle {
                     pinctrl-single,pins = <0x05C  0>;
                     pinctrl-single,bias-pulldown = <0 2 0 2>;
                     pinctrl-single,bias-pullup = <0 1 0 1>;
                     pinctrl-single,drive-strength = <0x00 0x70>;
                     pinctrl-single,slew-rate = <0x0 0x80>;
		};

		gpio189_cfg_func {
                     pinctrl-single,pins = <0x060  0>;
                     pinctrl-single,bias-pulldown = <0 2 0 2>;
                     pinctrl-single,bias-pullup = <0 1 0 1>;
                     pinctrl-single,drive-strength = <0x00 0x70>;
                     pinctrl-single,slew-rate = <0x0 0x80>;
		};
		gpio189_cfg_idle {
                     pinctrl-single,pins = <0x060  0>;
                     pinctrl-single,bias-pulldown = <0 2 0 2>;
                     pinctrl-single,bias-pullup = <0 1 0 1>;
                     pinctrl-single,drive-strength = <0x00 0x70>;
                     pinctrl-single,slew-rate = <0x0 0x80>;
		};

		gpio190_cfg_func {
                     pinctrl-single,pins = <0x064  0>;
                     pinctrl-single,bias-pulldown = <0 2 0 2>;
                     pinctrl-single,bias-pullup = <0 1 0 1>;
                     pinctrl-single,drive-strength = <0x00 0x70>;
                     pinctrl-single,slew-rate = <0x0 0x80>;
		};
		gpio190_cfg_idle {
                     pinctrl-single,pins = <0x064  0>;
                     pinctrl-single,bias-pulldown = <0 2 0 2>;
                     pinctrl-single,bias-pullup = <0 1 0 1>;
                     pinctrl-single,drive-strength = <0x00 0x70>;
                     pinctrl-single,slew-rate = <0x0 0x80>;
		};

		gpio193_cfg_func {
                     pinctrl-single,pins = <0x070  0>;
                     pinctrl-single,bias-pulldown = <0 2 0 2>;
                     pinctrl-single,bias-pullup = <0 1 0 1>;
                     pinctrl-single,drive-strength = <0x00 0x70>;
                     pinctrl-single,slew-rate = <0x0 0x80>;
		};
		gpio193_cfg_idle {
                     pinctrl-single,pins = <0x070  0>;
                     pinctrl-single,bias-pulldown = <2 2 0 2>;
                     pinctrl-single,bias-pullup = <0 1 0 1>;
                     pinctrl-single,drive-strength = <0x00 0x70>;
                     pinctrl-single,slew-rate = <0x0 0x80>;
		};

		gpio194_cfg_func {
                     pinctrl-single,pins = <0x074  0>;
                     pinctrl-single,bias-pulldown = <2 2 0 2>;
                     pinctrl-single,bias-pullup = <0 1 0 1>;
                     pinctrl-single,drive-strength = <0x00 0x70>;
                     pinctrl-single,slew-rate = <0x0 0x80>;
		};
		gpio194_cfg_idle {
                     pinctrl-single,pins = <0x074  0>;
                     pinctrl-single,bias-pulldown = <2 2 0 2>;
                     pinctrl-single,bias-pullup = <0 1 0 1>;
                     pinctrl-single,drive-strength = <0x00 0x70>;
                     pinctrl-single,slew-rate = <0x0 0x80>;
		};

		gpio195_cfg_func {
                     pinctrl-single,pins = <0x078  0>;
                     pinctrl-single,bias-pulldown = <0 2 0 2>;
                     pinctrl-single,bias-pullup = <0 1 0 1>;
                     pinctrl-single,drive-strength = <0x00 0x70>;
                     pinctrl-single,slew-rate = <0x0 0x80>;
		};
		gpio195_cfg_idle {
                     pinctrl-single,pins = <0x078  0>;
                     pinctrl-single,bias-pulldown = <0 2 0 2>;
                     pinctrl-single,bias-pullup = <0 1 0 1>;
                     pinctrl-single,drive-strength = <0x00 0x70>;
                     pinctrl-single,slew-rate = <0x0 0x80>;
		};

		gpio196_cfg_func {
                     pinctrl-single,pins = <0x07C  0>;
                     pinctrl-single,bias-pulldown = <0 2 0 2>;
                     pinctrl-single,bias-pullup = <0 1 0 1>;
                     pinctrl-single,drive-strength = <0x00 0x70>;
                     pinctrl-single,slew-rate = <0x0 0x80>;
		};
		gpio196_cfg_idle {
                     pinctrl-single,pins = <0x07C  0>;
                     pinctrl-single,bias-pulldown = <0 2 0 2>;
                     pinctrl-single,bias-pullup = <0 1 0 1>;
                     pinctrl-single,drive-strength = <0x00 0x70>;
                     pinctrl-single,slew-rate = <0x0 0x80>;
		};

		gpio197_cfg_func {
                     pinctrl-single,pins = <0x080  0>;
                     pinctrl-single,bias-pulldown = <0 2 0 2>;
                     pinctrl-single,bias-pullup = <0 1 0 1>;
                     pinctrl-single,drive-strength = <0x00 0x70>;
                     pinctrl-single,slew-rate = <0x0 0x80>;
		};
		gpio197_cfg_idle {
                     pinctrl-single,pins = <0x080  0>;
                     pinctrl-single,bias-pulldown = <0 2 0 2>;
                     pinctrl-single,bias-pullup = <0 1 0 1>;
                     pinctrl-single,drive-strength = <0x00 0x70>;
                     pinctrl-single,slew-rate = <0x0 0x80>;
		};

		gpio198_cfg_func {
                     pinctrl-single,pins = <0x084  0>;
                     pinctrl-single,bias-pulldown = <0 2 0 2>;
                     pinctrl-single,bias-pullup = <0 1 0 1>;
                     pinctrl-single,drive-strength = <0x00 0x70>;
                     pinctrl-single,slew-rate = <0x0 0x80>;
		};
		gpio198_cfg_idle {
                     pinctrl-single,pins = <0x084  0>;
                     pinctrl-single,bias-pulldown = <0 2 0 2>;
                     pinctrl-single,bias-pullup = <0 1 0 1>;
                     pinctrl-single,drive-strength = <0x00 0x70>;
                     pinctrl-single,slew-rate = <0x0 0x80>;
		};

		gpio199_cfg_func {
                     pinctrl-single,pins = <0x088  0>;
                     pinctrl-single,bias-pulldown = <0 2 0 2>;
                     pinctrl-single,bias-pullup = <0 1 0 1>;
                     pinctrl-single,drive-strength = <0x00 0x70>;
                     pinctrl-single,slew-rate = <0x0 0x80>;
		};
		gpio199_cfg_idle {
                     pinctrl-single,pins = <0x088  0>;
                     pinctrl-single,bias-pulldown = <0 2 0 2>;
                     pinctrl-single,bias-pullup = <0 1 0 1>;
                     pinctrl-single,drive-strength = <0x00 0x70>;
                     pinctrl-single,slew-rate = <0x0 0x80>;
		};

		gpio201_cfg_func {
                     pinctrl-single,pins = <0x090  0>;
                     pinctrl-single,bias-pulldown = <2 2 0 2>;
                     pinctrl-single,bias-pullup = <0 1 0 1>;
                     pinctrl-single,drive-strength = <0x00 0x70>;
                     pinctrl-single,slew-rate = <0x0 0x80>;
		};
		gpio201_cfg_idle {
                     pinctrl-single,pins = <0x090  0>;
                     pinctrl-single,bias-pulldown = <2 2 0 2>;
                     pinctrl-single,bias-pullup = <0 1 0 1>;
                     pinctrl-single,drive-strength = <0x00 0x70>;
                     pinctrl-single,slew-rate = <0x0 0x80>;
		};

		gpio202_cfg_func {
                     pinctrl-single,pins = <0x094  0>;
                     pinctrl-single,bias-pulldown = <2 2 0 2>;
                     pinctrl-single,bias-pullup = <0 1 0 1>;
                     pinctrl-single,drive-strength = <0x00 0x70>;
                     pinctrl-single,slew-rate = <0x0 0x80>;
		};
		gpio202_cfg_idle {
                     pinctrl-single,pins = <0x094  0>;
                     pinctrl-single,bias-pulldown = <2 2 0 2>;
                     pinctrl-single,bias-pullup = <0 1 0 1>;
                     pinctrl-single,drive-strength = <0x00 0x70>;
                     pinctrl-single,slew-rate = <0x0 0x80>;
		};

		gpio203_cfg_func {
                     pinctrl-single,pins = <0x098  0>;
                     pinctrl-single,bias-pulldown = <0 2 0 2>;
                     pinctrl-single,bias-pullup = <0 1 0 1>;
                     pinctrl-single,drive-strength = <0x00 0x70>;
                     pinctrl-single,slew-rate = <0x0 0x80>;
		};
		gpio203_cfg_idle {
                     pinctrl-single,pins = <0x098  0>;
                     pinctrl-single,bias-pulldown = <0 2 0 2>;
                     pinctrl-single,bias-pullup = <0 1 0 1>;
                     pinctrl-single,drive-strength = <0x00 0x70>;
                     pinctrl-single,slew-rate = <0x0 0x80>;
		};

		gpio204_cfg_func {
                     pinctrl-single,pins = <0x09C  0>;
                     pinctrl-single,bias-pulldown = <0 2 0 2>;
                     pinctrl-single,bias-pullup = <1 1 0 1>;
                     pinctrl-single,drive-strength = <0x00 0x70>;
                     pinctrl-single,slew-rate = <0x0 0x80>;
		};
		gpio204_cfg_idle {
                     pinctrl-single,pins = <0x09C  0>;
                     pinctrl-single,bias-pulldown = <2 2 0 2>;
                     pinctrl-single,bias-pullup = <0 1 0 1>;
                     pinctrl-single,drive-strength = <0x00 0x70>;
                     pinctrl-single,slew-rate = <0x0 0x80>;
		};

		gpio205_cfg_func {
                     pinctrl-single,pins = <0x0A0  0>;
                     pinctrl-single,bias-pulldown = <0 2 0 2>;
                     pinctrl-single,bias-pullup = <0 1 0 1>;
                     pinctrl-single,drive-strength = <0x00 0x70>;
                     pinctrl-single,slew-rate = <0x0 0x80>;
		};
		gpio205_cfg_idle {
                     pinctrl-single,pins = <0x0A0  0>;
                     pinctrl-single,bias-pulldown = <0 2 0 2>;
                     pinctrl-single,bias-pullup = <0 1 0 1>;
                     pinctrl-single,drive-strength = <0x00 0x70>;
                     pinctrl-single,slew-rate = <0x0 0x80>;
		};

		gpio207_cfg_func {
                     pinctrl-single,pins = <0x0A8  0>;
                     pinctrl-single,bias-pulldown = <0 2 0 2>;
                     pinctrl-single,bias-pullup = <1 1 0 1>;
                     pinctrl-single,drive-strength = <0x00 0x70>;
                     pinctrl-single,slew-rate = <0x0 0x80>;
		};
		gpio207_cfg_idle {
                     pinctrl-single,pins = <0x0A8  0>;
                     pinctrl-single,bias-pulldown = <0 2 0 2>;
                     pinctrl-single,bias-pullup = <1 1 0 1>;
                     pinctrl-single,drive-strength = <0x00 0x70>;
                     pinctrl-single,slew-rate = <0x0 0x80>;
		};

		gpio208_cfg_func {
                     pinctrl-single,pins = <0x0AC  0>;
                     pinctrl-single,bias-pulldown = <0 2 0 2>;
                     pinctrl-single,bias-pullup = <1 1 0 1>;
                     pinctrl-single,drive-strength = <0x00 0x70>;
                     pinctrl-single,slew-rate = <0x0 0x80>;
		};
		gpio208_cfg_idle {
                     pinctrl-single,pins = <0x0AC  0>;
                     pinctrl-single,bias-pulldown = <0 2 0 2>;
                     pinctrl-single,bias-pullup = <1 1 0 1>;
                     pinctrl-single,drive-strength = <0x00 0x70>;
                     pinctrl-single,slew-rate = <0x0 0x80>;
		};

    };

