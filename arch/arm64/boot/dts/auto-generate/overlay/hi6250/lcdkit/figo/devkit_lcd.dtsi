/*---------------------------------------------------------------------------
 * This file is autogenerated file using huawei LCD parser. Please do not edit it.
 * Update input XML file to add a new entry or update variable in this file
 * Parser location: vendor/huawei/chipset_common/devkit/lcdkit/tools 
 *---------------------------------------------------------------------------*/


/include/ "figo_boe_hx8399c_5p65_1080p_video.dtsi"
/include/ "figo_boe_otm1911a_5p65_1080p_video.dtsi"
/include/ "figo_ebbg_hx8399c_5p65_1080p_video.dtsi"
/include/ "figo_ebbg_otm1911a_5p65_1080p_video.dtsi"
/include/ "figo_tm_otm1911a_5p65_1080p_video.dtsi"
/include/ "figo_truly_otm1911a_5p65_1080p_video.dtsi"