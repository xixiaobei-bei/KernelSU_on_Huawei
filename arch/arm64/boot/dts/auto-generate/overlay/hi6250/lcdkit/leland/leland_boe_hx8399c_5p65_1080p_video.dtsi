/* Copyright (c) 2013, The Linux Foundation. All rights reserved.
 *
 * This program is free software; you can redistribute it and/or modify
 * it under the terms of the GNU General Public License version 2 and
 * only version 2 as published by the Free Software Foundation.
 *
 * This program is distributed in the hope that it will be useful,
 * but WITHOUT ANY WARRANTY; without even the implied warranty of
 * MERCHANTABILITY or FITNESS FOR A PARTICULAR PURPOSE.  See the
 * GNU General Public License for more details.
 */

/*-------------------------------------------------------------------------
 * This file is autogenerated file using gcdb parser. Please do not edit it.
 * Update input XML file to add a new entry or update variable in this file
 * VERSION = 1.1
 *-----------------------------------------------------------------------*/
/ {
	dsi_leland_boe_hx8399c_5p65_1080p_video: lcdkit_leland_boe_hx8399c_5p65_1080p_video {
		compatible = "boe_hx8399c_5p65_1080p_video";
		hw,lcdkit-panel-name = "BOE_HX8399C 5P65 VIDEO TFT 1080 x 2160";
		hw,lcdkit-panel-type = <1>;
		hw,lcdkit-panel-xres = <1080>;
		hw,lcdkit-panel-yres = <2160>;
		hw,lcdkit-panel-width = <64>;
		hw,lcdkit-panel-height = <128>;
		hw,lcdkit-panel-on-command = <0x39 0x01 0x00 0x00 0x0a 0x00 0x04 0xB9 0xFF 0x83 0x99
				0x39 0x01 0x00 0x00 0x02 0x01 0x03 0xe4 0x01 0x00
				0x39 0x01 0x00 0x00 0x0a 0x00 0x03 0xBA 0x63 0x23
				0x15 0x01 0x00 0x00 0x0a 0x00 0x02 0xD2 0x66
				0x39 0x01 0x00 0x00 0x0a 0x00 0x0D 0xB1 0x00 0x04 0x71 0x91 0x01 0x32 0x33 0x11 0x11 0x4D 0x57 0x06
				0x39 0x01 0x00 0x00 0x0a 0x00 0x0C 0xB2 0x00 0x88 0x80 0xCC 0x05 0x07 0x5A 0x11 0x00 0x00 0x10
				0x39 0x01 0x00 0x00 0x0a 0x00 0x2D 0xB4 0x00 0xFF 0x02 0xA7 0x02 0xA7 0x02 0xA7 0x02 0x00 0x03 0x05 0x00 0x2D 0x03 0x09 0x0A 0x21 0x03 0x02 0x00 0x06 0xA5 0x87 0x02 0xA7 0x02 0xA7 0x02 0xA7 0x02 0x00 0x03 0x05 0x00 0x2D 0x03 0x09 0x0A 0x02 0x00 0x06 0xA5 0x01
				0x39 0x01 0x00 0x00 0x0a 0x00 0x22 0xD3 0x00 0x0C 0x03 0x03 0x00 0x00 0x14 0x04 0x32 0x10 0x09 0x00 0x09 0x32 0x10 0x00 0x00 0x00 0x00 0x00 0x00 0x00 0x00 0x11 0x00 0x02 0x02 0x03 0x00 0x00 0x00 0x0A 0x40
				0x39 0x01 0x00 0x00 0x0a 0x00 0x21 0xD5 0x18 0x18 0x18 0x18 0x03 0x02 0x01 0x00 0x18 0x18 0x18 0x18 0x18 0x18 0x19 0x19 0x21 0x20 0x18 0x18 0x18 0x18 0x18 0x18 0x18 0x18 0x2F 0x2F 0x30 0x30 0x31 0x31
				0x39 0x01 0x00 0x00 0x0a 0x00 0x21 0xD6 0x18 0x18 0x18 0x18 0x00 0x01 0x02 0x03 0x18 0x18 0x40 0x40 0x19 0x19 0x18 0x18 0x20 0x21 0x40 0x40 0x18 0x18 0x18 0x18 0x18 0x18 0x2F 0x40 0x30 0x40 0x31 0x40
				0x39 0x01 0x00 0x00 0x0a 0x00 0x11 0xD8 0xAF 0xAA 0xEA 0xAA 0xAF 0xAA 0xEA 0xAA 0x00 0x00 0x00 0x00 0x00 0x00 0x00 0x00
				0x15 0x01 0x00 0x00 0x0a 0x00 0x02 0xBD 0x01
				0x39 0x01 0x00 0x00 0x0a 0x00 0x11 0xD8 0xFF 0xEF 0xEA 0xBF 0xFF 0xEF 0xEA 0xBF 0x00 0x00 0x00 0x00 0x00 0x00 0x00 0x00
				0x15 0x01 0x00 0x00 0x0a 0x00 0x02 0xBD 0x02
				0x39 0x01 0x00 0x00 0x0a 0x00 0x09 0xD8 0xFF 0xEF 0xEA 0xBF 0xFF 0xEF 0xEA 0xBF
				0x15 0x01 0x00 0x00 0x0a 0x00 0x02 0xBD 0x00
				0x39 0x01 0x00 0x00 0x0a 0x00 0x37 0xE0 0x01 0x1A 0x29 0x26 0x59 0x64 0x73 0x6F 0x77 0x80 0x87 0x8D 0x92 0x9A 0xA2 0xA6 0xAA 0xB7 0xB9 0xC0 0xB4 0xC1 0xC3 0x63 0x5E 0x68 0x73 0x01 0x1A 0x29 0x26 0x59 0x64 0x73 0x6F 0x77 0x80 0x87 0x8D 0x92 0x9A 0xA2 0xA6 0xAA 0xB1 0xB4 0xC0 0xB4 0xC1 0xC3 0x63 0x5E 0x68 0x73
				0x15 0x01 0x00 0x00 0x0a 0x00 0x02 0xCC 0x08
				0x15 0x01 0x00 0x00 0x0a 0x00 0x02 0xE3 0x01
				0x39 0x01 0x00 0x00 0x0a 0x00 0x05 0xCF 0x00 0x14 0x00 0x80
				0x39 0x01 0x00 0x00 0x0a 0x00 0x03 0xC6 0xFF 0xFA
				0x39 0x01 0x00 0x00 0x0a 0x00 0x03 0xC7 0x00 0x88
				0x39 0x01 0x00 0x00 0x0a 0x00 0x09 0xC9 0x07 0x00 0x0F 0x1E 0x91 0x1E 0x00 0x91
				0x39 0x01 0x00 0x00 0x0a 0x00 0x03 0x51 0x0f 0xfb
				0x15 0x01 0x00 0x00 0x0a 0x00 0x02 0x53 0x24
				0x15 0x01 0x00 0x00 0x0a 0x01 0x02 0x55 0x00
				0x05 0x01 0x00 0x00 0x55 0x01 0x02 0x11 0x00
				0x05 0x01 0x00 0x00 0x00 0x01 0x02 0x29 0x00>;
		hw,lcdkit-panel-on-command-state = "dsi_lp_mode";
		hw,lcdkit-panel-display-on-command = <0x05 0x01 0x00 0x00 0x64 0x00 0x02 0x29 0x00>;
		hw,lcdkit-panel-off-command = <0x39 0x01 0x00 0x00 0x0a 0x00 0x04 0xB9 0xFF 0x83 0x99
			0x39 0x01 0x00 0x00 0x0a 0x00 0x02 0xB1 0x08
			0x05 0x01 0x00 0x00 0x3C 0x01 0x02 0x28 0x00
			0x05 0x01 0x00 0x00 0x32 0x01 0x02 0x10 0x00
			0x05 0x01 0x00 0x00 0x0A 0x01 0x02 0x4F 0x00>;
		hw,lcdkit-panel-off-command-state = "dsi_lp_mode";
		hw,lcdkit-panel-backlight-command = <0x39 0x01 0x00 0x00 0x0a 0x00 0x03 0x51 0x00 0x00>;
		hw,lcdkit-panel-backlight-command-state = "dsi_lp_mode";
		hw,lcdkit-panel-cabc-off-command = <0x15 0x01 0x00 0x00 0x0a 0x00 0x02 0x55 0x00>;
		hw,lcdkit-panel-cabc-off-command-state = "dsi_lp_mode";
		hw,lcdkit-panel-cabc-ui-command = <0x15 0x01 0x00 0x00 0x0a 0x00 0x02 0x55 0x01
			0x15 0x01 0x00 0x00 0x0a 0x00 0x02 0x53 0x24>;
		hw,lcdkit-panel-cabc-ui-command-state = "dsi_lp_mode";
		hw,lcdkit-panel-cabc-still-command = <0x15 0x01 0x00 0x00 0x0a 0x00 0x02 0x55 0x02
			0x15 0x01 0x00 0x00 0x0a 0x00 0x02 0x53 0x2C>;
		hw,lcdkit-panel-cabc-still-command-state = "dsi_lp_mode";
		hw,lcdkit-panel-cabc-moving-command = <0x15 0x01 0x00 0x00 0x0a 0x00 0x02 0x55 0x03
			0x15 0x01 0x00 0x00 0x0a 0x00 0x02 0x53 0x2C>;
		hw,lcdkit-panel-cabc-moving-command-state = "dsi_lp_mode";
		hw,lcdkit-panel-cabc-gaming-command = <0x15 0x01 0x00 0x00 0x0a 0x00 0x02 0x55 0x03
			0x15 0x01 0x00 0x00 0x0a 0x00 0x02 0x53 0x2C>;
		hw,lcdkit-panel-cabc-Gaming-command-state = "dsi_lp_mode";
		hw,lcdkit-panel-cabc-support = <1>;
		hw,lcdkit-panel-se-support = <1>;
		hw,lcdkit-panel-se-off-command = <0x39 0x01 0x00 0x00 0x02 0x01 0x03 0xe4 0x01 0x00>;
		hw,lcdkit-panel-se-hd-command = <0x39 0x01 0x00 0x00 0x02 0x01 0x03 0xe4 0x01 0x00>;
		hw,lcdkit-panel-se-fhd-command = <0x39 0x01 0x00 0x00 0x02 0x01 0x03 0xe4 0x01 0x00>;
		hw,lcdkit-panel-cabc-switch-support = <1>;
		hw,lcdkit-panel-btb-support = <0>;
		hw,lcdkit-panel-display-on-effect-command = <0x15 0x01 0x00 0x00 0x0a 0x00 0x02 0x55 0x81>;
		hw,lcdkit-panel-dot-inversion-command = <0x39 0x01 0x00 0x00 0x0a 0x00 0x02 0xb2 0x42>;
		hw,lcdkit-panel-dot-inversion-command-state = "dsi_lp_mode";
		hw,lcdkit-panel-column-inversion-command = <0x39 0x01 0x00 0x00 0x0a 0x00 0x02 0xb2 0x40>;
		hw,lcdkit-panel-column-inversion-command-state = "dsi_lp_mode";
		hw,lcdkit-panel-inversion-support = <1>;
		hw,lcdkit-panel-forword-scan-command = <0x39 0x01 0x00 0x00 0x0a 0x00 0x02 0xcc 0x08>;
		hw,lcdkit-panel-forword-scan-command-state = "dsi_lp_mode";
		hw,lcdkit-panel-revert-scan-command = <0x39 0x01 0x00 0x00 0x0a 0x00 0x02 0xcc 0x04>;
		hw,lcdkit-panel-revert-scan-command-state = "dsi_lp_mode";
		hw,lcdkit-panel-scan-support = <1>;
		hw,lcdkit-panel-display-region-support = <0>;
		hw,lcdkit-panel-checksum-support = <0>;
		hw,lcdkit-panel-esd-reg-command = <0x06 0x01 0x00 0x00 0x0a 0x00 0x01 0x0a
			0x06 0x01 0x00 0x00 0x0a 0x00 0x01 0x45>;
		hw,lcdkit-panel-esd-reg-command-state = "dsi_lp_mode";
		hw,lcdkit-panel-esd-value = <0x9d 0x08>;
		hw,lcdkit-panel-esd-support = <0>;
		hw,lcdkit-panel-check-reg-command = <0x06 0x01 0x00 0x00 0x0a 0x00 0x01 0x0a>;
		hw,lcdkit-panel-check-reg-value = <0x9d>;
		hw,lcdkit-panel-check-reg-command-state = "dsi_lp_mode";
		hw,lcdkit-panel-mipi-check-support = <0>;
		hw,lcdkit-panel-mipi-error-report-threshold = <1>;
		hw,lcdkit-panel-check-reg-support = <1>;
		hw,lcdkit-panel-mipi-detect-support = <0>;
		hw,lcdkit-panel-dynamic-sram-check-support = <0>;
		hw,lcdkit-panel-fps-updt-support = <0>;
		hw,lcdkit-panel-lptohs-mipi-check-support = <0>;
		hw,lcdkit-panel-acl-ctrl-support = <0>;
		hw,lcdkit-panel-hbm-ctrl-support = <0>;
		hw,lcdkit-panel-vr-support = <0>;
		hw,lcdkit-panel-current-detect-support = <0>;
		hw,lcdkit-panel-lv-detect-support = <0>;
		hw,lcdkit-panel-orientation = <1>;
		hw,lcdkit-panel-bpp = <2>;
		hw,lcdkit-panel-bgrfmt = <0>;
		hw,lcdkit-panel-bl-type = <4>;
		hw,lcdkit-panel-blmin = <43>;
		hw,lcdkit-panel-blmax = <4095>;
		hw,lcdkit-panel-bl-def = <1638>;
		hw,lcdkit-panel-bl-maxnit = <530>;
		hw,lcdkit-panel-bl-v200 = <1>;
		hw,lcdkit-panel-bl-otm = <0>;
		hw,lcdkit-panel-getblmaxnit-type = <0>;
		hw,lcdkit-panel-cmd-type = <8>;
		hw,lcdkit-panel-ifbctype = <0>;
		hw,lcdkit-panel-frc-enable = <0>;
		hw,lcdkit-panel-esd-skip-mipi-check = <1>;
		hw,lcdkit-panel-pxl-clk = <160>;
		hw,lcdkit-panel-pxl-clk-div = <1>;
		hw,lcdkit-panel-tp-resume-nosync = <1>;
		hw,lcdkit-panel-dirt-updt-support = <0>;
		hw,lcdkit-panel-dsi-upt-support = <1>;
		hw,lcdkit-panel-vsyn-ctr-type = <0>;
		hw,lcdkit-panel-bl-pwm-preci-type = <3>;
		hw,lcdkit-panel-bl-pwm-out-div-value = <0>;
		hw,lcdkit-panel-step-support = <1>;
		hw,lcdkit-panel-xcc-set-in-isr-support = <1>;
		hw,lcdkit-ldi-hsync-plr = <0>;
		hw,lcdkit-ldi-vsync-plr = <0>;
		hw,lcdkit-ldi-pixel-clk-plr = <0>;
		hw,lcdkit-ldi-data-en-plr = <0>;
		hw,lcdkit-ldi-dpi-a-overlap-size = <0>;
		hw,lcdkit-ldi-dpi-b-overlap-size = <0>;
		hw,lcdkit-sbl-stren-limit = <128>;
		hw,lcdkit-sbl-cal-a = <60>;
		hw,lcdkit-sbl-cal-b = <95>;
		hw,lcdkit-sbl-cal-c = <5>;
		hw,lcdkit-sbl-cal-d = <1>;
		hw,lcdkit-sbl-tf-ctl = <5>;
		hw,lcdkit-sbl-bl-min = <480>;
		hw,lcdkit-sbl-bl-max = <4096>;
		hw,lcdkit-sbl-bl-scale = <0xff>;
		hw,lcdkit-sbl-am-light-min = <14>;
		hw,lcdkit-sbl-filter-a = <1738>;
		hw,lcdkit-sbl-filter-b = <6>;
		hw,lcdkit-sbl-logo-left = <0>;
		hw,lcdkit-sbl-logo-top = <0>;
		hw,lcdkit-sbl-variance-intensity-space = <145>;
		hw,lcdkit-sbl-slope-max = <54>;
		hw,lcdkit-sbl-slope-min = <160>;
		hw,lcdkit-mipi-lane-nums = <3>;
		hw,lcdkit-mipi-color-mode = <5>;
		hw,lcdkit-mipi-vc = <0>;
		hw,lcdkit-mipi-dsi-bit-clk = <490>;
		hw,lcdkit-mipi-burst-mode = <2>;
		hw,lcdkit-mipi-max-esc-clk = <9>;
		hw,lcdkit-mipi-dsi-bit-clk-val-a = <490>;
		hw,lcdkit-mipi-dsi-bit-clk-val-b = <495>;
		hw,lcdkit-mipi-dsi-bit-clk-val-c = <0>;
		hw,lcdkit-mipi-dsi-bit-clk-val-d = <0>;
		hw,lcdkit-mipi-dsi-bit-clk-val-e = <0>;
		hw,lcdkit-mipi-dsi-bit-clk-upt = <490>;
		hw,lcdkit-mipi-rg-vcm-adjust = <5>;
		hw,lcdkit-mipi-non-continue-enable = <1>;
		hw,lcdkit-mipi-clk-post-adjust = <110>;
		hw,lcdkit-mipi-lp11_flag = <1>;
		hw,lcdkit-mipi-phy_update = <1>;
		hw,lcdkit-mipi-clk-pre-adjust = <0>;
		hw,lcdkit-mipi-clk-t-hs-prepare-adjust = <0>;
		hw,lcdkit-mipi-clk-t-lpx-adjust = <0>;
		hw,lcdkit-mipi-clk-t-hs-trail-adjust = <0>;
		hw,lcdkit-mipi-clk-t-hs-exit-adjust = <0>;
		hw,lcdkit-mipi-clk-t-hs-zero-adjust = <0>;
		hw,lcdkit-mipi-data-t-hs-trail-adjust = <0>;
		hw,lcdkit-dirt-left-align = <2>;
		hw,lcdkit-dirt-right-align = <2>;
		hw,lcdkit-dirt-top-align = <2>;
		hw,lcdkit-dirt-bott-align = <2>;
		hw,lcdkit-dirt-width-align = <2>;
		hw,lcdkit-dirt-height-align = <2>;
		hw,lcdkit-dirt-width-min = <2>;
		hw,lcdkit-dirt-height-min = <2>;
		hw,lcdkit-dirt-top-start = <0xffff>;
		hw,lcdkit-dirt-bott-start = <0xffff>;
		hw,lcdkit-gpios = <&gpio1 7 0>,<&gpio9 5 0>,<&gpio2 4 0>,<&gpio2 5 0>;
		lcd_backlight-supply = <&schg_boost2>;
		vcc_lcdbias-supply = <&schg_boost4>;
		lcd_vsp-supply = <&schg_ldo3>;
		lcd_vsn-supply = <&schg_cpn1>;
		lcdio-vcc-supply = <&ldo4>;
		lcdanalog-vcc-supply = <&ldo17>;
		pinctrl-0 = <&gpio015_pmx_func &gpio077_pmx_func &gpio020_pmx_func &gpio021_pmx_func &gpio015_cfg_func &gpio077_cfg_func &gpio020_cfg_func &gpio021_cfg_func>;
		pinctrl-1 = <&gpio015_pmx_idle &gpio077_pmx_idle &gpio020_pmx_idle &gpio021_pmx_idle &gpio015_cfg_idle &gpio077_cfg_idle &gpio020_cfg_idle &gpio021_cfg_idle>;
		pinctrl-names = "default","idle";
		status = "disabled";
		hw,lcdkit-sbl-support = <0>;
		hw,lcdkit-gamma-support = <1>;
		hw,lcdkit-gmp-support = <0>;
		hw,lcdkit-color-temp-support = <1>;
		hw,lcdkit-color-temp-rectify-support = <0>;
		hw,lcdkit-comform-mode-support = <1>;
		hw,lcdkit-cinema-mode-support = <0>;
		hw,lcdkit-prefix-sharp-two-d-support = <0>;
		hw,lcdkit-xcc-support = <1>;
		hw,lcdkit-prefix-ce-support = <0>;
		hw,lcdkit-prefix-sharp-one-d-support = <0>;
		hw,lcdkit-acm-support = <1>;
		hw,lcdkit-smart-color-mode-support = <0>;
		hw,lcdkit-acm-ce-support = <0>;
		hw,lcdkit-acm-valid-num = <7>;
		hw,lcdkit-r_hh0 = <0x7f>;
		hw,lcdkit-r_lh0 = <0x0>;
		hw,lcdkit-r_hh1 = <0xc0>;
		hw,lcdkit-r_lh1 = <0x80>;
		hw,lcdkit-r_hh2 = <0x1C0>;
		hw,lcdkit-r_lh2 = <0xc1>;
		hw,lcdkit-r_hh3 = <0x23f>;
		hw,lcdkit-r_lh3 = <0x1c1>;
		hw,lcdkit-r_hh4 = <0x2bd>;
		hw,lcdkit-r_lh4 = <0x240>;
		hw,lcdkit-r_hh5 = <0x33f>;
		hw,lcdkit-r_lh5 = <0x2be>;
		hw,lcdkit-r_hh6 = <0x37f>;
		hw,lcdkit-r_lh6 = <0x340>;
		hw,lcdkit-color-temp-rectify-r = <32768>;
		hw,lcdkit-color-temp-rectify-g = <32768>;
		hw,lcdkit-color-temp-rectify-b = <32768>;
		hw,lcdkit-bl-support-mode = <0>;
		hw,lcdkit-delay-af-rst-off = <5>;
		hw,lcdkit-h-back-porch = <34>;
		hw,lcdkit-h-front-porch = <40>;
		hw,lcdkit-h-pulse-width = <50>;
		hw,lcdkit-v-back-porch = <25>;
		hw,lcdkit-v-pulse-width = <10>;
		hw,lcdkit-v-front-porch = <7>;
		hw,lcdkit-h-sync-skew = <0>;
		hw,lcdkit-lcd-type = <2>;
		hw,lcdkit-panel-pt-test-support = <1>;
		hw,lcdkit-mipi-clk-config-support = <0>;
		hw,lcdkit-panel-hkadc-support = <0>;
		hw,lcdkit-bias-power-ctrl-mode = <1>;
		hw,lcdkit-iovcc-power-ctrl-mode = <1>;
		hw,lcdkit-vci-power-ctrl-mode = <1>;
		hw,lcdkit-vbat-power-ctrl-mode = <0>;
		hw,lcdkit-id0-gpio = <15>;
		hw,lcdkit-id1-gpio = <77>;
		hw,lcdkit-reset-gpio = <20>;
		hw,lcdkit-te-gpio = <21>;
		hw,lcdkit-vsp-gpio = <40>;
		hw,lcdkit-vsn-gpio = <67>;
		hw,lcdkit-iovcc-gpio = <0>;
		hw,lcdkit-vci-gpio = <0>;
		hw,lcdkit-bl-gpio = <75>;
		hw,lcdkit-vbat-gpio = <0>;
		hw,lcdkit-iovcc-on-is-need-reset = <0>;
		hw,lcdkit-vsn-on-is-need-reset = <1>;
		hw,lcdkit-lcdanalog-vcc = <2800000>;
		hw,lcdkit-lcdio-vcc = <1800000>;
		hw,lcdkit-lcd-bias = <5500000>;
		hw,lcdkit-lcd-vsp = <5500000>;
		hw,lcdkit-lcd-vsn = <5500000>;
		hw,lcdkit-lcd-rst-first-high = <2>;
		hw,lcdkit-lcd-rst-low = <5>;
		hw,lcdkit-lcd-rst-second-high = <25>;
		hw,lcdkit-delay-af-vci-on = <3>;
		hw,lcdkit-delay-af-iovcc-on = <1>;
		hw,lcdkit-delay-af-vbat-on = <0>;
		hw,lcdkit-delay-af-bias-on = <0>;
		hw,lcdkit-delay-af-vsp-on = <5>;
		hw,lcdkit-delay-af-vsn-on = <5>;
		hw,lcdkit-delay-af-lp11 = <5>;
		hw,lcdkit-delay-af-tp-reset = <0>;
		hw,lcdkit-delay-af-vsn-off = <5>;
		hw,lcdkit-delay-af-vsp-off = <5>;
		hw,lcdkit-delay-af-bias-off = <0>;
		hw,lcdkit-delay-af-vbat-off = <0>;
		hw,lcdkit-delay-af-iovcc-off = <3>;
		hw,lcdkit-delay-af-vci-off = <0>;
		hw,lcdkit-ulps-flag = <1>;
    };
};