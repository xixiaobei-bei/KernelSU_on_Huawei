/*---------------------------------------------------------------------------
 * This file is autogenerated file using huawei LCD parser. Please do not edit it.
 * Update input XML file to add a new entry or update variable in this file
 * Parser location: vendor/huawei/chipset_common/devkit/lcdkit/tools 
 *---------------------------------------------------------------------------*/


/include/ "handel_v2_auo1_nt51021_8p0_1200p_video.dtsi"
/include/ "handel_v2_auo_otm1901a_5p2_1080p_video_default_1.dtsi"
/include/ "handel_v2_boe_nt51021_8p0_1200p_video.dtsi"
/include/ "handel_v2_truly_nt51021_8p0_1200p_video.dtsi"