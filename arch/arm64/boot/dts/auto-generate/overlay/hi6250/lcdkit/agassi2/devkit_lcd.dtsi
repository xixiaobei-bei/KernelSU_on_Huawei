/*---------------------------------------------------------------------------
 * This file is autogenerated file using huawei LCD parser. Please do not edit it.
 * Update input XML file to add a new entry or update variable in this file
 * Parser location: vendor/huawei/chipset_common/devkit/lcdkit/tools 
 *---------------------------------------------------------------------------*/


/include/ "agassi2_auo_otm1901a_5p2_1080p_video_default_1.dtsi"
/include/ "agassi2_boe_ft8201_10p1_1200p_video.dtsi"
/include/ "agassi2_boe_nt51021h_10p1_1200p_video.dtsi"
/include/ "agassi2_inx_ft8201_10p1_1200p_video.dtsi"