/*---------------------------------------------------------------------------
 * This file is autogenerated file using huawei LCD parser. Please do not edit it.
 * Update input XML file to add a new entry or update variable in this file
 * Parser location: vendor/huawei/chipset_common/devkit/lcdkit/tools 
 *---------------------------------------------------------------------------*/


/include/ "lelandplus_auo_otm1901a_5p2_1080p_video_default_1.dtsi"
/include/ "lelandplus_auo_otm1911a_5p84_1080p_video.dtsi"
/include/ "lelandplus_boe_otm1911a_5p84_1080p_video.dtsi"
/include/ "lelandplus_ctc_otm1911a_5p84_1080p_video.dtsi"
/include/ "lelandplus_tm_otm1911a_5p84_1080p_video.dtsi"