/* Copyright (c) 2013, The Linux Foundation. All rights reserved.
 *
 * This program is free software; you can redistribute it and/or modify
 * it under the terms of the GNU General Public License version 2 and
 * only version 2 as published by the Free Software Foundation.
 *
 * This program is distributed in the hope that it will be useful,
 * but WITHOUT ANY WARRANTY; without even the implied warranty of
 * MERCHANTABILITY or FITNESS FOR A PARTICULAR PURPOSE.  See the
 * GNU General Public License for more details.
 */

/*-------------------------------------------------------------------------
 * This file is autogenerated file using gcdb parser. Please do not edit it.
 * Update input XML file to add a new entry or update variable in this file
 * VERSION = 1.1
 *-----------------------------------------------------------------------*/
/ {
	dsi_agassi2_inx_ft8201_10p1_1200p_video: lcdkit_agassi2_inx_ft8201_10p1_1200p_video {
		compatible = "inx_ft8201_10p1_1200p_video";
		hw,lcdkit-panel-name = "INX_FT8201 10p1 VIDEO TFT 1200 x 1920";
		hw,lcdkit-panel-type = <0x1>;
		hw,lcdkit-panel-xres = <1200>;
		hw,lcdkit-panel-yres = <1920>;
		hw,lcdkit-panel-width = <135>;
		hw,lcdkit-panel-height = <216>;
		hw,lcdkit-panel-on-command = <0x05 0x01 0x00 0x00 0x78 0x01 0x02 0x11 0x00
			0x39 0x01 0x00 0x00 0x00 0x00 0x03 0x50 0x5A 0x19
			0x39 0x01 0x00 0x00 0x00 0x00 0x11 0x80 0x94 0x92 0x91 0x8F 0x8D 0x8B 0x89 0x88 0x86 0x84 0x83 0x83 0x00 0x60 0xF6 0xFF
			0x39 0x01 0x00 0x00 0x00 0x00 0x08 0x90 0xFF 0x2F 0xF3 0xEF 0xFF 0xBF 0x0F
			0x39 0x01 0x00 0x00 0x00 0x00 0x03 0x50 0x5A 0x23
			0x39 0x01 0x00 0x00 0x00 0x00 0x07 0x90 0xff 0x00 0x00 0x00 0x24 0x01
			0x39 0x01 0x00 0x00 0x00 0x00 0x03 0x50 0x00 0x2f
			0x05 0x01 0x00 0x00 0x0A 0x01 0x02 0x29 0x00>;
		hw,lcdkit-panel-on-command-state = "dsi_lp_mode";
		hw,lcdkit-panel-display-on-command = <>;
		hw,lcdkit-panel-off-command = <0x15 0x01 0x00 0x00 0x78 0x01 0x02 0x28 0x00
			0x15 0x01 0x00 0x00 0x96 0x01 0x02 0x10 0x00
			0x15 0x01 0x00 0x00 0x00 0x00 0x02 0x04 0x5a
			0x15 0x01 0x00 0x00 0x00 0x00 0x02 0x05 0x5a>;
		hw,lcdkit-panel-off-command-state = "dsi_lp_mode";
		hw,lcdkit-panel-backlight-command = <>;
		hw,lcdkit-panel-backlight-command-state = "dsi_lp_mode";
		hw,lcdkit-panel-cabc-off-command = <0x39 0x01 0x00 0x00 0x00 0x00 0x03 0x50 0x5A 0x23
			0x15 0x01 0x00 0x00 0x00 0x01 0x02 0x95 0x00
			0x39 0x01 0x00 0x00 0x00 0x00 0x03 0x50 0x00 0x2f>;
		hw,lcdkit-panel-cabc-off-command-state = "dsi_lp_mode";
		hw,lcdkit-panel-cabc-ui-command = <0x39 0x01 0x00 0x00 0x00 0x00 0x03 0x50 0x5A 0x23
			0x15 0x01 0x00 0x00 0x00 0x01 0x02 0x95 0x01
			0x39 0x01 0x00 0x00 0x00 0x00 0x03 0x50 0x00 0x2f>;
		hw,lcdkit-panel-cabc-ui-command-state = "dsi_lp_mode";
		hw,lcdkit-panel-cabc-still-command = <>;
		hw,lcdkit-panel-cabc-still-command-state = "dsi_lp_mode";
		hw,lcdkit-panel-cabc-moving-command = <0x39 0x01 0x00 0x00 0x00 0x00 0x03 0x50 0x5A 0x23
			0x15 0x01 0x00 0x00 0x00 0x01 0x02 0x95 0x03
			0x39 0x01 0x00 0x00 0x00 0x00 0x03 0x50 0x00 0x2f>;
		hw,lcdkit-panel-cabc-moving-command-state = "dsi_lp_mode";
		hw,lcdkit-panel-cabc-support = <1>;
		hw,lcdkit-panel-se-support = <0>;
		hw,lcdkit-power-off-simut-support = <0>;
		hw,lcdkit-panel-btb-support = <0>;
		hw,lcdkit-panel-display-on-effect-command = <>;
		hw,lcdkit-panel-inversion-support = <0>;
		hw,lcdkit-panel-scan-support = <0>;
		hw,lcdkit-panel-display-region-support = <0>;
		hw,lcdkit-panel-checksum-support = <0>;
		hw,lcdkit-panel-esd-support = <0>;
		hw,lcdkit-panel-mipi-check-support = <0>;
		hw,lcdkit-panel-mipi-error-report-threshold = <1>;
		hw,lcdkit-panel-check-reg-support = <0>;
		hw,lcdkit-panel-mipi-detect-support = <0>;
		hw,lcdkit-panel-dynamic-sram-check-support = <0>;
		hw,lcdkit-panel-fps-updt-support = <0>;
		hw,lcdkit-panel-ts-resume-ctrl-mode = <2>;
		hw,lcdkit-panel-lptohs-mipi-check-support = <0>;
		hw,lcdkit-panel-acl-ctrl-support = <0>;
		hw,lcdkit-panel-hbm-ctrl-support = <0>;
		hw,lcdkit-panel-vr-support = <0>;
		hw,lcdkit-panel-current-detect-support = <0>;
		hw,lcdkit-panel-lv-detect-support = <0>;
		hw,lcdkit-reset-shutdown-later = <1>;
		hw,lcdkit-rst-after-vbat = <1>;
		hw,lcdkit-lcdph-delay-set-flag = <1>;
		hw,lcdkit-panel-orientation = <1>;
		hw,lcdkit-panel-bpp = <2>;
		hw,lcdkit-panel-bgrfmt = <0>;
		hw,lcdkit-panel-bl-type = <4>;
		hw,lcdkit-panel-blmin = <69>;
		hw,lcdkit-panel-blmax = <10000>;
		hw,lcdkit-panel-bl-def = <4000>;
		hw,lcdkit-panel-bl-maxnit = <530>;
		hw,lcdkit-panel-bl-v200 = <0>;
		hw,lcdkit-panel-bl-otm = <0>;
		hw,lcdkit-panel-getblmaxnit-type = <0>;
		hw,lcdkit-panel-cmd-type = <8>;
		hw,lcdkit-panel-ifbctype = <0>;
		hw,lcdkit-panel-frc-enable = <0>;
		hw,lcdkit-panel-esd-skip-mipi-check = <1>;
		hw,lcdkit-panel-pxl-clk = <160>;
		hw,lcdkit-panel-pxl-clk-div = <1>;
		hw,lcdkit-panel-dirt-updt-support = <0>;
		hw,lcdkit-panel-dsi-upt-support = <1>;
		hw,mipiclk-updt-support-new = <1>;
		hw,lcdkit-panel-vsyn-ctr-type = <0>;
		hw,lcdkit-panel-bl-pwm-preci-type = <1>;
		hw,lcdkit-panel-bl-ic-ctrl-type = <8>;
		hw,lcdkit-panel-bl-pwm-out-div-value = <3>;
		hw,lcdkit-panel-step-support = <1>;
		hw,lcdkit-panel-xcc-set-in-isr-support = <1>;
		hw,lcdkit-ldi-hsync-plr = <0>;
		hw,lcdkit-ldi-vsync-plr = <0>;
		hw,lcdkit-ldi-pixel-clk-plr = <0>;
		hw,lcdkit-ldi-data-en-plr = <0>;
		hw,lcdkit-ldi-dpi-a-overlap-size = <0>;
		hw,lcdkit-ldi-dpi-b-overlap-size = <0>;
		hw,lcdkit-sbl-stren-limit = <128>;
		hw,lcdkit-sbl-cal-a = <60>;
		hw,lcdkit-sbl-cal-b = <95>;
		hw,lcdkit-sbl-cal-c = <5>;
		hw,lcdkit-sbl-cal-d = <1>;
		hw,lcdkit-sbl-tf-ctl = <5>;
		hw,lcdkit-sbl-bl-min = <480>;
		hw,lcdkit-sbl-bl-max = <4096>;
		hw,lcdkit-sbl-bl-scale = <0xff>;
		hw,lcdkit-sbl-am-light-min = <14>;
		hw,lcdkit-sbl-filter-a = <1738>;
		hw,lcdkit-sbl-filter-b = <6>;
		hw,lcdkit-sbl-logo-left = <0>;
		hw,lcdkit-sbl-logo-top = <0>;
		hw,lcdkit-sbl-variance-intensity-space = <145>;
		hw,lcdkit-sbl-slope-max = <54>;
		hw,lcdkit-sbl-slope-min = <160>;
		hw,lcdkit-mipi-lane-nums = <3>;
		hw,lcdkit-mipi-color-mode = <5>;
		hw,lcdkit-mipi-vc = <0>;
		hw,lcdkit-mipi-dsi-bit-clk = <480>;
		hw,lcdkit-mipi-burst-mode = <2>;
		hw,lcdkit-mipi-max-esc-clk = <9>;
		hw,lcdkit-mipi-dsi-bit-clk-val-a = <473>;
		hw,lcdkit-mipi-dsi-bit-clk-val-b = <499>;
		hw,lcdkit-mipi-dsi-bit-clk-val-c = <480>;
		hw,lcdkit-mipi-dsi-bit-clk-val-d = <0>;
		hw,lcdkit-mipi-dsi-bit-clk-val-e = <0>;
		hw,lcdkit-mipi-dsi-bit-clk-upt = <480>;
		hw,lcdkit-mipi-rg-vcm-adjust = <0>;
		hw,lcdkit-mipi-non-continue-enable = <0>;
		hw,lcdkit-mipi-clk-post-adjust = <30>;
		hw,lcdkit-mipi-lp11_flag = <0>;
		hw,lcdkit-mipi-phy_update = <0>;
		hw,lcdkit-mipi-clk-pre-adjust = <0>;
		hw,lcdkit-mipi-clk-t-hs-prepare-adjust = <0>;
		hw,lcdkit-mipi-clk-t-lpx-adjust = <0>;
		hw,lcdkit-mipi-clk-t-hs-trail-adjust = <0>;
		hw,lcdkit-mipi-clk-t-hs-exit-adjust = <0>;
		hw,lcdkit-mipi-clk-t-hs-zero-adjust = <0>;
		hw,lcdkit-mipi-data-t-hs-trail-adjust = <0>;
		hw,lcdkit-dirt-left-align = <2>;
		hw,lcdkit-dirt-right-align = <2>;
		hw,lcdkit-dirt-top-align = <2>;
		hw,lcdkit-dirt-bott-align = <2>;
		hw,lcdkit-dirt-width-align = <2>;
		hw,lcdkit-dirt-height-align = <2>;
		hw,lcdkit-dirt-width-min = <2>;
		hw,lcdkit-dirt-height-min = <2>;
		hw,lcdkit-dirt-top-start = <0xffff>;
		hw,lcdkit-dirt-bott-start = <0xffff>;
		hw,lcdkit-gpios = <&gpio1 7 0>,<&gpio7 4 0>,<&gpio3 0 0>,<&gpio8 4 0>,<&gpio9 5 0>,<&gpio18 1 0>,<&gpio9 3 0>;
		lcd_backlight-supply = <&schg_boost2>;
		vcc_lcdbias-supply = <&schg_boost4>;
		lcd_vsp-supply = <&schg_ldo3>;
		lcd_vsn-supply = <&schg_cpn1>;
		lcdio-vcc-supply = <&ldo4>;
		lcdanalog-vcc-supply = <&ldo17>;
		pinctrl-0 = <&gpio015_pmx_func &gpio060_pmx_func &gpio068_pmx_func &gpio055_pmx_func &gpio024_pmx_func &gpio077_pmx_func &gpio075_pmx_func &gpio015_cfg_func &gpio060_cfg_func &gpio068_cfg_func &gpio024_cfg_func &gpio077_cfg_func &gpio075_cfg_func &gpio055_cfg_func>;
		pinctrl-1 = <&gpio015_pmx_idle &gpio060_pmx_idle &gpio068_pmx_idle &gpio055_pmx_idle &gpio024_pmx_idle &gpio077_pmx_idle &gpio075_pmx_idle &gpio015_cfg_idle &gpio060_cfg_idle &gpio068_cfg_idle &gpio024_cfg_idle &gpio077_cfg_idle &gpio075_cfg_idle &gpio055_cfg_idle>;
		pinctrl-names = "default","idle";
		status = "disabled";
		hw,lcdkit-sbl-support = <1>;
		hw,lcdkit-gamma-support = <1>;
		hw,lcdkit-gmp-support = <0>;
		hw,lcdkit-color-temp-support = <1>;
		hw,lcdkit-color-temp-rectify-support = <0>;
		hw,lcdkit-comform-mode-support = <1>;
		hw,lcdkit-cinema-mode-support = <0>;
		hw,lcdkit-prefix-sharp-two-d-support = <0>;
		hw,lcdkit-xcc-support = <1>;
		hw,lcdkit-prefix-ce-support = <0>;
		hw,lcdkit-prefix-sharp-one-d-support = <0>;
		hw,lcdkit-acm-support = <0>;
		hw,lcdkit-smart-color-mode-support = <0>;
		hw,lcdkit-acm-ce-support = <0>;
		hw,lcdkit-acm-valid-num = <7>;
		hw,lcdkit-r_hh0 = <0x7f>;
		hw,lcdkit-r_lh0 = <0x3ff>;
		hw,lcdkit-r_hh1 = <0xc2>;
		hw,lcdkit-r_lh1 = <0x80>;
		hw,lcdkit-r_hh2 = <0x1c0>;
		hw,lcdkit-r_lh2 = <0xc3>;
		hw,lcdkit-r_hh3 = <0x1fe>;
		hw,lcdkit-r_lh3 = <0x1c1>;
		hw,lcdkit-r_hh4 = <0x2fd>;
		hw,lcdkit-r_lh4 = <0x1ff>;
		hw,lcdkit-r_hh5 = <0x33f>;
		hw,lcdkit-r_lh5 = <0x2fe>;
		hw,lcdkit-r_hh6 = <0x37f>;
		hw,lcdkit-r_lh6 = <0x340>;
		hw,lcdkit-color-temp-rectify-r = <32768>;
		hw,lcdkit-color-temp-rectify-g = <32768>;
		hw,lcdkit-color-temp-rectify-b = <32768>;
		hw,lcdkit-bl-support-mode = <0>;
		hw,lcdkit-delay-af-rst-off = <5>;
		hw,lcdkit-h-back-porch = <40>;
		hw,lcdkit-h-front-porch = <40>;
		hw,lcdkit-h-pulse-width = <20>;
		hw,lcdkit-v-back-porch = <32>;
		hw,lcdkit-v-pulse-width = <13>;
		hw,lcdkit-v-front-porch = <150>;
		hw,lcdkit-h-sync-skew = <0>;
		hw,lcdkit-lcd-type = <2>;
		hw,lcdkit-panel-pt-test-support = <0>;
		hw,lcdkit-mipi-clk-config-support = <0>;
		hw,lcdkit-panel-hkadc-support = <0>;
		hw,lcdkit-bias-power-ctrl-mode = <16>;
		hw,lcdkit-bl-power-ctrl-mode = <0>;
		hw,lcdkit-bl-gpio-ctrl-mode = <1>;
		hw,lcdkit-bl-gpio-suspend-disable = <1>;
		hw,lcdkit-iovcc-power-ctrl-mode = <1>;
		hw,lcdkit-vci-power-ctrl-mode = <16>;
		hw,lcdkit-vbat-power-ctrl-mode = <2>;
		hw,lcdkit-id0-gpio = <15>;
		hw,lcdkit-id1-gpio = <24>;
		hw,lcdkit-reset-gpio = <60>;
		hw,lcdkit-te-gpio = <21>;
		hw,lcdkit-vsp-gpio = <40>;
		hw,lcdkit-vsn-gpio = <67>;
		hw,lcdkit-iovcc-gpio = <0>;
		hw,lcdkit-vci-gpio = <77>;
		hw,lcdkit-bl-gpio = <68>;
		hw,lcdkit-vbat-gpio = <75>;
		hw,lcdkit-iovcc-on-is-need-reset = <0>;
		hw,lcdkit-vsn-on-is-need-reset = <1>;
		hw,lcdkit-reset-pull-high-flag = <1>;
		hw,lcdkit-lcdanalog-vcc = <3100000>;
		hw,lcdkit-lcdio-vcc = <1850000>;
		hw,lcdkit-lcd-bias = <5500000>;
		hw,lcdkit-lcd-vsp = <5500000>;
		hw,lcdkit-lcd-vsn = <5500000>;
		hw,lcdkit-lcd-rst-first-high = <10>;
		hw,lcdkit-lcd-rst-low = <10>;
		hw,lcdkit-lcd-rst-second-high = <35>;
		hw,lcdkit-delay-af-vci-on = <0>;
		hw,lcdkit-delay-af-iovcc-on = <5>;
		hw,lcdkit-delay-af-vbat-on = <11>;
		hw,lcdkit-delay-af-bias-on = <0>;
		hw,lcdkit-delay-af-vsp-on = <5>;
		hw,lcdkit-delay-af-vsn-on = <5>;
		hw,lcdkit-delay-af-lp11 = <5>;
		hw,lcdkit-delay-af-tp-reset = <1>;
		hw,lcdkit-delay-af-vsn-off = <5>;
		hw,lcdkit-delay-af-vsp-off = <5>;
		hw,lcdkit-delay-af-bias-off = <0>;
		hw,lcdkit-delay-af-vbat-off = <10>;
		hw,lcdkit-delay-af-iovcc-off = <50>;
		hw,lcdkit-delay-af-vci-off = <0>;
		hw,lcdkit-ulps-flag = <0>;
		hw_lp8556,lcdkit-bl-ic-level = <4095>;
		hw_lp8556,lcdkit-bl-ic-ctrl-mode = <0>;
		hw_lp8556,lcdkit-bl-ic-type = <0>;
		hw_lp8556,lcdkit-bl-ic-before-init-delay = <32>;
		hw_lp8556,lcdkit-bl-ic-init-delay = <0>;
		hw_lp8556,lcdkit-bl-ic-ovp-check = <1>;
		hw_lp8556,lcdkit-bl-ic-fake-lcd-ovp-check = <0>;
		hw_lp8556,lcdkit-bl-ic-init-cmd = <0x01 0x01 0x85 0xFF
						0x01 0xA0 0xFF 0xFF
						0x01 0xA1 0xBF 0xFF
						0x01 0xA2 0x29 0xFF
						0x01 0xA3 0x32 0xFF
						0x01 0xA4 0x72 0xFF
						0x01 0xA5 0x20 0xFF
						0x01 0xA6 0x40 0xFF
						0x01 0xA7 0xF7 0xFF
						0x01 0xA9 0x80 0xFF
						0x01 0xAA 0x0F 0xFF
						0x01 0xAE 0x0E 0xFF
						0x01 0x9E 0x22 0xFF
						0x01 0x16 0x0F 0xFF>;
		hw_lp8556,lcdkit-bl-ic-num-of-init-cmd = <0x0E>;
		hw_lp8556,lcdkit-bl-ic-bl-lsb-reg-cmd = <0x08 0x10 0x66 0xFF>;
		hw_lp8556,lcdkit-bl-ic-bl-msb-reg-cmd = <0x04 0x11 0x02 0x0F>;
		hw_lp8556,lcdkit-bl-ic-bl-enable-cmd = <0x02 0x01 0x01 0x01>;
		hw_lp8556,lcdkit-bl-ic-bl-disable-cmd = <0x02 0x01 0x00 0x01>;
		hw_lp8556,lcdkit-bl-ic-disable-device-cmd = <0x01 0x01 0x00 0x01>;
		hw_lp8556,lcdkit-bl-ic-fault-flag-cmd = <0x02 0x02 0x00 0x08>;
		hw_lp8556,lcdkit-bl-ic-bias-disable-cmd = <0x01 0x00 0x00 0x00>;
		hw_lp8556,lcdkit-bl-ic-pull-down-vsp-cmd = <0x00 0x00 0x00 0x00>;
		hw_lp8556,lcdkit-bl-ic-pull-down-vsn-cmd = <0x00 0x00 0x00 0x00>;
		hw_lp8556,lcdkit-bl-ic-sec-enable-cmd = <0x00 0x00 0x00 0x00>;
		hw_lp8556,lcdkit-bl-ic-pull-down-boost-cmd = <0x00 0x00 0x00 0x00>;
		hw_lp8556,lcdkit-bl-ic-bias-enable-cmd = <0x01 0x00 0x00 0x00>;
		hw_lp8556,lcdkit-bl-ic-led-open-short-test = <0>;
		hw_lp8556,lcdkit-bl-ic-num-of-led = <4>;
		hw_lp8556,lcdkit-bl-ic-brt-ctrl-cmd = <0x01 0x01 0x00 0x06>;
		hw_lp8556,lcdkit-bl-ic-fault-ctrl-cmd = <0x02 0x02 0x00 0x04>;
		hw_lp8556,lcdkit-bl-ic-hidden-reg-surpport = <0>;
		hw_lp8556,lcdkit-bl-ic-sec-reg-enable-cmd = <0x00 0x00 0x00 0x00>;
		hw_lp8556,lcdkit-bl-ic-sec-reg-disable-cmd = <0x00 0x00 0x00 0x00>;
		hw_lp8556,lcdkit-bl-ic-hidden-reg-cmd = <0x00 0x00 0x00 0x00>;
		hw_lp8556,lcdkit-bl-ic-hidden-reg-val-mask = <0>;
		hw_lp8556,lcdkit-bl-ic-suspend-disbright-support = <0>;
		hw_lp8556,lcdkit-bl-ic-bl-wq-support = <0>;
		hw_lp8556,lcdkit-bl-ic-bl-enahnce-support = <0>;
		hw_lp8556,lcdkit-bl-ic-pull-down-boost-support = <0>;
		hw_lp8556,lcdkit-bl-ic-pull-down-boost-delay = <0>;
		hw_lp8556,lcdkit-bl-ic-bl-lowpower-delay = <0>;
		hw_lp8556,lcdkit-bl-ic-bl-normal-level = <0>;
		hw_lp8556,lcdkit-bl-ic-bl-enhance-level = <0>;
		hw_lp8556,lcdkit-bl-ic-bl-enhance-hrdtimer-time = <0>;
		hw_lp8556,lcdkit-bl-ic-bl-normal-ovp-cmd = <0x00 0x00 0x00 0x00>;
		hw_lp8556,lcdkit-bl-ic-bl-normal-cur-ramp-cmd = <0x00 0x00 0x00 0x00>;
		hw_lp8556,lcdkit-bl-ic-bl-normal-boost-cur-cmd = <0x00 0x00 0x00 0x00>;
		hw_lp8556,lcdkit-bl-ic-bl-normal-sink-cmd = <0x00 0x00 0x00 0x00>;
		hw_lp8556,lcdkit-bl-ic-bl-enhance-ovp-cmd = <0x00 0x00 0x00 0x00>;
		hw_lp8556,lcdkit-bl-ic-bl-enhance-cur-ramp-cmd = <0x00 0x00 0x00 0x00>;
		hw_lp8556,lcdkit-bl-ic-bl-enhance-boost-cur-cmd = <0x00 0x00 0x00 0x00>;
		hw_lp8556,lcdkit-bl-ic-bl-enhance-sink-cmd = <0x00 0x00 0x00 0x00>;
		hw_lp8556,lcdkit-bl-ovp-bit = <0>;
		hw_lp8556,lcdkit-bl-ocp-bit = <0>;
		hw_lp8556,lcdkit-bl-tsd-bit = <0>;
		hw_lp8556_sub,lcdkit-bl-ic-level = <4095>;
		hw_lp8556_sub,lcdkit-bl-ic-ctrl-mode = <0>;
		hw_lp8556_sub,lcdkit-bl-ic-type = <0>;
		hw_lp8556_sub,lcdkit-bl-ic-before-init-delay = <32>;
		hw_lp8556_sub,lcdkit-bl-ic-init-delay = <0>;
		hw_lp8556_sub,lcdkit-bl-ic-ovp-check = <1>;
		hw_lp8556_sub,lcdkit-bl-ic-fake-lcd-ovp-check = <0>;
		hw_lp8556_sub,lcdkit-bl-ic-init-cmd = <0x01 0x01 0x85 0xFF
						0x01 0xA0 0xFF 0xFF
						0x01 0xA1 0xBF 0xFF
						0x01 0xA2 0x29 0xFF
						0x01 0xA3 0x32 0xFF
						0x01 0xA4 0x72 0xFF
						0x01 0xA5 0x20 0xFF
						0x01 0xA6 0x40 0xFF
						0x01 0xA7 0xF7 0xFF
						0x01 0xA9 0x80 0xFF
						0x01 0xAA 0x0F 0xFF
						0x01 0xAE 0x0E 0xFF
						0x01 0x9E 0x22 0xFF
						0x01 0x16 0x0F 0xFF>;
		hw_lp8556_sub,lcdkit-bl-ic-num-of-init-cmd = <0x0E>;
		hw_lp8556_sub,lcdkit-bl-ic-bl-lsb-reg-cmd = <0x08 0x10 0x60 0xFF>;
		hw_lp8556_sub,lcdkit-bl-ic-bl-msb-reg-cmd = <0x04 0x11 0x06 0x0F>;
		hw_lp8556_sub,lcdkit-bl-ic-bl-enable-cmd = <0x02 0x01 0x01 0x01>;
		hw_lp8556_sub,lcdkit-bl-ic-bl-disable-cmd = <0x02 0x01 0x00 0x01>;
		hw_lp8556_sub,lcdkit-bl-ic-disable-device-cmd = <0x01 0x01 0x00 0x01>;
		hw_lp8556_sub,lcdkit-bl-ic-fault-flag-cmd = <0x02 0x02 0x00 0x08>;
		hw_lp8556_sub,lcdkit-bl-ic-bias-disable-cmd = <0x01 0x00 0x00 0x00>;
		hw_lp8556_sub,lcdkit-bl-ic-pull-down-vsp-cmd = <0x00 0x00 0x00 0x00>;
		hw_lp8556_sub,lcdkit-bl-ic-pull-down-vsn-cmd = <0x00 0x00 0x00 0x00>;
		hw_lp8556_sub,lcdkit-bl-ic-sec-enable-cmd = <0x00 0x00 0x00 0x00>;
		hw_lp8556_sub,lcdkit-bl-ic-pull-down-boost-cmd = <0x00 0x00 0x00 0x00>;
		hw_lp8556_sub,lcdkit-bl-ic-bias-enable-cmd = <0x01 0x00 0x00 0x00>;
		hw_lp8556_sub,lcdkit-bl-ic-led-open-short-test = <0>;
		hw_lp8556_sub,lcdkit-bl-ic-num-of-led = <4>;
		hw_lp8556_sub,lcdkit-bl-ic-brt-ctrl-cmd = <0x01 0x01 0x00 0x06>;
		hw_lp8556_sub,lcdkit-bl-ic-fault-ctrl-cmd = <0x02 0x02 0x00 0x04>;
		hw_lp8556_sub,lcdkit-bl-ic-hidden-reg-surpport = <0>;
		hw_lp8556_sub,lcdkit-bl-ic-sec-reg-enable-cmd = <0x00 0x00 0x00 0x00>;
		hw_lp8556_sub,lcdkit-bl-ic-sec-reg-disable-cmd = <0x00 0x00 0x00 0x00>;
		hw_lp8556_sub,lcdkit-bl-ic-hidden-reg-cmd = <0x00 0x00 0x00 0x00>;
		hw_lp8556_sub,lcdkit-bl-ic-hidden-reg-val-mask = <0>;
		hw_lp8556_sub,lcdkit-bl-ic-suspend-disbright-support = <0>;
		hw_lp8556_sub,lcdkit-bl-ic-bl-wq-support = <0>;
		hw_lp8556_sub,lcdkit-bl-ic-bl-enahnce-support = <0>;
		hw_lp8556_sub,lcdkit-bl-ic-pull-down-boost-support = <0>;
		hw_lp8556_sub,lcdkit-bl-ic-pull-down-boost-delay = <0>;
		hw_lp8556_sub,lcdkit-bl-ic-bl-lowpower-delay = <0>;
		hw_lp8556_sub,lcdkit-bl-ic-bl-normal-level = <0>;
		hw_lp8556_sub,lcdkit-bl-ic-bl-enhance-level = <0>;
		hw_lp8556_sub,lcdkit-bl-ic-bl-enhance-hrdtimer-time = <0>;
		hw_lp8556_sub,lcdkit-bl-ic-bl-normal-ovp-cmd = <0x00 0x00 0x00 0x00>;
		hw_lp8556_sub,lcdkit-bl-ic-bl-normal-cur-ramp-cmd = <0x00 0x00 0x00 0x00>;
		hw_lp8556_sub,lcdkit-bl-ic-bl-normal-boost-cur-cmd = <0x00 0x00 0x00 0x00>;
		hw_lp8556_sub,lcdkit-bl-ic-bl-normal-sink-cmd = <0x00 0x00 0x00 0x00>;
		hw_lp8556_sub,lcdkit-bl-ic-bl-enhance-ovp-cmd = <0x00 0x00 0x00 0x00>;
		hw_lp8556_sub,lcdkit-bl-ic-bl-enhance-cur-ramp-cmd = <0x00 0x00 0x00 0x00>;
		hw_lp8556_sub,lcdkit-bl-ic-bl-enhance-boost-cur-cmd = <0x00 0x00 0x00 0x00>;
		hw_lp8556_sub,lcdkit-bl-ic-bl-enhance-sink-cmd = <0x00 0x00 0x00 0x00>;
		hw_lp8556_sub,lcdkit-bl-ovp-bit = <0>;
		hw_lp8556_sub,lcdkit-bl-ocp-bit = <0>;
		hw_lp8556_sub,lcdkit-bl-tsd-bit = <0>;
    };
};