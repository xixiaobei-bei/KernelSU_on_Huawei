/*---------------------------------------------------------------------------
 * This file is autogenerated file using huawei LCD parser. Please do not edit it.
 * Update input XML file to add a new entry or update variable in this file
 * Parser location: vendor/huawei/chipset_common/devkit/lcdkit/tools 
 *---------------------------------------------------------------------------*/


/include/ "rne_auo_otm1911a_5p93_1080p_video.dtsi"
/include/ "rne_auog6_otm1911a_5p93_1080p_video.dtsi"
/include/ "rne_boe_hx8398a_5p93_1080p_video.dtsi"
/include/ "rne_ebbg_hx8399c_5p93_1080p_video.dtsi"
/include/ "rne_ebbg_otm1911a_5p93_1080p_video.dtsi"
/include/ "rne_tm_otm1911a_5p93_1080p_video.dtsi"