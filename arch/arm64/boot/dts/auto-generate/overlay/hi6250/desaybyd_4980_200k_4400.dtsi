/* DO NOT EDIT - Automatically generated by python */
		&desaybyd_4980_200k_4400 {
			fcc = <4980>;
			default_rbatt_mohm = <100>;
			identify_type = "id_volt";
			id_identify_min = <2786>;
			id_identify_max = <3312>;
			id_voltage_min = <2941>;
			id_voltage_max = <3167>;
			vbat_max = <4400>;
			temp_para = 
						"-32767","0","-1","0","4100","0",
						"0","5","-1","498","4400","0",
						"5","10","-1","1494","4400","3",
						"10","45","-1","-1","4400","3",
						"45","50","-1","1743","4100","3",
						"50","32767","-1","0","4100","0";
			vbat_para = 
						"-32767","3400","-1","820","0",
						"3400","32767","-1","-1","0";
			segment_para = 
						"-32767","4150","4980","4208","50",
						"4150","4450","3486","4400","0";
			batt_brand = "desaybyd";
			fcc_temp = <5168 5161 5167 5193 5168 5137>;
			fcc_sf_x = <0 100 200 300 400 500 600 700 800 1000 1500>;
			fcc_sf_y = <100 96 94 92 90 88 87 84 81 75 50>;
			fcc_sf_cols = <11>;
			pc_sf_rows = <1>;
			pc_sf_cols = <1>;
			pc_sf_row_entries = <0>;
			pc_sf_percent = <100>;
			pc_sf_sf = <100>;
			rbatt_sf_rows = <28>;
			rbatt_sf_cols = <6>;
			rbatt_sf_percent = <100 95 90 85 80 75 70 65 60 55 50 45 40 35 30 25 20 15 10 9 8 7 6 5 4 3 2 1>;
			rbatt_sf_sf = <
			               1555 1150 561 113 84 77
			               1548 1145 561 113 84 77
			               1373 1014 546 112 84 77
			               1264 919 519 111 84 77
			               1218 889 500 112 85 78
			               1123 840 515 116 87 79
			               1079 746 448 124 90 80
			               1065 740 428 127 95 83
			               1066 723 417 128 98 85
			               1080 716 407 107 87 79
			               1102 735 412 101 82 77
			               1137 762 432 101 83 77
			               1185 799 466 104 84 78
			               1239 851 508 107 87 80
			               1303 909 561 106 86 79
			               1378 969 625 104 83 77
			               1464 1035 701 106 83 78
			               1578 1114 788 112 85 78
			               3107 1515 689 108 84 77
			               3365 1716 760 110 85 79
			               3649 1924 846 113 86 81
			               3967 2143 974 113 87 82
			               4258 2413 1122 114 87 81
			               4566 2663 1241 114 86 78
			               4912 2916 1412 117 84 78
			               5292 3232 1609 123 86 80
			               5704 3612 1908 135 90 81
			               6300 4160 2228 218 128 86
			              >;
			pc_temp_ocv_rows = <29>;
			pc_temp_ocv_cols = <6>;
			pc_temp_ocv_percent = <100 95 90 85 80 75 70 65 60 55 50 45 40 35 30 25 20 15 10 9 8 7 6 5 4 3 2 1>;
			pc_temp_ocv_ocv = <
			                   4391 4387 4385 4377 4370 4362
			                   4276 4282 4294 4314 4309 4302
			                   4201 4207 4225 4254 4250 4244
			                   4135 4142 4161 4196 4192 4186
			                   4087 4101 4104 4140 4135 4130
			                   4005 4043 4060 4088 4082 4077
			                   3943 3960 3985 4040 4033 4028
			                   3899 3919 3936 3982 3987 3984
			                   3864 3877 3893 3939 3940 3938
			                   3837 3841 3853 3888 3889 3887
			                   3817 3820 3824 3853 3854 3852
			                   3802 3805 3806 3828 3828 3826
			                   3788 3793 3795 3807 3808 3805
			                   3774 3782 3785 3790 3791 3788
			                   3762 3770 3775 3773 3771 3766
			                   3748 3754 3762 3756 3750 3739
			                   3731 3735 3745 3738 3731 3718
			                   3714 3715 3717 3712 3706 3692
			                   3685 3690 3690 3689 3682 3670
			                   3676 3685 3686 3688 3681 3669
			                   3667 3679 3681 3686 3680 3668
			                   3657 3672 3677 3682 3677 3665
			                   3643 3663 3671 3677 3672 3659
			                   3621 3644 3655 3656 3656 3640
			                   3592 3612 3622 3616 3620 3602
			                   3550 3563 3570 3562 3568 3551
			                   3490 3495 3499 3488 3497 3482
			                   3395 3393 3393 3383 3395 3382
			                   3200 3200 3200 3200 3200 3200
			                  >;
		};
