/* DO NOT EDIT - Automatically generated by python */
		&SCUDSONY_6500_110k_4350 {
			fcc = <6500>;
			default_rbatt_mohm = <100>;
			identify_type = "id_volt";
			id_identify_min = <2281>;
			id_identify_max = <2786>;
			id_voltage_min = <2426>;
			id_voltage_max = <2631>;
			vbat_max = <4350>;
			temp_para = 
						"-32767","0","-1","0","4100","0",
						"0","5","-1","650","4350","0",
						"5","10","-1","1950","4350","3",
						"10","45","-1","-1","4350","3",
						"45","50","-1","2275","4100","3",
						"50","32767","-1","0","4100","0";
			vbat_para = 
						"-32767","3400","-1","820","0",
						"3400","32767","-1","-1","0";
			segment_para = 
						"-32767","4150","6500","4208","50",
						"4150","4450","4550","4350","0";
			batt_brand = "SCUDSONY";
			fcc_temp = <6651 6686 6729 6824 6782 6724>;
			fcc_sf_x = <0 100 200 300 400 500 600 700 800 1000 1500>;
			fcc_sf_y = <100 96 94 92 90 88 87 84 81 75 50>;
			fcc_sf_cols = <11>;
			pc_sf_rows = <1>;
			pc_sf_cols = <1>;
			pc_sf_row_entries = <0>;
			pc_sf_percent = <100>;
			pc_sf_sf = <100>;
			rbatt_sf_rows = <28>;
			rbatt_sf_cols = <6>;
			rbatt_sf_percent = <100 95 90 85 80 75 70 65 60 55 50 45 40 35 30 25 20 15 10 9 8 7 6 5 4 3 2 1>;
			rbatt_sf_sf = <
			               581 276 152 81 71 71
			               581 276 152 82 71 71
			               580 289 158 83 72 71
			               580 293 166 86 72 72
			               579 283 173 89 75 73
			               593 282 178 92 77 72
			               605 276 177 98 80 75
			               605 278 161 102 84 79
			               610 282 157 93 84 79
			               620 288 157 85 76 74
			               625 293 161 84 73 72
			               653 306 166 83 74 72
			               683 314 173 86 75 73
			               719 323 179 89 77 75
			               776 337 185 90 76 74
			               848 354 195 88 74 72
			               967 376 205 87 74 73
			               1189 443 216 87 74 73
			               1534 467 207 87 74 73
			               1731 511 209 87 75 73
			               2011 578 232 89 75 74
			               2400 634 255 91 76 74
			               3137 789 266 92 77 74
			               4327 1019 299 92 75 74
			               7812 1396 367 94 77 75
			               17418 2483 492 97 78 79
			               36001 6758 839 101 80 79
			               59774 17968 1958 106 85 79
			              >;
			pc_temp_ocv_rows = <29>;
			pc_temp_ocv_cols = <6>;
			pc_temp_ocv_percent = <100 95 90 85 80 75 70 65 60 55 50 45 40 35 30 25 20 15 10 9 8 7 6 5 4 3 2 1>;
			pc_temp_ocv_ocv = <
			                   4343 4342 4339 4334 4327 4320
			                   4256 4265 4268 4269 4262 4258
			                   4186 4205 4209 4211 4205 4201
			                   4123 4146 4153 4156 4150 4147
			                   4063 4084 4100 4102 4099 4096
			                   4009 4030 4048 4053 4049 4047
			                   3960 3977 3997 4007 4004 4004
			                   3913 3933 3943 3962 3962 3963
			                   3870 3894 3901 3914 3919 3922
			                   3833 3860 3868 3874 3875 3877
			                   3797 3830 3839 3844 3844 3845
			                   3773 3808 3815 3820 3821 3821
			                   3754 3788 3796 3802 3802 3802
			                   3736 3771 3779 3786 3786 3785
			                   3721 3756 3765 3769 3767 3761
			                   3705 3738 3751 3750 3744 3733
			                   3688 3711 3729 3729 3723 3710
			                   3667 3680 3695 3699 3693 3681
			                   3641 3654 3663 3669 3665 3655
			                   3631 3646 3656 3664 3661 3651
			                   3619 3639 3650 3659 3656 3647
			                   3602 3626 3643 3651 3650 3640
			                   3587 3614 3631 3640 3638 3627
			                   3565 3598 3612 3617 3613 3599
			                   3532 3564 3578 3576 3570 3557
			                   3479 3510 3521 3522 3516 3504
			                   3412 3428 3446 3452 3447 3437
			                   3314 3326 3344 3354 3351 3344
			                   3200 3200 3200 3200 3200 3200
			                  >;
		};
