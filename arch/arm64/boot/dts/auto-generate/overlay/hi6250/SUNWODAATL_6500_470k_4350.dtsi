/* DO NOT EDIT - Automatically generated by python */
		&SUNWODAATL_6500_470k_4350 {
			fcc = <6500>;
			default_rbatt_mohm = <100>;
			identify_type = "id_volt";
			id_identify_min = <3312>;
			id_identify_max = <3767>;
			id_voltage_min = <3407>;
			id_voltage_max = <3696>;
			vbat_max = <4350>;
			temp_para = 
						"-32767","0","-1","0","4100","0",
						"0","5","-1","650","4350","0",
						"5","10","-1","1950","4350","3",
						"10","45","-1","-1","4350","3",
						"45","50","-1","2275","4100","3",
						"50","32767","-1","0","4100","0";
			vbat_para = 
						"-32767","3400","-1","820","0",
						"3400","32767","-1","-1","0";
			segment_para = 
						"-32767","4150","6500","4208","50",
						"4150","4450","4550","4350","0";
			batt_brand = "SUNWODAATL";
			fcc_temp = <6850 6857 6862 6895 6874 6815>;
			fcc_sf_x = <0 100 200 300 400 500 600 700 800 1000 1500>;
			fcc_sf_y = <100 96 94 92 90 88 87 84 81 75 50>;
			fcc_sf_cols = <11>;
			pc_sf_rows = <1>;
			pc_sf_cols = <1>;
			pc_sf_row_entries = <0>;
			pc_sf_percent = <100>;
			pc_sf_sf = <100>;
			rbatt_sf_rows = <28>;
			rbatt_sf_cols = <6>;
			rbatt_sf_percent = <100 95 90 85 80 75 70 65 60 55 50 45 40 35 30 25 20 15 10 9 8 7 6 5 4 3 2 1>;
			rbatt_sf_sf = <
			               1137 648 261 105 92 87
			               1131 647 261 105 92 87
			               1020 625 262 106 92 88
			               952 601 267 108 93 88
			               924 590 275 110 94 89
			               851 554 292 114 96 90
			               835 500 262 117 98 91
			               829 505 254 124 101 93
			               828 496 246 121 104 95
			               842 492 240 109 98 92
			               860 497 240 103 92 89
			               885 513 240 103 92 88
			               924 538 245 103 93 89
			               968 566 255 105 94 91
			               1015 608 270 105 94 90
			               1077 660 288 103 90 88
			               1145 727 320 104 91 88
			               1237 796 357 105 92 88
			               2105 719 296 101 91 87
			               2321 788 305 104 92 89
			               2538 865 321 105 93 89
			               2784 962 341 105 92 90
			               3017 1091 365 106 93 89
			               3296 1204 402 106 92 89
			               3583 1364 429 106 92 88
			               3864 1599 472 110 93 90
			               4222 1888 556 121 95 91
			               4778 2348 760 234 123 99
			              >;
			pc_temp_ocv_rows = <29>;
			pc_temp_ocv_cols = <6>;
			pc_temp_ocv_percent = <100 95 90 85 80 75 70 65 60 55 50 45 40 35 30 25 20 15 10 9 8 7 6 5 4 3 2 1>;
			pc_temp_ocv_ocv = <
			                   4338 4336 4335 4331 4326 4318
			                   4240 4248 4256 4262 4257 4251
			                   4170 4184 4195 4205 4200 4194
			                   4112 4130 4142 4150 4146 4140
			                   4064 4082 4094 4099 4093 4088
			                   3978 4018 4045 4050 4044 4040
			                   3927 3944 3972 3995 3997 3996
			                   3890 3910 3932 3959 3959 3955
			                   3856 3874 3893 3916 3918 3916
			                   3832 3842 3858 3871 3873 3872
			                   3813 3818 3831 3839 3839 3837
			                   3800 3802 3808 3816 3816 3814
			                   3790 3792 3793 3798 3798 3796
			                   3779 3782 3783 3784 3784 3781
			                   3765 3772 3774 3771 3769 3763
			                   3752 3759 3763 3757 3749 3738
			                   3738 3740 3747 3739 3731 3717
			                   3716 3721 3721 3713 3706 3692
			                   3691 3697 3697 3689 3681 3669
			                   3683 3692 3693 3688 3680 3668
			                   3674 3687 3690 3686 3678 3666
			                   3662 3679 3687 3683 3676 3664
			                   3644 3669 3680 3676 3671 3658
			                   3621 3647 3665 3653 3656 3641
			                   3590 3610 3633 3612 3618 3603
			                   3544 3562 3580 3554 3565 3552
			                   3483 3493 3506 3477 3495 3485
			                   3389 3395 3400 3368 3392 3388
			                   3200 3200 3200 3200 3200 3200
			                  >;
		};
