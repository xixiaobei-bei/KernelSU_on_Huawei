/* DO NOT EDIT - Automatically generated by python */
		&SUNWODALG_3270_68k_4400 {
			fcc = <3270>;
			default_rbatt_mohm = <100>;
			identify_type = "id_volt";
			id_identify_min = <1759>;
			id_identify_max = <2281>;
			id_voltage_min = <1956>;
			id_voltage_max = <2135>;
			vbat_max = <4400>;
			temp_para = 
						"-32767","0","-1","0","4100","0",
						"0","5","-1","327","4400","0",
						"5","10","-1","981","4400","3",
						"10","45","-1","-1","4400","3",
						"45","50","-1","1144","4100","3",
						"50","32767","-1","0","4100","0";
			vbat_para = 
						"-32767","3400","-1","820","0",
						"3400","32767","-1","-1","0";
			segment_para = 
						"-32767","4150","3270","4208","50",
						"4150","4450","2289","4400","0";
			batt_brand = "SUNWODALG";
			fcc_temp = <3330 3333 3330 3354 3328 3303>;
			fcc_sf_x = <0 100 200 300 400 500 600 700 800 1000 1500>;
			fcc_sf_y = <100 96 94 92 90 88 87 84 81 75 50>;
			fcc_sf_cols = <11>;
			pc_sf_rows = <1>;
			pc_sf_cols = <1>;
			pc_sf_row_entries = <0>;
			pc_sf_percent = <100>;
			pc_sf_sf = <100>;
			rbatt_sf_rows = <28>;
			rbatt_sf_cols = <6>;
			rbatt_sf_percent = <100 95 90 85 80 75 70 65 60 55 50 45 40 35 30 25 20 15 10 9 8 7 6 5 4 3 2 1>;
			rbatt_sf_sf = <
			               2039 1056 445 108 77 65
			               2036 1056 445 108 77 65
			               1880 1044 453 109 77 65
			               1751 1025 453 112 79 66
			               1689 1010 457 116 81 67
			               1588 1018 500 120 84 69
			               1453 871 456 129 88 72
			               1463 870 414 143 95 75
			               1444 858 399 151 104 80
			               1447 848 380 122 95 77
			               1476 856 374 105 77 66
			               1530 893 369 105 77 67
			               1619 959 377 109 81 68
			               1740 1053 407 113 85 72
			               1880 1180 452 115 85 74
			               2028 1338 520 112 77 66
			               2188 1506 617 110 76 65
			               2380 1664 761 113 77 66
			               3863 1592 609 112 78 67
			               4355 1796 642 113 78 67
			               4846 2029 714 114 79 68
			               5404 2302 795 115 80 66
			               5977 2637 914 118 82 68
			               6514 2982 1079 121 82 67
			               7217 3352 1193 129 82 68
			               7882 3825 1375 147 85 72
			               8679 4484 1655 193 90 70
			               9518 5395 2260 553 97 74
			              >;
			pc_temp_ocv_rows = <29>;
			pc_temp_ocv_cols = <6>;
			pc_temp_ocv_percent = <100 95 90 85 80 75 70 65 60 55 50 45 40 35 30 25 20 15 10 9 8 7 6 5 4 3 2 1>;
			pc_temp_ocv_ocv = <
			                   4383 4381 4377 4374 4366 4362
			                   4274 4288 4291 4302 4293 4290
			                   4201 4219 4228 4242 4233 4230
			                   4138 4159 4170 4184 4176 4173
			                   4087 4103 4117 4128 4120 4118
			                   4021 4055 4072 4075 4068 4066
			                   3943 3965 4000 4024 4019 4017
			                   3906 3925 3948 3977 3976 3974
			                   3863 3885 3907 3936 3935 3934
			                   3830 3848 3867 3885 3887 3887
			                   3808 3818 3836 3848 3847 3847
			                   3792 3800 3810 3823 3822 3822
			                   3780 3788 3792 3803 3803 3802
			                   3769 3779 3783 3788 3787 3786
			                   3757 3768 3775 3775 3772 3769
			                   3745 3756 3763 3760 3752 3740
			                   3732 3740 3746 3740 3732 3719
			                   3716 3721 3721 3712 3706 3694
			                   3691 3697 3695 3689 3681 3670
			                   3682 3691 3690 3688 3680 3669
			                   3673 3685 3685 3686 3679 3667
			                   3664 3678 3678 3682 3676 3665
			                   3652 3670 3667 3673 3670 3659
			                   3630 3655 3649 3646 3651 3640
			                   3603 3626 3617 3601 3612 3602
			                   3557 3578 3570 3542 3561 3553
			                   3494 3509 3501 3462 3491 3484
			                   3394 3404 3398 3358 3387 3383
			                   3200 3200 3200 3200 3200 3200
			                  >;
		};
