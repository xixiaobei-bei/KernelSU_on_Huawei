/* DO NOT EDIT - Automatically generated by python */
		&DESAYLGFL_2900_200k_4400 {
			fcc = <2900>;
			default_rbatt_mohm = <100>;
			identify_type = "id_volt";
			id_identify_min = <2786>;
			id_identify_max = <3312>;
			id_voltage_min = <2941>;
			id_voltage_max = <3167>;
			vbat_max = <4400>;
			temp_para = 
						"-32767","0","-1","0","4100","0",
						"0","5","-1","290","4400","0",
						"5","10","-1","870","4400","3",
						"10","45","-1","-1","4400","3",
						"45","50","-1","1015","4100","3",
						"50","32767","-1","0","4100","0";
			vbat_para = 
						"-32767","3400","-1","820","0",
						"3400","32767","-1","-1","0";
			segment_para = 
						"-32767","4150","2900","4208","50",
						"4150","4450","2030","4400","0";
			batt_brand = "DESAYLGFL";
			fcc_temp = <2940 2944 2950 2963 2952 2926>;
			fcc_sf_x = <0 100 200 300 400 500 600 700 800 1000 1500>;
			fcc_sf_y = <100 96 94 92 90 88 87 84 81 75 50>;
			fcc_sf_cols = <11>;
			pc_sf_rows = <1>;
			pc_sf_cols = <1>;
			pc_sf_row_entries = <0>;
			pc_sf_percent = <100>;
			pc_sf_sf = <100>;
			rbatt_sf_rows = <28>;
			rbatt_sf_cols = <6>;
			rbatt_sf_percent = <100 95 90 85 80 75 70 65 60 55 50 45 40 35 30 25 20 15 10 9 8 7 6 5 4 3 2 1>;
			rbatt_sf_sf = <
			               1941 709 364 118 91 80
			               1940 710 364 118 91 80
			               1842 714 370 123 94 81
			               1751 713 375 130 99 84
			               1724 729 385 138 104 88
			               1705 757 408 148 109 90
			               1523 774 458 163 116 95
			               1515 659 390 172 125 101
			               1496 668 362 176 132 106
			               1488 664 343 127 107 89
			               1506 666 341 120 95 83
			               1543 676 340 124 99 87
			               1596 693 353 130 107 92
			               1674 723 365 138 111 96
			               1777 761 387 143 109 94
			               1918 802 413 136 101 88
			               2092 869 435 125 97 85
			               2317 986 474 123 96 85
			               3350 979 459 133 102 88
			               3646 1028 479 133 102 87
			               3950 1100 498 132 99 87
			               4247 1164 548 132 100 86
			               4551 1277 621 128 97 86
			               4848 1397 630 131 99 85
			               5130 1481 634 137 103 89
			               5465 1583 706 160 109 89
			               5872 1664 766 439 124 91
			               6557 1861 985 932 226 148
			              >;
			pc_temp_ocv_rows = <29>;
			pc_temp_ocv_cols = <6>;
			pc_temp_ocv_percent = <100 95 90 85 80 75 70 65 60 55 50 45 40 35 30 25 20 15 10 9 8 7 6 5 4 3 2 1>;
			pc_temp_ocv_ocv = <
			                   4390 4388 4383 4375 4369 4361
			                   4305 4315 4317 4318 4313 4307
			                   4235 4252 4258 4261 4257 4251
			                   4171 4193 4201 4205 4201 4197
			                   4121 4140 4146 4151 4147 4143
			                   4071 4094 4097 4099 4094 4091
			                   3973 4036 4053 4054 4046 4042
			                   3931 3951 3972 3995 3999 3998
			                   3891 3914 3927 3953 3954 3954
			                   3855 3878 3887 3898 3900 3900
			                   3829 3846 3855 3863 3863 3864
			                   3811 3820 3826 3836 3837 3837
			                   3795 3799 3805 3814 3815 3815
			                   3781 3785 3788 3796 3796 3795
			                   3768 3772 3776 3780 3777 3772
			                   3754 3757 3763 3761 3755 3744
			                   3737 3740 3741 3735 3729 3717
			                   3717 3720 3716 3704 3699 3686
			                   3691 3698 3698 3687 3680 3667
			                   3683 3693 3695 3686 3679 3666
			                   3674 3687 3690 3683 3677 3664
			                   3665 3677 3683 3678 3674 3660
			                   3651 3664 3672 3662 3665 3649
			                   3631 3645 3648 3626 3636 3620
			                   3599 3612 3611 3578 3594 3579
			                   3551 3565 3562 3516 3540 3526
			                   3482 3497 3492 3446 3469 3455
			                   3384 3395 3394 3364 3371 3357
			                   3200 3200 3200 3200 3200 3200
			                  >;
		};
