/*---------------------------------------------------------------------------
 * This file is autogenerated file using huawei LCD parser. Please do not edit it.
 * Update input XML file to add a new entry or update variable in this file
 * Parser location: device/hisilicon/common/display/tools/huawei_lcd_panel 
 *---------------------------------------------------------------------------*/


/include/ "hw-panel-auo-ili9885-5p5-1080p-video.dtsi"
/include/ "hw-panel-auo-nt35532-5p5-1080p-video.dtsi"
/include/ "hw-panel-auo-otm1901a-5p2-1080p-video-default.dtsi"
/include/ "hw-panel-auo-td4310-5p2-1080p-video-was.dtsi"
/include/ "hw-panel-boe-nt35532-5p5-1080p-video.dtsi"
/include/ "hw-panel-boe-nt35596-5p2-1080p-video.dtsi"
/include/ "hw-panel-boe-nt35596s-5p2-1080p-video.dtsi"
/include/ "hw-panel-boe-otm1901a-5p2-1080p-video.dtsi"
/include/ "hw-panel-boe-otm1906c-5p2-1080p-cmd.dtsi"
/include/ "hw-panel-boe-td4300-5p2-1080p-video.dtsi"
/include/ "hw-panel-ebbg-nt35596s-5p2-1080p-video-was.dtsi"
/include/ "hw-panel-ebbg-nt35596s-5p2-1080p-video.dtsi"
/include/ "hw-panel-ebbg-otm1906c-5p2-1080p-cmd.dtsi"
/include/ "hw-panel-inx-nt35532-5p5-1080p-video.dtsi"
/include/ "hw-panel-inx-nt35596-5p2-1080p-video-pra.dtsi"
/include/ "hw-panel-inx-nt35596-5p2-1080p-video.dtsi"
/include/ "hw-panel-inx-otm1901a-5p2-1080p-video.dtsi"
/include/ "hw-panel-jdi-nt35695-5p2-1080p-cmd.dtsi"
/include/ "hw-panel-lg-r69006-5p2-1080p-cmd.dtsi"
/include/ "hw-panel-tm-ft8716-5p2-1080p-video.dtsi"
/include/ "hw-panel-tm-nt35596-5p2-1080p-video.dtsi"
/include/ "hw-panel-tm-nt35596-5p5-1080p-video.dtsi"
/include/ "hw-panel-tm-otm1901a-5p2-1080p-video.dtsi"
/include/ "hw-panel-tm-otm1901a-5p5-1080p-video.dtsi"
/include/ "hw-panel-tm-r63350-5p2-1080p-video.dtsi"
/include/ "hw-panel-tm-r63350-5p5-1080p-video.dtsi"
