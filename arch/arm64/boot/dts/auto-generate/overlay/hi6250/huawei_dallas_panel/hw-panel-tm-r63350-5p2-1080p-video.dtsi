/* Copyright (c) 2013, The Linux Foundation. All rights reserved.
 *
 * This program is free software; you can redistribute it and/or modify
 * it under the terms of the GNU General Public License version 2 and
 * only version 2 as published by the Free Software Foundation.
 *
 * This program is distributed in the hope that it will be useful,
 * but WITHOUT ANY WARRANTY; without even the implied warranty of
 * MERCHANTABILITY or FITNESS FOR A PARTICULAR PURPOSE.  See the
 * GNU General Public License for more details.
 */

/*---------------------------------------------------------------------------
 * This file is autogenerated file using gcdb parser. Please do not edit it.
 * Update input XML file to add a new entry or update variable in this file
 * VERSION = "1.0"
 *---------------------------------------------------------------------------*/
/{
	dss_tm_r63350_5p2_1080p_video:tm_r63350_5p2_1080p_video {
		compatible = "hisilicon,tm_r63350_5p2_1080p_video";
		hisilicon,dss-panel-name = "TM_R63350 5.2' VIDEO TFT 1080 x 1920";
		hisilicon,dss-panel-xres = <1080>;
		hisilicon,dss-panel-yres = <1920>;
		hisilicon,dss-panel-width = <65>;
		hisilicon,dss-panel-height = <115>;
		hisilicon,dss-panel-orientation = <1>;
		hisilicon,dss-panel-bpp = <2>;
		hisilicon,dss-panel-bgrfmt = <0>;
		hisilicon,dss-panel-bl-type = <8>;
		hisilicon,dss-panel-blmin = <4>;
		hisilicon,dss-panel-blmax = <255>;
		hisilicon,dss-panel-bl-def = <102>;
		hisilicon,dss-panel-type = <8>;
		hisilicon,dss-panel-ifbc-type = <0>;
		hisilicon,dss-panel-bl-pwm-preci-type = <0>;
		hisilicon,dss-panel-frc-enable = <0>;
		hisilicon,dss-panel-esd-enable = <1>;
		hisilicon,dss-panel-pxl-clk = <144>;
		hisilicon,dss-panel-pxl-clk-div = <1>;
		hisilicon,dss-panel-dirt-updt-support = <0>;
		hisilicon,dss-panel-dsi-upt-support = <1>;
		hisilicon,dss-panel-vsyn-ctr-type = <0>;
		hisilicon,dss-panel-step-support = <1>;
		hisilicon,dss-panel-esd-skip-mipi-check = <1>;
		hisilicon,dss-panel-xcc-set-in-isr-support = <1>;
		hisilicon,dss-panel-sre-support = <1>;
		hisilicon,dss-ldi-h-back-porch = <22>;
		hisilicon,dss-ldi-h-front-porch = <142>;
		hisilicon,dss-ldi-h-pulse-width = <8>;
		hisilicon,dss-ldi-v-back-porch = <25>;
		hisilicon,dss-ldi-v-front-porch = <12>;
		hisilicon,dss-ldi-v-pulse-width = <6>;
		hisilicon,dss-ldi-hsync-plr = <0>;
		hisilicon,dss-ldi-vsync-plr = <0>;
		hisilicon,dss-ldi-pixel-clk-plr = <0>;
		hisilicon,dss-ldi-data-en-plr = <0>;
		hisilicon,dss-ldi-dpi-a-overlap-size = <0>;
		hisilicon,dss-ldi-dpi-b-overlap-size = <0>;
		hisilicon,dss-panel-fps = <60>;
		hisilicon,dss-panel-fps-updt = <60>;
		hisilicon,dss-panel-fps-updt-support = <0>;
		hisilicon,dss-ldi-lfps-h-back-porch = <22>;
		hisilicon,dss-ldi-lfps-h-front-porch = <232>;
		hisilicon,dss-ldi-lfps-h-pulse-width = <8>;
		hisilicon,dss-ldi-lfps-v-back-porch = <25>;
		hisilicon,dss-ldi-lfps-v-front-porch = <12>;
		hisilicon,dss-ldi-lfps-v-pulse-width = <6>;
		hisilicon,dss-sbl-stren-limit = <128>;
		hisilicon,dss-sbl-cal-a = <60>;
		hisilicon,dss-sbl-cal-b = <95>;
		hisilicon,dss-sbl-cal-c = <5>;
		hisilicon,dss-sbl-cal-d = <1>;
		hisilicon,dss-sbl-tf-ctl = <5>;
		hisilicon,dss-sbl-blmin = <480>;
		hisilicon,dss-sbl-blmax = <4096>;
		hisilicon,dss-sbl-bl-scale = <0xff>;
		hisilicon,dss-sbl-am-light-min = <14>;
		hisilicon,dss-sbl-filter-a = <1738>;
		hisilicon,dss-sbl-filter-b = <6>;
		hisilicon,dss-sbl-logo-left = <0>;
		hisilicon,dss-sbl-logo-top = <0>;
		hisilicon,dss-mipi-vc = <0>;
		hisilicon,dss-mipi-lane-nums = <3>;
		hisilicon,dss-mipi-color-mode = <5>;
		hisilicon,dss-mipi-dsi-bit-clk = <454>;
		hisilicon,dss-mipi-burst-mode = <2>;
		hisilicon,dss-mipi-max-esc-clk = <9>;
		hisilicon,dss-mipi-dsi-bit-clk-val-a = <454>;
		hisilicon,dss-mipi-dsi-bit-clk-val-b = <480>;
		hisilicon,dss-mipi-dsi-bit-clk-val-c = <0>;
		hisilicon,dss-mipi-dsi-bit-clk-val-d = <0>;
		hisilicon,dss-mipi-dsi-bit-clk-val-e = <0>;
		hisilicon,dss-mipi-dsi-bit-clk-upt = <454>;
		hisilicon,dss-mipi-rg-vcm-adjust = <1>;
		hisilicon,dss-mipi-non-continue-enable = <1>;
		hisilicon,dss-mipi-clk-post-adjust = <30>;
		hisilicon,dss-dirt-left-align = <2>;
		hisilicon,dss-dirt-right-align = <2>;
		hisilicon,dss-dirt-top-align = <2>;
		hisilicon,dss-dirt-bott-align = <2>;
		hisilicon,dss-dirt-width-align = <2>;
		hisilicon,dss-dirt-height-align = <2>;
		hisilicon,dss-dirt-width-min = <2>;
		hisilicon,dss-dirt-height-min = <2>;
		hisilicon,dss-dirt-top-start = <0xffff>;
		hisilicon,dss-dirt-bott-start = <0xffff>;
		lcd-ctrl-tp-power = <0>;
		lock-cmd-support = <0>;
		read-power-status = <1>;
		esd-set-backlight = <0>;
		pt-station-test-support = <1>;
		read-data-type = <0x06>;
		power-on-sequence = <0 0 0 0 0 5 5 5 10 20 10 25 100>;
		power-off-sequence = <5 5 5 0 3 0>;
		hisilicon,dss-color-temp-support = <0>;
		hisilicon,dss-prefix-ce-support = <0>;
		hisilicon,dss-prefix-sharp-one-d-support = <0>;
		hisilicon,dss-prefix-sharp-two-d-support = <0>;
		hisilicon,dss-sbl-support = <0>;
		hisilicon,dss-gamma-support = <1>;
		hisilicon,dss-gmp-support = <0>;
		hisilicon,dss-xcc-support = <1>;
		hisilicon,dss-comform-mode-support = <1>;
		hisilicon,dss-acm-support = <1>;
		hisilicon,dss-acm-ce-support = <0>;
		hisilicon,dss-acm-valid-num = <7>;
		hisilicon,dss-acm-r_hh0 = <0x7f>;
		hisilicon,dss-acm-r_lh0 = <0x0>;
		hisilicon,dss-acm-r_hh1 = <0xbd>;
		hisilicon,dss-acm-r_lh1 = <0x80>;
		hisilicon,dss-acm-r_hh2 = <0x1d7>;
		hisilicon,dss-acm-r_lh2 = <0xbe>;
		hisilicon,dss-acm-r_hh3 = <0x1ff>;
		hisilicon,dss-acm-r_lh3 = <0x1d8>;
		hisilicon,dss-acm-r_hh4 = <0x27f>;
		hisilicon,dss-acm-r_lh4 = <0x200>;
		hisilicon,dss-acm-r_hh5 = <0x304>;
		hisilicon,dss-acm-r_lh5 = <0x280>;
		hisilicon,dss-acm-r_hh6 = <0x37f>;
		hisilicon,dss-acm-r_lh6 = <0x305>;

		hisilicon,dss-on-cmds = <
					0x29 0x00 0x0a 0x00 0x02 0xb0 0x04
			0x29 0x00 0x0a 0x00 0x09 0xc2 0x31 0xF7 0x80 0x1F 0x0c 0x00 0x00 0x08
			0x29 0x00 0x0a 0x00 0x02 0xd6 0x01
			0x29 0x00 0x0a 0x00 0x04 0xb6 0x4a 0xdb 0x76
			0x29 0x00 0x0a 0x00 0x05 0xd3 0x1b 0x33 0x99 0xbb
			0x29 0x00 0x0a 0x00 0x08 0xb8 0x57 0x4d 0x03 0x00 0x02 0x00 0x00
			0x29 0x00 0x0a 0x00 0x08 0xb9 0x01 0x3d 0x68 0x00 0x02 0x00 0x00
			0x29 0x00 0x0a 0x00 0x03 0xbb 0x10 0x00
			0x29 0x00 0x0a 0x00 0x0a 0xf9 0x61 0xff 0x5a 0xe6 0x00 0x8d 0xbf 0x80 0x00
			0x29 0x00 0x0a 0x00 0x1f 0xc7 0x00 0x10 0x19 0x25 0x35 0x43 0x4d 0x5c 0x40 0x48 0x55 0x60 0x69 0x6f 0x76 0x00 0x10 0x19 0x25 0x35 0x43 0x4d 0x5c 0x40 0x48 0x55 0x60 0x69 0x6f 0x76
			0x29 0x00 0x0a 0x00 0x1a 0xce 0x25 0x40 0x49 0x53 0x59 0x5e 0x63 0x68 0x6e 0x74 0x7e 0x8a 0x98 0xa8 0xbb 0xd0 0xff 0x02 0x13 0x04 0x04 0x42 0x00 0x69 0x5a
			0x29 0x00 0x0a 0x00 0x02 0xb0 0x03
			0x15 0x00 0x0a 0x00 0x02 0x51 0x00
			0x15 0x00 0x0a 0x00 0x02 0x53 0x24
			0x15 0x00 0x0a 0x00 0x02 0x55 0x01
			0x15 0x00 0x0a 0x00 0x02 0x5E 0x28
			0x05 0x00 0x14 0x01 0x02 0x29 0x00
			0x05 0x00 0x00 0x01 0x02 0x11 0x00>;
		hisilicon,dss-off-cmds = <
					0x05 0x00 0x0a 0x01 0x02 0x28 0x00
			0x29 0x00 0x0a 0x00 0x02 0xb0 0x04
			0x29 0x00 0x0a 0x00 0x02 0xd6 0x01
			0x29 0x00 0x32 0x01 0x05 0xd3 0x13 0x33 0x99 0xb3
			0x29 0x00 0x0a 0x00 0x02 0xb0 0x03
			0x05 0x00 0x78 0x01 0x02 0x10 0x00>;
		hisilicon,dss-esd-reg = <
					0x0a>;
		hisilicon,dss-esd-value = <
					0x1c>;
		hisilicon,dss-mipi-check-reg = <
					0x0a>;
		hisilicon,dss-mipi-check-value = <
					0x1c>;
		hisilicon,dss-cabc-off-mode = <
					0x15 0x00 0x0a 0x00 0x02 0x55 0x00>;
		hisilicon,dss-cabc-ui-mode = <
					0x15 0x00 0xff 0x01 0x02 0x55 0x01
			0x15 0x00 0x0a 0x00 0x02 0x53 0x24>;
		hisilicon,dss-cabc-still-mode = <
					0x15 0x00 0x0a 0x00 0x02 0x55 0x02
			0x15 0x00 0x0a 0x00 0x02 0x53 0x2C>;
		hisilicon,dss-cabc-moving-mode = <
					0x15 0x00 0x0a 0x00 0x02 0x53 0x2C
			0x15 0x00 0x0a 0x00 0x02 0x55 0x03>;
		hisilicon,dss-sre-on-cmd = <
					0x29 0x00 0x0a 0x00 0x02 0xb0 0x03
			0x15 0x00 0x0a 0x00 0x02 0x53 0x2c
			0x15 0x00 0x0a 0x00 0x02 0x55 0xd0>;
		hisilicon,dss-sre-off-cmd = <
					0x15 0x00 0x0a 0x00 0x02 0x55 0x00>;
		hisilicon,dss-dot-inversion = <
					0x29 0x00 0x0a 0x00 0x02 0xb0 0x04
				0x29 0x00 0x0a 0x00 0x03 0xc2 0x31 0x07
				0x29 0x00 0x0a 0x00 0x02 0xb0 0x03>;
		hisilicon,dss-column-inversion = <
					0x29 0x00 0x0a 0x00 0x02 0xb0 0x04
				0x29 0x00 0x0a 0x00 0x03 0xc2 0x31 0xf7
				0x29 0x00 0x0a 0x00 0x02 0xb0 0x03>;
		hisilicon,dss-forword-scan = <
					0x39 0x00 0x0a 0x00 0x02 0x36 0x00>;
		hisilicon,dss-revert-scan = <
					0x39 0x00 0x0a 0x00 0x02 0x36 0xc0>;
		gpios = <&gpio1 7 0>, <&gpio2 4 0>, <&gpio2 5 0>, <&gpio0 0 0>, <&gpio0 0 0>, <&gpio3 0 0>;
		lcdanalog-vcc = <3100000>;
		lcdio-vcc = <1800000>;
		lcd-bias = <5400000>;
		lcd-vsp = <5400000>;
		lcd-vsn = <5400000>;
		lcdio-vcc-supply = <&ldo4>;
		lcdanalog-vcc-supply = <&ldo17>;
		lcd_backlight-supply = <&schg_boost2>;
		vcc_lcdbias-supply = <&schg_boost4>;
		lcd_vsp-supply = <&schg_ldo3>;
		lcd_vsn-supply = <&schg_cpn1>;
		pinctrl-names = "default","idle";
		pinctrl-0 = <&gpio015_pmx_func &gpio020_pmx_func &gpio021_pmx_func &gpio024_pmx_func &gpio015_cfg_func &gpio020_cfg_func &gpio021_cfg_func &gpio024_cfg_func>;
		pinctrl-1 = <&gpio015_pmx_idle &gpio020_pmx_idle &gpio021_pmx_idle &gpio024_pmx_idle &gpio015_cfg_idle &gpio020_cfg_idle &gpio021_cfg_idle &gpio024_cfg_idle>;
		status = "disabled";
	};
};
