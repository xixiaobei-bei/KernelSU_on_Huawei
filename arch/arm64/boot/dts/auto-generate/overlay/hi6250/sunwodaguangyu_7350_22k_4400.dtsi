/* DO NOT EDIT - Automatically generated by python */
		&sunwodaguangyu_7350_22k_4400 {
			fcc = <7350>;
			default_rbatt_mohm = <100>;
			identify_type = "id_volt";
			id_identify_min = <751>;
			id_identify_max = <1235>;
			id_voltage_min = <939>;
			id_voltage_max = <1059>;
			vbat_max = <4400>;
			temp_para = 
						"-32767","0","-1","0","4100","0",
						"0","5","-1","735","4400","0",
						"5","10","-1","2205","4400","3",
						"10","45","-1","-1","4400","3",
						"45","50","-1","2572","4100","3",
						"50","32767","-1","0","4100","0";
			vbat_para = 
						"-32767","3400","-1","820","0",
						"3400","32767","-1","-1","0";
			segment_para = 
						"-32767","4150","7350","4208","50",
						"4150","4450","5145","4400","0";
			batt_brand = "sunwodaguangyu";
			fcc_temp = <7495 7472 7490 7485 7484 7401>;
			fcc_sf_x = <0 100 200 300 400 500 600 700 800 1000 1500>;
			fcc_sf_y = <100 96 94 92 90 88 87 84 81 75 50>;
			fcc_sf_cols = <11>;
			pc_sf_rows = <1>;
			pc_sf_cols = <1>;
			pc_sf_row_entries = <0>;
			pc_sf_percent = <100>;
			pc_sf_sf = <100>;
			rbatt_sf_rows = <28>;
			rbatt_sf_cols = <6>;
			rbatt_sf_percent = <100 95 90 85 80 75 70 65 60 55 50 45 40 35 30 25 20 15 10 9 8 7 6 5 4 3 2 1>;
			rbatt_sf_sf = <
			               1160 854 395 114 77 80
			               1158 853 395 114 77 80
			               1065 795 382 112 77 83
			               1015 741 367 111 77 82
			               958 722 360 110 77 82
			               898 641 357 112 78 84
			               873 636 319 112 80 85
			               862 615 310 117 84 85
			               862 601 298 119 96 89
			               873 608 287 107 80 84
			               890 623 282 100 76 82
			               916 648 291 98 74 82
			               950 683 313 100 73 82
			               987 719 347 102 74 84
			               1030 756 390 103 79 85
			               1077 794 448 102 76 82
			               1132 836 518 102 76 82
			               1203 884 604 107 77 82
			               2249 1152 583 107 76 82
			               2427 1276 581 105 77 83
			               2600 1398 643 99 77 83
			               2807 1537 721 91 78 84
			               2987 1686 804 101 78 85
			               3192 1835 897 106 79 84
			               3447 2000 993 106 78 82
			               3717 2206 1083 122 79 83
			               4068 2451 1279 158 93 86
			               4633 2840 1515 174 124 86
			              >;
			pc_temp_ocv_rows = <29>;
			pc_temp_ocv_cols = <6>;
			pc_temp_ocv_percent = <100 95 90 85 80 75 70 65 60 55 50 45 40 35 30 25 20 15 10 9 8 7 6 5 4 3 2 1>;
			pc_temp_ocv_ocv = <
			                   4370 4365 4375 4370 4367 4354
			                   4243 4256 4277 4296 4301 4284
			                   4162 4181 4209 4238 4242 4229
			                   4108 4114 4148 4181 4185 4172
			                   4042 4068 4095 4127 4128 4118
			                   3970 3979 4047 4077 4077 4068
			                   3920 3941 3981 4028 4031 4020
			                   3879 3894 3935 3983 3988 3978
			                   3849 3855 3891 3938 3947 3938
			                   3829 3831 3852 3889 3897 3886
			                   3812 3814 3820 3852 3858 3850
			                   3798 3801 3802 3826 3831 3824
			                   3784 3788 3791 3806 3809 3804
			                   3769 3775 3781 3789 3791 3788
			                   3754 3761 3770 3774 3777 3771
			                   3737 3744 3756 3758 3756 3741
			                   3720 3726 3737 3739 3735 3719
			                   3697 3708 3713 3714 3712 3694
			                   3669 3685 3684 3686 3683 3670
			                   3659 3678 3678 3685 3681 3668
			                   3647 3670 3672 3683 3680 3667
			                   3636 3661 3666 3679 3678 3664
			                   3620 3650 3657 3674 3676 3660
			                   3598 3632 3642 3660 3672 3644
			                   3570 3603 3617 3623 3659 3610
			                   3530 3559 3570 3569 3626 3559
			                   3474 3492 3506 3500 3579 3493
			                   3385 3391 3405 3391 3474 3396
			                   3200 3200 3200 3200 3200 3200
			                  >;
			vol_dec0=  <400>;
			pc_temp_ocv_ocv0 = < 
			                   3970 3965 3975 3970 3967 3954
			                   3956 3958 3966 3962 3962 3950
			                   3943 3950 3956 3955 3958 3946
			                   3929 3936 3947 3948 3942 3940
			                   3898 3898 3925 3920 3906 3907
			                   3868 3864 3891 3885 3876 3874
			                   3845 3841 3858 3858 3852 3849
			                   3828 3825 3831 3837 3833 3831
			                   3814 3812 3811 3820 3817 3815
			                   3801 3801 3799 3806 3802 3801
			                   3790 3791 3791 3793 3791 3790
			                   3777 3780 3783 3782 3782 3779
			                   3765 3769 3774 3771 3768 3762
			                   3752 3756 3765 3759 3753 3741
			                   3738 3743 3753 3746 3739 3725
			                   3724 3728 3737 3731 3725 3709
			                   3706 3713 3718 3710 3706 3690
			                   3686 3697 3696 3689 3683 3672
			                   3653 3671 3672 3680 3678 3665
			                   3642 3664 3668 3677 3677 3662
			                   3633 3656 3661 3673 3675 3656
			                   3618 3645 3652 3663 3671 3644
			                   3599 3629 3638 3640 3662 3622
			                   3577 3606 3617 3605 3646 3589
			                   3547 3572 3581 3564 3618 3551
			                   3507 3524 3537 3517 3584 3503
			                   3452 3457 3473 3450 3528 3442
			                   3367 3362 3377 3350 3434 3353
			                   3200 3200 3200 3200 3200 3200
			                  >;
		};
