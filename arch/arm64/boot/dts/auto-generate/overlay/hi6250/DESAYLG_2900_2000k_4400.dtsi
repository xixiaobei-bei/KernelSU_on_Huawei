/* DO NOT EDIT - Automatically generated by python */
		&DESAYLG_2900_2000k_4400 {
			fcc = <2900>;
			default_rbatt_mohm = <100>;
			identify_type = "id_volt";
			id_identify_min = <3767>;
			id_identify_max = <4095>;
			id_voltage_min = <3838>;
			id_voltage_max = <4082>;
			vbat_max = <4400>;
			temp_para = 
						"-32767","0","-1","0","4100","0",
						"0","5","-1","290","4400","0",
						"5","10","-1","870","4400","3",
						"10","45","-1","-1","4400","3",
						"45","50","-1","1015","4100","3",
						"50","32767","-1","0","4100","0";
			vbat_para = 
						"-32767","3400","-1","820","0",
						"3400","32767","-1","-1","0";
			segment_para = 
						"-32767","4150","2900","4208","50",
						"4150","4450","2030","4400","0";
			batt_brand = "DESAYLG";
			fcc_temp = <2907 2916 2912 2921 2912 2896>;
			fcc_sf_x = <0 100 200 300 400 500 600 700 800 1000 1500>;
			fcc_sf_y = <100 96 94 92 90 88 87 84 81 75 50>;
			fcc_sf_cols = <11>;
			pc_sf_rows = <1>;
			pc_sf_cols = <1>;
			pc_sf_row_entries = <0>;
			pc_sf_percent = <100>;
			pc_sf_sf = <100>;
			rbatt_sf_rows = <28>;
			rbatt_sf_cols = <6>;
			rbatt_sf_percent = <100 95 90 85 80 75 70 65 60 55 50 45 40 35 30 25 20 15 10 9 8 7 6 5 4 3 2 1>;
			rbatt_sf_sf = <
			               2156 1025 466 124 89 76
			               2156 1025 466 124 89 76
			               2047 1028 465 127 91 77
			               1944 1024 473 132 95 79
			               1941 1020 487 138 99 82
			               1904 1102 517 146 104 85
			               1682 994 565 163 111 88
			               1670 933 454 168 118 93
			               1639 927 443 188 133 101
			               1648 911 421 125 100 82
			               1684 917 416 121 90 78
			               1733 955 413 124 94 81
			               1794 1015 416 128 100 86
			               1874 1083 438 135 105 90
			               1972 1170 475 139 104 86
			               2096 1278 524 136 97 81
			               2249 1410 579 125 92 80
			               2459 1601 655 126 92 78
			               3413 1610 661 138 99 82
			               4084 1716 623 137 99 83
			               4396 1872 663 133 97 82
			               4697 2032 712 132 96 81
			               5015 2218 779 131 94 81
			               5292 2427 846 133 94 82
			               5663 2555 878 142 99 85
			               6031 2748 951 151 103 85
			               6449 3056 1003 204 105 86
			               7257 3561 1190 493 132 95
			              >;
			pc_temp_ocv_rows = <29>;
			pc_temp_ocv_cols = <6>;
			pc_temp_ocv_percent = <100 95 90 85 80 75 70 65 60 55 50 45 40 35 30 25 20 15 10 9 8 7 6 5 4 3 2 1>;
			pc_temp_ocv_ocv = <
			                   4390 4388 4383 4374 4367 4361
			                   4289 4304 4309 4317 4312 4307
			                   4216 4236 4245 4260 4255 4251
			                   4149 4174 4188 4204 4199 4196
			                   4107 4115 4135 4150 4145 4142
			                   4057 4078 4089 4098 4093 4090
			                   3957 3997 4036 4056 4046 4041
			                   3914 3937 3955 3991 3996 3996
			                   3872 3896 3915 3954 3954 3954
			                   3844 3858 3875 3894 3896 3896
			                   3825 3827 3844 3861 3861 3861
			                   3810 3810 3818 3834 3835 3835
			                   3795 3799 3798 3812 3813 3813
			                   3780 3786 3786 3794 3795 3794
			                   3764 3772 3775 3778 3776 3772
			                   3749 3755 3761 3762 3755 3744
			                   3731 3735 3738 3736 3730 3719
			                   3712 3715 3711 3703 3697 3683
			                   3685 3694 3695 3688 3680 3668
			                   3677 3688 3691 3686 3679 3667
			                   3666 3681 3685 3684 3677 3665
			                   3652 3672 3675 3680 3674 3662
			                   3634 3660 3660 3668 3665 3651
			                   3609 3643 3637 3636 3639 3624
			                   3574 3611 3602 3590 3597 3584
			                   3526 3560 3555 3531 3543 3532
			                   3455 3487 3488 3452 3472 3462
			                   3357 3381 3386 3349 3368 3361
			                   3200 3200 3200 3200 3200 3200
			                  >;
		};
