/* DO NOT EDIT - Automatically generated by python */
		&DESAYSONYB_3240_110k_4400 {
			fcc = <3240>;
			default_rbatt_mohm = <100>;
			identify_type = "id_volt";
			id_identify_min = <2281>;
			id_identify_max = <2786>;
			id_voltage_min = <2426>;
			id_voltage_max = <2631>;
			vbat_max = <4400>;
			temp_para = 
						"-32767","0","-1","0","4100","0",
						"0","5","-1","324","4400","0",
						"5","10","-1","972","4400","3",
						"10","45","-1","-1","4400","3",
						"45","50","-1","1134","4100","3",
						"50","32767","-1","0","4100","0";
			vbat_para = 
						"-32767","3400","-1","820","0",
						"3400","32767","-1","-1","0";
			segment_para = 
						"-32767","4150","3240","4208","50",
						"4150","4450","2268","4400","0";
			batt_brand = "DESAYSONYB";
			fcc_temp = <3257 3246 3255 3287 3281 3260>;
			fcc_sf_x = <0 100 200 300 400 500 600 700 800 1000 1500>;
			fcc_sf_y = <100 96 94 92 90 88 87 84 81 75 50>;
			fcc_sf_cols = <11>;
			pc_sf_rows = <1>;
			pc_sf_cols = <1>;
			pc_sf_row_entries = <0>;
			pc_sf_percent = <100>;
			pc_sf_sf = <100>;
			rbatt_sf_rows = <28>;
			rbatt_sf_cols = <6>;
			rbatt_sf_percent = <100 95 90 85 80 75 70 65 60 55 50 45 40 35 30 25 20 15 10 9 8 7 6 5 4 3 2 1>;
			rbatt_sf_sf = <
			               1695 768 410 148 117 106
			               1695 768 410 147 117 106
			               1710 785 422 145 118 107
			               1663 796 435 150 121 108
			               1686 801 439 154 124 109
			               1644 833 465 161 128 111
			               1584 793 462 170 133 114
			               1590 806 453 178 141 118
			               1566 811 446 173 142 120
			               1581 814 440 151 123 108
			               1618 827 448 146 119 107
			               1665 858 449 147 120 107
			               1725 907 469 153 123 108
			               1800 969 498 159 127 112
			               1894 1033 534 161 129 112
			               2021 1118 577 158 122 108
			               2219 1235 628 157 122 111
			               2640 1460 716 160 123 111
			               4271 2005 830 163 125 113
			               5191 2012 776 163 124 113
			               6304 2205 828 164 125 113
			               7786 2581 895 167 127 114
			               10062 3100 990 172 128 114
			               14405 3787 1145 173 127 113
			               25205 4854 1291 174 128 114
			               43952 7026 1579 187 134 114
			               61330 12258 2135 268 170 148
			               119061 24599 3170 295 216 136
			              >;
			pc_temp_ocv_rows = <29>;
			pc_temp_ocv_cols = <6>;
			pc_temp_ocv_percent = <100 95 90 85 80 75 70 65 60 55 50 45 40 35 30 25 20 15 10 9 8 7 6 5 4 3 2 1>;
			pc_temp_ocv_ocv = <
			                   4365 4361 4358 4350 4345 4339
			                   4273 4285 4287 4286 4281 4276
			                   4206 4222 4226 4224 4222 4217
			                   4133 4162 4167 4166 4164 4160
			                   4086 4102 4109 4111 4110 4106
			                   4028 4054 4059 4060 4058 4055
			                   3962 3989 4005 4011 4011 4008
			                   3917 3941 3954 3966 3967 3965
			                   3869 3896 3908 3920 3922 3921
			                   3833 3855 3868 3875 3876 3874
			                   3807 3821 3836 3844 3844 3843
			                   3783 3797 3807 3820 3820 3818
			                   3762 3778 3787 3801 3801 3799
			                   3744 3762 3772 3785 3785 3782
			                   3726 3745 3758 3769 3768 3761
			                   3706 3728 3743 3749 3743 3730
			                   3685 3704 3719 3727 3721 3709
			                   3660 3670 3685 3698 3693 3682
			                   3621 3633 3643 3666 3663 3652
			                   3608 3625 3637 3662 3658 3648
			                   3594 3613 3631 3657 3653 3643
			                   3576 3602 3624 3649 3647 3637
			                   3556 3589 3613 3639 3635 3624
			                   3529 3570 3596 3616 3612 3597
			                   3498 3535 3563 3576 3572 3557
			                   3468 3483 3510 3524 3519 3506
			                   3398 3412 3440 3459 3454 3441
			                   3307 3326 3343 3367 3363 3349
			                   3200 3200 3200 3200 3200 3200
			                  >;
			vol_dec1=  <50>;
			pc_temp_ocv_ocv1 = <
			                   4315 4311 4308 4300 4295 4289
			                   4238 4245 4246 4240 4237 4232
			                   4171 4186 4189 4184 4181 4176
			                   4112 4128 4132 4129 4128 4123
			                   4061 4077 4081 4079 4077 4073
			                   4001 4022 4030 4031 4030 4027
			                   3945 3967 3980 3987 3987 3984
			                   3900 3922 3933 3943 3945 3943
			                   3857 3880 3891 3898 3900 3898
			                   3825 3843 3855 3861 3862 3860
			                   3800 3813 3825 3834 3834 3833
			                   3778 3791 3800 3813 3813 3811
			                   3758 3773 3783 3796 3796 3793
			                   3740 3758 3768 3780 3781 3777
			                   3722 3741 3755 3764 3762 3753
			                   3703 3724 3739 3745 3739 3726
			                   3682 3699 3714 3723 3717 3705
			                   3657 3666 3681 3694 3689 3678
			                   3617 3630 3641 3665 3661 3651
			                   3605 3622 3635 3660 3657 3647
			                   3591 3610 3630 3655 3651 3642
			                   3573 3599 3621 3647 3644 3635
			                   3553 3586 3610 3636 3631 3621
			                   3525 3565 3592 3610 3605 3591
			                   3494 3529 3557 3569 3564 3550
			                   3467 3476 3504 3517 3512 3499
			                   3395 3406 3434 3454 3448 3435
			                   3304 3323 3339 3362 3359 3345
			                   3200 3200 3200 3200 3200 3200
			                  >;
			vol_dec2=  <200>;
			pc_temp_ocv_ocv2 = <
			                   4165 4161 4158 4150 4145 4139
			                   4131 4123 4122 4112 4112 4104
			                   4089 4084 4081 4069 4068 4061
			                   4037 4038 4037 4028 4027 4022
			                   3979 3984 3991 3989 3990 3985
			                   3933 3942 3948 3950 3952 3948
			                   3891 3902 3909 3911 3913 3910
			                   3854 3866 3874 3874 3875 3872
			                   3825 3835 3845 3847 3847 3845
			                   3802 3810 3819 3826 3827 3824
			                   3781 3791 3799 3809 3809 3807
			                   3763 3775 3783 3794 3795 3792
			                   3746 3761 3770 3781 3781 3777
			                   3730 3746 3758 3767 3765 3757
			                   3713 3731 3745 3751 3744 3731
			                   3695 3712 3726 3733 3727 3714
			                   3675 3686 3700 3711 3705 3692
			                   3649 3655 3667 3681 3677 3667
			                   3607 3621 3635 3659 3656 3645
			                   3595 3611 3630 3654 3651 3641
			                   3579 3601 3622 3647 3645 3635
			                   3561 3590 3613 3637 3634 3623
			                   3540 3576 3599 3618 3614 3599
			                   3512 3549 3576 3587 3582 3566
			                   3484 3511 3536 3545 3541 3526
			                   3459 3456 3484 3496 3491 3477
			                   3383 3391 3418 3437 3431 3418
			                   3297 3313 3327 3349 3345 3333
			                   3200 3200 3200 3200 3200 3200
			                  >;
		};
