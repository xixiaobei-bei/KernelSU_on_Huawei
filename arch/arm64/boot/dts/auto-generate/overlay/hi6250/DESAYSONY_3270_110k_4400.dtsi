/* DO NOT EDIT - Automatically generated by python */
		&DESAYSONY_3270_110k_4400 {
			fcc = <3270>;
			default_rbatt_mohm = <100>;
			identify_type = "id_volt";
			id_identify_min = <2281>;
			id_identify_max = <2786>;
			id_voltage_min = <2426>;
			id_voltage_max = <2631>;
			vbat_max = <4400>;
			temp_para = 
						"-32767","0","-1","0","4100","0",
						"0","5","-1","327","4400","0",
						"5","10","-1","981","4400","3",
						"10","45","-1","-1","4400","3",
						"45","50","-1","1144","4100","3",
						"50","32767","-1","0","4100","0";
			vbat_para = 
						"-32767","3400","-1","820","0",
						"3400","32767","-1","-1","0";
			segment_para = 
						"-32767","4150","3270","4208","50",
						"4150","4450","2289","4400","0";
			batt_brand = "DESAYSONY";
			fcc_temp = <3363 3374 3390 3429 3422 3400>;
			fcc_sf_x = <0 100 200 300 400 500 600 700 800 1000 1500>;
			fcc_sf_y = <100 96 94 92 90 88 87 84 81 75 50>;
			fcc_sf_cols = <11>;
			pc_sf_rows = <1>;
			pc_sf_cols = <1>;
			pc_sf_row_entries = <0>;
			pc_sf_percent = <100>;
			pc_sf_sf = <100>;
			rbatt_sf_rows = <28>;
			rbatt_sf_cols = <6>;
			rbatt_sf_percent = <100 95 90 85 80 75 70 65 60 55 50 45 40 35 30 25 20 15 10 9 8 7 6 5 4 3 2 1>;
			rbatt_sf_sf = <
			               1235 655 344 143 114 104
			               1235 655 345 143 114 104
			               1250 669 354 147 115 103
			               1244 674 362 151 118 104
			               1246 674 368 156 121 106
			               1251 688 384 163 125 109
			               1196 668 384 172 130 112
			               1195 640 368 180 137 116
			               1193 646 355 177 139 119
			               1190 643 346 155 126 111
			               1205 640 343 144 116 105
			               1234 657 345 145 115 105
			               1275 680 349 150 118 106
			               1335 715 363 156 123 110
			               1422 762 381 158 122 108
			               1553 823 405 151 117 105
			               1755 917 431 152 117 107
			               2126 1096 483 155 119 108
			               3086 1213 466 148 116 106
			               3484 1349 484 152 118 106
			               4025 1532 521 154 118 108
			               4767 1807 572 157 120 109
			               6038 2242 643 163 123 110
			               8668 2980 754 166 122 110
			               19944 4326 946 168 123 109
			               56209 8018 1390 211 150 121
			               111089 25984 2943 215 153 117
			               198653 57421 7813 226 141 119
			              >;
			pc_temp_ocv_rows = <29>;
			pc_temp_ocv_cols = <6>;
			pc_temp_ocv_percent = <100 95 90 85 80 75 70 65 60 55 50 45 40 35 30 25 20 15 10 9 8 7 6 5 4 3 2 1>;
			pc_temp_ocv_ocv = <
			                   4380 4378 4376 4369 4366 4362
			                   4298 4304 4305 4296 4295 4292
			                   4231 4241 4244 4235 4235 4232
			                   4166 4181 4185 4177 4177 4174
			                   4108 4121 4127 4121 4122 4120
			                   4056 4069 4075 4069 4070 4068
			                   3990 4011 4022 4020 4022 4021
			                   3941 3954 3969 3974 3977 3977
			                   3898 3911 3922 3929 3933 3933
			                   3858 3872 3882 3883 3887 3887
			                   3825 3836 3849 3849 3851 3851
			                   3799 3810 3821 3823 3826 3825
			                   3777 3790 3797 3803 3805 3805
			                   3757 3774 3780 3787 3789 3788
			                   3738 3759 3767 3771 3770 3765
			                   3720 3740 3753 3752 3746 3736
			                   3699 3717 3731 3731 3724 3713
			                   3677 3684 3698 3703 3697 3686
			                   3646 3648 3662 3670 3667 3657
			                   3635 3639 3655 3666 3663 3653
			                   3624 3630 3648 3660 3658 3649
			                   3610 3619 3640 3653 3651 3643
			                   3594 3606 3629 3642 3640 3632
			                   3571 3589 3612 3622 3616 3606
			                   3540 3560 3581 3584 3575 3565
			                   3484 3510 3527 3532 3522 3513
			                   3407 3435 3464 3463 3453 3444
			                   3305 3332 3360 3363 3355 3350
			                   3200 3200 3200 3200 3200 3200
			                  >;
		};
