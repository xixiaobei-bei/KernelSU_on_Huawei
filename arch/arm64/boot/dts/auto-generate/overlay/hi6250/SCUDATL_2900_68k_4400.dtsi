/* DO NOT EDIT - Automatically generated by python */
		&SCUDATL_2900_68k_4400 {
			fcc = <2900>;
			default_rbatt_mohm = <100>;
			identify_type = "id_volt";
			id_identify_min = <1759>;
			id_identify_max = <2281>;
			id_voltage_min = <1956>;
			id_voltage_max = <2135>;
			vbat_max = <4400>;
			temp_para = 
						"-32767","0","-1","0","4100","0",
						"0","5","-1","290","4400","0",
						"5","10","-1","870","4400","3",
						"10","45","-1","-1","4400","3",
						"45","50","-1","1015","4100","3",
						"50","32767","-1","0","4100","0";
			vbat_para = 
						"-32767","3400","-1","820","0",
						"3400","32767","-1","-1","0";
			segment_para = 
						"-32767","4150","2900","4208","50",
						"4150","4450","2030","4400","0";
			batt_brand = "SCUDATL";
			fcc_temp = <2952 2953 2945 2959 2947 2932>;
			fcc_sf_x = <0 100 200 300 400 500 600 700 800 1000 1500>;
			fcc_sf_y = <100 96 94 92 90 88 87 84 81 75 50>;
			fcc_sf_cols = <11>;
			pc_sf_rows = <1>;
			pc_sf_cols = <1>;
			pc_sf_row_entries = <0>;
			pc_sf_percent = <100>;
			pc_sf_sf = <100>;
			rbatt_sf_rows = <28>;
			rbatt_sf_cols = <6>;
			rbatt_sf_percent = <100 95 90 85 80 75 70 65 60 55 50 45 40 35 30 25 20 15 10 9 8 7 6 5 4 3 2 1>;
			rbatt_sf_sf = <
			               2421 1537 725 168 125 113
			               2417 1535 725 168 125 113
			               2226 1475 723 168 127 114
			               2056 1405 700 171 128 114
			               1951 1347 695 175 131 115
			               1854 1321 716 180 135 118
			               1652 1147 672 194 140 122
			               1648 1117 614 206 150 127
			               1614 1094 587 209 159 133
			               1630 1076 562 168 135 120
			               1682 1096 554 157 123 114
			               1743 1162 561 158 124 114
			               1814 1240 609 163 129 117
			               1895 1326 681 169 133 121
			               1988 1421 761 171 135 123
			               2096 1531 856 167 125 114
			               2227 1646 973 165 123 114
			               2404 1760 1131 170 125 114
			               3603 1699 877 163 126 115
			               3959 1866 937 166 127 113
			               4322 2068 1039 167 127 119
			               4748 2305 1155 170 130 118
			               5186 2608 1304 168 131 118
			               5614 2934 1507 170 130 118
			               6250 3272 1684 174 127 119
			               6973 3727 1957 190 131 121
			               8053 4413 2381 223 135 121
			               9741 5567 3158 471 179 127
			              >;
			pc_temp_ocv_rows = <29>;
			pc_temp_ocv_cols = <6>;
			pc_temp_ocv_percent = <100 95 90 85 80 75 70 65 60 55 50 45 40 35 30 25 20 15 10 9 8 7 6 5 4 3 2 1>;
			pc_temp_ocv_ocv = <
			                   4379 4377 4373 4368 4361 4357
			                   4273 4288 4292 4305 4299 4296
			                   4204 4220 4231 4246 4241 4237
			                   4142 4161 4173 4189 4183 4180
			                   4091 4107 4119 4133 4128 4125
			                   4037 4060 4072 4080 4075 4073
			                   3950 3975 4010 4031 4027 4024
			                   3912 3930 3953 3983 3982 3981
			                   3869 3889 3909 3939 3939 3938
			                   3840 3851 3868 3886 3887 3886
			                   3821 3823 3835 3852 3852 3852
			                   3807 3807 3808 3826 3827 3826
			                   3793 3796 3794 3806 3807 3806
			                   3780 3786 3785 3790 3791 3789
			                   3767 3775 3776 3775 3774 3771
			                   3753 3763 3765 3759 3753 3742
			                   3737 3745 3747 3739 3732 3720
			                   3721 3720 3720 3712 3706 3696
			                   3697 3694 3689 3689 3683 3672
			                   3690 3690 3685 3688 3682 3670
			                   3683 3686 3682 3686 3680 3669
			                   3676 3681 3678 3683 3678 3667
			                   3666 3674 3673 3677 3674 3661
			                   3647 3659 3663 3657 3658 3645
			                   3619 3630 3635 3615 3622 3609
			                   3573 3582 3586 3557 3569 3559
			                   3509 3513 3514 3478 3498 3491
			                   3406 3409 3410 3360 3391 3391
			                   3200 3200 3200 3200 3200 3200
			                  >;
		};
