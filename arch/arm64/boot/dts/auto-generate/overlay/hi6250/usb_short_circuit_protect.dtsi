/ {
	usb_short_circuit_protect: usb_short_circuit_protect{
		compatible = "huawei,usb_short_circuit_protect";
		gpio_usb_short_circuit_protect = <&gpio7 3 0>;
		uscp_threshold_tusb = <40>;
		open_mosfet_temp = <20>;
		close_mosfet_temp = <10>;
		interval_switch_temp = <7>;
		dmd_hiz_enable = <1>;
		status = "disable";
	};
};
