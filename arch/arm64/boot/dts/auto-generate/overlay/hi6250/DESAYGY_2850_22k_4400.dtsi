/* DO NOT EDIT - Automatically generated by python */
		&DESAYGY_2850_22k_4400 {
			fcc = <2850>;
			default_rbatt_mohm = <100>;
			identify_type = "id_volt";
			id_identify_min = <751>;
			id_identify_max = <1235>;
			id_voltage_min = <939>;
			id_voltage_max = <1059>;
			vbat_max = <4400>;
			temp_para = 
						"-32767","0","-1","0","4100","0",
						"0","5","-1","285","4400","0",
						"5","10","-1","855","4400","3",
						"10","45","-1","-1","4400","3",
						"45","50","-1","997","4100","3",
						"50","32767","-1","0","4100","0";
			vbat_para = 
						"-32767","3400","-1","820","0",
						"3400","32767","-1","-1","0";
			segment_para = 
						"-32767","4150","2850","4208","50",
						"4150","4450","1995","4400","0";
			batt_brand = "DESAYGY";
			fcc_temp = <2840 2844 2841 2847 2842 2824>;
			fcc_sf_x = <0 100 200 300 400 500 600 700 800 1000 1500>;
			fcc_sf_y = <100 96 94 92 90 88 87 84 81 75 50>;
			fcc_sf_cols = <11>;
			pc_sf_rows = <1>;
			pc_sf_cols = <1>;
			pc_sf_row_entries = <0>;
			pc_sf_percent = <100>;
			pc_sf_sf = <100>;
			rbatt_sf_rows = <28>;
			rbatt_sf_cols = <6>;
			rbatt_sf_percent = <100 95 90 85 80 75 70 65 60 55 50 45 40 35 30 25 20 15 10 9 8 7 6 5 4 3 2 1>;
			rbatt_sf_sf = <
			               1819 731 439 132 108 98
			               1818 731 439 132 108 98
			               1783 734 439 133 109 98
			               1713 739 443 135 111 99
			               1733 731 448 138 112 100
			               1666 813 516 143 115 102
			               1490 689 468 149 119 105
			               1505 675 432 170 128 109
			               1488 675 416 165 141 116
			               1487 665 397 131 111 101
			               1508 668 389 128 108 99
			               1550 681 391 130 108 99
			               1610 708 400 135 112 102
			               1698 749 422 138 117 106
			               1812 803 456 137 116 101
			               1940 890 515 129 107 99
			               2097 982 585 130 107 100
			               2294 1101 689 134 110 101
			               2616 1241 798 138 112 102
			               2907 1092 629 138 113 106
			               3166 1149 640 137 112 107
			               3292 1236 693 139 113 105
			               3432 1332 769 136 110 105
			               3500 1413 841 139 109 103
			               3424 1473 899 139 110 103
			               3244 1577 970 152 112 102
			               3281 1797 1148 216 126 109
			               3699 2253 1497 611 228 164
			              >;
			pc_temp_ocv_rows = <29>;
			pc_temp_ocv_cols = <6>;
			pc_temp_ocv_percent = <100 95 90 85 80 75 70 65 60 55 50 45 40 35 30 25 20 15 10 9 8 7 6 5 4 3 2 1>;
			pc_temp_ocv_ocv = <
			                   4363 4361 4357 4351 4346 4339
			                   4275 4284 4286 4290 4285 4280
			                   4209 4224 4227 4233 4228 4223
			                   4147 4170 4171 4177 4172 4167
			                   4106 4117 4119 4124 4118 4114
			                   4047 4079 4082 4073 4067 4064
			                   3955 3987 4004 4019 4018 4016
			                   3917 3938 3950 3978 3977 3974
			                   3877 3901 3908 3929 3932 3929
			                   3845 3865 3870 3878 3878 3878
			                   3823 3835 3838 3848 3847 3847
			                   3808 3812 3813 3825 3824 3823
			                   3796 3797 3796 3806 3805 3803
			                   3783 3787 3787 3789 3789 3787
			                   3771 3777 3778 3773 3770 3763
			                   3756 3766 3768 3754 3747 3735
			                   3741 3747 3749 3736 3728 3715
			                   3725 3722 3722 3708 3702 3688
			                   3701 3705 3698 3688 3681 3670
			                   3694 3700 3694 3687 3679 3668
			                   3686 3696 3690 3684 3678 3666
			                   3675 3690 3684 3680 3674 3662
			                   3661 3680 3674 3667 3666 3652
			                   3641 3660 3653 3635 3639 3623
			                   3610 3624 3616 3589 3597 3582
			                   3564 3571 3563 3530 3544 3530
			                   3496 3500 3492 3453 3473 3461
			                   3397 3398 3395 3353 3374 3363
			                   3200 3200 3200 3200 3200 3200
			                  >;
			vol_dec1=  <50>;
			pc_temp_ocv_ocv1 = <
			                   4313 4311 4307 4301 4296 4289
			                   4240 4247 4246 4246 4240 4234
			                   4177 4193 4192 4192 4186 4181
			                   4127 4141 4140 4140 4134 4129
			                   4079 4098 4098 4090 4084 4079
			                   4008 4034 4041 4039 4037 4034
			                   3940 3965 3978 3995 3994 3991
			                   3902 3922 3931 3952 3953 3949
			                   3866 3887 3892 3904 3905 3903
			                   3838 3854 3857 3865 3864 3863
			                   3819 3827 3829 3838 3838 3836
			                   3805 3808 3808 3818 3817 3815
			                   3793 3795 3793 3800 3800 3797
			                   3781 3785 3784 3785 3784 3780
			                   3768 3775 3776 3768 3764 3756
			                   3754 3763 3765 3750 3743 3731
			                   3739 3744 3746 3731 3724 3711
			                   3723 3720 3719 3705 3699 3685
			                   3700 3703 3696 3688 3680 3668
			                   3693 3699 3693 3686 3679 3667
			                   3684 3694 3689 3683 3677 3665
			                   3672 3688 3682 3677 3672 3660
			                   3658 3677 3671 3661 3661 3645
			                   3638 3655 3648 3626 3631 3615
			                   3606 3618 3609 3580 3589 3574
			                   3559 3566 3556 3521 3536 3522
			                   3491 3494 3487 3445 3465 3454
			                   3394 3393 3391 3347 3368 3358
			                   3200 3200 3200 3200 3200 3200
			                  >;
			vol_dec2=  <200>;
			pc_temp_ocv_ocv2 = <
			                   4163 4161 4157 4151 4146 4139
			                   4140 4133 4130 4117 4110 4103
			                   4103 4105 4100 4075 4068 4061
			                   4051 4060 4053 4029 4027 4022
			                   3971 3983 3991 3993 3991 3986
			                   3928 3940 3946 3955 3955 3950
			                   3893 3908 3910 3913 3915 3910
			                   3861 3876 3877 3874 3874 3871
			                   3837 3848 3848 3849 3848 3846
			                   3819 3825 3825 3829 3828 3826
			                   3807 3808 3807 3813 3811 3809
			                   3795 3796 3794 3798 3797 3794
			                   3784 3787 3786 3784 3783 3779
			                   3774 3778 3778 3770 3767 3758
			                   3761 3769 3770 3754 3747 3735
			                   3747 3754 3755 3739 3731 3718
			                   3733 3734 3733 3717 3711 3697
			                   3717 3715 3711 3698 3691 3678
			                   3693 3699 3692 3685 3678 3666
			                   3686 3695 3689 3682 3676 3664
			                   3676 3690 3684 3677 3672 3659
			                   3664 3681 3674 3664 3663 3647
			                   3648 3665 3657 3635 3639 3623
			                   3625 3637 3629 3597 3605 3589
			                   3592 3598 3588 3550 3563 3548
			                   3544 3545 3536 3493 3511 3497
			                   3477 3475 3468 3420 3443 3431
			                   3384 3379 3375 3329 3352 3341
			                   3200 3200 3200 3200 3200 3200
			                  >;
		};
