/*
 * Hisilicon Ltd. Hi3660 SoC
 *
 * Copyright (C) 2012-2013 Hisilicon Ltd.
 *
 * This program is free software; you can redistribute it and/or modify
 * it under the terms of the GNU General Public License version 2 as
 * publishhed by the Free Software Foundation.
 */

  /{
    jtagtosd:jtagtosd {
        compatible = "hisilicon,jtagtosd";
        sdio-ldo = <&ldo9>;
        reg = <0x0 0xFFF0A854 0x0 0x1000>;
        value = <0x90000001>;
        mask = <0x9E0000FF>;
        sdcard_io_sel_reg = <0x0 0xFFF0A31c 0x0 0x1000>;
        sdcard_io_sel_value = <0x00400040>;
        sdcard_io_sel_mask = <0x00000000>;
        sel0_pd_gpio = <0xAB>;
        testmode_pd_gpio = <0x1>;
    };

    djtagtosd{
        compatible = "hisilicon,djtagtosd";
        reg = <0x0 0xFFF0A854 0x0 0x1000>;
        value = <0x90000002>;
        mask = <0x9E0000FF>;
        sdcard_io_sel_reg = <0x0 0xFFF0A31c 0x0 0x1000>;
        sdcard_io_sel_value = <0x00400040>;
        sdcard_io_sel_mask = <0x00000000>;
        sel0_pd_gpio = <0xAB>;
        testmode_pd_gpio = <0x1>;
    };

    uart6tosd{
        compatible = "hisilicon,uart6tosd";
        reg = <0x0 0xFFF0A854 0x0 0x1000>;
        value = <0x90000032>;
        mask = <0x9E0000FF>;
        sdcard_io_sel_reg = <0x0 0xFFF0A31c 0x0 0x1000>;
        sdcard_io_sel_value = <0x00400040>;
        sdcard_io_sel_mask = <0x00000000>;
        sel0_pd_gpio = <0xAB>;
        testmode_pd_gpio = <0x1>;
    };
  };
