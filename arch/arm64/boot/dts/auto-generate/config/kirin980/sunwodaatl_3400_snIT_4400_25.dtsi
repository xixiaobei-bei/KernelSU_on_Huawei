/* DO NOT EDIT - Automatically generated by python */
/ {
		sunwodaatl_3400_snIT_4400_25:sunwodaatl_3400_snIT_4400_25 {
			fcc = <3400>;
			default_rbatt_mohm = <100>;
			identify_type = "id_sn";
			id_sn = "IT";
			vbat_max = <4400>;
			temp_para = 
						"-32767","0","-1","0","4100","0",
						"0","5","-1","340","4400","0",
						"5","10","-1","1020","4400","3",
						"10","45","-1","-1","4400","3",
						"45","50","-1","1190","4100","3",
						"50","32767","-1","0","4100","0";
			vbat_para = 
						"-32767","3400","-1","820","0",
						"3400","32767","-1","-1","0";
			segment_para = 
						"-32767","4150","3400","4208","50",
						"4150","4450","2380","4400","0";
			batt_brand = "sunwodaatl";
			fcc_temp = <3420 3387 3387 3369 3363 3328>;
			fcc_sf_x = <0 100 200 300 400 500 600 700 800 1000 1500>;
			fcc_sf_y = <100 96 94 92 90 88 87 84 81 75 50>;
			fcc_sf_cols = <11>;
			pc_sf_rows = <1>;
			pc_sf_cols = <1>;
			pc_sf_row_entries = <0>;
			pc_sf_percent = <100>;
			pc_sf_sf = <100>;
			rbatt_sf_rows = <28>;
			rbatt_sf_cols = <6>;
			rbatt_sf_percent = <100 95 90 85 80 75 70 65 60 55 50 45 40 35 30 25 20 15 10 9 8 7 6 5 4 3 2 1>;
			rbatt_sf_sf = <
			               1473 1040 436 86 58 47
			               1459 1033 430 86 59 47
			               1417 1008 416 85 60 49
			               1381 977 409 86 61 50
			               1352 966 406 89 62 51
			               1340 965 423 93 65 53
			               1230 920 442 99 69 54
			               1190 864 407 112 75 59
			               1195 850 383 115 78 60
			               1182 836 364 96 66 50
			               1194 838 355 85 60 50
			               1253 871 356 86 62 52
			               1321 936 365 89 64 52
			               1404 1010 396 94 68 55
			               1503 1098 439 97 68 56
			               1618 1203 488 88 61 50
			               1750 1321 548 85 60 51
			               1906 1450 637 88 60 51
			               2462 1423 545 102 76 57
			               2693 1566 578 104 76 69
			               2969 1723 619 105 79 66
			               3204 1924 680 107 77 65
			               3536 2128 767 107 79 66
			               3877 2294 807 111 84 75
			               4267 2490 851 122 96 87
			               4773 2805 966 135 115 91
			               5618 3266 1124 143 130 99
			               6554 3412 1424 165 158 126
			              >;
			pc_temp_ocv_rows = <29>;
			pc_temp_ocv_cols = <6>;
			pc_temp_ocv_percent = <100 95 90 85 80 75 70 65 60 55 50 45 40 35 30 25 20 15 10 9 8 7 6 5 4 3 2 1>;
			pc_temp_ocv_ocv = <
			                   4377 4371 4371 4367 4364 4358
			                   4292 4297 4305 4309 4307 4301
			                   4225 4234 4244 4251 4251 4245
			                   4166 4175 4188 4195 4195 4190
			                   4112 4122 4134 4140 4140 4136
			                   4061 4073 4085 4089 4088 4084
			                   3982 4011 4033 4039 4039 4036
			                   3929 3951 3972 3993 3994 3992
			                   3893 3908 3926 3947 3948 3947
			                   3855 3866 3883 3897 3897 3895
			                   3825 3833 3848 3861 3862 3862
			                   3810 3812 3821 3835 3837 3836
			                   3798 3800 3801 3815 3815 3814
			                   3786 3790 3790 3798 3798 3796
			                   3774 3780 3781 3782 3779 3775
			                   3757 3768 3769 3762 3753 3742
			                   3738 3748 3749 3740 3730 3719
			                   3718 3721 3720 3715 3705 3693
			                   3697 3693 3692 3691 3683 3672
			                   3689 3688 3689 3690 3682 3670
			                   3681 3682 3685 3688 3680 3668
			                   3672 3678 3681 3685 3676 3664
			                   3657 3670 3673 3678 3666 3652
			                   3633 3652 3653 3655 3641 3625
			                   3595 3617 3614 3616 3599 3584
			                   3539 3563 3559 3563 3547 3532
			                   3470 3490 3484 3493 3478 3462
			                   3369 3387 3380 3387 3375 3363
			                   3200 3200 3200 3200 3200 3200
			                  >;
		};
};
