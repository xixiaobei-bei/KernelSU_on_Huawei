/* DO NOT EDIT - Automatically generated by python */
/ {
		desayatl_4900_39k_4400_24:desayatl_4900_39k_4400_24 {
			fcc = <4900>;
			default_rbatt_mohm = <100>;
			identify_type = "id_volt";
			id_identify_min = <1235>;
			id_identify_max = <1759>;
			id_voltage_min = <1420>;
			id_voltage_max = <1562>;
			vbat_max = <4400>;
			temp_para = 
						"-32767","0","-1","0","4100","0",
						"0","5","-1","490","4400","0",
						"5","10","-1","1470","4400","3",
						"10","45","-1","-1","4400","3",
						"45","50","-1","1715","4100","3",
						"50","32767","-1","0","4100","0";
			vbat_para = 
						"-32767","3400","-1","820","0",
						"3400","32767","-1","-1","0";
			segment_para = 
						"-32767","4150","4900","4208","50",
						"4150","4450","3430","4400","0";
			batt_brand = "desayatl";
			fcc_temp = <4903 4896 4905 4900 4880 4836>;
			fcc_sf_x = <0 100 200 300 400 500 600 700 800 1000 1500>;
			fcc_sf_y = <100 96 94 92 90 88 87 84 81 75 50>;
			fcc_sf_cols = <11>;
			pc_sf_rows = <1>;
			pc_sf_cols = <1>;
			pc_sf_row_entries = <0>;
			pc_sf_percent = <100>;
			pc_sf_sf = <100>;
			rbatt_sf_rows = <28>;
			rbatt_sf_cols = <6>;
			rbatt_sf_percent = <100 95 90 85 80 75 70 65 60 55 50 45 40 35 30 25 20 15 10 9 8 7 6 5 4 3 2 1>;
			rbatt_sf_sf = <
			               1476 1080 327 102 83 76
			               1447 1061 324 102 83 76
			               1329 989 318 102 84 77
			               1253 933 314 103 84 78
			               1222 902 316 104 86 78
			               1154 864 329 108 88 80
			               1095 799 329 113 90 81
			               1091 781 307 119 94 84
			               1067 755 296 121 96 85
			               1096 741 278 107 89 80
			               1139 767 275 99 83 77
			               1171 799 277 99 84 78
			               1206 839 288 102 86 79
			               1245 884 313 104 89 81
			               1308 928 343 105 88 82
			               1374 993 379 103 84 78
			               1490 1059 423 103 84 78
			               1648 1139 482 105 84 78
			               2422 1274 442 103 86 80
			               2610 1379 468 105 86 81
			               2826 1504 515 105 87 82
			               3013 1645 568 107 88 82
			               3203 1801 638 108 88 81
			               3469 1979 684 107 87 80
			               3751 2151 710 108 86 80
			               4191 2392 823 109 87 81
			               4937 2754 982 115 89 83
			               6038 3322 1267 123 93 86
			              >;
			pc_temp_ocv_rows = <29>;
			pc_temp_ocv_cols = <6>;
			pc_temp_ocv_percent = <100 95 90 85 80 75 70 65 60 55 50 45 40 35 30 25 20 15 10 9 8 7 6 5 4 3 2 1>;
			pc_temp_ocv_ocv = <
			                   4365 4362 4360 4353 4349 4342
			                   4267 4273 4288 4292 4288 4282
			                   4196 4205 4227 4235 4232 4226
			                   4136 4146 4171 4179 4176 4171
			                   4090 4097 4120 4125 4122 4118
			                   4023 4044 4071 4074 4072 4068
			                   3954 3976 4015 4026 4024 4022
			                   3910 3931 3959 3980 3980 3979
			                   3868 3885 3915 3937 3938 3936
			                   3842 3845 3872 3888 3890 3887
			                   3823 3824 3840 3852 3854 3853
			                   3808 3809 3815 3827 3829 3828
			                   3794 3798 3797 3808 3809 3808
			                   3781 3787 3787 3791 3793 3791
			                   3767 3777 3778 3776 3775 3771
			                   3750 3764 3766 3760 3753 3741
			                   3732 3744 3746 3740 3731 3718
			                   3714 3717 3718 3713 3706 3694
			                   3691 3688 3690 3689 3683 3670
			                   3684 3684 3686 3688 3681 3669
			                   3677 3679 3682 3686 3680 3668
			                   3669 3673 3676 3684 3677 3665
			                   3654 3664 3666 3678 3671 3658
			                   3634 3645 3647 3662 3653 3636
			                   3599 3610 3609 3623 3616 3597
			                   3548 3558 3556 3569 3564 3545
			                   3481 3488 3484 3498 3495 3477
			                   3382 3386 3378 3393 3396 3379
			                   3200 3200 3200 3200 3200 3200
			                  >;
		};
};
