/* DO NOT EDIT - Automatically generated by python */
/ {
		sunwodaatl_3400_snIA_4400_25:sunwodaatl_3400_snIA_4400_25 {
			fcc = <3400>;
			default_rbatt_mohm = <100>;
			identify_type = "id_sn";
			id_sn = "IA";
			vbat_max = <4400>;
			temp_para = 
						"-32767","0","-1","0","4100","0",
						"0","5","-1","340","4400","0",
						"5","10","-1","1020","4400","3",
						"10","45","-1","-1","4400","3",
						"45","50","-1","1190","4100","3",
						"50","32767","-1","0","4100","0";
			vbat_para = 
						"-32767","3400","-1","820","0",
						"3400","32767","-1","-1","0";
			segment_para = 
						"-32767","4150","3400","4208","50",
						"4150","4450","2380","4400","0";
			batt_brand = "sunwodaatl";
			fcc_temp = <3415 3411 3400 3388 3376 3340>;
			fcc_sf_x = <0 100 200 300 400 500 600 700 800 1000 1500>;
			fcc_sf_y = <100 96 94 92 90 88 87 84 81 75 50>;
			fcc_sf_cols = <11>;
			pc_sf_rows = <1>;
			pc_sf_cols = <1>;
			pc_sf_row_entries = <0>;
			pc_sf_percent = <100>;
			pc_sf_sf = <100>;
			rbatt_sf_rows = <28>;
			rbatt_sf_cols = <6>;
			rbatt_sf_percent = <100 95 90 85 80 75 70 65 60 55 50 45 40 35 30 25 20 15 10 9 8 7 6 5 4 3 2 1>;
			rbatt_sf_sf = <
			               1908 1130 445 81 57 46
			               1866 1122 445 81 57 46
			               1722 1088 437 81 57 48
			               1620 1043 423 82 59 49
			               1550 1022 422 84 60 50
			               1491 1014 444 89 63 52
			               1383 958 456 98 68 54
			               1356 903 411 113 75 59
			               1339 892 388 112 78 61
			               1330 874 367 89 66 51
			               1354 875 362 79 58 49
			               1395 909 367 81 59 51
			               1442 970 380 84 62 52
			               1507 1037 414 90 66 54
			               1575 1116 460 90 66 55
			               1648 1214 517 83 59 50
			               1740 1325 589 79 57 51
			               1882 1439 691 81 57 51
			               2814 1370 581 100 72 64
			               3148 1526 611 101 74 66
			               3432 1680 667 102 73 66
			               3768 1863 732 104 75 66
			               4187 2075 809 106 76 68
			               4588 2266 923 117 82 75
			               4982 2489 981 131 94 86
			               5517 2846 1110 148 109 98
			               6215 3392 1344 184 125 112
			               7453 3931 1723 424 167 147
			              >;
			pc_temp_ocv_rows = <29>;
			pc_temp_ocv_cols = <6>;
			pc_temp_ocv_percent = <100 95 90 85 80 75 70 65 60 55 50 45 40 35 30 25 20 15 10 9 8 7 6 5 4 3 2 1>;
			pc_temp_ocv_ocv = <
			                   4375 4374 4368 4366 4361 4354
			                   4285 4297 4302 4312 4306 4298
			                   4218 4233 4242 4255 4249 4242
			                   4161 4173 4184 4198 4193 4186
			                   4110 4120 4132 4143 4138 4132
			                   4055 4071 4082 4092 4087 4081
			                   3978 4006 4028 4043 4038 4033
			                   3928 3948 3969 3995 3993 3989
			                   3888 3907 3923 3946 3946 3944
			                   3852 3865 3880 3896 3896 3893
			                   3827 3832 3846 3862 3860 3859
			                   3811 3811 3820 3836 3835 3834
			                   3798 3800 3800 3816 3815 3813
			                   3787 3790 3788 3798 3798 3795
			                   3773 3780 3780 3781 3779 3773
			                   3755 3768 3769 3761 3754 3742
			                   3734 3749 3750 3737 3731 3719
			                   3715 3722 3721 3711 3705 3693
			                   3695 3693 3692 3691 3683 3672
			                   3691 3690 3689 3690 3682 3670
			                   3684 3685 3686 3687 3681 3668
			                   3677 3680 3682 3683 3677 3665
			                   3667 3674 3673 3673 3669 3653
			                   3647 3657 3656 3645 3644 3626
			                   3612 3621 3618 3600 3603 3585
			                   3561 3566 3563 3543 3550 3532
			                   3490 3492 3488 3466 3479 3462
			                   3386 3383 3381 3355 3375 3360
			                   3200 3200 3200 3200 3200 3200
			                  >;
		};
};
