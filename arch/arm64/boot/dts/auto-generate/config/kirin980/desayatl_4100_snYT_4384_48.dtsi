/* DO NOT EDIT - Automatically generated by python */
/ {
		desayatl_4100_snYT_4384_48:desayatl_4100_snYT_4384_48 {
			fcc = <4100>;
			default_rbatt_mohm = <100>;
			identify_type = "id_sn";
			id_sn = "YT";
			vbat_max = <4384>;
			temp_para = 
						"-32767","0","-1","0","4100","0",
						"0","5","-1","410","4384","0",
						"5","10","-1","1230","4384","3",
						"10","45","-1","-1","4384","3",
						"45","50","-1","1435","4100","3",
						"50","32767","-1","0","4100","0";
			vbat_para = 
						"-32767","3400","-1","820","0",
						"3400","32767","-1","-1","0";
			segment_para = 
						"-32767","4150","4100","4208","50",
						"4150","4450","2870","4384","0";
			batt_brand = "desayatl";
			fcc_temp = <4091 4037 4036 4009 4000 3963>;
			fcc_sf_x = <0 100 200 300 400 500 600 700 800 1000 1500>;
			fcc_sf_y = <100 96 94 92 90 88 87 84 81 75 50>;
			fcc_sf_cols = <11>;
			pc_sf_rows = <1>;
			pc_sf_cols = <1>;
			pc_sf_row_entries = <0>;
			pc_sf_percent = <100>;
			pc_sf_sf = <100>;
			rbatt_sf_rows = <28>;
			rbatt_sf_cols = <6>;
			rbatt_sf_percent = <100 95 90 85 80 75 70 65 60 55 50 45 40 35 30 25 20 15 10 9 8 7 6 5 4 3 2 1>;
			rbatt_sf_sf = <
			               1251 856 372 93 74 68
			               1231 850 370 92 75 68
			               1196 840 363 92 75 69
			               1151 830 359 93 76 71
			               1141 838 363 96 78 71
			               1126 828 393 100 81 72
			               1052 795 399 105 83 74
			               1012 790 381 118 90 79
			               1006 813 365 114 88 76
			               995 776 355 99 79 71
			               1010 717 349 92 76 71
			               1049 737 347 93 77 71
			               1097 776 356 96 78 73
			               1158 834 384 100 82 75
			               1234 907 420 100 81 76
			               1326 997 446 95 76 72
			               1435 1109 491 92 76 72
			               1556 1233 574 94 76 72
			               1930 1138 441 106 89 81
			               2096 1241 455 106 89 88
			               2302 1368 483 107 92 88
			               2500 1495 509 110 94 87
			               2785 1637 565 112 90 85
			               3048 1767 586 114 93 89
			               3363 1972 619 121 106 98
			               3800 2222 668 130 119 101
			               4310 2604 758 135 132 105
			               4874 2576 943 153 154 127
			              >;
			pc_temp_ocv_rows = <29>;
			pc_temp_ocv_cols = <6>;
			pc_temp_ocv_percent = <100 95 90 85 80 75 70 65 60 55 50 45 40 35 30 25 20 15 10 9 8 7 6 5 4 3 2 1>;
			pc_temp_ocv_ocv = <
			                   4354 4346 4348 4345 4341 4336
			                   4279 4279 4288 4288 4287 4281
			                   4216 4219 4230 4232 4231 4226
			                   4154 4163 4175 4177 4176 4172
			                   4105 4114 4123 4124 4123 4119
			                   4055 4063 4075 4075 4074 4070
			                   3984 4000 4017 4025 4025 4024
			                   3927 3944 3962 3982 3983 3981
			                   3890 3903 3918 3935 3934 3932
			                   3852 3863 3878 3888 3888 3887
			                   3825 3831 3845 3855 3856 3856
			                   3809 3811 3820 3831 3832 3831
			                   3796 3799 3801 3812 3812 3811
			                   3784 3789 3788 3796 3795 3793
			                   3771 3779 3779 3779 3775 3770
			                   3755 3766 3767 3760 3751 3740
			                   3737 3746 3748 3738 3729 3717
			                   3718 3722 3720 3713 3704 3692
			                   3694 3693 3693 3691 3683 3671
			                   3687 3688 3691 3690 3681 3670
			                   3681 3685 3687 3688 3680 3668
			                   3672 3677 3683 3685 3676 3663
			                   3658 3669 3676 3677 3665 3651
			                   3634 3650 3656 3654 3638 3623
			                   3597 3616 3616 3615 3597 3582
			                   3543 3561 3561 3563 3544 3530
			                   3474 3487 3488 3493 3474 3460
			                   3377 3386 3385 3391 3372 3360
			                   3200 3200 3200 3200 3200 3200
			                  >;
		};
};
