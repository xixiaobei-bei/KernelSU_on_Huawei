/* DO NOT EDIT - Automatically generated by python */
/ {
		desayatl_4100_snYA_4400_48:desayatl_4100_snYA_4400_48 {
			fcc = <4100>;
			default_rbatt_mohm = <100>;
			identify_type = "id_sn";
			id_sn = "YA";
			vbat_max = <4400>;
			temp_para = 
						"-32767","0","-1","0","4100","0",
						"0","5","-1","410","4400","0",
						"5","10","-1","1230","4400","3",
						"10","45","-1","-1","4400","3",
						"45","50","-1","1435","4100","3",
						"50","32767","-1","0","4100","0";
			vbat_para = 
						"-32767","3400","-1","820","0",
						"3400","32767","-1","-1","0";
			segment_para = 
						"-32767","4150","4100","4208","50",
						"4150","4450","2870","4400","0";
			batt_brand = "desayatl";
			fcc_temp = <4051 4034 4013 3984 3976 3949>;
			fcc_sf_x = <0 100 200 300 400 500 600 700 800 1000 1500>;
			fcc_sf_y = <100 96 94 92 90 88 87 84 81 75 50>;
			fcc_sf_cols = <11>;
			pc_sf_rows = <1>;
			pc_sf_cols = <1>;
			pc_sf_row_entries = <0>;
			pc_sf_percent = <100>;
			pc_sf_sf = <100>;
			rbatt_sf_rows = <28>;
			rbatt_sf_cols = <6>;
			rbatt_sf_percent = <100 95 90 85 80 75 70 65 60 55 50 45 40 35 30 25 20 15 10 9 8 7 6 5 4 3 2 1>;
			rbatt_sf_sf = <
			               1624 1081 463 86 64 56
			               1556 1056 462 86 65 57
			               1443 1007 448 86 65 58
			               1357 959 438 87 66 58
			               1312 935 437 89 68 59
			               1250 911 467 93 71 60
			               1176 846 453 99 73 62
			               1157 804 418 112 82 67
			               1138 798 396 104 78 64
			               1136 783 379 88 68 59
			               1164 786 376 83 66 59
			               1196 814 385 84 66 59
			               1233 858 408 87 68 60
			               1284 904 445 91 72 63
			               1334 961 491 90 72 63
			               1396 1036 547 84 66 60
			               1476 1113 616 83 66 61
			               1595 1202 720 86 66 61
			               2581 1257 620 97 77 67
			               2860 1397 680 97 78 75
			               3091 1537 743 100 79 75
			               3388 1715 808 102 81 73
			               3719 1926 915 102 79 71
			               4065 2084 1031 100 82 75
			               4432 2276 1124 112 91 86
			               4808 2571 1297 126 104 94
			               5464 2999 1583 144 112 99
			               6693 3533 2015 189 129 124
			              >;
			pc_temp_ocv_rows = <29>;
			pc_temp_ocv_cols = <6>;
			pc_temp_ocv_percent = <100 95 90 85 80 75 70 65 60 55 50 45 40 35 30 25 20 15 10 9 8 7 6 5 4 3 2 1>;
			pc_temp_ocv_ocv = <
			                   4353 4352 4347 4345 4341 4335
			                   4275 4283 4286 4290 4287 4282
			                   4210 4220 4226 4234 4231 4227
			                   4151 4162 4170 4179 4177 4172
			                   4102 4111 4118 4126 4123 4120
			                   4040 4058 4072 4077 4074 4070
			                   3968 3991 4015 4027 4026 4024
			                   3921 3936 3959 3983 3984 3981
			                   3879 3898 3913 3933 3933 3931
			                   3846 3858 3871 3887 3887 3886
			                   3827 3829 3839 3855 3855 3855
			                   3810 3811 3814 3831 3831 3830
			                   3797 3800 3798 3811 3811 3810
			                   3785 3789 3788 3795 3795 3791
			                   3769 3777 3779 3779 3775 3769
			                   3752 3765 3767 3759 3751 3739
			                   3733 3745 3747 3737 3729 3717
			                   3714 3719 3718 3712 3704 3691
			                   3698 3694 3690 3690 3683 3671
			                   3690 3689 3688 3689 3682 3670
			                   3680 3684 3685 3688 3680 3668
			                   3673 3680 3680 3684 3677 3664
			                   3661 3673 3671 3676 3669 3652
			                   3637 3654 3651 3654 3644 3625
			                   3607 3618 3612 3613 3603 3584
			                   3553 3563 3557 3559 3551 3532
			                   3484 3490 3484 3489 3482 3463
			                   3382 3382 3375 3387 3382 3363
			                   3200 3200 3200 3200 3200 3200
			                  >;
		};
};
