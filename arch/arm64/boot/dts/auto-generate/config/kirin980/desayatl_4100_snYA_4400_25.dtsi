/* DO NOT EDIT - Automatically generated by python */
/ {
		desayatl_4100_snYA_4400_25:desayatl_4100_snYA_4400_25 {
			fcc = <4100>;
			default_rbatt_mohm = <100>;
			identify_type = "id_sn";
			id_sn = "YA";
			vbat_max = <4400>;
			temp_para = 
						"-32767","0","-1","0","4100","0",
						"0","5","-1","410","4400","0",
						"5","10","-1","1230","4400","3",
						"10","45","-1","-1","4400","3",
						"45","50","-1","1435","4100","3",
						"50","32767","-1","0","4100","0";
			vbat_para = 
						"-32767","3400","-1","820","0",
						"3400","32767","-1","-1","0";
			segment_para = 
						"-32767","4150","4100","4208","50",
						"4150","4450","2870","4400","0";
			batt_brand = "desayatl";
			fcc_temp = <4103 4096 4086 4073 4065 4036>;
			fcc_sf_x = <0 100 200 300 400 500 600 700 800 1000 1500>;
			fcc_sf_y = <100 96 94 92 90 88 87 84 81 75 50>;
			fcc_sf_cols = <11>;
			pc_sf_rows = <1>;
			pc_sf_cols = <1>;
			pc_sf_row_entries = <0>;
			pc_sf_percent = <100>;
			pc_sf_sf = <100>;
			rbatt_sf_rows = <28>;
			rbatt_sf_cols = <6>;
			rbatt_sf_percent = <100 95 90 85 80 75 70 65 60 55 50 45 40 35 30 25 20 15 10 9 8 7 6 5 4 3 2 1>;
			rbatt_sf_sf = <
			               1624 1081 463 86 64 56
			               1588 1068 463 86 65 56
			               1466 1022 455 86 65 57
			               1373 970 440 87 66 58
			               1315 937 436 88 67 59
			               1274 919 455 91 70 60
			               1179 866 466 97 73 62
			               1161 803 423 108 78 65
			               1141 802 401 110 81 67
			               1133 784 381 91 70 59
			               1159 783 375 83 65 59
			               1192 808 383 84 66 59
			               1227 852 403 86 68 60
			               1280 899 439 90 71 62
			               1330 954 485 91 73 64
			               1392 1030 541 85 66 60
			               1471 1108 610 83 66 61
			               1589 1197 712 86 66 61
			               2543 1235 611 98 76 64
			               2835 1379 668 97 78 75
			               3061 1518 736 100 79 75
			               3359 1689 797 101 81 73
			               3692 1911 900 102 79 71
			               4040 2071 1024 99 81 74
			               4415 2260 1114 111 90 85
			               4786 2554 1283 124 103 94
			               5434 2982 1570 143 112 98
			               6669 3526 2004 185 129 122
			              >;
			pc_temp_ocv_rows = <29>;
			pc_temp_ocv_cols = <6>;
			pc_temp_ocv_percent = <100 95 90 85 80 75 70 65 60 55 50 45 40 35 30 25 20 15 10 9 8 7 6 5 4 3 2 1>;
			pc_temp_ocv_ocv = <
			                   4376 4375 4370 4368 4364 4358
			                   4292 4302 4307 4314 4310 4304
			                   4224 4237 4246 4257 4254 4249
			                   4163 4177 4187 4200 4197 4193
			                   4110 4123 4133 4145 4142 4138
			                   4057 4072 4084 4093 4090 4086
			                   3977 4007 4031 4043 4041 4037
			                   3928 3942 3971 3995 3995 3993
			                   3885 3906 3923 3948 3949 3947
			                   3849 3865 3879 3897 3896 3894
			                   3829 3832 3844 3861 3861 3861
			                   3812 3813 3818 3835 3835 3834
			                   3798 3801 3800 3814 3814 3813
			                   3787 3790 3789 3797 3797 3794
			                   3771 3778 3780 3781 3779 3774
			                   3753 3767 3769 3762 3753 3742
			                   3734 3746 3749 3740 3731 3719
			                   3715 3720 3720 3714 3706 3693
			                   3699 3694 3690 3691 3683 3672
			                   3692 3690 3688 3689 3682 3670
			                   3680 3685 3685 3688 3680 3668
			                   3674 3680 3680 3685 3678 3665
			                   3662 3674 3672 3679 3671 3655
			                   3639 3657 3654 3658 3647 3629
			                   3609 3621 3616 3617 3607 3588
			                   3556 3566 3560 3564 3555 3537
			                   3486 3493 3487 3493 3485 3467
			                   3384 3384 3377 3391 3384 3367
			                   3200 3200 3200 3200 3200 3200
			                  >;
		};
};
