/* DO NOT EDIT - Automatically generated by python */
/ {
		sunwodamurata_3550_110k_4434_64:sunwodamurata_3550_110k_4434_64 {
			fcc = <3550>;
			default_rbatt_mohm = <100>;
			identify_type = "id_volt";
			id_identify_min = <2281>;
			id_identify_max = <2786>;
			id_voltage_min = <2426>;
			id_voltage_max = <2631>;
			vbat_max = <4434>;
			temp_para = 
						"-32767","0","-1","0","4100","0",
						"0","5","-1","355","4434","0",
						"5","10","-1","1065","4434","3",
						"10","45","-1","-1","4434","3",
						"45","50","-1","1242","4100","3",
						"50","32767","-1","0","4100","0";
			vbat_para = 
						"-32767","3400","-1","820","0",
						"3400","32767","-1","-1","0";
			segment_para = 
						"-32767","4150","3550","4208","50",
						"4150","4450","2485","4434","0";
			batt_brand = "sunwodamurata";
			fcc_temp = <3518 3515 3529 3555 3541 3512>;
			fcc_sf_x = <0 100 200 300 400 500 600 700 800 1000 1500>;
			fcc_sf_y = <100 96 94 92 90 88 87 84 81 75 50>;
			fcc_sf_cols = <11>;
			pc_sf_rows = <1>;
			pc_sf_cols = <1>;
			pc_sf_row_entries = <0>;
			pc_sf_percent = <100>;
			pc_sf_sf = <100>;
			rbatt_sf_rows = <28>;
			rbatt_sf_cols = <6>;
			rbatt_sf_percent = <100 95 90 85 80 75 70 65 60 55 50 45 40 35 30 25 20 15 10 9 8 7 6 5 4 3 2 1>;
			rbatt_sf_sf = <
			               1708 917 469 152 113 100
			               1705 923 478 154 115 101
			               1687 917 481 157 117 102
			               1663 908 482 162 119 104
			               1645 902 481 169 122 105
			               1622 894 479 178 127 107
			               1593 878 456 190 135 111
			               1591 869 447 194 147 120
			               1590 868 439 177 141 120
			               1589 867 436 160 119 105
			               1600 870 437 155 115 102
			               1631 880 439 157 116 103
			               1683 902 444 160 118 104
			               1749 934 452 166 124 110
			               1835 977 467 169 123 104
			               1952 1034 486 162 117 103
			               2114 1115 508 163 121 109
			               2344 1272 546 165 122 108
			               3784 1510 561 175 128 117
			               4023 1602 574 176 130 120
			               4338 1723 601 182 133 120
			               4782 1874 645 186 134 119
			               5375 2081 701 190 135 119
			               6211 2404 772 196 137 121
			               7498 2906 855 211 146 129
			               10069 3701 1048 231 160 138
			               15618 5470 1344 264 180 152
			               29676 8222 2160 317 236 197
			              >;
			pc_temp_ocv_rows = <29>;
			pc_temp_ocv_cols = <6>;
			pc_temp_ocv_percent = <100 95 90 85 80 75 70 65 60 55 50 45 40 35 30 25 20 15 10 9 8 7 6 5 4 3 2 1>;
			pc_temp_ocv_ocv = <
			                   4359 4355 4360 4354 4349 4341
			                   4285 4291 4300 4295 4290 4283
			                   4219 4229 4240 4236 4231 4224
			                   4157 4168 4180 4178 4173 4167
			                   4096 4109 4122 4122 4118 4112
			                   4037 4051 4066 4069 4065 4061
			                   3978 3995 4006 4019 4017 4013
			                   3929 3946 3956 3971 3973 3970
			                   3885 3902 3913 3921 3924 3923
			                   3845 3864 3876 3879 3879 3877
			                   3812 3832 3845 3847 3847 3845
			                   3788 3805 3818 3823 3823 3821
			                   3769 3785 3797 3803 3804 3801
			                   3751 3768 3779 3787 3788 3785
			                   3734 3751 3765 3772 3768 3758
			                   3717 3733 3749 3752 3745 3733
			                   3698 3710 3728 3733 3726 3712
			                   3671 3684 3696 3704 3698 3684
			                   3641 3659 3672 3676 3670 3658
			                   3632 3650 3666 3672 3666 3654
			                   3619 3641 3659 3666 3661 3649
			                   3604 3629 3650 3658 3653 3641
			                   3588 3617 3638 3643 3639 3626
			                   3567 3597 3619 3612 3610 3596
			                   3535 3572 3585 3568 3566 3553
			                   3489 3522 3526 3510 3511 3498
			                   3428 3449 3447 3435 3438 3428
			                   3336 3346 3338 3333 3346 3341
			                   3200 3200 3200 3200 3200 3200
			                  >;
		};
};
