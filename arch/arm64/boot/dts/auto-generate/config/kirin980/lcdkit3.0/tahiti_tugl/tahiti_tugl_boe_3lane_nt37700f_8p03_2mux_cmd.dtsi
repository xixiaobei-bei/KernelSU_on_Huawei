/* Copyright (c) 2013, The Linux Foundation. All rights reserved.
 *
 * This program is free software; you can redistribute it and/or modify
 * it under the terms of the GNU General Public License version 2 and
 * only version 2 as published by the Free Software Foundation.
 *
 * This program is distributed in the hope that it will be useful,
 * but WITHOUT ANY WARRANTY; without even the implied warranty of
 * MERCHANTABILITY or FITNESS FOR A PARTICULAR PURPOSE.  See the
 * GNU General Public License for more details.
 */

/*-------------------------------------------------------------------------
 * This file is autogenerated file using gcdb parser. Please do not edit it.
 * Update input XML file to add a new entry or update variable in this file
 * VERSION = 1.1
 *-----------------------------------------------------------------------*/
&huawei_lcd_config {
	dsi_tahiti_tugl_boe_3lane_nt37700f_8p03_2mux_cmd: lcd_kit_tahiti_tugl_boe_3lane_nt37700f_8p03_2mux_cmd {
		compatible = "boe_3lane_nt37700f_8p03_2mux_cmd";
		lcd-kit,panel-name = "BOE_3LANE_NT37700 2MUX 8.03' CMD TFT 2160 x 2200";
		lcd-kit,panel-type = <0x02>;
		lcd-kit,panel-xres = <2160>;
		lcd-kit,panel-yres = <2200>;
		lcd-kit,panel-width = <153>;
		lcd-kit,panel-height = <135>;
		lcd-kit,panel-on-cmds = <0x39 0x01 0x00 0x00 0x0a 0x00 0x06 0xF0 0x55 0xAA 0x52 0x08 0x00
			0x39 0x01 0x00 0x00 0x0a 0x00 0x05 0xB2 0x01 0x00 0x20 0x20
			0x15 0x01 0x00 0x00 0x0a 0x00 0x02 0x6F 0x09
			0x39 0x01 0x00 0x00 0x0a 0x00 0x03 0xB2 0x20 0x60
			0x39 0x01 0x00 0x00 0x0a 0x00 0x0D 0xB3 0x00 0x28 0x00 0xCC 0x00 0xCC 0x01 0x33 0x01 0x33 0x01 0x99
			0x15 0x01 0x00 0x00 0x0a 0x00 0x02 0x6F 0x0C
			0x39 0x01 0x00 0x00 0x0a 0x00 0x0D 0xB3 0x01 0x99 0x02 0x66 0x02 0x66 0x03 0xFF 0x03 0xFF 0x06 0xE0
			0x15 0x01 0x00 0x00 0x0a 0x00 0x02 0x6F 0x18
			0x39 0x01 0x00 0x00 0x0a 0x00 0x0D 0xB3 0x06 0xE0 0x09 0x99 0x09 0x99 0x0C 0xCC 0x0C 0xCC 0x0F 0xFF
			0x39 0x01 0x00 0x00 0x0a 0x00 0x0B 0xB4 0x88 0x66 0x55 0x33 0x22 0x11 0x00 0x00 0x00 0x00
			0x15 0x01 0x00 0x00 0x0a 0x00 0x02 0x6F 0x0A
			0x39 0x01 0x00 0x00 0x0a 0x00 0x0B 0xB4 0x90 0x90 0xDA 0xDA 0x23 0x23 0xAF 0xAF 0x24 0x24
			0x15 0x01 0x00 0x00 0x0a 0x00 0x02 0x6F 0x14
			0x39 0x01 0x00 0x00 0x0a 0x00 0x0B 0xB4 0x49 0x49 0xDB 0xDB 0xA4 0xA4 0x6E 0x6E 0x18 0x18
			0x15 0x01 0x00 0x00 0x0a 0x00 0x02 0x6F 0x06
			0x39 0x01 0x00 0x00 0x0a 0x00 0x04 0xB5 0x00 0x23 0x00
			0x39 0x01 0x00 0x00 0x0a 0x00 0x03 0xB9 0x00 0x01
			0x39 0x01 0x00 0x00 0x0a 0x00 0x09 0xBA 0x02 0xC4 0x00 0x08 0x00 0x08 0x00 0x01
			0x39 0x01 0x00 0x00 0x0a 0x00 0x09 0xBB 0x02 0xC4 0x00 0x08 0x00 0x08 0x00 0x21
			0x39 0x01 0x00 0x00 0x0a 0x00 0x04 0xBD 0x91 0x91 0x00
			0x39 0x01 0x00 0x00 0x0a 0x00 0x06 0xBE 0x0E 0x02 0x09 0x10 0x11
			0x39 0x01 0x00 0x00 0x0a 0x00 0x04 0xC0 0x11 0x73 0x00
			0x15 0x01 0x00 0x00 0x0a 0x00 0x02 0xC2 0x01
			0x39 0x01 0x00 0x00 0x0a 0x00 0x07 0xC3 0x00 0x00 0x00 0x00 0x00 0x00
			0x15 0x01 0x00 0x00 0x0a 0x00 0x02 0x6F 0x06
			0x15 0x01 0x00 0x00 0x0a 0x00 0x02 0xC3 0x04
			0x39 0x01 0x00 0x00 0x0a 0x00 0x08 0xC4 0x00 0x00 0x00 0x00 0x00 0x00 0x00
			0x15 0x01 0x00 0x00 0x0a 0x00 0x02 0x6F 0x07
			0x39 0x01 0x00 0x00 0x0a 0x00 0x05 0xC4 0x00 0x00 0x00 0x00
			0x39 0x01 0x00 0x00 0x0a 0x00 0x03 0xC5 0x11 0x00
			0x39 0x01 0x00 0x00 0x0a 0x00 0x03 0xC6 0x3F 0x1F
			0x15 0x01 0x00 0x00 0x0a 0x00 0x02 0xC8 0x0D
			0x15 0x01 0x00 0x00 0x0a 0x00 0x02 0xC9 0x84
			0x39 0x01 0x00 0x00 0x0a 0x00 0x03 0xCA 0x33 0x01
			0x15 0x01 0x00 0x00 0x0a 0x00 0x02 0xCB 0x88
			0x39 0x01 0x00 0x00 0x0a 0x00 0x06 0xF0 0x55 0xAA 0x52 0x08 0x01
			0x39 0x01 0x00 0x00 0x0a 0x00 0x03 0xB0 0x00 0x00
			0x39 0x01 0x00 0x00 0x0a 0x00 0x03 0xB3 0x05 0x05
			0x39 0x01 0x00 0x00 0x0a 0x00 0x07 0xB7 0x14 0x14 0x14 0x14 0x14 0x14
			0x39 0x01 0x00 0x00 0x0a 0x00 0x03 0xB1 0x07 0x07
			0x39 0x01 0x00 0x00 0x0a 0x00 0x03 0xB4 0x35 0x35
			0x39 0x01 0x00 0x00 0x0a 0x00 0x05 0xB8 0x5F 0x5F 0x5F 0x5F
			0x39 0x01 0x00 0x00 0x0a 0x00 0x07 0xB5 0x00 0xCF 0x00 0xCF 0x00 0xCF
			0x39 0x01 0x00 0x00 0x0a 0x00 0x07 0xB6 0x00 0xC0 0x00 0xC0 0x00 0xC0
			0x39 0x01 0x00 0x00 0x0a 0x00 0x09 0xB9 0x1E 0x1A 0x1E 0x1A 0x1E 0x1A 0x1E 0x1A
			0x39 0x01 0x00 0x00 0x0a 0x00 0x03 0xBB 0x1E 0x1E
			0x39 0x01 0x00 0x00 0x0a 0x00 0x03 0xCD 0x04 0x82
			0x15 0x01 0x00 0x00 0x0a 0x00 0x02 0xC7 0x01
			0x39 0x01 0x00 0x00 0x0a 0x00 0x06 0xF0 0x55 0xAA 0x52 0x08 0x02
			0x15 0x01 0x00 0x00 0x0a 0x00 0x02 0xBF 0x09
			0x39 0x01 0x00 0x00 0x0a 0x00 0x19 0xB0 0x00 0x00 0x00 0x04 0x00 0x04 0x00 0x45 0x00 0x58 0x00 0x76 0x00 0x92 0x00 0xA4 0x00 0xB8 0x00 0xC2 0x00 0xCE 0x00 0xEA
			0x39 0x01 0x00 0x00 0x0a 0x00 0x19 0xB1 0x01 0x0F 0x01 0x32 0x01 0x4F 0x01 0x69 0x01 0x7F 0x01 0xAA 0x01 0xCF 0x01 0xF2 0x02 0x13 0x02 0x33 0x02 0x54 0x02 0x73
			0x39 0x01 0x00 0x00 0x0a 0x00 0x17 0xB2 0x02 0x82 0x02 0x91 0x02 0xA2 0x02 0xB1 0x02 0xC1 0x02 0xD1 0x02 0xE2 0x02 0xF3 0x03 0x04 0x03 0x15 0x03 0x17
			0x39 0x01 0x00 0x00 0x0a 0x00 0x19 0xB3 0x00 0x00 0x00 0x53 0x00 0x80 0x00 0x85 0x00 0x8e 0x00 0x97 0x00 0xA5 0x00 0xAC 0x00 0xBA 0x00 0xC2 0x00 0xCB 0x00 0xE0
			0x39 0x01 0x00 0x00 0x0a 0x00 0x19 0xB4 0x00 0xFE 0x01 0x1B 0x01 0x35 0x01 0x4B 0x01 0x5E 0x01 0x85 0x01 0xA5 0x01 0xC4 0x01 0xE2 0x01 0xFE 0x02 0x1B 0x02 0x37
			0x39 0x01 0x00 0x00 0x0a 0x00 0x17 0xB5 0x02 0x44 0x02 0x52 0x02 0x61 0x02 0x6F 0x02 0x7D 0x02 0x8B 0x02 0x9A 0x02 0xA9 0x02 0xB8 0x02 0xC7 0x02 0xC8
			0x39 0x01 0x00 0x00 0x0a 0x00 0x19 0xB6 0x00 0x00 0x00 0x97 0x00 0xAA 0x00 0xBC 0x00 0xCD 0x00 0xDB 0x00 0xEE 0x00 0xF8 0x01 0x0B 0x01 0x15 0x01 0x20 0x01 0x3C
			0x39 0x01 0x00 0x00 0x0a 0x00 0x19 0xB7 0x01 0x63 0x01 0x89 0x01 0xAA 0x01 0xC8 0x01 0xE1 0x02 0x14 0x02 0x3F 0x02 0x69 0x02 0x91 0x02 0xB7 0x02 0xDF 0x03 0x05
			0x39 0x01 0x00 0x00 0x0a 0x00 0x17 0xB8 0x03 0x18 0x03 0x2B 0x03 0x40 0x03 0x54 0x03 0x68 0x03 0x7C 0x03 0x92 0x03 0xA8 0x03 0xBE 0x03 0xD5 0x03 0xD7
			0x15 0x01 0x00 0x00 0x0a 0x00 0x02 0xBF 0x08
			0x39 0x01 0x00 0x00 0x0a 0x00 0x19 0xB0 0x00 0x00 0x00 0x2D 0x00 0x42 0x00 0x52 0x00 0x62 0x00 0x6F 0x00 0x83 0x00 0x98 0x00 0xA9 0x00 0xB9 0x00 0xC3 0x00 0xDA
			0x39 0x01 0x00 0x00 0x0a 0x00 0x19 0xB1 0x01 0x01 0x01 0x21 0x01 0x3E 0x01 0x57 0x01 0x6E 0x01 0x95 0x01 0xB9 0x01 0xDA 0x01 0xF9 0x02 0x17 0x02 0x34 0x02 0x52
			0x39 0x01 0x00 0x00 0x0a 0x00 0x17 0xB2 0x02 0x60 0x02 0x6E 0x02 0x7C 0x02 0x89 0x02 0x97 0x02 0xA6 0x02 0xB4 0x02 0xC2 0x02 0xD1 0x02 0xE0 0x02 0xE2
			0x39 0x01 0x00 0x00 0x0a 0x00 0x19 0xB3 0x00 0x00 0x00 0x4A 0x00 0x63 0x00 0x73 0x00 0x83 0x00 0x90 0x00 0x9D 0x00 0xA7 0x00 0xAF 0x00 0xBB 0x00 0xC2 0x00 0xD4
			0x39 0x01 0x00 0x00 0x0a 0x00 0x19 0xB4 0x00 0xF2 0x01 0x0D 0x01 0x26 0x01 0x3C 0x01 0x4F 0x01 0x72 0x01 0x92 0x01 0xAF 0x01 0xCB 0x01 0xE5 0x01 0xFF 0x02 0x19
			0x39 0x01 0x00 0x00 0x0a 0x00 0x17 0xB5 0x02 0x26 0x02 0x32 0x02 0x3E 0x02 0x4B 0x02 0x58 0x02 0x65 0x02 0x72 0x02 0x7E 0x02 0x8B 0x02 0x98 0x02 0x9A
			0x39 0x01 0x00 0x00 0x0a 0x00 0x19 0xB6 0x00 0x00 0x00 0x88 0x00 0xA7 0x00 0xB7 0x00 0xC7 0x00 0xD4 0x00 0xE3 0x00 0xF1 0x00 0xFD 0x01 0x0C 0x01 0x15 0x01 0x2C
			0x39 0x01 0x00 0x00 0x0a 0x00 0x19 0xB7 0x01 0x54 0x01 0x77 0x01 0x97 0x01 0xB4 0x01 0xCE 0x01 0xFB 0x02 0x26 0x02 0x4C 0x02 0x72 0x02 0x96 0x02 0xB8 0x02 0xDC
			0x39 0x01 0x00 0x00 0x0a 0x00 0x17 0xB8 0x02 0xEE 0x02 0xFF 0x03 0x10 0x03 0x21 0x03 0x33 0x03 0x46 0x03 0x58 0x03 0x6A 0x03 0x7C 0x03 0x90 0x03 0x92
			0x15 0x01 0x00 0x00 0x0a 0x00 0x02 0xBF 0x07
			0x39 0x01 0x00 0x00 0x0a 0x00 0x19 0xB0 0x00 0x00 0x00 0x27 0x00 0x3F 0x00 0x4D 0x00 0x5B 0x00 0x68 0x00 0x74 0x00 0x88 0x00 0x9A 0x00 0xA8 0x00 0xB8 0x00 0xC9
			0x39 0x01 0x00 0x00 0x0a 0x00 0x19 0xB1 0x00 0xF1 0x01 0x0E 0x01 0x2A 0x01 0x42 0x01 0x58 0x01 0x7D 0x01 0xA0 0x01 0xBE 0x01 0xDB 0x01 0xF6 0x02 0x11 0x02 0x2A
			0x39 0x01 0x00 0x00 0x0a 0x00 0x17 0xB2 0x02 0x37 0x02 0x44 0x02 0x51 0x02 0x5D 0x02 0x6A 0x02 0x76 0x02 0x82 0x02 0x8E 0x02 0x9B 0x02 0xA7 0x02 0xA9
			0x39 0x01 0x00 0x00 0x0a 0x00 0x19 0xB3 0x00 0x00 0x00 0x41 0x00 0x60 0x00 0x6E 0x00 0x7C 0x00 0x89 0x00 0x95 0x00 0xA0 0x00 0xA8 0x00 0xAF 0x00 0xBA 0x00 0xC7
			0x39 0x01 0x00 0x00 0x0a 0x00 0x19 0xB4 0x00 0xE5 0x00 0xFD 0x01 0x14 0x01 0x29 0x01 0x3D 0x01 0x5D 0x01 0x7C 0x01 0x96 0x01 0xB0 0x01 0xC8 0x01 0xE0 0x01 0xF6
			0x39 0x01 0x00 0x00 0x0a 0x00 0x17 0xB5 0x02 0x01 0x02 0x0D 0x02 0x18 0x02 0x23 0x02 0x2F 0x02 0x39 0x02 0x44 0x02 0x4F 0x02 0x5B 0x02 0x66 0x02 0x67
			0x39 0x01 0x00 0x00 0x0a 0x00 0x19 0xB6 0x00 0x00 0x00 0x77 0x00 0xA4 0x00 0xB2 0x00 0xC0 0x00 0xCD 0x00 0xD9 0x00 0xE7 0x00 0xF2 0x00 0xFC 0x01 0x0B 0x01 0x1B
			0x39 0x01 0x00 0x00 0x0a 0x00 0x19 0xB7 0x01 0x43 0x01 0x62 0x01 0x80 0x01 0x9B 0x01 0xB5 0x01 0xDF 0x02 0x08 0x02 0x2C 0x02 0x4D 0x02 0x6E 0x02 0x8E 0x02 0xAC
			0x39 0x01 0x00 0x00 0x0a 0x00 0x17 0xB8 0x02 0xBC 0x02 0xCC 0x02 0xDB 0x02 0xEB 0x02 0xFA 0x03 0x09 0x03 0x18 0x03 0x27 0x03 0x37 0x03 0x47 0x03 0x49
			0x15 0x01 0x00 0x00 0x0a 0x00 0x02 0xBF 0x06
			0x39 0x01 0x00 0x00 0x0a 0x00 0x19 0xB0 0x00 0x00 0x00 0x22 0x00 0x3B 0x00 0x48 0x00 0x54 0x00 0x60 0x00 0x6B 0x00 0x75 0x00 0x87 0x00 0x97 0x00 0xA3 0x00 0xBB
			0x39 0x01 0x00 0x00 0x0a 0x00 0x19 0xB1 0x00 0xDC 0x00 0xFA 0x01 0x13 0x01 0x2B 0x01 0x40 0x01 0x65 0x01 0x83 0x01 0xA0 0x01 0xBB 0x01 0xD4 0x01 0xEC 0x02 0x03
			0x39 0x01 0x00 0x00 0x0a 0x00 0x17 0xB2 0x02 0x0E 0x02 0x19 0x02 0x24 0x02 0x2F 0x02 0x3A 0x02 0x45 0x02 0x50 0x02 0x5B 0x02 0x66 0x02 0x70 0x02 0x71
			0x39 0x01 0x00 0x00 0x0a 0x00 0x19 0xB3 0x00 0x00 0x00 0x38 0x00 0x5C 0x00 0x69 0x00 0x75 0x00 0x81 0x00 0x8C 0x00 0x96 0x00 0x9F 0x00 0xA7 0x00 0xAB 0x00 0xBC
			0x39 0x01 0x00 0x00 0x0a 0x00 0x19 0xB4 0x00 0xD6 0x00 0xED 0x01 0x01 0x01 0x15 0x01 0x27 0x01 0x47 0x01 0x62 0x01 0x7C 0x01 0x94 0x01 0xA9 0x01 0xBE 0x01 0xD3
			0x39 0x01 0x00 0x00 0x0a 0x00 0x17 0xB5 0x01 0xDD 0x01 0xE7 0x01 0xF1 0x01 0xFA 0x02 0x04 0x02 0x0E 0x02 0x18 0x02 0x21 0x02 0x2B 0x02 0x34 0x02 0x35
			0x39 0x01 0x00 0x00 0x0a 0x00 0x19 0xB6 0x00 0x00 0x00 0x66 0x00 0xA0 0x00 0xAD 0x00 0xB9 0x00 0xC5 0x00 0xD0 0x00 0xDA 0x00 0xE6 0x00 0xF0 0x00 0xF7 0x01 0x0E
			0x39 0x01 0x00 0x00 0x0a 0x00 0x19 0xB7 0x01 0x2E 0x01 0x4D 0x01 0x67 0x01 0x81 0x01 0x99 0x01 0xC3 0x01 0xE6 0x02 0x09 0x02 0x28 0x02 0x45 0x02 0x62 0x02 0x7D
			0x39 0x01 0x00 0x00 0x0a 0x00 0x17 0xB8 0x02 0x8B 0x02 0x98 0x02 0xA5 0x02 0xB2 0x02 0xBF 0x02 0xCD 0x02 0xDB 0x02 0xE8 0x02 0xF5 0x03 0x02 0x03 0x03
			0x15 0x01 0x00 0x00 0x0a 0x00 0x02 0xBF 0x05
			0x39 0x01 0x00 0x00 0x0a 0x00 0x19 0xB0 0x00 0x00 0x00 0x1A 0x00 0x37 0x00 0x41 0x00 0x4B 0x00 0x55 0x00 0x5E 0x00 0x67 0x00 0x6E 0x00 0x76 0x00 0x85 0x00 0x9D
			0x39 0x01 0x00 0x00 0x0a 0x00 0x19 0xB1 0x00 0xBF 0x00 0xDA 0x00 0xF3 0x01 0x07 0x01 0x1A 0x01 0x3D 0x01 0x5A 0x01 0x74 0x01 0x8B 0x01 0xA2 0x01 0xB7 0x01 0xCA
			0x39 0x01 0x00 0x00 0x0a 0x00 0x17 0xB2 0x01 0xD4 0x01 0xDD 0x01 0xE7 0x01 0xF0 0x01 0xF9 0x02 0x01 0x02 0x0A 0x02 0x13 0x02 0x1C 0x02 0x24 0x02 0x25
			0x39 0x01 0x00 0x00 0x0a 0x00 0x19 0xB3 0x00 0x00 0x00 0x2C 0x00 0x58 0x00 0x62 0x00 0x6C 0x00 0x76 0x00 0x7F 0x00 0x88 0x00 0x8F 0x00 0x97 0x00 0x9E 0x00 0xA9
			0x39 0x01 0x00 0x00 0x0a 0x00 0x19 0xB4 0x00 0xC0 0x00 0xD4 0x00 0xE7 0x00 0xF7 0x01 0x07 0x01 0x24 0x01 0x3E 0x01 0x54 0x01 0x69 0x01 0x7E 0x01 0x90 0x01 0xA1
			0x39 0x01 0x00 0x00 0x0a 0x00 0x17 0xB5 0x01 0xA9 0x01 0xB2 0x01 0xBA 0x01 0xC2 0x01 0xCA 0x01 0xD2 0x01 0xDA 0x01 0xE2 0x01 0xE9 0x01 0xF1 0x01 0xF2
			0x39 0x01 0x00 0x00 0x0a 0x00 0x19 0xB6 0x00 0x00 0x00 0x50 0x00 0x9C 0x00 0xA6 0x00 0xB0 0x00 0xBA 0x00 0xC3 0x00 0xCC 0x00 0xD3 0x00 0xDB 0x00 0xE5 0x00 0xF4
			0x39 0x01 0x00 0x00 0x0a 0x00 0x19 0xB7 0x01 0x12 0x01 0x2C 0x01 0x45 0x01 0x5A 0x01 0x6F 0x01 0x95 0x01 0xB7 0x01 0xD4 0x01 0xEF 0x02 0x0A 0x02 0x23 0x02 0x3A
			0x39 0x01 0x00 0x00 0x0a 0x00 0x17 0xB8 0x02 0x45 0x02 0x50 0x02 0x5B 0x02 0x66 0x02 0x71 0x02 0x7C 0x02 0x87 0x02 0x91 0x02 0x9B 0x02 0xA5 0x02 0xA6
			0x15 0x01 0x00 0x00 0x0a 0x00 0x02 0xBF 0x04
			0x39 0x01 0x00 0x00 0x0a 0x00 0x19 0xB0 0x00 0x00 0x00 0x15 0x00 0x34 0x00 0x3C 0x00 0x44 0x00 0x4C 0x00 0x53 0x00 0x5B 0x00 0x62 0x00 0x69 0x00 0x6F 0x00 0x7F
			0x39 0x01 0x00 0x00 0x0a 0x00 0x19 0xB1 0x00 0xA4 0x00 0xBF 0x00 0xD3 0x00 0xEB 0x00 0xFA 0x01 0x19 0x01 0x36 0x01 0x4E 0x01 0x64 0x01 0x77 0x01 0x8A 0x01 0x9C
			0x39 0x01 0x00 0x00 0x0a 0x00 0x17 0xB2 0x01 0xA5 0x01 0xAD 0x01 0xB5 0x01 0xBD 0x01 0xC5 0x01 0xCD 0x01 0xD4 0x01 0xDB 0x01 0xE3 0x01 0xEA 0x01 0xEB
			0x39 0x01 0x00 0x00 0x0a 0x00 0x19 0xB3 0x00 0x00 0x00 0x23 0x00 0x55 0x00 0x5D 0x00 0x65 0x00 0x6D 0x00 0x74 0x00 0x7C 0x00 0x83 0x00 0x8A 0x00 0x90 0x00 0x9B
			0x39 0x01 0x00 0x00 0x0a 0x00 0x19 0xB4 0x00 0xAC 0x00 0xBF 0x00 0xCF 0x00 0xE0 0x00 0xED 0x01 0x06 0x01 0x1E 0x01 0x34 0x01 0x47 0x01 0x57 0x01 0x68 0x01 0x78
			0x39 0x01 0x00 0x00 0x0a 0x00 0x17 0xB5 0x01 0x80 0x01 0x88 0x01 0x8F 0x01 0x95 0x01 0x9C 0x01 0xA3 0x01 0xA9 0x01 0xB0 0x01 0xB6 0x01 0xBD 0x01 0xBE
			0x39 0x01 0x00 0x00 0x0a 0x00 0x19 0xB6 0x00 0x00 0x00 0x3F 0x00 0x99 0x00 0xA1 0x00 0xA9 0x00 0xB1 0x00 0xB8 0x00 0xC0 0x00 0xC7 0x00 0xCE 0x00 0xD4 0x00 0xE1
			0x39 0x01 0x00 0x00 0x0a 0x00 0x19 0xB7 0x00 0xF8 0x01 0x12 0x01 0x25 0x01 0x3D 0x01 0x4D 0x01 0x6E 0x01 0x8D 0x01 0xA9 0x01 0xC2 0x01 0xD8 0x01 0xEE 0x02 0x03
			0x39 0x01 0x00 0x00 0x0a 0x00 0x17 0xB8 0x02 0x0E 0x02 0x18 0x02 0x21 0x02 0x2A 0x02 0x33 0x02 0x3C 0x02 0x45 0x02 0x4E 0x02 0x57 0x02 0x60 0x02 0x61
			0x15 0x01 0x00 0x00 0x0a 0x00 0x02 0xBF 0x03
			0x39 0x01 0x00 0x00 0x0a 0x00 0x19 0xB0 0x00 0x00 0x00 0x11 0x00 0x32 0x00 0x39 0x00 0x3F 0x00 0x46 0x00 0x4C 0x00 0x53 0x00 0x59 0x00 0x5F 0x00 0x65 0x00 0x6F
			0x39 0x01 0x00 0x00 0x0a 0x00 0x19 0xB1 0x00 0x90 0x00 0xAA 0x00 0xBF 0x00 0xD0 0x00 0xE3 0x00 0xFF 0x01 0x19 0x01 0x31 0x01 0x46 0x01 0x59 0x01 0x6B 0x01 0x7A
			0x39 0x01 0x00 0x00 0x0a 0x00 0x17 0xB2 0x01 0x82 0x01 0x89 0x01 0x91 0x01 0x99 0x01 0xA0 0x01 0xA8 0x01 0xAE 0x01 0xB5 0x01 0xBB 0x01 0xC2 0x01 0xC2
			0x39 0x01 0x00 0x00 0x0a 0x00 0x19 0xB3 0x00 0x00 0x00 0x1D 0x00 0x53 0x00 0x5A 0x00 0x60 0x00 0x67 0x00 0x6D 0x00 0x74 0x00 0x7A 0x00 0x80 0x00 0x86 0x00 0x90
			0x39 0x01 0x00 0x00 0x0a 0x00 0x19 0xB4 0x00 0xA4 0x00 0xB0 0x00 0xC0 0x00 0xCC 0x00 0xDB 0x00 0xF1 0x01 0x06 0x01 0x1A 0x01 0x2D 0x01 0x3D 0x01 0x4C 0x01 0x5A
			0x39 0x01 0x00 0x00 0x0a 0x00 0x17 0xB5 0x01 0x61 0x01 0x67 0x01 0x6E 0x01 0x75 0x01 0x7C 0x01 0x83 0x01 0x89 0x01 0x8E 0x01 0x94 0x01 0x9A 0x01 0x9A
			0x39 0x01 0x00 0x00 0x0a 0x00 0x19 0xB6 0x00 0x00 0x00 0x35 0x00 0x97 0x00 0x9E 0x00 0xA4 0x00 0xAB 0x00 0xB1 0x00 0xB8 0x00 0xBE 0x00 0xC4 0x00 0xCA 0x00 0xD4
			0x39 0x01 0x00 0x00 0x0a 0x00 0x19 0xB7 0x00 0xEC 0x00 0xFE 0x01 0x12 0x01 0x22 0x01 0x35 0x01 0x53 0x01 0x6E 0x01 0x88 0x01 0xA0 0x01 0xB6 0x01 0xCA 0x01 0xDC
			0x39 0x01 0x00 0x00 0x0a 0x00 0x17 0xB8 0x01 0xE4 0x01 0xED 0x01 0xF6 0x01 0xFF 0x02 0x08 0x02 0x11 0x02 0x19 0x02 0x21 0x02 0x28 0x02 0x30 0x02 0x31
			0x15 0x01 0x00 0x00 0x0a 0x00 0x02 0xBF 0x02
			0x39 0x01 0x00 0x00 0x0a 0x00 0x19 0xB0 0x00 0x00 0x00 0x0F 0x00 0x2E 0x00 0x37 0x00 0x3C 0x00 0x42 0x00 0x48 0x00 0x4E 0x00 0x53 0x00 0x59 0x00 0x5E 0x00 0x68
			0x39 0x01 0x00 0x00 0x0a 0x00 0x19 0xB1 0x00 0x7D 0x00 0x9B 0x00 0xB2 0x00 0xC1 0x00 0xD0 0x00 0xF0 0x01 0x06 0x01 0x1C 0x01 0x32 0x01 0x44 0x01 0x55 0x01 0x65
			0x39 0x01 0x00 0x00 0x0a 0x00 0x17 0xB2 0x01 0x6C 0x01 0x73 0x01 0x7A 0x01 0x81 0x01 0x87 0x01 0x8E 0x01 0x94 0x01 0x9B 0x01 0xA2 0x01 0xA8 0x01 0xA9
			0x39 0x01 0x00 0x00 0x0a 0x00 0x19 0xB3 0x00 0x00 0x00 0x19 0x00 0x4C 0x00 0x58 0x00 0x5D 0x00 0x63 0x00 0x69 0x00 0x6F 0x00 0x74 0x00 0x7A 0x00 0x7F 0x00 0x89
			0x39 0x01 0x00 0x00 0x0a 0x00 0x19 0xB4 0x00 0x9A 0x00 0xA8 0x00 0xB6 0x00 0xC1 0x00 0xCD 0x00 0xE5 0x00 0xF7 0x01 0x09 0x01 0x1B 0x01 0x2B 0x01 0x3A 0x01 0x48
			0x39 0x01 0x00 0x00 0x0a 0x00 0x17 0xB5 0x01 0x4E 0x01 0x54 0x01 0x59 0x01 0x5F 0x01 0x65 0x01 0x6B 0x01 0x71 0x01 0x77 0x01 0x7D 0x01 0x83 0x01 0x84
			0x39 0x01 0x00 0x00 0x0a 0x00 0x19 0xB6 0x00 0x00 0x00 0x2E 0x00 0x8B 0x00 0x9C 0x00 0xA1 0x00 0xA7 0x00 0xAD 0x00 0xB3 0x00 0xB8 0x00 0xBE 0x00 0xC3 0x00 0xCD
			0x39 0x01 0x00 0x00 0x0a 0x00 0x19 0xB7 0x00 0xE0 0x00 0xF3 0x01 0x06 0x01 0x14 0x01 0x22 0x01 0x42 0x01 0x5A 0x01 0x72 0x01 0x89 0x01 0x9D 0x01 0xB1 0x01 0xC3
			0x39 0x01 0x00 0x00 0x0a 0x00 0x17 0xB8 0x01 0xCC 0x01 0xD4 0x01 0xDB 0x01 0xE3 0x01 0xEB 0x01 0xF3 0x01 0xFB 0x02 0x02 0x02 0x0A 0x02 0x12 0x02 0x13
			0x15 0x01 0x00 0x00 0x0a 0x00 0x02 0xBF 0x01
			0x39 0x01 0x00 0x00 0x0a 0x00 0x19 0xB0 0x00 0x00 0x00 0x0C 0x00 0x26 0x00 0x34 0x00 0x39 0x00 0x3E 0x00 0x43 0x00 0x47 0x00 0x4C 0x00 0x51 0x00 0x55 0x00 0x5E
			0x39 0x01 0x00 0x00 0x0a 0x00 0x19 0xB1 0x00 0x6E 0x00 0x83 0x00 0x9B 0x00 0xAE 0x00 0xBD 0x00 0xD6 0x00 0xF0 0x01 0x03 0x01 0x15 0x01 0x27 0x01 0x38 0x01 0x47
			0x39 0x01 0x00 0x00 0x0a 0x00 0x17 0xB2 0x01 0x4E 0x01 0x55 0x01 0x5B 0x01 0x62 0x01 0x69 0x01 0x6E 0x01 0x74 0x01 0x7A 0x01 0x7F 0x01 0x85 0x01 0x85
			0x39 0x01 0x00 0x00 0x0a 0x00 0x19 0xB3 0x00 0x00 0x00 0x15 0x00 0x3F 0x00 0x55 0x00 0x5A 0x00 0x5F 0x00 0x64 0x00 0x68 0x00 0x6D 0x00 0x72 0x00 0x76 0x00 0x7F
			0x39 0x01 0x00 0x00 0x0a 0x00 0x19 0xB4 0x00 0x8F 0x00 0x9D 0x00 0xA8 0x00 0xB3 0x00 0xBE 0x00 0xD1 0x00 0xE5 0x00 0xF4 0x01 0x03 0x01 0x12 0x01 0x20 0x01 0x2D
			0x39 0x01 0x00 0x00 0x0a 0x00 0x17 0xB5 0x01 0x34 0x01 0x3A 0x01 0x3F 0x01 0x45 0x01 0x4B 0x01 0x50 0x01 0x54 0x01 0x59 0x01 0x5E 0x01 0x63 0x01 0x64
			0x39 0x01 0x00 0x00 0x0a 0x00 0x19 0xB6 0x00 0x00 0x00 0x26 0x00 0x74 0x00 0x99 0x00 0x9E 0x00 0xA3 0x00 0xA8 0x00 0xAC 0x00 0xB1 0x00 0xB6 0x00 0xBA 0x00 0xC3
			0x39 0x01 0x00 0x00 0x0a 0x00 0x19 0xB7 0x00 0xD3 0x00 0xE4 0x00 0xF3 0x01 0x02 0x01 0x10 0x01 0x28 0x01 0x42 0x01 0x56 0x01 0x6A 0x01 0x7D 0x01 0x90 0x01 0xA1
			0x39 0x01 0x00 0x00 0x0a 0x00 0x17 0xB8 0x01 0xA9 0x01 0xB1 0x01 0xB8 0x01 0xC0 0x01 0xC8 0x01 0xCE 0x01 0xD5 0x01 0xDB 0x01 0xE1 0x01 0xE8 0x01 0xE9
			0x15 0x01 0x00 0x00 0x0a 0x00 0x02 0xBF 0x00
			0x39 0x01 0x00 0x00 0x0a 0x00 0x19 0xB0 0x00 0x00 0x00 0x06 0x00 0x12 0x00 0x1E 0x00 0x2B 0x00 0x33 0x00 0x35 0x00 0x37 0x00 0x3A 0x00 0x3C 0x00 0x3E 0x00 0x43
			0x39 0x01 0x00 0x00 0x0a 0x00 0x19 0xB1 0x00 0x4C 0x00 0x55 0x00 0x5D 0x00 0x66 0x00 0x6D 0x00 0x80 0x00 0x98 0x00 0xAA 0x00 0xBB 0x00 0xC5 0x00 0xD2 0x00 0xE0
			0x39 0x01 0x00 0x00 0x0a 0x00 0x17 0xB2 0x00 0xE6 0x00 0xEC 0x00 0xF1 0x00 0xF5 0x00 0xFA 0x00 0xFE 0x01 0x03 0x01 0x07 0x01 0x0C 0x01 0x10 0x01 0x11
			0x39 0x01 0x00 0x00 0x0a 0x00 0x19 0xB3 0x00 0x00 0x00 0x0A 0x00 0x1E 0x00 0x33 0x00 0x47 0x00 0x54 0x00 0x56 0x00 0x58 0x00 0x5B 0x00 0x5D 0x00 0x5F 0x00 0x64
			0x39 0x01 0x00 0x00 0x0a 0x00 0x19 0xB4 0x00 0x6D 0x00 0x76 0x00 0x7E 0x00 0x87 0x00 0x8E 0x00 0x9C 0x00 0xA7 0x00 0xB0 0x00 0xBC 0x00 0xC4 0x00 0xCE 0x00 0xD8
			0x39 0x01 0x00 0x00 0x0a 0x00 0x17 0xB5 0x00 0xDD 0x00 0xE2 0x00 0xE5 0x00 0xE9 0x00 0xED 0x00 0xF0 0x00 0xF4 0x00 0xF8 0x00 0xFB 0x00 0xFF 0x00 0xFF
			0x39 0x01 0x00 0x00 0x0a 0x00 0x19 0xB6 0x00 0x00 0x00 0x12 0x00 0x37 0x00 0x5D 0x00 0x82 0x00 0x98 0x00 0x9A 0x00 0x9C 0x00 0x9F 0x00 0xA1 0x00 0xA3 0x00 0xA8
			0x39 0x01 0x00 0x00 0x0a 0x00 0x19 0xB7 0x00 0xB1 0x00 0xBA 0x00 0xC2 0x00 0xCB 0x00 0xD2 0x00 0xE2 0x00 0xF1 0x00 0xFE 0x01 0x0E 0x01 0x18 0x01 0x24 0x01 0x32
			0x39 0x01 0x00 0x00 0x0a 0x00 0x17 0xB8 0x01 0x38 0x01 0x3E 0x01 0x43 0x01 0x48 0x01 0x4D 0x01 0x51 0x01 0x56 0x01 0x5B 0x01 0x60 0x01 0x65 0x01 0x65
			0x39 0x01 0x00 0x00 0x0a 0x00 0x06 0xF0 0x55 0xAA 0x52 0x08 0x02
			0x39 0x01 0x00 0x00 0x0a 0x00 0x19 0xB9 0x00 0x04 0x00 0x0C 0x00 0x14 0x00 0x1C 0x00 0x24 0x00 0x2C 0x00 0x34 0x00 0x3C 0x00 0x44 0x00 0x4C 0x00 0x5C 0x00 0x7C
			0x39 0x01 0x00 0x00 0x0a 0x00 0x19 0xBA 0x00 0x9C 0x00 0xBC 0x00 0xDC 0x00 0xFC 0x01 0x3C 0x01 0x7C 0x01 0xBC 0x01 0xFC 0x02 0x3C 0x02 0x7C 0x02 0xBC 0x02 0xDC
			0x39 0x01 0x00 0x00 0x0a 0x00 0x15 0xBB 0x02 0xFC 0x03 0x1C 0x03 0x3C 0x03 0x5C 0x03 0x7C 0x03 0x9C 0x03 0xBC 0x03 0xDC 0x03 0xFC 0x03 0xFF
			0x15 0x01 0x00 0x00 0x0a 0x00 0x02 0xBC 0x10
			0x39 0x01 0x00 0x00 0x0a 0x00 0x11 0xBD 0xA8 0x00 0x00 0x54 0x54 0x00 0x00 0xA8 0xCC 0x30 0x30 0xCC 0x54 0xA8 0xA8 0x54
			0x15 0x01 0x00 0x00 0x0a 0x00 0x02 0xC1 0x02
			0x39 0x01 0x00 0x00 0x0a 0x00 0x09 0xC2 0x19 0x00 0x91 0x00 0x19 0x00 0x91 0x00
			0x39 0x01 0x00 0x00 0x0a 0x00 0x06 0xF0 0x55 0xAA 0x52 0x08 0x03
			0x39 0x01 0x00 0x00 0x0a 0x00 0x06 0xB0 0x00 0x00 0x00 0x00 0x00
			0x39 0x01 0x00 0x00 0x0a 0x00 0x0B 0xB2 0x00 0x31 0x0E 0x02 0x01 0x00 0x31 0x0E 0x02 0x01
			0x39 0x01 0x00 0x00 0x0a 0x00 0x0B 0xB3 0x00 0x02 0x02 0x03 0x22 0x00 0x02 0x02 0x03 0x22
			0x39 0x01 0x00 0x00 0x0a 0x00 0x0B 0xB7 0x01 0x04 0x79 0x20 0x00 0x00 0x00 0x00 0x06 0x3A
			0x39 0x01 0x00 0x00 0x0a 0x00 0x07 0xB4 0x03 0x00 0x03 0x03 0x00 0x03
			0x39 0x01 0x00 0x00 0x0a 0x00 0x0F 0xB5 0x01 0x00 0x2F 0x5D 0x00 0x09 0x07 0x01 0x00 0x2F 0x5D 0x00 0x09 0x07
			0x39 0x01 0x00 0x00 0x0a 0x00 0x08 0xBB 0x11 0x00 0x46 0xA8 0x00 0x46 0xA8
			0x39 0x01 0x00 0x00 0x0a 0x00 0x08 0xBC 0x11 0x00 0x0B 0xA5 0x00 0x0B 0xA5
			0x39 0x01 0x00 0x00 0x0a 0x00 0x06 0xF0 0x55 0xAA 0x52 0x08 0x05
			0x39 0x01 0x00 0x00 0x0a 0x00 0x04 0xB0 0x03 0x53 0x00
			0x39 0x01 0x00 0x00 0x0a 0x00 0x04 0xB2 0x87 0x00 0x30
			0x39 0x01 0x00 0x00 0x0a 0x00 0x03 0xB3 0x86 0x80
			0x39 0x01 0x00 0x00 0x0a 0x00 0x03 0xB5 0x04 0x05
			0x39 0x01 0x00 0x00 0x0a 0x00 0x03 0xB6 0x86 0x85
			0x39 0x01 0x00 0x00 0x0a 0x00 0x05 0xB7 0x04 0x00 0x00 0x05
			0x39 0x01 0x00 0x00 0x0a 0x00 0x05 0xB8 0x04 0x00 0x00 0x05
			0x39 0x01 0x00 0x00 0x0a 0x00 0x03 0xC7 0x03 0x01
			0x39 0x01 0x00 0x00 0x0a 0x00 0x04 0xD0 0x00 0x05 0x10
			0x39 0x01 0x00 0x00 0x0a 0x00 0x04 0xD1 0x00 0x05 0x10
			0x39 0x01 0x00 0x00 0x0a 0x00 0x05 0xE0 0x02 0x00 0x00 0x00
			0x39 0x01 0x00 0x00 0x0a 0x00 0x05 0xE1 0x02 0x00 0x00 0x00
			0x15 0x01 0x00 0x00 0x0a 0x00 0x02 0xCA 0x33
			0x39 0x01 0x00 0x00 0x0a 0x00 0x03 0xCB 0x33 0x33
			0x39 0x01 0x00 0x00 0x0a 0x00 0x03 0xD8 0x22 0x22
			0x39 0x01 0x00 0x00 0x0a 0x00 0x03 0xEC 0x01 0x11
			0x15 0x01 0x00 0x00 0x0a 0x00 0x02 0xD9 0x01
			0x39 0x01 0x00 0x00 0x0a 0x00 0x06 0xF0 0x55 0xAA 0x52 0x08 0x06
			0x39 0x01 0x00 0x00 0x0a 0x00 0x06 0xB0 0x10 0x11 0x02 0x0D 0x0C
			0x39 0x01 0x00 0x00 0x0a 0x00 0x06 0xB1 0x00 0x06 0x06 0x34 0x34
			0x39 0x01 0x00 0x00 0x0a 0x00 0x06 0xB2 0x34 0x34 0x34 0x34 0x34
			0x39 0x01 0x00 0x00 0x0a 0x00 0x06 0xB3 0x34 0x34 0x34 0x34 0x34
			0x39 0x01 0x00 0x00 0x0a 0x00 0x05 0xB4 0x2C 0x2C 0x2E 0x2E
			0x39 0x01 0x00 0x00 0x0a 0x00 0x06 0xB6 0x10 0x11 0x02 0x0D 0x0C
			0x39 0x01 0x00 0x00 0x0a 0x00 0x06 0xB7 0x00 0x06 0x06 0x34 0x34
			0x39 0x01 0x00 0x00 0x0a 0x00 0x06 0xB8 0x34 0x34 0x34 0x34 0x34
			0x39 0x01 0x00 0x00 0x0a 0x00 0x06 0xB9 0x34 0x34 0x34 0x34 0x34
			0x39 0x01 0x00 0x00 0x0a 0x00 0x05 0xBA 0x2C 0x2C 0x2E 0x2E
			0x39 0x01 0x00 0x00 0x0a 0x00 0x06 0xF0 0x55 0xAA 0x52 0x08 0x07
			0x39 0x01 0x00 0x00 0x0a 0x00 0x04 0xB0 0x00 0x40 0x40
			0x39 0x01 0x00 0x00 0x0a 0x00 0x0D 0xB1 0x0C 0x1C 0x00 0x1C 0x0C 0x00 0x70 0x70 0x00 0x70 0x70 0x00
			0x39 0x01 0x00 0x00 0x0a 0x00 0x0D 0xB2 0xa0 0xa0 0xa0 0xa0 0xa0 0xa0 0xa0 0xa0 0xa0 0xa0 0xa0 0xa0
			0x39 0x01 0x00 0x00 0x0a 0x00 0x0D 0xB3 0x00 0x00 0x00 0x00 0x00 0x00 0xa0 0xa0 0xa0 0xa0 0xa0 0xa0
			0x39 0x01 0x00 0x00 0x0a 0x00 0x0D 0xB4 0xa0 0xa0 0xa0 0xa0 0xa0 0xa0 0x00 0x00 0x00 0x00 0x00 0x00
			0x39 0x01 0x00 0x00 0x0a 0x00 0x18 0xB5 0xa0 0xa0 0x0e 0xaa 0x00 0x00 0x00 0x00 0x00 0x00 0x00 0x00 0x00 0x00 0x00 0x00 0x00 0x00 0x00 0x00 0x00 0x00 0x00
			0x39 0x01 0x00 0x00 0x0a 0x00 0x13 0xBE 0x00 0x00 0x00 0x00 0x00 0x00 0x00 0x00 0x00 0x00 0x00 0x00 0x00 0x00 0x00 0x00 0x00 0x00
			0x15 0x01 0x00 0x00 0x0a 0x00 0x02 0xB9 0x01
			0x39 0x01 0x00 0x00 0x0a 0x00 0x0A 0xc0 0x73 0x3c 0x3c 0x00 0x17 0x3c 0x3c 0x25 0x00
			0x39 0x01 0x00 0x00 0x0a 0x00 0x11 0xc1 0x26 0x25 0x23 0x23 0x23 0x22 0x22 0x22 0x22 0x22 0x21 0x22 0x21 0x21 0x22 0x21
			0x39 0x01 0x00 0x00 0x0a 0x00 0x11 0xc2 0x21 0x21 0x21 0x21 0x21 0x21 0x21 0x22 0x02 0x21 0x21 0x22 0x02 0x21 0x22 0x02
			0x39 0x01 0x00 0x00 0x0a 0x00 0x11 0xc3 0x22 0x02 0x22 0x02 0x22 0x02 0x22 0x02 0x23 0x03 0x03 0x23 0x03 0x03 0x23 0x03
			0x39 0x01 0x00 0x00 0x0a 0x00 0x11 0xc4 0x03 0x25 0x05 0x05 0x05 0x05 0x26 0x06 0x06 0x06 0x06 0x06 0x00 0x00 0x00 0x00
			0x39 0x01 0x00 0x00 0x0a 0x00 0x11 0xd0 0x26 0x06 0x06 0x06 0x06 0x06 0x25 0x05 0x05 0x05 0x05 0x23 0x03 0x03 0x23 0x03
			0x39 0x01 0x00 0x00 0x0a 0x00 0x11 0xd1 0x03 0x23 0x03 0x03 0x22 0x02 0x22 0x02 0x22 0x02 0x22 0x02 0x22 0x02 0x21 0x22
			0x39 0x01 0x00 0x00 0x0a 0x00 0x11 0xd2 0x02 0x21 0x21 0x22 0x02 0x21 0x21 0x21 0x21 0x21 0x21 0x21 0x21 0x22 0x21 0x21
			0x39 0x01 0x00 0x00 0x0a 0x00 0x11 0xd3 0x22 0x21 0x22 0x22 0x22 0x22 0x22 0x23 0x23 0x23 0x25 0x26 0x00 0x00 0x00 0x00
			0x39 0x01 0x00 0x00 0x0a 0x00 0x11 0xd4 0x24 0x25 0x2b 0x00 0x00 0x00 0x00 0x00 0x00 0x00 0x00 0x00 0x00 0x00 0x00 0x00
			0x39 0x01 0x00 0x00 0x0a 0x00 0x05 0xFF 0xAA 0x55 0xA5 0x81
			0x15 0x01 0x00 0x00 0x0a 0x00 0x02 0x6F 0x05
			0x15 0x01 0x00 0x00 0x0a 0x00 0x02 0xF3 0x25
			0x15 0x01 0x00 0x00 0x0a 0x00 0x02 0x6F 0x0D
			0x15 0x01 0x00 0x00 0x0a 0x00 0x02 0xF3 0xAB
			0x39 0x01 0x00 0x00 0x0a 0x00 0x05 0xFF 0xAA 0x55 0xA5 0x00
			0x05 0x01 0x00 0x00 0x0a 0x00 0x01 0x35
			0x15 0x01 0x00 0x00 0x0a 0x00 0x02 0x36 0x40
			0x39 0x01 0x00 0x00 0x0a 0x00 0x05 0x3B 0x00 0x50 0x00 0x10
			0x15 0x01 0x00 0x00 0x0a 0x00 0x02 0x53 0x28
			0x39 0x01 0x00 0x00 0x0a 0x00 0x03 0x51 0x00 0xFF
			0x15 0x01 0x00 0x00 0x0a 0x00 0x02 0x90 0x00
			0x39 0x01 0x00 0x00 0x0a 0x00 0x05 0x2A 0x00 0x00 0x04 0x37
			0x39 0x01 0x00 0x00 0x0a 0x00 0x05 0x2B 0x00 0x00 0x08 0x97
			0x05 0x01 0x00 0x00 0x78 0x01 0x01 0x11
			0x05 0x01 0x00 0x00 0x14 0x01 0x01 0x29>;
		lcd-kit,panel-on-cmds-state = "dsi_lp_mode";
		lcd-kit,panel-off-cmds = <0x05 0x01 0x00 0x00 0x14 0x01 0x02 0x28 0x00
			0x05 0x01 0x00 0x00 0x78 0x01 0x02 0x10 0x00>;
		lcd-kit,panel-off-cmds-state = "dsi_lp_mode";
		lcd-kit,backlight-cmds = <0x39 0x01 0x00 0x00 0x00 0x00 0x03 0x51 0x00 0x00>;
		lcd-kit,backlight-cmds-state = "dsi_lp_mode";
		lcd-kit,tp-color-cmds = <0x06 0x01 0x00 0x00 0x0a 0x00 0x01 0xda>;
		lcd-kit,effect-on-cmds = <0x15 0x01 0x00 0x00 0x0a 0x00 0x02 0xFF 0x2A
					0x15 0x01 0x00 0x00 0x0a 0x00 0x02 0xFB 0x01
					0x15 0x01 0x00 0x00 0x0a 0x00 0x02 0x10 0x73
					0x15 0x01 0x00 0x00 0x0a 0x00 0x02 0x11 0x73
					0x15 0x01 0x00 0x00 0x0a 0x00 0x02 0x12 0x73
					0x15 0x01 0x00 0x00 0x0a 0x00 0x02 0x13 0x73
					0x15 0x01 0x00 0x00 0x0a 0x00 0x02 0x14 0x73
					0x15 0x01 0x00 0x00 0x0a 0x00 0x02 0xFF 0x10
					0x15 0x01 0x00 0x00 0x0a 0x00 0x02 0xFB 0x01>;
		lcd-kit,cabc-off-cmds = <0x15 0x01 0x00 0x00 0x0a 0x00 0x02 0xFF 0x10
			0x15 0x01 0x00 0x00 0x0a 0x00 0x02 0x55 0x00>;
		lcd-kit,cabc-off-cmds-state = "dsi_lp_mode";
		lcd-kit,cabc-ui-cmds = <0x15 0x01 0x00 0x00 0x0a 0x00 0x02 0xFF 0x10
			0x15 0x01 0x00 0x00 0x0a 0x00 0x02 0x55 0x01>;
		lcd-kit,cabc-ui-cmds-state = "dsi_lp_mode";
		lcd-kit,cabc-still-cmds = <0x15 0x01 0x00 0x00 0x0a 0x00 0x02 0xFF 0x10
			0x15 0x01 0x00 0x00 0x0a 0x00 0x02 0x55 0x02>;
		lcd-kit,cabc-still-cmds-state = "dsi_lp_mode";
		lcd-kit,cabc-moving-cmds = <0x15 0x01 0x00 0x00 0x0a 0x00 0x02 0xFF 0x10
			0x15 0x01 0x00 0x00 0x0a 0x00 0x02 0x55 0x03>;
		lcd-kit,cabc-moving-cmds-state = "dsi_lp_mode";
		lcd-kit,rgbw-mode1-cmds = <0x15 0x01 0x00 0x00 0x0a 0x00 0x02 0x65 0x01>;
		lcd-kit,rgbw-mode1-cmds-state = "dsi_lp_mode";
		lcd-kit,rgbw-mode2-cmds = <0x15 0x01 0x00 0x00 0x0a 0x00 0x02 0x65 0x02>;
		lcd-kit,rgbw-mode2-cmds-state = "dsi_lp_mode";
		lcd-kit,rgbw-mode3-cmds = <0x15 0x01 0x00 0x00 0x0a 0x00 0x02 0x65 0x03>;
		lcd-kit,rgbw-mode3-cmds-state = "dsi_lp_mode";
		lcd-kit,rgbw-mode4-cmds = <0x15 0x01 0x00 0x00 0x0a 0x00 0x02 0x65 0x04>;
		lcd-kit,rgbw-mode4-cmds-state = "dsi_lp_mode";
		lcd-kit,rgbw-backlight-cmds = <0x39 0x01 0x00 0x00 0x0a 0x00 0x03 0x61 0x00 0x00>;
		lcd-kit,rgbw-backlight-cmds-state = "dsi_lp_mode";
		lcd-kit,rgbw-pixel-gain-limit-cmds = <0x15 0x01 0x00 0x00 0x0a 0x00 0x02 0x6A 0x00>;
		lcd-kit,rgbw-pixel-gain-limit-cmds-state = "dsi_lp_mode";
		lcd-kit,ce-off-cmds = <>;
		lcd-kit,ce-srgb-cmds = <>;
		lcd-kit,ce-user-cmds = <>;
		lcd-kit,ce-vivid-cmds = <>;
		lcd-kit,esd-reg-cmds = <0x06 0x01 0x00 0x00 0x0a 0x00 0x01 0x0a>;
		lcd-kit,esd-reg-cmds-state = "dsi_lp_mode";
		lcd-kit,esd-value = <0x9c>;
		lcd-kit,check-reg-cmds = <0x06 0x01 0x00 0x00 0x0a 0x00 0x01 0x0a>;
		lcd-kit,check-reg-cmds-state = "dsi_lp_mode";
		lcd-kit,check-reg-value = <0x9c>;
		lcd-kit,check-reg-on-cmds = <0x06 0x01 0x00 0x00 0x0a 0x00 0x01 0x0a>;
		lcd-kit,check-reg-on-value = <0x9c>;
		lcd-kit,check-reg-off-cmds = <0x06 0x01 0x00 0x00 0x0a 0x00 0x01 0x0a>;
		lcd-kit,check-reg-off-value = <0x08>;
		lcd-kit,project-id-cmds = <0x29 0x01 0x00 0x00 0x0a 0x00 0x02 0xFF 0x22
        0x29 0x01 0x00 0x00 0x0a 0x00 0x02 0xFB 0x01
        0x14 0x01 0x00 0x00 0x0a 0x00 0x0a 0x29 0x00 0x00 0x00 0x00 0x00 0x00 0x00 0x00 0x00
        0x29 0x01 0x00 0x00 0x0a 0x00 0x02 0xFF 0x10
        0x29 0x01 0x00 0x00 0x0a 0x00 0x02 0xFB 0x01>;
		lcd-kit,gamma-cmds = <0x96 0x97 0x98 0xB0 0xB1 0xB2 0xB3 0xB4 0xB5 0xB6 0xB7 0xB8 0xB9 0xBA 0xBB 0xBC 0xBD 0xBE 0xBF 0xB0 0xB1 0xB2 0xB3 0xB4 0xB5 0xB6 0xB7 0xB8 0xB9 0xBA 0xBB 0xC0 0xC1 0xC2 0xC3>;
		lcd-kit,current-det-cmds = <0x06 0x01 0x00 0x00 0x0a 0x00 0x01 0x51>;
		lcd-kit,lv-det-cmds = <0x06 0x01 0x00 0x00 0x0a 0x00 0x01 0x52>;
		lcd-kit,pcd-errflag-check-support = <0>;
		lcd-kit,gpio-pcd = <0>;
		lcd-kit,gpio-errflag = <0>;
		lcd-kit,bkl-open-short-support = <>;
		lcd-kit,checksum-enable-cmds = <0x15 0x01 0x00 0x00 0x0a 0x00 0x02 0xFF 0xF0
					0x15 0x01 0x00 0x00 0x0a 0x00 0x02 0x92 0x01>;
		lcd-kit,checksum-disable-cmds = <0x15 0x01 0x00 0x00 0x0a 0x00 0x02 0xFF 0xF0
					0x15 0x01 0x00 0x00 0x0a 0x00 0x02 0x92 0x00
					0x15 0x01 0x00 0x00 0x0a 0x00 0x02 0x7B 0x00
					0x15 0x01 0x00 0x00 0x0a 0x00 0x02 0xFF 0x10>;
		lcd-kit,checksum-cmds = <0x06 0x01 0x00 0x00 0x14 0x00 0x01 0x73>;
		lcd-kit,fps-to-30-cmds = <0x15 0x01 0x00 0x00 0x0a 0x00 0x02 0xff 0x10
				0x15 0x01 0x00 0x00 0x0a 0x00 0x02 0xb1 0x80
				0x15 0x01 0x00 0x00 0x0a 0x00 0x02 0xfb 0x01
				>;
		lcd-kit,fps-to-60-cmds = <0x15 0x01 0x00 0x00 0x0a 0x00 0x02 0xff 0x10
				0x15 0x01 0x00 0x00 0x0a 0x00 0x02 0xb1 0x00
				0x15 0x01 0x00 0x00 0x0a 0x00 0x02 0xfb 0x01
				>;
		lcd-kit,fps-dfr-enable-cmds = <0x15 0x01 0x00 0x00 0x0a 0x00 0x02 0xff 0x10
				0x15 0x01 0x00 0x00 0x0a 0x00 0x02 0xb1 0x03
				0x15 0x01 0x00 0x00 0x0a 0x00 0x02 0xfb 0x01
				>;
		lcd-kit,panel-orientation = <1>;
		lcd-kit,panel-bpp = <0>;
		lcd-kit,panel-bgr-fmt = <0>;
		lcd-kit,panel-cmd-type = <32>;
		lcd-kit,panel-pxl-clk = <384>;
		lcd-kit,panel-pxl-clk-div = <1>;
		lcd-kit,panel-vsyn-ctr-type = <0>;
		lcd-kit,panel-ifbc-type = <0>;
		lcd-kit,vesa-slice-width = <719>;
		lcd-kit,vesa-slice-height = <7>;
		lcd-kit,panel-frc-enable = <0>;
		lcd-kit,panel-esd-skip-mipi-check = <1>;
		lcd-kit,sensorhub-aod-support = <0>;
		lcd-kit,mask-delay-time-before-fp = <16666>;
		lcd-kit,mask-delay-time-after-fp = <16666>;
		lcd-kit,bl-delay-frame = <0>;
		lcd-kit,panel-version-support = <0>;
		lcd-kit,fps-support = <0>;
		lcd-kit,backlight-order = <0>;
		lcd-kit,backlight-precision = <0>;
		lcd-kit,quickly-sleep-out-support = <0>;
		lcd-kit,quickly-sleep-out-interval = <0>;
		lcd-kit,esd-support = <0>;
		lcd-kit,project-id-support = <0>;
		lcd-kit,dsi1-support = <1>;
		lcd-kit,dpi01-set-change = <1>;
		lcd-kit,pxl-clk-to-pll2 = <1>;
		lcd-kit,oem-info-support = <0>;
		lcd-kit,oem-barcode-2d-support = <0>;
		lcd-kit,dirty-region-support = <0>;
		lcd-kit,dirty-left-align = <0xffff>;
		lcd-kit,dirty-right-align = <0xffff>;
		lcd-kit,dirty-top-align = <8>;
		lcd-kit,dirty-bott-align = <0xffff>;
		lcd-kit,dirty-width-align = <0xffff>;
		lcd-kit,dirty-height-align = <8>;
		lcd-kit,dirty-width-min = <2160>;
		lcd-kit,dirty-height-min = <8>;
		lcd-kit,dirty-top-start = <0xffff>;
		lcd-kit,dirty-bott-start = <0xffff>;
		lcd-kit,panel-bl-type = <8>;
		lcd-kit,panel-bl-min = <15>;
		lcd-kit,panel-bl-max = <4095>;
		lcd-kit,panel-bl-def = <2000>;
		lcd-kit,panel-bl-ic-ctrl-type = <1>;
		lcd-kit,h-back-porch = <4>;
		lcd-kit,h-front-porch = <655>;
		lcd-kit,ldi-dpi0-overlap-size = <0>;
		lcd-kit,ldi-dpi1-overlap-size = <0>;
		lcd-kit,h-pulse-width = <4>;
		lcd-kit,v-back-porch = <64>;
		lcd-kit,v-front-porch = <16>;
		lcd-kit,v-pulse-width = <16>;
		lcd-kit,ldi-hsync-plr = <0>;
		lcd-kit,ldi-vsync-plr = <0>;
		lcd-kit,ldi-pixel-clk-plr = <0>;
		lcd-kit,ldi-data-en-plr = <0>;
		lcd-kit,ldi-dpi-a-overlap-size = <0>;
		lcd-kit,ldi-dpi-b-overlap-size = <0>;
		lcd-kit,mipi-dsi-upt-support = <0>;
		lcd-kit,mipi-lane-nums = <2>;
		lcd-kit,mipi-color-mode = <5>;
		lcd-kit,video-idle-mode-support = <0>;
		lcd-kit,mipi-vc = <0>;
		lcd-kit,mipi-dsi-bit-clk = <800>;
		lcd-kit,mipi-burst-mode = <0>;
		lcd-kit,mipi-max-tx-esc-clk = <10>;
		lcd-kit,mipi-dsi-bit-clk-val1 = <960>;
		lcd-kit,mipi-dsi-bit-clk-val2 = <960>;
		lcd-kit,mipi-dsi-bit-clk-val3 = <0>;
		lcd-kit,mipi-dsi-bit-clk-val4 = <0>;
		lcd-kit,mipi-dsi-bit-clk-val5 = <0>;
		lcd-kit,mipi-dsi-bit-clk-upt = <960>;
		lcd-kit,mipi-rg-vrefsel-vcm-adjust = <0>;
		lcd-kit,mipi-non-continue-enable = <1>;
		lcd-kit,mipi-clk-post-adjust = <0>;
		lcd-kit,mipi-lp11-flag = <0>;
		lcd-kit,mipi-phy-update = <1>;
		lcd-kit,mipi-clk-pre-adjust = <0>;
		lcd-kit,mipi-data-t-lpx-adjust = <0>;
		lcd-kit,mipi-phy-mode = <1>;
		lcd-kit,inversion-support = <0>;
		lcd-kit,scan-support = <0>;
		lcd-kit,check-reg-support = <0>;
		lcd-kit,check-reg-on-support = <1>;
		lcd-kit,check-reg-on-support-dsm-report = <0>;
		lcd-kit,check-reg-off-support = <1>;
		lcd-kit,dsi1-cmd-support = <0>;
		lcd-kit,check-reg-off-support-dsm-report = <0>;
		lcd-kit,mipi-check-support = <0>;
		lcd-kit,panel-mipi-error-report-threshold = <1>;
		lcd-kit,checksum-support = <0>;
		lcd-kit,current-det-support = <0>;
		lcd-kit,lv-det-support = <0>;
		lcd-kit,pt-support = <0>;
		lcd-kit,hkadc-support = <0>;
		lcd-kit,ldo-check-support = <0>;
		lcd-kit,Does-lcd-poweron-tp = <1>;
		lcd-kit,ldo-check-name = "ldo4";
		lcd-kit,ldo-check-channel = <0>;
		lcd-kit,ldo-check-threshold = <0>;
		status = "disabled";
		iovcc-supply = <&ldo4>;
		vdd-supply = <&ldo25>;
		vci-supply = <&ldo17>;
		lcd-kit,lcd-vci = <2 53 0>;
		lcd-kit,lcd-aod = <2 249 0>;
		lcd-kit,lcd-iovcc = <1 4 1850000>;
		lcd-kit,lcd-vdd = <1 25 1250000>;
		lcd-kit,lcd-vsp = <2 0 5500000>;
		lcd-kit,lcd-vsn = <2 0 5500000>;
		lcd-kit,lcd-reset = <2 8 0>;
		lcd-kit,tp-reset = <2 0 0>;
		lcd-kit,lcd-te0 = <2 3 0>;
		lcd-kit,lcd-backlight = <0 0 0>;
		lcd-kit,power-on-stage = <10 1 50
				2 1 10
				9 1 10
				1 1 10>;
		lcd-kit,lp-on-stage = <5 1 10
				5 0 10
                5 1 10
                7 1 0
				6 1 0
				8 1 0>;
		lcd-kit,hs-on-stage = <0 0 0>;
		lcd-kit,hs-off-stage = <10 0 0
				7 0 0
				6 0 0
				8 0 0>;
		lcd-kit,lp-off-stage = <0 0 0>;
		lcd-kit,power-off-stage = <5 0 10
				1 0 10
				9 0 10
				2 0 10>;
		lcd-kit,tp-color-support = <0>;
		lcd-kit,panel-bl-max-nit = <0>;
		lcd-kit,cabc-support = <0>;
		lcd-kit,rgbw-support = <0>;
		lcd-kit,blpwm-disable = <0>;
		lcd-kit,blpwm-div = <0>;
		lcd-kit,bl-work-delay-frame = <0>;
		lcd-kit,acl-support = <0>;
		lcd-kit,hbm-support = <0>;
		lcd-kit,hbm-special-bit-ctrl-support = <0>;
		lcd-kit,hbm-elvss-dim-support = <0>;
		lcd-kit,hbm-elvss-dim-cmd-delay = <0>;
		lcd-kit,hbm-set-elvss-dim-lp = <0>;
		lcd-kit,hbm-fp-support = <0>;
		lcd-kit,hbm-fp-prepare-support = <0>;
		lcd-kit,hbm-level-max = <0>;
		lcd-kit,vr-support = <0>;
		lcd-kit,gamma-cal-support = <0>;
		lcd-kit,sbl-support = <0>;
		lcd-kit,sbl-stren-limit = <128>;
		lcd-kit,sbl-cal-a = <60>;
		lcd-kit,sbl-cal-b = <95>;
		lcd-kit,sbl-cal-c = <5>;
		lcd-kit,sbl-cal-d = <1>;
		lcd-kit,sbl-tf-ctl = <5>;
		lcd-kit,sbl-bl-min = <480>;
		lcd-kit,sbl-bl-max = <4096>;
		lcd-kit,sbl-bl-scale = <0xff>;
		lcd-kit,sbl-am-light-min = <14>;
		lcd-kit,sbl-filter-a = <1738>;
		lcd-kit,sbl-filter-b = <6>;
		lcd-kit,sbl-logo-left = <0>;
		lcd-kit,sbl-logo-top = <0>;
		lcd-kit,sbl-variance-intensity-space = <145>;
		lcd-kit,sbl-slope-max = <54>;
		lcd-kit,sbl-slope-min = <160>;
		lcd-kit,brightness-color-uniform-support = <0>;
		lcd-kit,dbv-curve-mapped-support = <0>;
		lcd-kit,gamma-support = <0>;
		lcd-kit,cascade-ic-support = <0>;
		lcd-kit,otp-gamma-support = <0>;
		lcd-kit,pcd-cmds-support = <0>;
		lcd-kit,ce-support = <0>;
		lcd-kit,effect-on-support = <0>;
		lcd-kit,gmp-support = <0>;
		lcd-kit,color-temp-support = <0>;
		lcd-kit,color-temp-rectify-support = <0>;
		lcd-kit,hiace-support = <0>;
		lcd-kit,iglobal-hist-black-pos = <16>;
		lcd-kit,iglobal-hist-white-pos = <240>;
		lcd-kit,iglobal-hist-black-weight = <51>;
		lcd-kit,iglobal-hist-white-weight = <51>;
		lcd-kit,iglobal-hist-zero-cut-ratio = <486>;
		lcd-kit,iglobal-hist-slope-cut-ratio = <410>;
		lcd-kit,imax-lcd-luminance = <500>;
		lcd-kit,imin-lcd-luminance = <3>;
		lcd-kit,xcc-support = <0>;
		lcd-kit,comform-mode-support = <0>;
		lcd-kit,cinema-mode-support = <0>;
		lcd-kit,effect-color-support = <0>;
		lcd-kit,effect-color-mode = <0>;
		lcd-kit,prefix-ce-support = <0>;
		lcd-kit,arsr1p-sharpness-support = <0>;
		lcd-kit,prefix-sharp-1D-support = <0>;
		lcd-kit,prefix-sharp-2D-support = <0>;
		lcd-kit,smart-color-mode-support = <0>;
		lcd-kit,color-temp-rectify-r = <32768>;
		lcd-kit,color-temp-rectify-g = <32768>;
		lcd-kit,color-temp-rectify-b = <32768>;
		lcd-kit,acm-support = <0>;
		lcd-kit,acm-ce-support = <0>;
		lcd-kit,acm-valid-num = <7>;
		lcd-kit,r_hh0 = <0x7f>;
		lcd-kit,r_lh0 = <0xe>;
		lcd-kit,r_hh1 = <0xbe>;
		lcd-kit,r_lh1 = <0x80>;
		lcd-kit,r_hh2 = <0xff>;
		lcd-kit,r_lh2 = <0xbf>;
		lcd-kit,r_hh3 = <0x1c0>;
		lcd-kit,r_lh3 = <0x100>;
		lcd-kit,r_hh4 = <0x27f>;
		lcd-kit,r_lh4 = <0x1c1>;
		lcd-kit,r_hh5 = <0x323>;
		lcd-kit,r_lh5 = <0x280>;
		lcd-kit,r_hh6 = <0x381>;
		lcd-kit,r_lh6 = <0x324>;
		lcd-kit,r_video_hh0 = <0x7f>;
		lcd-kit,r_video_lh0 = <0xe>;
		lcd-kit,r_video_hh1 = <0xbe>;
		lcd-kit,r_video_lh1 = <0x80>;
		lcd-kit,r_video_hh2 = <0xff>;
		lcd-kit,r_video_lh2 = <0xbf>;
		lcd-kit,r_video_hh3 = <0x1c0>;
		lcd-kit,r_video_lh3 = <0x100>;
		lcd-kit,r_video_hh4 = <0x27f>;
		lcd-kit,r_video_lh4 = <0x1c1>;
		lcd-kit,r_video_hh5 = <0x323>;
		lcd-kit,r_video_lh5 = <0x280>;
		lcd-kit,r_video_hh6 = <0x381>;
		lcd-kit,r_video_lh6 = <0x324>;
		lcd-kit,check-thread-enable = <0>;
		lcd-kit,check-bl-support = <0>;
		lcd-kit,vss-support = <0>;
    };
};