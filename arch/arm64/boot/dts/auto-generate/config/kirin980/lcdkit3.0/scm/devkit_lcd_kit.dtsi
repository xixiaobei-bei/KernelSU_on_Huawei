/*---------------------------------------------------------------------------
 * This file is autogenerated file using huawei LCD parser. Please do not edit it.
 * Update input XML file to add a new entry or update variable in this file
 * Parser location: vendor/huawei/chipset_common/devkit/lcdkit/tools 
 *---------------------------------------------------------------------------*/


/include/ "scm_auo_otm1901a_5p2_1080p_video_default.dtsi"
/include/ "scm_boedvt2_nt35523_10p7_1600p_video.dtsi"
/include/ "scm_inx_nt35523_10p7_1600p_video.dtsi"