/* Copyright (c) 2013, The Linux Foundation. All rights reserved.
 *
 * This program is free software; you can redistribute it and/or modify
 * it under the terms of the GNU General Public License version 2 and
 * only version 2 as published by the Free Software Foundation.
 *
 * This program is distributed in the hope that it will be useful,
 * but WITHOUT ANY WARRANTY; without even the implied warranty of
 * MERCHANTABILITY or FITNESS FOR A PARTICULAR PURPOSE.  See the
 * GNU General Public License for more details.
 */

/*-------------------------------------------------------------------------
 * This file is autogenerated file using gcdb parser. Please do not edit it.
 * Update input XML file to add a new entry or update variable in this file
 * VERSION = 1.1
 *-----------------------------------------------------------------------*/
&huawei_lcd_config {
	dsi_pct_auo_nt36672a_pct_al10_6p4_1080p_video: lcd_kit_pct_auo_nt36672a_pct_al10_6p4_1080p_video {
		compatible = "auo_nt36672a_pct_al10_6p4_1080p_video";
		lcd-kit,panel-name = "AUO_NT36672A_PCT_AL10 6.4' VIDEO TFT 1080 x 2310";
		lcd-kit,panel-model = "PRCT_170 202 0 6.4' 2310 x 1080";
		lcd-kit,panel-type = <0x01>;
		lcd-kit,panel-xres = <1080>;
		lcd-kit,panel-yres = <2310>;
		lcd-kit,panel-width = <68>;
		lcd-kit,panel-height = <147>;
		lcd-kit,panel-on-cmds = <0x29 0x01 0x00 0x00 0x0a 0x00 0x02 0xFF 0x10
			0x29 0x01 0x00 0x00 0x0a 0x00 0x02 0xFB 0x01
			0x05 0x01 0x00 0x00 0x0a 0x01 0x02 0x11 0x00
			0x05 0x01 0x00 0x00 0x0a 0x00 0x02 0x29 0x00>;
		lcd-kit,panel-on-cmds-state = "dsi_lp_mode";
		lcd-kit,panel-off-cmds = <0x05 0x01 0x00 0x00 0x14 0x01 0x02 0x28 0x00
			0x05 0x01 0x00 0x00 0x32 0x01 0x02 0x10 0x00>;
		lcd-kit,panel-off-cmds-state = "dsi_lp_mode";
		lcd-kit,tp-color-cmds = <0x06 0x01 0x00 0x00 0x0a 0x00 0x01 0xda>;
		lcd-kit,esd-reg-cmds = <0x06 0x01 0x00 0x00 0x0a 0x00 0x01 0x0a>;
		lcd-kit,esd-reg-cmds-state = "dsi_lp_mode";
		lcd-kit,esd-value = <0x9c>;
		lcd-kit,check-reg-cmds = <0x06 0x01 0x00 0x00 0x0a 0x00 0x01 0x0a>;
		lcd-kit,check-reg-cmds-state = "dsi_lp_mode";
		lcd-kit,check-reg-value = <0x9c>;
		lcd-kit,project-id-cmds = <0x15 0x01 0x00 0x00 0x01 0x01 0x02 0xFF 0x21
				0x14 0x01 0x00 0x00 0x0a 0x00 0x09 0xf7 0x00 0x00 0x00 0x00 0x00 0x00 0x00 0x00
				0x15 0x01 0x00 0x00 0x01 0x01 0x02 0xFF 0x10>;
		lcd-kit,panel-bl-maxnit-command = <0x06 0x01 0x00 0x00 0x0a 0x00 0x01 0xdb>;
		lcd-kit,panel-bl-maxnit-command-state = "dsi_lp_mode";
		lcd-kit,pcd-errflag-check-support = <0>;
		lcd-kit,gpio-pcd = <0>;
		lcd-kit,gpio-errflag = <0>;
		lcd-kit,bkl-open-short-support = <>;
		lcd-kit,panel-orientation = <1>;
		lcd-kit,panel-bpp = <0>;
		lcd-kit,panel-bgr-fmt = <0>;
		lcd-kit,panel-getblmaxnit-type = <1>;
		lcd-kit,panel-cmd-type = <8>;
		lcd-kit,panel-pxl-clk = <185>;
		lcd-kit,panel-pxl-clk-div = <1>;
		lcd-kit,panel-vsyn-ctr-type = <0>;
		lcd-kit,panel-ifbc-type = <0>;
		lcd-kit,vesa-slice-width = <0>;
		lcd-kit,vesa-slice-height = <0>;
		lcd-kit,panel-frc-enable = <0>;
		lcd-kit,panel-esd-skip-mipi-check = <1>;
		lcd-kit,sensorhub-aod-support = <0>;
		lcd-kit,mask-delay-time-before-fp = <16666>;
		lcd-kit,mask-delay-time-after-fp = <16666>;
		lcd-kit,bl-delay-frame = <0>;
		lcd-kit,panel-version-support = <0>;
		lcd-kit,fps-support = <0>;
		lcd-kit,backlight-order = <0>;
		lcd-kit,backlight-precision = <0>;
		lcd-kit,quickly-sleep-out-support = <1>;
		lcd-kit,quickly-sleep-out-interval = <102>;
		lcd-kit,esd-support = <1>;
		lcd-kit,project-id-support = <1>;
		lcd-kit,oem-info-support = <0>;
		lcd-kit,oem-barcode-2d-support = <0>;
		lcd-kit,dirty-region-support = <0>;
		lcd-kit,dirty-left-align = <0xffff>;
		lcd-kit,dirty-right-align = <0xffff>;
		lcd-kit,dirty-top-align = <0xffff>;
		lcd-kit,dirty-bott-align = <0xffff>;
		lcd-kit,dirty-width-align = <0xffff>;
		lcd-kit,dirty-height-align = <0xffff>;
		lcd-kit,dirty-width-min = <0xffff>;
		lcd-kit,dirty-height-min = <0xffff>;
		lcd-kit,dirty-top-start = <0xffff>;
		lcd-kit,dirty-bott-start = <0xffff>;
		lcd-kit,panel-bl-type = <4>;
		lcd-kit,panel-bl-min = <100>;
		lcd-kit,panel-bl-max = <9260>;
		lcd-kit,panel-bl-def = <4000>;
		lcd-kit,panel-bl-pwm-preci-type = <1>;
		lcd-kit,panel-bl-ic-ctrl-type = <6>;
		lcd-kit,h-back-porch = <20>;
		lcd-kit,h-front-porch = <184>;
		lcd-kit,h-pulse-width = <6>;
		lcd-kit,v-back-porch = <54>;
		lcd-kit,v-front-porch = <7>;
		lcd-kit,v-pulse-width = <10>;
		lcd-kit,ldi-hsync-plr = <0>;
		lcd-kit,ldi-vsync-plr = <0>;
		lcd-kit,ldi-pixel-clk-plr = <0>;
		lcd-kit,ldi-data-en-plr = <0>;
		lcd-kit,ldi-dpi-a-overlap-size = <0>;
		lcd-kit,ldi-dpi-b-overlap-size = <0>;
		lcd-kit,mipi-dsi-upt-support = <0>;
		lcd-kit,mipi-lane-nums = <3>;
		lcd-kit,mipi-color-mode = <5>;
		lcd-kit,mipi-vc = <0>;
		lcd-kit,mipi-dsi-bit-clk = <538>;
		lcd-kit,mipi-burst-mode = <2>;
		lcd-kit,mipi-max-tx-esc-clk = <10>;
		lcd-kit,mipi-dsi-bit-clk-val1 = <0>;
		lcd-kit,mipi-dsi-bit-clk-val2 = <0>;
		lcd-kit,mipi-dsi-bit-clk-val3 = <0>;
		lcd-kit,mipi-dsi-bit-clk-val4 = <0>;
		lcd-kit,mipi-dsi-bit-clk-val5 = <0>;
		lcd-kit,mipi-rg-vrefsel-vcm-adjust = <0>;
		lcd-kit,mipi-non-continue-enable = <0>;
		lcd-kit,mipi-clk-post-adjust = <0>;
		lcd-kit,mipi-lp11-flag = <1>;
		lcd-kit,mipi-phy-update = <1>;
		lcd-kit,mipi-clk-pre-adjust = <0>;
		lcd-kit,mipi-data-t-lpx-adjust = <0>;
		lcd-kit,mipi-phy-mode = <0>;
		lcd-kit,inversion-support = <0>;
		lcd-kit,scan-support = <0>;
		lcd-kit,check-reg-support = <1>;
		lcd-kit,checksum-support = <0>;
		lcd-kit,current-det-support = <0>;
		lcd-kit,lv-det-support = <0>;
		lcd-kit,pt-support = <1>;
		lcd-kit,hkadc-support = <0>;
		lcd-kit,ldo-check-support = <1>;
		lcd-kit,Does-lcd-poweron-tp = <1>;
		lcd-kit,ldo-check-name = "ldo4";
		lcd-kit,ldo-check-channel = <2>;
		lcd-kit,ldo-check-threshold = <250>;
		status = "disabled";
		iovcc-supply = <&ldo4>;
		vdd-supply = <&ldo25>;
		vci-supply = <&ldo17>;
		lcd-kit,lcd-vci = <1 0 0>;
		lcd-kit,lcd-iovcc = <1 4 1850000>;
		lcd-kit,lcd-vdd = <1 0 0>;
		lcd-kit,lcd-vsp = <2 195 5500000>;
		lcd-kit,lcd-vsn = <2 222 5500000>;
		lcd-kit,lcd-reset = <2 13 0>;
		lcd-kit,tp-reset = <2 15 0>;
		lcd-kit,lcd-te0 = <2 3 0>;
		lcd-kit,lcd-backlight = <2 0 0>;
		lcd-kit,power-on-stage = <2 1 11
				3 1 10
				4 1 12>;
		lcd-kit,lp-on-stage = <0 1 10
				7 1 0
				5 1 6
				5 0 1
				5 1 15
				6 1 0>;
		lcd-kit,hs-on-stage = <8 1 0>;
		lcd-kit,hs-off-stage = <6 0 0
				7 0 5
				8 0 0>;
		lcd-kit,lp-off-stage = <0 0 0>;
		lcd-kit,power-off-stage = <0 0 5
				5 0 5
				4 0 5
				3 0 5
				2 0 10>;
		lcd-kit,tp-color-support = <1>;
		lcd-kit,panel-bl-max-nit = <500>;
		lcd-kit,cabc-support = <1>;
		lcd-kit,rgbw-support = <0>;
		lcd-kit,blpwm-disable = <1>;
		lcd-kit,blpwm-div = <0>;
		lcd-kit,acl-support = <0>;
		lcd-kit,hbm-support = <0>;
		lcd-kit,hbm-fp-support = <0>;
		lcd-kit,hbm-level-max = <0>;
		lcd-kit,vr-support = <0>;
		lcd-kit,gamma-cal-support = <1>;
		lcd-kit,sbl-support = <0>;
		lcd-kit,sbl-stren-limit = <128>;
		lcd-kit,sbl-cal-a = <60>;
		lcd-kit,sbl-cal-b = <95>;
		lcd-kit,sbl-cal-c = <5>;
		lcd-kit,sbl-cal-d = <1>;
		lcd-kit,sbl-tf-ctl = <5>;
		lcd-kit,sbl-bl-min = <480>;
		lcd-kit,sbl-bl-max = <4096>;
		lcd-kit,sbl-bl-scale = <0xff>;
		lcd-kit,sbl-am-light-min = <14>;
		lcd-kit,sbl-filter-a = <1738>;
		lcd-kit,sbl-filter-b = <6>;
		lcd-kit,sbl-logo-left = <0>;
		lcd-kit,sbl-logo-top = <0>;
		lcd-kit,sbl-variance-intensity-space = <145>;
		lcd-kit,sbl-slope-max = <54>;
		lcd-kit,sbl-slope-min = <160>;
		lcd-kit,brightness-color-uniform-support = <0>;
		lcd-kit,dbv-curve-mapped-support = <0>;
		lcd-kit,gamma-support = <1>;
		lcd-kit,otp-gamma-support = <0>;
		lcd-kit,ce-support = <0>;
		lcd-kit,effect-on-support = <0>;
		lcd-kit,gmp-support = <1>;
		lcd-kit,color-temp-support = <1>;
		lcd-kit,color-temp-rectify-support = <0>;
		lcd-kit,hiace-support = <1>;
		lcd-kit,iglobal-hist-black-pos = <16>;
		lcd-kit,iglobal-hist-white-pos = <240>;
		lcd-kit,iglobal-hist-black-weight = <51>;
		lcd-kit,iglobal-hist-white-weight = <51>;
		lcd-kit,iglobal-hist-zero-cut-ratio = <486>;
		lcd-kit,iglobal-hist-slope-cut-ratio = <410>;
		lcd-kit,imax-lcd-luminance = <500>;
		lcd-kit,imin-lcd-luminance = <3>;
		lcd-kit,xcc-support = <1>;
		lcd-kit,comform-mode-support = <1>;
		lcd-kit,cinema-mode-support = <0>;
		lcd-kit,effect-color-support = <0>;
		lcd-kit,effect-color-mode = <0>;
		lcd-kit,prefix-ce-support = <0>;
		lcd-kit,arsr1p-sharpness-support = <1>;
		lcd-kit,prefix-sharp-1D-support = <0>;
		lcd-kit,prefix-sharp-2D-support = <1>;
		lcd-kit,smart-color-mode-support = <0>;
		lcd-kit,color-temp-rectify-r = <32768>;
		lcd-kit,color-temp-rectify-g = <32768>;
		lcd-kit,color-temp-rectify-b = <32768>;
		lcd-kit,acm-support = <0>;
		lcd-kit,acm-ce-support = <0>;
		lcd-kit,acm-valid-num = <7>;
		lcd-kit,r_hh0 = <0x7f>;
		lcd-kit,r_lh0 = <0xe>;
		lcd-kit,r_hh1 = <0xbe>;
		lcd-kit,r_lh1 = <0x80>;
		lcd-kit,r_hh2 = <0xff>;
		lcd-kit,r_lh2 = <0xbf>;
		lcd-kit,r_hh3 = <0x1c0>;
		lcd-kit,r_lh3 = <0x100>;
		lcd-kit,r_hh4 = <0x27f>;
		lcd-kit,r_lh4 = <0x1c1>;
		lcd-kit,r_hh5 = <0x323>;
		lcd-kit,r_lh5 = <0x280>;
		lcd-kit,r_hh6 = <0x381>;
		lcd-kit,r_lh6 = <0x324>;
		lcd-kit,r_video_hh0 = <0x7f>;
		lcd-kit,r_video_lh0 = <0xe>;
		lcd-kit,r_video_hh1 = <0xbe>;
		lcd-kit,r_video_lh1 = <0x80>;
		lcd-kit,r_video_hh2 = <0xff>;
		lcd-kit,r_video_lh2 = <0xbf>;
		lcd-kit,r_video_hh3 = <0x1c0>;
		lcd-kit,r_video_lh3 = <0x100>;
		lcd-kit,r_video_hh4 = <0x27f>;
		lcd-kit,r_video_lh4 = <0x1c1>;
		lcd-kit,r_video_hh5 = <0x323>;
		lcd-kit,r_video_lh5 = <0x280>;
		lcd-kit,r_video_hh6 = <0x381>;
		lcd-kit,r_video_lh6 = <0x324>;
		lcd-kit,check-thread-enable = <0>;
		lcd-kit,check-bl-support = <0>;
		lcd-kit,vss-support = <0>;
    };
};