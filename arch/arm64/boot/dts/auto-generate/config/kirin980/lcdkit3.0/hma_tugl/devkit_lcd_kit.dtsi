/*---------------------------------------------------------------------------
 * This file is autogenerated file using huawei LCD parser. Please do not edit it.
 * Update input XML file to add a new entry or update variable in this file
 * Parser location: vendor/huawei/chipset_common/devkit/lcdkit/tools 
 *---------------------------------------------------------------------------*/


/include/ "hma_tugl_auo_otm1901a_5p2_1080p_video_default.dtsi"
/include/ "hma_tugl_boe_hx83112e_hma_6p53_1080plus_cmd.dtsi"
/include/ "hma_tugl_jdi_td4336_hma_6p53_1080plus_cmd.dtsi"
/include/ "hma_tugl_jdi_td4336_hma_v2_6p53_1080plus_cmd.dtsi"
/include/ "hma_tugl_lg_nt36772a_hma_6p53_1080plus_cmd.dtsi"
/include/ "hma_tugl_lg_nt36772a_hma_v2_6p53_1080plus_cmd.dtsi"
/include/ "hma_tugl_samsung_ea8074_6p01_1080plus_cmd.dtsi"
/include/ "hma_tugl_samsung_v2_ea8074_6p01_1080plus_cmd.dtsi"
/include/ "hma_tugl_sharp_td4336_hma_6p53_1080plus_cmd.dtsi"
/include/ "hma_tugl_sharp_td4336_hma_v2_6p53_1080plus_cmd.dtsi"