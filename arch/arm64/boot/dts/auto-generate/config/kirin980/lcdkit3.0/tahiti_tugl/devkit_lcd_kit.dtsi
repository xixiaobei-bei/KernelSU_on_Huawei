/*---------------------------------------------------------------------------
 * This file is autogenerated file using huawei LCD parser. Please do not edit it.
 * Update input XML file to add a new entry or update variable in this file
 * Parser location: vendor/huawei/chipset_common/devkit/lcdkit/tools 
 *---------------------------------------------------------------------------*/


/include/ "tahiti_tugl_auo_otm1901a_5p2_1080p_video_default.dtsi"
/include/ "tahiti_tugl_boe_3lane_nt37700f_8p03_2mux_cmd.dtsi"
/include/ "tahiti_tugl_boe_nt37800f_tah_8p03_3lane_2mux_cmd.dtsi"