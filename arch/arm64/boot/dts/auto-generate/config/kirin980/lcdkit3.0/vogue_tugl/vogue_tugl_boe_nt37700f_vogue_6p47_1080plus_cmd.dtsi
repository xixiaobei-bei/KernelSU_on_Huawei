/* Copyright (c) 2013, The Linux Foundation. All rights reserved.
 *
 * This program is free software; you can redistribute it and/or modify
 * it under the terms of the GNU General Public License version 2 and
 * only version 2 as published by the Free Software Foundation.
 *
 * This program is distributed in the hope that it will be useful,
 * but WITHOUT ANY WARRANTY; without even the implied warranty of
 * MERCHANTABILITY or FITNESS FOR A PARTICULAR PURPOSE.  See the
 * GNU General Public License for more details.
 */

/*-------------------------------------------------------------------------
 * This file is autogenerated file using gcdb parser. Please do not edit it.
 * Update input XML file to add a new entry or update variable in this file
 * VERSION = 1.1
 *-----------------------------------------------------------------------*/
&huawei_lcd_config {
	dsi_vogue_tugl_boe_nt37700f_vogue_6p47_1080plus_cmd: lcd_kit_vogue_tugl_boe_nt37700f_vogue_6p47_1080plus_cmd {
		compatible = "boe_nt37700f_vogue_6p47_1080plus_cmd";
		lcd-kit,panel-name = "BOE_NT37700F_VOGUE 6'47 CMD TFT 1080 x 2340";
		lcd-kit,panel-type = <0x02>;
		lcd-kit,panel-xres = <1080>;
		lcd-kit,panel-yres = <2340>;
		lcd-kit,panel-width = <69>;
		lcd-kit,panel-height = <149>;
		lcd-kit,panel-enter-aod-cmds = <0x39 0x01 0x00 0x00 0x0a 0x00 0x03 0x51 0x00 0x00
			0x05 0x01 0x00 0x00 0x0a 0x00 0x01 0x39
			0x15 0x01 0x00 0x00 0x0a 0x00 0x02 0x65 0x01>;
		lcd-kit,panel-exit-aod-cmds = <0x39 0x01 0x00 0x00 0x0a 0x00 0x03 0x51 0x00 0x00
			0x05 0x01 0x00 0x00 0x0a 0x00 0x01 0x38
			0x15 0x01 0x00 0x00 0x0a 0x00 0x02 0x65 0x00>;
		lcd-kit,panel-aod-high-brightness-cmds = <0x39 0x01 0x00 0x00 0x0a 0x00 0x06 0xF0 0x55 0xAA 0x52 0x08 0x00
			0x15 0x01 0x00 0x00 0x0a 0x00 0x02 0x6F 0x09
			0x15 0x01 0x00 0x00 0x0a 0x00 0x02 0xB4 0x00
			0x15 0x01 0x00 0x00 0x0a 0x00 0x02 0x6F 0x1D
			0x15 0x01 0x00 0x00 0x0a 0x00 0x02 0xB4 0x0E>;
		lcd-kit,panel-aod-low-brightness-cmds = <0x39 0x01 0x00 0x00 0x0a 0x00 0x06 0xF0 0x55 0xAA 0x52 0x08 0x00
			0x15 0x01 0x00 0x00 0x0a 0x00 0x02 0x6F 0x09
			0x15 0x01 0x00 0x00 0x0a 0x00 0x02 0xB4 0x07
			0x15 0x01 0x00 0x00 0x0a 0x00 0x02 0x6F 0x1D
			0x15 0x01 0x00 0x00 0x0a 0x00 0x02 0xB4 0x7A>;
		lcd-kit,panel-on-cmds = <0x05 0x01 0x00 0x00 0x0a 0x00 0x01 0x35
			0x15 0x01 0x00 0x00 0x0a 0x00 0x02 0x36 0x40
			0x39 0x01 0x00 0x00 0x0a 0x00 0x05 0x3B 0x00 0x04 0x00 0x04
			0x15 0x01 0x00 0x00 0x0a 0x00 0x02 0x53 0x20
			0x39 0x01 0x00 0x00 0x0a 0x00 0x03 0x51 0x00 0x00
			0x15 0x01 0x00 0x00 0x0a 0x00 0x02 0x90 0x01
			0x39 0x01 0x00 0x00 0x0a 0x00 0x05 0x2A 0x00 0x00 0x04 0x37
			0x39 0x01 0x00 0x00 0x0a 0x00 0x05 0x2B 0x00 0x00 0x09 0x23
			0x39 0x01 0x00 0x00 0x0a 0x00 0x06 0xF0 0x55 0xAA 0x52 0x08 0x01
			0x39 0x01 0x00 0x00 0x0a 0x00 0x03 0xCD 0x04 0x62
			0x39 0x01 0x00 0x00 0x0a 0x00 0x05 0xD2 0x10 0x40 0x30 0x70
			0x39 0x01 0x00 0x00 0x0a 0x00 0x03 0xD0 0xEC 0xF0
			0x39 0x01 0x00 0x00 0x0a 0x00 0x04 0xCE 0x0C 0x2C 0x01
			0x39 0x01 0x00 0x00 0x0a 0x00 0x06 0xF0 0x55 0xAA 0x52 0x08 0x00
			0x39 0x01 0x00 0x00 0x0a 0x00 0x03 0xBA 0x02 0x99
			0x39 0x01 0x00 0x00 0x0a 0x00 0x03 0xB5 0x84 0x00
			0x39 0x01 0x00 0x00 0x0a 0x00 0x06 0xF0 0x55 0xAA 0x52 0x08 0x00
			0x39 0x01 0x00 0x00 0x0a 0x00 0x05 0xB2 0x01 0x63 0x20 0x20
			0x15 0x01 0x00 0x00 0x0a 0x00 0x02 0x6F 0x09
			0x39 0x01 0x00 0x00 0x0a 0x00 0x03 0xB2 0x20 0x30
			0x39 0x01 0x00 0x00 0x0a 0x00 0x06 0xF0 0x55 0xAA 0x52 0x08 0x07
			0x15 0x01 0x00 0x00 0x0a 0x00 0x02 0xC0 0x00
			0x39 0x01 0x00 0x00 0x0a 0x00 0x05 0xFF 0xAA 0x55 0xA5 0x81
			0x15 0x01 0x00 0x00 0x0a 0x00 0x02 0x6F 0x0D
			0x15 0x01 0x00 0x00 0x0a 0x00 0x02 0xF3 0xAB
			0x39 0x01 0x00 0x00 0x0a 0x00 0x03 0x44 0x08 0xE4
			0x05 0x01 0x00 0x00 0x78 0x01 0x01 0x11
			0x05 0x01 0x00 0x00 0x0a 0x00 0x01 0x29>;
		lcd-kit,panel-off-cmds = <0x39 0x01 0x00 0x00 0x0a 0x00 0x06 0xF0 0x55 0xAA 0x52 0x08 0x00
			0x39 0x01 0x00 0x00 0x0a 0x00 0x09 0xB5 0x80 0x00 0x25 0x00 0x00 0x7F 0x4B 0x50
			0x05 0x01 0x00 0x00 0x0a 0x00 0x01 0x28
			0x05 0x01 0x00 0x00 0x78 0x01 0x01 0x10>;
		lcd-kit,backlight-cmds = <0x39 0x01 0x00 0x00 0x00 0x00 0x03 0x51 0x00 0x00>;
		lcd-kit,panel-hbm-fp-prepare-cmds = <0x29 0x01 0x00 0x00 0x0a 0x00 0x06 0xF0 0x55 0xAA 0x52 0x08 0x00
			0x29 0x01 0x00 0x00 0x0a 0x00 0x03 0xB2 0x00 0x00
			0x15 0x01 0x00 0x00 0x0a 0x00 0x02 0x6F 0x09
			0x29 0x01 0x00 0x00 0x0a 0x00 0x03 0xB2 0x20 0x00>;
		lcd-kit,panel-hbm-fp-prepare-cmds-state = "dsi_lp_mode";
		lcd-kit,panel-hbm-fp-prepare-cmds-vn1 = <0x29 0x01 0x00 0x00 0x0a 0x00 0x06 0xF0 0x55 0xAA 0x52 0x08 0x00
			0x15 0x01 0x00 0x00 0x0a 0x00 0x02 0x6F 0x09
			0x29 0x01 0x00 0x00 0x0a 0x00 0x03 0xB2 0x20 0x00
			0x15 0x01 0x00 0x00 0x0a 0x00 0x02 0x6F 0x14
			0x29 0x01 0x00 0x00 0x0a 0x00 0x0B 0xB4 0xD5 0xD5 0x75 0x75 0xFE 0xFE 0x30 0x30 0x30 0x30>;
		lcd-kit,panel-hbm-fp-prepare-cmds-vn1-state = "dsi_lp_mode";
		lcd-kit,panel-hbm-fp-post-cmds = <0x29 0x01 0x00 0x00 0x0a 0x00 0x06 0xF0 0x55 0xAA 0x52 0x08 0x00
			0x29 0x01 0x00 0x00 0x0a 0x00 0x03 0xB2 0x01 0x60
			0x15 0x01 0x00 0x00 0x0a 0x00 0x02 0x6F 0x09
			0x29 0x01 0x00 0x00 0x0a 0x00 0x03 0xB2 0x20 0x60>;
		lcd-kit,panel-hbm-fp-post-cmds-state = "dsi_lp_mode";
		lcd-kit,panel-hbm-fp-post-cmds-vn1 = <0x29 0x01 0x00 0x00 0x0a 0x00 0x06 0xF0 0x55 0xAA 0x52 0x08 0x00
			0x15 0x01 0x00 0x00 0x0a 0x00 0x02 0x6F 0x09
			0x29 0x01 0x00 0x00 0x0a 0x00 0x03 0xB2 0x20 0x30
			0x15 0x01 0x00 0x00 0x0a 0x00 0x02 0x6F 0x14
			0x29 0x01 0x00 0x00 0x0a 0x00 0x0B 0xB4 0xD5 0xD5 0x75 0x75 0xFE 0xFE 0x0E 0x0E 0x0E 0x0E>;
		lcd-kit,panel-hbm-fp-post-cmds-vn1-state = "dsi_lp_mode";
		lcd-kit,tp-color-cmds = <0x39 0x01 0x00 0x00 0x0a 0x00 0x06 0xF0 0x55 0xAA 0x52 0x08 0x01
			0x06 0x01 0x00 0x00 0x0a 0x00 0x01 0xbe>;
		lcd-kit,ce-off-cmds = <>;
		lcd-kit,ce-srgb-cmds = <>;
		lcd-kit,ce-user-cmds = <>;
		lcd-kit,ce-vivid-cmds = <>;
		lcd-kit,esd-reg-cmds = <0x06 0x01 0x00 0x00 0x0a 0x00 0x01 0x0a>;
		lcd-kit,esd-value = <0x9c>;
		lcd-kit,check-reg-cmds = <0x06 0x01 0x00 0x00 0x0a 0x00 0x01 0x0a>;
		lcd-kit,pcd-check-reg-cmds = <0x00>;
		lcd-kit,check-reg-value = <0x9c>;
		lcd-kit,check-reg-on-cmds = <0x06 0x01 0x00 0x00 0x0a 0x00 0x01 0x0a>;
		lcd-kit,check-reg-on-value = <0x9c>;
		lcd-kit,pcd-check-reg-value = <0x00>;
		lcd-kit,check-reg-off-cmds = <0x06 0x01 0x00 0x00 0x0a 0x00 0x01 0x0a>;
		lcd-kit,check-reg-off-value = <0x08>;
		lcd-kit,barcode-2d-cmds = <0x39 0x01 0x00 0x00 0x0a 0x00 0x06 0xF0 0x55 0xAA 0x52 0x08 0x01
			0x14 0x01 0x00 0x00 0x0a 0x00 0x08 0xD6 0x00 0x00 0x00 0x00 0x00 0x00 0x00
			0x14 0x01 0x00 0x00 0x0a 0x00 0x06 0xBF 0x00 0x00 0x00 0x00 0x00
			0x14 0x01 0x00 0x00 0x0a 0x00 0x08 0xD7 0x00 0x00 0x00 0x00 0x00 0x00 0x00>;
		lcd-kit,pcd-errflag-check-support = <1>;
		lcd-kit,gpio-pcd = <0>;
		lcd-kit,gpio-errflag = <0>;
		lcd-kit,bkl-open-short-support = <>;
		lcd-kit,checksum-enable-cmds = <0x29 0x01 0x00 0x00 0x0a 0x00 0x05 0xFF 0xAA 0x55 0xA5 0x80
			0x15 0x01 0x00 0x00 0x0a 0x00 0x02 0xF6 0x21
			0x15 0x01 0x00 0x00 0x0a 0x00 0x02 0x6F 0x01>;
		lcd-kit,checksum-enable-cmds-state = "dsi_lp_mode";
		lcd-kit,checksum-disable-cmds = <0x15 0x01 0x00 0x00 0x0a 0x00 0x02 0xF6 0x00>;
		lcd-kit,checksum-disable-cmds-state = "dsi_lp_mode";
		lcd-kit,checksum-cmds = <0x06 0x01 0x00 0x00 0x0a 0x00 0x08 0xF6 0x00 0x00 0x00 0x00 0x00 0x00 0x00>;
		lcd-kit,checksum-cmds-state = "dsi_lp_mode";
		lcd-kit,logo-checksum-value = <0x23 0x8c 0x40 0x30 0x0A 0x55 0x90 0xAC>;
		lcd-kit,panel-version = "V3","V4","VN1","VN2","VN2";
		lcd-kit,panel-version-enter-cmds = <0x39 0x01 0x00 0x00 0x0a 0x00 0x06 0xF0 0x55 0xAA 0x52 0x08 0x00>;
		lcd-kit,panel-fastboot-version = "V3,V4,VN1,VN2,VN2";
		lcd-kit,panel-version-cmds = <0x06 0x01 0x00 0x00 0x0a 0x00 0x05 0xB3 0x04 0x00 0x00 0x00>;
		lcd-kit,panel-version-value = <0xc8
			0x2c
			0x10
			0x32
			0x33>;
		lcd-kit,dirty-region-cmds = <0x39 0x01 0x00 0x00 0x05 0x00 0x05 0x2A 0x00 0x00 0x04 0x37
				0x39 0x01 0x00 0x00 0x05 0x00 0x05 0x2B 0x00 0x00 0x09 0x23>;
		lcd-kit,hbm-enter-cmds = <0x39 0x01 0x00 0x00 0x0a 0x00 0x03 0x51 0x0F 0xFF>;
		lcd-kit,hbm-cmds = <0x39 0x01 0x00 0x00 0x0a 0x00 0x03 0x51 0x00 0x00>;
		lcd-kit,hbm-exit-cmds = <0x39 0x01 0x00 0x00 0x0a 0x00 0x03 0x51 0x00 0x00>;
		lcd-kit,pcd-read-cmds = <0x06 0x01 0x00 0x00 0x0a 0x00 0x03 0xD0 0x00 0x00>;
		lcd-kit,switch-page-cmds = <0x39 0x01 0x00 0x00 0x0a 0x00 0x06 0xF0 0x55 0xAA 0x52 0x08 0x01>;
		lcd-kit,panel-orientation = <1>;
		lcd-kit,panel-bpp = <0>;
		lcd-kit,panel-bgr-fmt = <0>;
		lcd-kit,panel-cmd-type = <16>;
		lcd-kit,panel-pxl-clk = <175>;
		lcd-kit,panel-pxl-clk-div = <1>;
		lcd-kit,panel-vsyn-ctr-type = <7>;
		lcd-kit,panel-ifbc-type = <0>;
		lcd-kit,vesa-slice-width = <0>;
		lcd-kit,vesa-slice-height = <0>;
		lcd-kit,panel-frc-enable = <0>;
		lcd-kit,panel-esd-skip-mipi-check = <1>;
		lcd-kit,sensorhub-aod-support = <1>;
		lcd-kit,mask-delay-time-before-fp = <16666>;
		lcd-kit,mask-delay-time-after-fp = <16666>;
		lcd-kit,bl-delay-frame = <0>;
		lcd-kit,panel-version-support = <1>;
		lcd-kit,fps-support = <0>;
		lcd-kit,backlight-order = <0>;
		lcd-kit,backlight-precision = <0>;
		lcd-kit,quickly-sleep-out-support = <0>;
		lcd-kit,quickly-sleep-out-interval = <0>;
		lcd-kit,esd-support = <1>;
		lcd-kit,project-id-support = <0>;
		lcd-kit,dpi01-set-change = <0>;
		lcd-kit,pxl-clk-to-pll2 = <0>;
		lcd-kit,oem-info-support = <1>;
		lcd-kit,oem-barcode-2d-support = <1>;
		lcd-kit,dirty-region-support = <1>;
		lcd-kit,dirty-left-align = <0xffff>;
		lcd-kit,dirty-right-align = <0xffff>;
		lcd-kit,dirty-top-align = <8>;
		lcd-kit,dirty-bott-align = <0xffff>;
		lcd-kit,dirty-width-align = <0xffff>;
		lcd-kit,dirty-height-align = <8>;
		lcd-kit,dirty-width-min = <1080>;
		lcd-kit,dirty-height-min = <8>;
		lcd-kit,dirty-top-start = <0xffff>;
		lcd-kit,dirty-bott-start = <0xffff>;
		lcd-kit,panel-bl-type = <8>;
		lcd-kit,panel-bl-min = <2>;
		lcd-kit,panel-bl-max = <4095>;
		lcd-kit,panel-bl-def = <640>;
		lcd-kit,panel-bl-ic-ctrl-type = <1>;
		lcd-kit,h-back-porch = <4>;
		lcd-kit,h-front-porch = <48>;
		lcd-kit,ldi-dpi0-overlap-size = <0>;
		lcd-kit,ldi-dpi1-overlap-size = <0>;
		lcd-kit,h-pulse-width = <12>;
		lcd-kit,v-back-porch = <57>;
		lcd-kit,v-front-porch = <4>;
		lcd-kit,v-pulse-width = <10>;
		lcd-kit,ldi-hsync-plr = <0>;
		lcd-kit,ldi-vsync-plr = <0>;
		lcd-kit,ldi-pixel-clk-plr = <0>;
		lcd-kit,ldi-data-en-plr = <0>;
		lcd-kit,ldi-dpi-a-overlap-size = <0>;
		lcd-kit,ldi-dpi-b-overlap-size = <0>;
		lcd-kit,mipi-dsi-upt-support = <0>;
		lcd-kit,mipi-lane-nums = <3>;
		lcd-kit,mipi-color-mode = <5>;
		lcd-kit,video-idle-mode-support = <0>;
		lcd-kit,mipi-vc = <0>;
		lcd-kit,mipi-dsi-bit-clk = <519>;
		lcd-kit,mipi-burst-mode = <0>;
		lcd-kit,mipi-max-tx-esc-clk = <10>;
		lcd-kit,mipi-dsi-bit-clk-val1 = <490>;
		lcd-kit,mipi-dsi-bit-clk-val2 = <500>;
		lcd-kit,mipi-dsi-bit-clk-val3 = <0>;
		lcd-kit,mipi-dsi-bit-clk-val4 = <0>;
		lcd-kit,mipi-dsi-bit-clk-val5 = <0>;
		lcd-kit,mipi-rg-vrefsel-vcm-adjust = <0>;
		lcd-kit,mipi-non-continue-enable = <1>;
		lcd-kit,mipi-clk-post-adjust = <60>;
		lcd-kit,mipi-lp11-flag = <0>;
		lcd-kit,mipi-phy-update = <1>;
		lcd-kit,mipi-clk-pre-adjust = <0>;
		lcd-kit,mipi-data-t-lpx-adjust = <0>;
		lcd-kit,mipi-phy-mode = <0>;
		lcd-kit,inversion-support = <0>;
		lcd-kit,scan-support = <0>;
		lcd-kit,check-reg-support = <0>;
		lcd-kit,check-reg-on-support = <1>;
		lcd-kit,check-reg-on-support-dsm-report = <0>;
		lcd-kit,check-reg-off-support = <1>;
		lcd-kit,dsi1-cmd-support = <0>;
		lcd-kit,check-reg-off-support-dsm-report = <0>;
		lcd-kit,mipi-check-support = <0>;
		lcd-kit,panel-mipi-error-report-threshold = <1>;
		lcd-kit,checksum-support = <0>;
		lcd-kit,logo-checksum-support = <1>;
		lcd-kit,current-det-support = <0>;
		lcd-kit,lv-det-support = <0>;
		lcd-kit,pt-support = <1>;
		lcd-kit,hkadc-support = <0>;
		lcd-kit,ldo-check-support = <1>;
		lcd-kit,Does-lcd-poweron-tp = <1>;
		lcd-kit,ldo-check-name = "ldo4";
		lcd-kit,ldo-check-channel = <2>;
		lcd-kit,ldo-check-threshold = <250>;
		status = "disabled";
		iovcc-supply = <&ldo4>;
		vdd-supply = <&ldo25>;
		vci-supply = <&ldo17>;
		lcd-kit,lcd-vci = <2 11 3100000>;
		lcd-kit,lcd-aod = <2 0 0>;
		lcd-kit,lcd-iovcc = <1 4 1850000>;
		lcd-kit,lcd-vdd = <1 25 1200000>;
		lcd-kit,lcd-vsp = <0 0 0>;
		lcd-kit,lcd-vsn = <0 0 0>;
		lcd-kit,lcd-reset = <2 51 0>;
		lcd-kit,tp-reset = <2 0 0>;
		lcd-kit,lcd-te0 = <2 3 0>;
		lcd-kit,lcd-backlight = <0 0 0>;
		lcd-kit,power-on-stage = <2 1 0
				9 1 1
				1 1 10>;
		lcd-kit,lp-on-stage = <5 1 10
				7 1 0
				6 1 0
				8 1 0>;
		lcd-kit,hs-on-stage = <0 0 0>;
		lcd-kit,hs-off-stage = <7 0 0
				6 0 0
				8 0 0>;
		lcd-kit,lp-off-stage = <0 0 0>;
		lcd-kit,power-off-stage = <5 0 0
				1 0 1
				9 0 0
				2 0 1>;
		lcd-kit,tp-color-support = <1>;
		lcd-kit,panel-bl-max-nit = <0>;
		lcd-kit,cabc-support = <0>;
		lcd-kit,rgbw-support = <0>;
		lcd-kit,blpwm-disable = <0>;
		lcd-kit,blpwm-div = <0>;
		lcd-kit,bl-work-delay-frame = <0>;
		lcd-kit,acl-support = <0>;
		lcd-kit,hbm-support = <1>;
		lcd-kit,hbm-special-bit-ctrl-support = <0>;
		lcd-kit,hbm-elvss-dim-support = <0>;
		lcd-kit,hbm-elvss-dim-cmd-delay = <0>;
		lcd-kit,hbm-set-elvss-dim-lp = <0>;
		lcd-kit,hbm-fp-support = <0>;
		lcd-kit,hbm-fp-prepare-support = <1>;
		lcd-kit,hbm-level-max = <1>;
		lcd-kit,vr-support = <0>;
		lcd-kit,gamma-cal-support = <1>;
		lcd-kit,sbl-support = <0>;
		lcd-kit,sbl-stren-limit = <128>;
		lcd-kit,sbl-cal-a = <60>;
		lcd-kit,sbl-cal-b = <95>;
		lcd-kit,sbl-cal-c = <5>;
		lcd-kit,sbl-cal-d = <1>;
		lcd-kit,sbl-tf-ctl = <5>;
		lcd-kit,sbl-bl-min = <480>;
		lcd-kit,sbl-bl-max = <4096>;
		lcd-kit,sbl-bl-scale = <0xff>;
		lcd-kit,sbl-am-light-min = <14>;
		lcd-kit,sbl-filter-a = <1738>;
		lcd-kit,sbl-filter-b = <6>;
		lcd-kit,sbl-logo-left = <0>;
		lcd-kit,sbl-logo-top = <0>;
		lcd-kit,sbl-variance-intensity-space = <145>;
		lcd-kit,sbl-slope-max = <54>;
		lcd-kit,sbl-slope-min = <160>;
		lcd-kit,brightness-color-uniform-support = <0>;
		lcd-kit,dbv-curve-mapped-support = <0>;
		lcd-kit,gamma-support = <1>;
		lcd-kit,cascade-ic-support = <0>;
		lcd-kit,otp-gamma-support = <0>;
		lcd-kit,pcd-cmds-support = <1>;
		lcd-kit,ce-support = <0>;
		lcd-kit,effect-on-support = <0>;
		lcd-kit,gmp-support = <1>;
		lcd-kit,color-temp-support = <0>;
		lcd-kit,color-temp-rectify-support = <0>;
		lcd-kit,hiace-support = <1>;
		lcd-kit,iglobal-hist-black-pos = <16>;
		lcd-kit,iglobal-hist-white-pos = <240>;
		lcd-kit,iglobal-hist-black-weight = <51>;
		lcd-kit,iglobal-hist-white-weight = <51>;
		lcd-kit,iglobal-hist-zero-cut-ratio = <486>;
		lcd-kit,iglobal-hist-slope-cut-ratio = <410>;
		lcd-kit,imax-lcd-luminance = <500>;
		lcd-kit,imin-lcd-luminance = <3>;
		lcd-kit,xcc-support = <1>;
		lcd-kit,comform-mode-support = <0>;
		lcd-kit,cinema-mode-support = <0>;
		lcd-kit,effect-color-support = <1>;
		lcd-kit,effect-color-mode = <2147483648>;
		lcd-kit,prefix-ce-support = <0>;
		lcd-kit,arsr1p-sharpness-support = <1>;
		lcd-kit,prefix-sharp-1D-support = <0>;
		lcd-kit,prefix-sharp-2D-support = <1>;
		lcd-kit,smart-color-mode-support = <0>;
		lcd-kit,color-temp-rectify-r = <32768>;
		lcd-kit,color-temp-rectify-g = <32768>;
		lcd-kit,color-temp-rectify-b = <32768>;
		lcd-kit,acm-support = <0>;
		lcd-kit,acm-ce-support = <0>;
		lcd-kit,acm-valid-num = <7>;
		lcd-kit,r_hh0 = <0x7f>;
		lcd-kit,r_lh0 = <0xe>;
		lcd-kit,r_hh1 = <0xbe>;
		lcd-kit,r_lh1 = <0x80>;
		lcd-kit,r_hh2 = <0xff>;
		lcd-kit,r_lh2 = <0xbf>;
		lcd-kit,r_hh3 = <0x1c0>;
		lcd-kit,r_lh3 = <0x100>;
		lcd-kit,r_hh4 = <0x27f>;
		lcd-kit,r_lh4 = <0x1c1>;
		lcd-kit,r_hh5 = <0x323>;
		lcd-kit,r_lh5 = <0x280>;
		lcd-kit,r_hh6 = <0x381>;
		lcd-kit,r_lh6 = <0x324>;
		lcd-kit,r_video_hh0 = <0x7f>;
		lcd-kit,r_video_lh0 = <0xe>;
		lcd-kit,r_video_hh1 = <0xbe>;
		lcd-kit,r_video_lh1 = <0x80>;
		lcd-kit,r_video_hh2 = <0xff>;
		lcd-kit,r_video_lh2 = <0xbf>;
		lcd-kit,r_video_hh3 = <0x1c0>;
		lcd-kit,r_video_lh3 = <0x100>;
		lcd-kit,r_video_hh4 = <0x27f>;
		lcd-kit,r_video_lh4 = <0x1c1>;
		lcd-kit,r_video_hh5 = <0x323>;
		lcd-kit,r_video_lh5 = <0x280>;
		lcd-kit,r_video_hh6 = <0x381>;
		lcd-kit,r_video_lh6 = <0x324>;
		lcd-kit,check-thread-enable = <0>;
		lcd-kit,check-bl-support = <0>;
		lcd-kit,vss-support = <0>;
    };
};