/*---------------------------------------------------------------------------
 * This file is autogenerated file using huawei LCD parser. Please do not edit it.
 * Update input XML file to add a new entry or update variable in this file
 * Parser location: vendor/huawei/chipset_common/devkit/lcdkit/tools 
 *---------------------------------------------------------------------------*/


/include/ "tny_auo_otm1901a_5p2_1080p_video_default.dtsi"
/include/ "tny_samsung_ea8076_6p39_1080plus_cmd.dtsi"
/include/ "tny_samsung_ea8076_v4_6p39_1080plus_cmd.dtsi"