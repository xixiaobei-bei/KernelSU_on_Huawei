/*
 * Hisilicon Ltd.
 *
 * It is only a demo for hisilicon balong modem board. You show change the
 * address of each node according to datasheet.
 */

/ {
	modem_aslr:modem_aslr{
		compatible = "hisilicon,modem_aslr";
		enabled = <1>;
		status = "ok";
	};
};
