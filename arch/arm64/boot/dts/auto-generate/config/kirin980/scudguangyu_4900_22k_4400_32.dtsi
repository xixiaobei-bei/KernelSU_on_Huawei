/* DO NOT EDIT - Automatically generated by python */
/ {
		scudguangyu_4900_22k_4400_32:scudguangyu_4900_22k_4400_32 {
			fcc = <4900>;
			default_rbatt_mohm = <100>;
			identify_type = "id_volt";
			id_identify_min = <751>;
			id_identify_max = <1235>;
			id_voltage_min = <939>;
			id_voltage_max = <1059>;
			vbat_max = <4400>;
			temp_para = 
						"-32767","0","-1","0","4100","0",
						"0","5","-1","490","4400","0",
						"5","10","-1","1470","4400","3",
						"10","45","-1","-1","4400","3",
						"45","50","-1","1715","4100","3",
						"50","32767","-1","0","4100","0";
			vbat_para = 
						"-32767","3400","-1","820","0",
						"3400","32767","-1","-1","0";
			segment_para = 
						"-32767","4150","4900","4208","50",
						"4150","4450","3430","4400","0";
			batt_brand = "scudguangyu";
			fcc_temp = <4932 4922 4920 4901 4888 4843>;
			fcc_sf_x = <0 100 200 300 400 500 600 700 800 1000 1500>;
			fcc_sf_y = <100 96 94 92 90 88 87 84 81 75 50>;
			fcc_sf_cols = <11>;
			pc_sf_rows = <1>;
			pc_sf_cols = <1>;
			pc_sf_row_entries = <0>;
			pc_sf_percent = <100>;
			pc_sf_sf = <100>;
			rbatt_sf_rows = <28>;
			rbatt_sf_cols = <6>;
			rbatt_sf_percent = <100 95 90 85 80 75 70 65 60 55 50 45 40 35 30 25 20 15 10 9 8 7 6 5 4 3 2 1>;
			rbatt_sf_sf = <
			               1455 1070 400 105 83 77
			               1420 1047 398 104 83 77
			               1301 971 391 102 83 78
			               1223 910 379 103 83 78
			               1158 871 381 104 84 78
			               1067 816 380 106 85 79
			               1039 757 354 111 88 81
			               1018 731 339 119 93 84
			               1009 715 320 116 94 85
			               1023 712 305 102 86 80
			               1044 734 300 97 82 78
			               1073 766 309 97 82 78
			               1113 802 332 99 83 79
			               1164 850 366 101 86 81
			               1221 907 409 101 86 82
			               1285 963 463 100 82 78
			               1360 1020 531 101 83 78
			               1459 1089 623 105 83 79
			               2576 1356 604 102 83 81
			               2830 1513 663 104 84 81
			               3038 1690 731 105 86 83
			               3267 1837 821 106 86 84
			               3544 2082 920 107 88 84
			               3842 2285 994 108 84 81
			               4193 2526 1089 107 86 82
			               4667 2836 1217 111 87 82
			               5252 3323 1474 117 89 83
			               6216 4001 1930 138 96 88
			              >;
			pc_temp_ocv_rows = <29>;
			pc_temp_ocv_cols = <6>;
			pc_temp_ocv_percent = <100 95 90 85 80 75 70 65 60 55 50 45 40 35 30 25 20 15 10 9 8 7 6 5 4 3 2 1>;
			pc_temp_ocv_ocv = <
			                   4355 4351 4351 4343 4338 4331
			                   4246 4252 4270 4276 4272 4265
			                   4173 4182 4208 4217 4213 4207
			                   4115 4125 4150 4161 4158 4152
			                   4057 4074 4099 4108 4104 4100
			                   3983 4015 4047 4057 4054 4050
			                   3935 3953 3989 4010 4008 4005
			                   3891 3905 3941 3967 3967 3964
			                   3856 3865 3895 3921 3922 3920
			                   3833 3835 3855 3875 3876 3874
			                   3816 3818 3825 3843 3843 3842
			                   3801 3804 3805 3819 3820 3818
			                   3786 3792 3793 3801 3801 3799
			                   3772 3781 3783 3786 3786 3784
			                   3757 3768 3772 3771 3769 3764
			                   3742 3751 3758 3756 3748 3737
			                   3726 3731 3738 3737 3728 3715
			                   3709 3710 3712 3711 3703 3692
			                   3685 3687 3685 3688 3681 3669
			                   3679 3682 3680 3686 3680 3668
			                   3671 3677 3673 3684 3678 3666
			                   3660 3669 3665 3681 3675 3664
			                   3648 3661 3655 3676 3670 3657
			                   3629 3645 3636 3659 3652 3636
			                   3600 3615 3605 3621 3613 3598
			                   3560 3565 3556 3568 3561 3547
			                   3498 3496 3486 3496 3492 3480
			                   3397 3392 3380 3388 3391 3382
			                   3200 3200 3200 3200 3200 3200
			                  >;
		};
};
