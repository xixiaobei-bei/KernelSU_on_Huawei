/* DO NOT EDIT - Automatically generated by python */
/ {
		scudatl_3650_39k_4400_25:scudatl_3650_39k_4400_25 {
			fcc = <3650>;
			default_rbatt_mohm = <100>;
			identify_type = "id_volt";
			id_identify_min = <1235>;
			id_identify_max = <1759>;
			id_voltage_min = <1420>;
			id_voltage_max = <1562>;
			vbat_max = <4400>;
			temp_para = 
						"-32767","0","-1","0","4100","0",
						"0","5","-1","365","4400","0",
						"5","10","-1","1095","4400","3",
						"10","45","-1","-1","4400","3",
						"45","50","-1","1277","4100","3",
						"50","32767","-1","0","4100","0";
			vbat_para = 
						"-32767","3400","-1","820","0",
						"3400","32767","-1","-1","0";
			segment_para = 
						"-32767","4150","3650","4208","50",
						"4150","4450","2555","4400","0";
			batt_brand = "scudatl";
			fcc_temp = <3545 3537 3535 3540 3532 3446>;
			fcc_sf_x = <0 100 200 300 400 500 600 700 800 1000 1500>;
			fcc_sf_y = <100 96 94 92 90 88 87 84 81 75 50>;
			fcc_sf_cols = <11>;
			pc_sf_rows = <1>;
			pc_sf_cols = <1>;
			pc_sf_row_entries = <0>;
			pc_sf_percent = <100>;
			pc_sf_sf = <100>;
			rbatt_sf_rows = <28>;
			rbatt_sf_cols = <6>;
			rbatt_sf_percent = <100 95 90 85 80 75 70 65 60 55 50 45 40 35 30 25 20 15 10 9 8 7 6 5 4 3 2 1>;
			rbatt_sf_sf = <
			               1851 1188 470 128 103 94
			               1816 1177 470 129 103 94
			               1677 1130 469 132 105 96
			               1571 1083 474 136 108 98
			               1502 1066 484 142 111 100
			               1380 1013 508 149 116 103
			               1346 917 466 157 122 107
			               1324 910 451 164 129 113
			               1299 898 426 147 127 104
			               1305 890 414 124 103 95
			               1331 904 409 124 103 96
			               1373 936 419 129 106 99
			               1424 978 448 132 111 103
			               1479 1025 489 138 117 106
			               1544 1083 538 137 111 101
			               1623 1153 599 130 105 98
			               1717 1230 668 131 107 99
			               1842 1321 763 135 108 98
			               2036 1457 933 140 111 101
			               2079 1487 970 141 112 102
			               2584 1388 741 141 113 103
			               3015 1435 743 139 114 103
			               3348 1627 849 137 112 102
			               3676 1835 944 138 107 100
			               4009 2046 1062 136 109 101
			               4441 2245 1232 142 111 118
			               5054 2617 1481 153 115 152
			               6037 3290 1889 318 128 107
			              >;
			pc_temp_ocv_rows = <29>;
			pc_temp_ocv_cols = <6>;
			pc_temp_ocv_percent = <100 95 90 85 80 75 70 65 60 55 50 45 40 35 30 25 20 15 10 9 8 7 6 5 4 3 2 1>;
			pc_temp_ocv_ocv = <
			                   4327 4325 4324 4317 4312 4288
			                   4240 4247 4255 4258 4254 4233
			                   4176 4183 4196 4203 4199 4180
			                   4120 4127 4143 4150 4146 4129
			                   4068 4084 4093 4099 4095 4079
			                   3993 4028 4046 4052 4047 4034
			                   3945 3957 3983 4004 4002 3991
			                   3906 3917 3938 3961 3962 3952
			                   3867 3879 3894 3912 3915 3902
			                   3840 3845 3858 3869 3870 3864
			                   3820 3822 3828 3842 3842 3838
			                   3804 3807 3807 3820 3820 3817
			                   3793 3796 3795 3801 3803 3800
			                   3780 3786 3785 3786 3788 3784
			                   3767 3777 3776 3771 3769 3759
			                   3754 3765 3766 3754 3747 3734
			                   3739 3747 3747 3736 3729 3714
			                   3723 3723 3719 3708 3703 3689
			                   3700 3702 3696 3690 3684 3669
			                   3695 3698 3692 3687 3681 3665
			                   3690 3693 3686 3685 3679 3661
			                   3681 3687 3680 3681 3676 3656
			                   3669 3678 3674 3672 3670 3648
			                   3650 3662 3658 3646 3649 3626
			                   3618 3631 3625 3603 3609 3587
			                   3569 3582 3576 3547 3557 3537
			                   3499 3512 3508 3472 3488 3472
			                   3390 3408 3408 3359 3386 3373
			                   3200 3200 3200 3200 3200 3200
			                  >;
		};
};
