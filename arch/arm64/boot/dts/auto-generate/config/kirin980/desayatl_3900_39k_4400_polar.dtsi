/* DO NOT EDIT - Automatically generated by python */
/ {
		desayatl_3900_39k_4400_polar:desayatl_3900_39k_4400_polar {
			id_identify_min = <1235>;
			id_identify_max = <1759>;
			id_voltage_min = <1420>;
			id_voltage_max = <1562>;
			batt_brand = "desayatl";
			polar_ocv_table = <
							4371	4371	4375	4381	4380	4380	4385	4391	4387
							4341	4341	4345	4349	4343	4343	4342	4347	4312
							4313	4313	4316	4320	4311	4307	4305	4309	4249
							4284	4284	4287	4291	4280	4273	4271	4274	4201
							4255	4255	4258	4262	4251	4242	4239	4241	4161
							4226	4226	4229	4233	4221	4212	4209	4210	4129
							4197	4197	4200	4204	4193	4184	4180	4180	4094
							4169	4169	4172	4176	4165	4156	4152	4151	4056
							4141	4141	4144	4149	4138	4129	4125	4123	4024
							4114	4114	4117	4122	4111	4102	4099	4098	3998
							4087	4087	4090	4095	4085	4078	4075	4072	3976
							4062	4062	4065	4071	4062	4053	4047	4040	3954
							4038	4038	4041	4047	4035	4024	4015	4007	3932
							4014	4014	4015	4016	4006	3997	3989	3981	3912
							3993	3993	3994	3992	3985	3977	3967	3958	3892
							3972	3972	3974	3972	3966	3955	3944	3934	3875
							3952	3952	3952	3949	3942	3930	3919	3911	3860
							3923	3923	3923	3920	3914	3904	3896	3889	3847
							3891	3891	3892	3894	3888	3881	3875	3870	3837
							3872	3872	3873	3874	3868	3862	3857	3853	3828
							3857	3857	3858	3859	3852	3846	3842	3838	3821
							3844	3844	3845	3845	3839	3833	3830	3826	3814
							3832	3832	3833	3833	3827	3821	3818	3815	3807
							3821	3821	3822	3822	3816	3811	3809	3807	3801
							3811	3811	3812	3812	3807	3802	3801	3801	3794
							3803	3803	3804	3803	3798	3795	3796	3796	3788
							3795	3795	3796	3795	3791	3790	3791	3791	3781
							3788	3788	3789	3788	3786	3786	3788	3787	3774
							3780	3780	3782	3782	3781	3782	3783	3782	3767
							3764	3764	3772	3777	3777	3777	3778	3777	3759
							3752	3752	3761	3770	3771	3771	3772	3770	3750
							3741	3741	3750	3760	3762	3762	3764	3762	3741
							3732	3732	3742	3751	3751	3751	3754	3751	3730
							3722	3722	3732	3740	3739	3738	3741	3738	3718
							3708	3708	3717	3725	3723	3721	3725	3722	3706
							3691	3691	3701	3708	3706	3703	3707	3703	3694
							3682	3682	3690	3695	3691	3687	3691	3688	3681
							3678	3678	3686	3689	3684	3676	3681	3676	3661
							3657	3657	3670	3675	3665	3650	3662	3650	3620
							3536	3536	3556	3575	3550	3537	3561	3535	3524
							3232	3232	3273	3330	3238	3236	3284	3284	3284
							>;
			polar_res_table = <
								 987	 961	 948	 943	 935	 925	 905	 905
								1006	 978	 964	 953	 935	 925	 905	 905
								1024	 995	 981	 970	 953	 941	 916	 916
								1046	1020	1007	 993	 971	 956	 927	 927
								1069	1045	1033	1017	 994	 972	 927	 927
								1127	1099	1085	1058	1016	 987	 928	 928
								1186	1154	1138	1089	1016	 985	 921	 921
								1270	1165	1112	1074	1016	 982	 914	 914
								1163	1074	1029	 988	 926	 908	 872	 872
								1010	 977	 960	 938	 906	 894	 869	 869
								1001	 975	 962	 947	 924	 909	 878	 878
								1026	1001	 989	 970	 941	 923	 888	 888
								1051	1027	1016	 994	 961	 941	 901	 901
								1028	1008	 998	 992	 982	 959	 915	 915
								1006	 989	 981	 975	 966	 946	 908	 908
								1015	1001	 994	 976	 949	 933	 901	 901
								1024	1013	1008	 985	 951	 937	 909	 909
								1075	1050	1037	1003	 953	 941	 917	 917
								1148	1108	1087	1082	1073	1043	 982	 982
								1437	1412	1399	1325	1213	1170	1084	1084
								1097	1068	1054	1048	1039	1028	1005	1005
								1117	1087	1071	1059	1039	1028	1005	1005
								1137	1105	1089	1077	1059	1045	1017	1017
								1162	1133	1119	1103	1079	1063	1030	1030
								1187	1161	1148	1130	1104	1080	1030	1030
								1253	1221	1206	1175	1129	1097	1031	1031
								1318	1282	1264	1210	1129	1094	1024	1024
								1411	1294	1235	1193	1129	1091	1016	1016
								1293	1193	1143	1098	1029	1009	 968	 968
								1122	1085	1067	1043	1007	 993	 965	 965
								1112	1083	1069	1052	1026	1009	 976	 976
								1140	1113	1099	1078	1046	1026	 987	 987
								1167	1142	1129	1105	1068	1046	1002	1002
								1142	1120	1109	1102	1091	1066	1017	1017
								1117	1099	1089	1083	1073	1051	1009	1009
								1127	1112	1105	1085	1055	1037	1001	1001
								1137	1126	1120	1095	1057	1041	1010	1010
								1194	1166	1152	1115	1059	1045	1019	1019
								1275	1231	1208	1202	1193	1159	1091	1091
								1597	1569	1555	1472	1347	1299	1204	1204
								1322	1280	1259	1251	1239	1225	1198	1198
								1347	1309	1290	1270	1239	1225	1198	1198
								1372	1339	1322	1300	1267	1247	1207	1207
								1425	1390	1372	1342	1296	1269	1216	1216
								1477	1441	1423	1381	1319	1286	1220	1220
								1590	1526	1494	1433	1343	1303	1224	1224
								1703	1611	1565	1466	1317	1279	1205	1205
								1703	1546	1468	1397	1291	1256	1186	1186
								1545	1417	1353	1301	1223	1200	1154	1154
								1372	1314	1286	1253	1204	1185	1148	1148
								1342	1304	1284	1260	1224	1203	1160	1160
								1385	1345	1325	1293	1245	1220	1171	1171
								1427	1387	1367	1329	1272	1244	1186	1186
								1422	1388	1372	1343	1299	1267	1202	1202
								1417	1390	1377	1340	1284	1255	1198	1198
								1402	1377	1364	1326	1268	1244	1195	1195
								1387	1363	1351	1321	1275	1253	1209	1209
								1451	1414	1396	1350	1281	1262	1224	1224
								1595	1556	1537	1501	1447	1401	1308	1308
								2074	2127	2154	2190	2244	2136	1920	1920
								1793	1730	1698	1675	1639	1613	1562	1562
								1850	1786	1754	1708	1639	1613	1562	1562
								1908	1842	1809	1752	1666	1634	1570	1570
								2001	1919	1879	1805	1693	1655	1577	1577
								2093	1996	1948	1846	1692	1650	1567	1567
								2198	2026	1939	1840	1690	1645	1556	1556
								2303	2055	1931	1823	1661	1621	1540	1540
								2147	1940	1836	1754	1632	1596	1524	1524
								1990	1836	1758	1694	1597	1572	1522	1522
								1879	1779	1729	1673	1590	1568	1523	1523
								1813	1758	1731	1682	1609	1581	1524	1524
								1860	1798	1768	1711	1627	1593	1525	1525
								1908	1839	1804	1742	1649	1612	1538	1538
								1978	1890	1845	1776	1672	1632	1552	1552
								2048	1940	1886	1806	1686	1644	1562	1562
								1993	1917	1879	1807	1700	1657	1572	1572
								1938	1893	1871	1814	1728	1691	1617	1617
								1995	1946	1922	1856	1757	1725	1662	1662
								2506	2594	2638	2419	2092	2070	2027	2027
								2989	3215	3328	4649	6631	5374	2861	2861
								2173	2064	2010	1971	1912	1886	1834	1834
								2238	2131	2078	2012	1912	1886	1834	1834
								2303	2199	2146	2061	1933	1901	1836	1836
								2406	2270	2202	2103	1954	1915	1838	1838
								2509	2341	2258	2130	1939	1900	1821	1821
								2549	2323	2211	2096	1924	1884	1805	1805
								2589	2305	2164	2060	1904	1865	1788	1788
								2429	2207	2096	2011	1883	1846	1772	1772
								2291	2127	2045	1971	1859	1837	1794	1794
								2217	2096	2036	1965	1859	1839	1798	1798
								2183	2096	2052	1983	1879	1849	1788	1788
								2231	2136	2088	2012	1899	1858	1778	1778
								2278	2176	2124	2043	1922	1879	1791	1791
								2349	2232	2174	2082	1945	1899	1805	1805
								2419	2288	2223	2124	1974	1926	1829	1829
								2391	2296	2248	2150	2002	1953	1854	1854
								2364	2303	2273	2205	2104	2069	1998	1998
								2444	2445	2445	2349	2206	2185	2142	2142
								3378	4584	5188	4458	3363	3242	2998	2998
								4967	8871	10825	8889	5985	7088	9292	9292
								2615	2585	2570	2425	2207	2218	2240	2240
								2729	2676	2649	2488	2248	2251	2258	2258
								2854	2755	2705	2526	2257	2264	2277	2277
								2988	2811	2722	2533	2248	2257	2274	2274
								3043	2802	2681	2501	2229	2238	2256	2256
								3053	2760	2613	2448	2201	2213	2239	2239
								2869	2657	2552	2400	2173	2187	2215	2215
								2674	2561	2504	2364	2154	2173	2211	2211
								2570	2519	2494	2356	2150	2172	2215	2215
								2560	2527	2511	2370	2158	2181	2227	2227
								2605	2566	2547	2399	2177	2201	2248	2248
								2679	2617	2586	2431	2198	2220	2266	2266
								2749	2666	2625	2459	2210	2232	2275	2275
								2799	2716	2675	2492	2218	2237	2276	2276
								2819	2757	2726	2528	2232	2249	2283	2283
								2779	2758	2748	2542	2232	2250	2285	2285
								2799	2805	2808	2581	2240	2260	2299	2299
								3132	3356	3467	3019	2348	2399	2502	2502
								5976	8552	9841	7359	3635	4277	5563	5563
								35319	20262	12730	9943	5761	5761	5761	5761
								3352	3171	3080	2929	2702	2628	2479	2479
								3482	3264	3155	2989	2740	2659	2499	2499
								3611	3315	3167	2994	2735	2658	2504	2504
								3696	3323	3137	2968	2714	2641	2495	2495
								3691	3283	3078	2922	2688	2618	2477	2477
								3566	3208	3029	2883	2665	2588	2435	2435
								3412	3131	2991	2855	2651	2591	2470	2470
								3292	3081	2976	2843	2645	2590	2479	2479
								3152	3109	3087	2914	2654	2659	2669	2669
								3267	3163	3111	2910	2608	2639	2701	2701
								3312	3204	3150	2962	2680	2684	2692	2692
								3367	3243	3181	2987	2695	2695	2695	2695
								3437	3292	3220	3017	2712	2709	2701	2701
								3506	3364	3292	3067	2729	2720	2702	2702
								3561	3434	3371	3125	2755	2742	2715	2715
								3606	3496	3441	3180	2789	2775	2745	2745
								3701	3662	3643	3326	2851	2842	2825	2825
								4535	4939	5140	4370	3215	3284	3423	3423
								12193	15654	17385	12916	6212	6212	6212	6212
								39870	30452	25740	21344	14750	14750	14750	14750
								5824	5559	5426	4934	4197	3919	3362	3362
								5679	5467	5361	4894	4193	3913	3354	3354
								5589	5363	5250	4805	4139	3872	3339	3339
								5594	5297	5149	4720	4077	3828	3329	3329
								5579	5245	5077	4653	4017	3786	3325	3325
								5779	5302	5063	4628	3975	3755	3316	3316
								5275	4915	4735	4404	3907	3694	3267	3267
								5080	4857	4745	4401	3885	3693	3310	3310
								4975	4802	4716	4380	3875	3683	3299	3299
								4895	4760	4692	4349	3835	3647	3273	3273
								4915	4793	4731	4374	3838	3652	3279	3279
								4990	4864	4802	4427	3866	3676	3295	3295
								5050	4968	4926	4516	3901	3705	3311	3311
								5235	5147	5103	4644	3955	3749	3337	3337
								5485	5386	5337	4821	4046	3833	3408	3408
								5764	5652	5595	5029	4179	3955	3506	3506
								6059	5964	5917	5290	4350	4119	3656	3656
								6449	6483	6501	5742	4605	4373	3910	3910
								7747	7876	7940	6812	5120	4911	4494	4494
								10824	11239	11446	9426	6395	6395	6395	6395
								15112	12647	11413	9592	6861	6199	4874	4874
								14053	12041	11035	9307	6714	6070	4783	4783
								13258	11451	10547	8937	6521	5931	4752	4752
								12769	11071	10222	8667	6335	5789	4697	4697
								12664	10725	9755	8340	6217	5692	4642	4642
								11569	10121	9396	8074	6091	5581	4561	4561
								11299	10020	9381	8031	6006	6006	6006	6006
								11344	10054	9408	8046	6002	6002	6002	6002
								11274	10035	9415	8054	6013	6013	6013	6013
								11249	10085	9502	8110	6022	6022	6022	6022
								11484	10266	9656	8200	6016	6016	6016	6016
								11854	10546	9892	8361	6064	6064	6064	6064
								12234	10879	10202	8588	6168	6168	6168	6168
								12879	11377	10626	8887	6279	6279	6279	6279
								13613	11981	11165	9272	6432	6432	6432	6432
								14453	12727	11863	9788	6675	6675	6675	6675
								15772	13770	12768	10450	6972	6972	6972	6972
								17596	15159	13940	11319	7387	7387	7387	7387
								20485	17440	15916	12616	7665	7665	7665	7665
								32979	23231	18354	14364	8378	8378	8378	8378
								>;
			polar_vector_table = <
								 721	  14	  18	  18	  18	  32	  27	  36	  17	  10	  10	  10	  14	  10	  10	  10	  10
								 700	  15	  17	  18	  18	  31	  23	  38	  13	  10	  12	   7	  12	  11	   8	   7	   6
								 697	  15	  17	  18	  17	  31	  24	  34	  15	  10	  13	   8	  10	   9	   6	   5	   4
								 702	  27	  14	  15	  19	  39	  19	  33	   8	   5	   7	   4	   5	   4	   2	   1	   1
								 721	  14	  20	  16	  18	  32	  27	  36	  17	  12	  16	  12	  15	  12	  14	  14	  12
								 700	  16	  16	  18	  18	  32	  24	  38	  16	  11	  15	   9	  14	  13	   9	   9	   7
								 697	  15	  17	  18	  17	  31	  24	  34	  15	  10	  13	   8	  10	   9	   6	   5	   4
								 702	  27	  14	  15	  19	  39	  19	  33	   8	   5	   7	   4	   5	   4	   2	   1	   1
								 721	  14	  23	  14	  18	  32	  27	  36	  17	  13	  21	  13	  17	  13	  17	  17	  13
								 699	  17	  15	  18	  18	  32	  25	  37	  19	  13	  19	  11	  16	  14	  10	  10	   7
								 696	  16	  17	  18	  18	  33	  25	  36	  17	  12	  16	   9	  13	  10	   7	   5	   5
								 704	  22	  16	  17	  19	  39	  22	  38	   7	   5	   7	   4	   6	   4	   2	   2	   1
								 721	  14	  20	  14	  20	  32	  27	  38	  19	  15	  23	  13	  21	  19	  19	  17	  15
								 698	  17	  16	  18	  19	  33	  25	  38	  21	  15	  20	  15	  20	  17	  14	  11	   9
								 695	  17	  17	  18	  19	  34	  27	  39	  19	  13	  18	  11	  15	  11	   7	   5	   5
								 707	  18	  19	  18	  20	  39	  25	  42	   6	   5	   6	   4	   7	   5	   2	   2	   1
								 721	  14	  18	  14	  23	  32	  27	  41	  21	  17	  25	  13	  25	  25	  21	  17	  17
								 697	  17	  17	  18	  20	  34	  26	  38	  24	  18	  22	  18	  24	  19	  18	  12	  12
								 694	  17	  18	  18	  19	  35	  27	  40	  18	  14	  19	  12	  20	  17	  11	   8	   6
								 705	  16	  22	  18	  19	  38	  24	  39	   7	   5	   6	   4	   7	   7	   5	   3	   2
								 719	  11	  18	  16	  20	  34	  27	  38	  22	  19	  28	  17	  30	  35	  33	  28	  31
								 698	  16	  18	  18	  20	  34	  27	  39	  25	  18	  26	  20	  31	  30	  27	  20	  19
								 694	  17	  18	  18	  19	  36	  27	  41	  18	  14	  20	  14	  24	  23	  16	  11	   7
								 703	  15	  25	  18	  18	  36	  23	  36	   7	   5	   6	   5	   7	   8	   8	   5	   3
								 717	   9	  18	  18	  18	  36	  27	  36	  22	  22	  31	  22	  36	  44	  44	  40	  44
								 699	  15	  18	  17	  20	  34	  28	  40	  27	  18	  30	  22	  39	  40	  36	  28	  27
								 695	  17	  18	  18	  19	  36	  27	  41	  15	  12	  16	  12	  20	  20	  17	  16	  17
								 699	  16	  22	  18	  19	  36	  24	  36	   6	   4	   6	   4	   6	   7	   6	   5	   5
								 714	  12	  18	  18	  15	  36	  24	  39	  25	  19	  31	  19	  41	  47	  59	  63	  88
								 701	  15	  17	  18	  19	  35	  28	  41	  20	  15	  21	  17	  29	  31	  32	  32	  39
								 697	  16	  17	  17	  20	  36	  27	  42	  13	  10	  13	   9	  16	  18	  19	  21	  26
								 695	  17	  18	  18	  20	  37	  26	  36	   6	   4	   5	   3	   5	   5	   5	   6	   8
								 710	  14	  18	  16	  16	  36	  23	  41	  23	  13	  23	  15	  32	  34	  41	  47	  63
								 703	  15	  16	  18	  18	  34	  27	  40	  15	  11	  14	  11	  17	  20	  20	  22	  27
								 699	  15	  17	  18	  18	  36	  27	  38	   8	   6	   7	   5	   7	   7	   6	   5	   6
								 699	  17	  18	  18	  19	  34	  24	  34	   2	   1	   1	   1	   1	   1	   1	   1	   1
								 711	  14	  17	  15	  17	  35	  23	  38	  17	  11	  16	  10	  20	  18	  16	  18	  17
								 704	  15	  15	  16	  17	  32	  26	  36	  13	  10	  12	   9	  11	  13	  10	  10	  10
								 700	  14	  15	  17	  17	  31	  23	  32	  10	   7	   9	   5	   7	   6	   5	   4	   4
								 697	  16	  15	  17	  17	  30	  23	  28	   6	   4	   4	   2	   3	   2	   2	   1	   1
								 717	  14	  14	  18	  14	  32	  23	  32	  12	  16	  16	   8	  20	  16	  16	  16	  20
								 705	  14	  15	  15	  15	  31	  25	  32	  15	  11	  14	  10	  14	  14	  11	  11	  11
								 701	  14	  15	  16	  16	  30	  23	  31	  13	   9	  11	   7	  10	   9	   7	   5	   4
								 699	  16	  15	  16	  16	  30	  22	  28	   7	   5	   6	   4	   5	   4	   3	   2	   1
								 715	  14	  14	  16	  14	  32	  23	  32	  17	  15	  19	  11	  23	  21	  21	  19	  23
								 707	  13	  16	  15	  15	  31	  23	  32	  16	  12	  17	  12	  18	  19	  16	  14	  13
								 703	  14	  14	  16	  16	  29	  23	  31	  15	  11	  14	   9	  13	  12	   9	   7	   5
								 701	  15	  16	  16	  16	  29	  21	  27	   9	   6	   8	   5	   6	   5	   4	   2	   2
								 712	  14	  14	  14	  14	  32	  23	  32	  22	  13	  22	  13	  26	  26	  26	  22	  26
								 708	  12	  17	  14	  15	  31	  22	  31	  18	  13	  19	  15	  22	  24	  21	  18	  15
								 706	  14	  14	  16	  16	  29	  22	  31	  15	  11	  15	  10	  16	  16	  12	  10	   9
								 701	  15	  15	  16	  16	  30	  21	  30	   9	   6	   8	   5	   8	   7	   5	   4	   3
								 717	  14	  14	  14	  16	  29	  23	  32	  20	  11	  22	  13	  20	  24	  22	  17	  24
								 710	  13	  15	  15	  15	  30	  22	  31	  17	  12	  17	  13	  19	  20	  18	  16	  15
								 708	  13	  14	  16	  16	  29	  22	  31	  15	  11	  16	  11	  19	  19	  15	  13	  14
								 701	  14	  15	  16	  17	  32	  21	  33	  10	   7	   9	   6	  10	   9	   6	   5	   4
								 721	  14	  14	  14	  18	  27	  23	  32	  17	   8	  21	  13	  13	  21	  17	  13	  21
								 713	  14	  12	  17	  15	  29	  22	  31	  15	  11	  15	  11	  15	  17	  14	  14	  14
								 709	  13	  14	  15	  16	  29	  22	  31	  15	  10	  15	  10	  16	  16	  12	  10	  11
								 704	  14	  15	  16	  16	  30	  22	  30	   9	   7	   9	   6	   9	   7	   5	   4	   3
								 719	  14	  14	  14	  18	  29	  23	  32	  15	  13	  19	  13	  17	  21	  17	  19	  21
								 715	  13	  14	  15	  16	  30	  22	  32	  16	  12	  16	  11	  17	  19	  16	  15	  15
								 710	  13	  14	  15	  17	  29	  22	  31	  14	  10	  14	   9	  14	  13	  10	   8	   8
								 707	  14	  15	  16	  16	  29	  24	  28	   9	   6	   8	   5	   8	   6	   4	   3	   3
								 717	  14	  14	  14	  18	  32	  23	  32	  12	  17	  17	  12	  21	  21	  17	  25	  21
								 717	  12	  15	  14	  17	  31	  23	  32	  17	  12	  17	  11	  18	  21	  18	  17	  17
								 712	  13	  14	  15	  17	  30	  23	  32	  14	  10	  13	   9	  13	  12	   9	   7	   7
								 706	  14	  15	  16	  17	  31	  24	  28	  11	   8	   9	   6	   8	   7	   5	   3	   3
								 717	  14	  14	  14	  18	  32	  26	  35	  19	  15	  24	  13	  28	  28	  27	  26	  28
								 717	  11	  15	  15	  17	  32	  24	  35	  20	  15	  19	  14	  22	  24	  21	  19	  17
								 714	  13	  14	  16	  17	  31	  24	  33	  14	  10	  13	   8	  12	  11	   9	   7	   6
								 704	  15	  15	  16	  17	  32	  24	  27	  14	   9	  11	   7	   9	   7	   5	   4	   3
								 719	  14	  16	  14	  20	  34	  32	  43	  24	  13	  26	  13	  30	  32	  32	  38	  49
								 722	  12	  16	  17	  18	  37	  28	  45	  21	  15	  20	  14	  24	  26	  24	  23	  26
								 716	  13	  14	  17	  18	  36	  28	  39	  25	  19	  25	  17	  28	  28	  22	  16	  12
								 706	  13	  16	  18	  19	  35	  26	  40	  20	  13	  17	  10	  15	  13	   9	   7	   5
								 868	  16	  22	  16	  27	  43	  43	  60	  30	  15	  30	  15	  35	  40	  40	  59	  79
								 905	  17	  21	  23	  25	  52	  40	  65	  25	  17	  25	  17	  29	  32	  30	  32	  44
								 728	  16	  20	  24	  26	  54	  46	  76	  23	  16	  22	  15	  24	  26	  28	  29	  40
								 712	  17	  20	  24	  27	  56	  48	  84	  15	  10	  13	   8	  11	  10	   9	   9	  12
								 802	  15	  20	  20	  20	  35	  30	  40	  19	  12	  12	  12	  15	  12	  12	  12	  12
								 778	  17	  19	  21	  21	  34	  26	  43	  15	  11	  13	   8	  13	  12	   9	   8	   7
								 774	  17	  19	  21	  19	  35	  27	  38	  17	  12	  15	   9	  12	  10	   7	   6	   5
								 780	  30	  15	  16	  21	  43	  21	  37	   9	   6	   8	   4	   5	   4	   2	   2	   1
								 802	  15	  23	  18	  20	  35	  30	  40	  19	  13	  18	  13	  17	  13	  15	  15	  13
								 777	  18	  18	  21	  21	  35	  27	  42	  18	  12	  17	  10	  15	  14	  10	  10	   7
								 774	  17	  19	  21	  19	  35	  27	  38	  17	  12	  15	   9	  12	  10	   7	   6	   5
								 780	  30	  15	  16	  21	  43	  21	  37	   9	   6	   8	   4	   5	   4	   2	   2	   1
								 802	  15	  25	  15	  20	  35	  30	  40	  19	  14	  24	  14	  19	  14	  19	  19	  14
								 776	  19	  17	  21	  21	  36	  27	  41	  21	  14	  21	  13	  17	  16	  11	  11	   8
								 773	  18	  19	  21	  20	  36	  28	  40	  19	  13	  17	  10	  14	  11	   7	   6	   5
								 783	  25	  18	  18	  21	  44	  25	  42	   8	   6	   7	   5	   6	   5	   3	   2	   1
								 802	  15	  23	  15	  23	  35	  30	  43	  21	  16	  26	  14	  23	  21	  21	  19	  16
								 776	  19	  18	  21	  21	  37	  28	  42	  23	  17	  23	  16	  22	  19	  15	  12	  11
								 772	  19	  19	  21	  21	  38	  29	  43	  21	  15	  20	  12	  17	  13	   8	   6	   6
								 786	  19	  21	  21	  22	  44	  28	  47	   7	   5	   7	   5	   7	   5	   3	   2	   1
								 802	  15	  20	  15	  25	  35	  30	  45	  23	  19	  28	  14	  28	  28	  23	  19	  19
								 775	  19	  19	  21	  22	  38	  29	  43	  26	  20	  25	  20	  26	  21	  20	  13	  13
								 771	  19	  20	  21	  21	  39	  30	  44	  20	  15	  21	  14	  22	  19	  13	   9	   7
								 784	  18	  24	  20	  21	  42	  27	  44	   7	   5	   7	   5	   8	   7	   6	   3	   2
								 799	  13	  20	  18	  23	  38	  30	  43	  24	  22	  31	  19	  34	  39	  36	  32	  34
								 776	  18	  20	  20	  22	  38	  30	  44	  28	  20	  29	  22	  35	  33	  30	  22	  21
								 771	  19	  20	  21	  21	  40	  30	  46	  20	  16	  22	  16	  26	  25	  17	  12	   8
								 781	  16	  28	  20	  20	  40	  25	  41	   8	   5	   7	   5	   8	   9	   9	   5	   3
								 797	  10	  20	  20	  20	  40	  30	  40	  25	  25	  35	  25	  39	  49	  49	  44	  49
								 776	  17	  21	  19	  22	  38	  31	  44	  30	  20	  33	  25	  43	  45	  40	  31	  30
								 773	  19	  20	  20	  21	  40	  30	  46	  17	  13	  18	  13	  22	  23	  19	  18	  19
								 777	  18	  24	  20	  21	  41	  27	  40	   7	   5	   7	   4	   7	   7	   7	   6	   6
								 793	  13	  20	  20	  17	  40	  27	  43	  28	  21	  34	  21	  46	  52	  66	  70	  98
								 779	  17	  19	  20	  21	  39	  31	  46	  23	  16	  24	  19	  32	  35	  36	  36	  43
								 775	  18	  19	  19	  22	  40	  29	  46	  14	  11	  14	  10	  17	  20	  21	  23	  29
								 772	  19	  20	  20	  22	  41	  29	  40	   7	   5	   6	   4	   6	   6	   5	   6	   9
								 789	  15	  20	  18	  18	  40	  25	  45	  26	  14	  26	  16	  35	  38	  45	  53	  70
								 781	  17	  18	  20	  21	  38	  30	  44	  17	  12	  16	  13	  19	  22	  23	  24	  30
								 777	  17	  19	  20	  21	  40	  30	  42	   9	   7	   8	   5	   8	   8	   7	   6	   7
								 776	  18	  20	  20	  21	  38	  26	  38	   2	   1	   2	   1	   1	   1	   1	   1	   1
								 790	  15	  18	  17	  18	  38	  25	  42	  19	  12	  17	  12	  22	  20	  17	  20	  19
								 782	  17	  17	  18	  19	  35	  29	  40	  15	  11	  14	   9	  13	  14	  12	  11	  11
								 778	  16	  17	  19	  19	  35	  26	  36	  11	   8	  10	   6	   8	   7	   5	   5	   4
								 775	  18	  17	  18	  18	  34	  25	  31	   6	   4	   5	   3	   3	   3	   2	   1	   1
								 797	  15	  15	  20	  15	  35	  25	  35	  13	  18	  18	   9	  22	  18	  18	  18	  22
								 783	  15	  17	  17	  17	  34	  27	  36	  17	  12	  15	  11	  15	  15	  12	  12	  12
								 779	  16	  16	  18	  18	  33	  25	  35	  14	  10	  13	   8	  11	  10	   7	   6	   5
								 777	  18	  17	  18	  18	  33	  24	  31	   8	   5	   7	   4	   5	   4	   3	   2	   2
								 794	  15	  15	  18	  15	  35	  25	  35	  19	  16	  21	  12	  26	  24	  24	  21	  26
								 785	  15	  18	  16	  17	  34	  26	  35	  18	  14	  18	  14	  20	  21	  18	  16	  14
								 781	  15	  16	  18	  18	  32	  25	  34	  17	  12	  16	  10	  15	  14	  10	   7	   6
								 779	  17	  17	  18	  18	  32	  23	  30	  10	   7	   8	   5	   7	   6	   4	   3	   2
								 792	  15	  15	  15	  15	  35	  25	  35	  24	  15	  24	  15	  29	  29	  29	  24	  29
								 787	  14	  19	  15	  17	  34	  24	  34	  20	  15	  22	  17	  25	  27	  23	  20	  17
								 784	  15	  16	  18	  18	  32	  25	  34	  17	  12	  16	  11	  18	  17	  13	  11	  10
								 779	  17	  17	  18	  18	  34	  23	  33	  10	   7	   9	   6	   9	   8	   6	   4	   3
								 797	  15	  15	  15	  18	  33	  25	  35	  22	  12	  24	  14	  22	  26	  24	  19	  26
								 789	  15	  16	  17	  17	  33	  24	  34	  19	  14	  19	  15	  21	  23	  19	  18	  16
								 787	  15	  15	  17	  18	  33	  24	  35	  17	  13	  17	  12	  21	  21	  17	  14	  15
								 779	  16	  17	  18	  18	  35	  23	  37	  11	   8	  10	   7	  11	  10	   7	   5	   5
								 802	  15	  15	  15	  20	  30	  25	  35	  19	   9	  24	  14	  14	  24	  19	  14	  24
								 792	  15	  14	  19	  17	  32	  24	  34	  17	  12	  17	  12	  17	  19	  16	  16	  16
								 788	  15	  16	  17	  18	  33	  24	  34	  16	  12	  16	  11	  18	  17	  14	  11	  12
								 782	  16	  17	  18	  18	  34	  25	  34	  10	   7	  10	   6	  10	   8	   6	   4	   4
								 799	  15	  15	  15	  20	  33	  25	  35	  16	  14	  21	  14	  19	  23	  19	  21	  23
								 794	  15	  15	  17	  18	  33	  25	  35	  18	  13	  18	  12	  19	  21	  18	  17	  17
								 789	  15	  16	  17	  19	  33	  24	  34	  16	  11	  15	  10	  16	  14	  11	   8	   8
								 786	  15	  16	  17	  18	  33	  26	  31	  10	   7	   9	   6	   8	   7	   5	   3	   3
								 797	  15	  15	  15	  20	  35	  25	  35	  14	  18	  18	  14	  23	  23	  18	  28	  23
								 797	  14	  17	  15	  19	  34	  26	  36	  18	  14	  18	  12	  20	  23	  20	  18	  18
								 792	  14	  16	  17	  19	  34	  25	  35	  16	  11	  15	  10	  15	  13	  10	   8	   8
								 784	  16	  16	  18	  18	  34	  26	  31	  13	   9	  11	   7	   9	   8	   5	   4	   3
								 797	  15	  15	  15	  20	  35	  28	  38	  21	  16	  26	  15	  31	  31	  30	  29	  31
								 797	  13	  17	  17	  19	  35	  27	  39	  22	  17	  21	  15	  25	  27	  23	  21	  18
								 794	  14	  16	  17	  19	  35	  26	  37	  16	  11	  15	   9	  13	  12	  10	   8	   7
								 782	  16	  16	  18	  19	  35	  26	  30	  15	  10	  12	   7	  10	   8	   6	   4	   3
								 799	  15	  18	  15	  23	  38	  35	  48	  26	  14	  29	  14	  34	  36	  36	  42	  54
								 802	  14	  18	  19	  21	  41	  32	  50	  23	  17	  22	  16	  26	  29	  26	  25	  29
								 796	  14	  16	  19	  21	  40	  31	  44	  28	  21	  28	  19	  31	  31	  24	  17	  13
								 785	  15	  18	  19	  21	  39	  29	  44	  22	  15	  18	  12	  17	  15	  11	   7	   5
								 964	  18	  24	  18	  30	  48	  48	  66	  33	  17	  33	  17	  39	  44	  44	  66	  88
								1005	  19	  23	  26	  28	  58	  45	  72	  28	  19	  28	  19	  32	  36	  34	  36	  49
								 809	  17	  22	  26	  29	  60	  51	  84	  25	  18	  24	  17	  27	  29	  31	  33	  45
								 791	  19	  22	  26	  30	  63	  53	  93	  17	  11	  14	   8	  12	  11	  10	  10	  13
								 906	  20	  15	  25	  20	  45	  35	  55	  27	  27	  27	  22	  27	  22	  18	  13	  18
								 879	  17	  19	  22	  22	  43	  34	  55	  28	  19	  28	  18	  22	  19	  13	  10	  10
								 873	  19	  18	  22	  23	  42	  34	  53	  28	  20	  28	  17	  23	  16	   9	   7	   6
								 888	  31	  20	  20	  22	  41	  33	  51	  18	  13	  17	  11	  14	  10	   5	   3	   2
								 901	  18	  18	  25	  20	  45	  35	  55	  32	  25	  35	  23	  30	  28	  21	  16	  21
								 877	  17	  20	  23	  23	  43	  35	  56	  31	  22	  33	  20	  29	  22	  16	  12	  12
								 873	  19	  18	  22	  23	  42	  34	  53	  28	  20	  28	  17	  23	  16	   9	   7	   6
								 888	  31	  20	  20	  22	  41	  33	  51	  18	  13	  17	  11	  14	  10	   5	   3	   2
								 896	  15	  20	  25	  20	  45	  35	  55	  38	  24	  43	  24	  33	  33	  24	  19	  24
								 876	  17	  21	  24	  24	  43	  36	  56	  35	  25	  38	  22	  35	  25	  19	  13	  13
								 871	  20	  19	  22	  24	  44	  36	  56	  29	  21	  29	  19	  27	  22	  14	   8	   7
								 884	  26	  20	  21	  23	  44	  35	  55	  17	  12	  17	  11	  15	  12	   8	   4	   3
								 894	  18	  18	  25	  23	  45	  35	  58	  41	  24	  46	  29	  43	  38	  34	  27	  29
								 875	  18	  21	  23	  25	  44	  37	  57	  38	  27	  42	  27	  42	  36	  27	  18	  17
								 869	  21	  20	  23	  24	  45	  37	  58	  29	  22	  31	  22	  31	  28	  18	  10	   8
								 879	  20	  21	  22	  24	  47	  37	  59	  17	  12	  17	  10	  16	  14	  12	   6	   3
								 891	  20	  15	  25	  25	  45	  35	  60	  44	  24	  49	  34	  54	  44	  44	  34	  34
								 874	  19	  21	  22	  26	  44	  38	  58	  41	  29	  46	  33	  49	  46	  34	  23	  21
								 870	  19	  20	  23	  24	  46	  38	  59	  28	  21	  30	  21	  31	  29	  25	  20	  15
								 876	  20	  20	  23	  24	  47	  38	  59	  17	  12	  16	  10	  15	  13	  12	  10	   8
								 886	  20	  18	  23	  25	  45	  35	  60	  42	  32	  52	  37	  62	  64	  64	  60	  65
								 875	  18	  21	  22	  25	  45	  38	  60	  38	  29	  45	  32	  54	  54	  51	  44	  44
								 871	  17	  21	  23	  24	  47	  38	  60	  27	  20	  29	  19	  31	  31	  32	  29	  23
								 873	  20	  20	  23	  24	  47	  39	  59	  17	  12	  16	  10	  14	  12	  12	  13	  12
								 881	  20	  20	  20	  25	  45	  35	  60	  40	  40	  55	  40	  70	  85	  85	  85	  95
								 876	  17	  22	  22	  24	  46	  38	  62	  36	  29	  44	  31	  58	  63	  68	  65	  66
								 872	  18	  21	  23	  24	  47	  39	  60	  24	  18	  25	  17	  26	  26	  25	  24	  27
								 872	  20	  21	  23	  24	  47	  39	  59	  15	  11	  14	   9	  12	  10	   9	   9	  11
								 885	  17	  20	  20	  22	  45	  32	  53	  43	  33	  48	  37	  67	  78	  88	  95	 119
								 878	  17	  20	  22	  24	  45	  38	  58	  31	  24	  35	  25	  42	  46	  48	  50	  65
								 873	  19	  21	  23	  24	  47	  39	  61	  22	  16	  22	  14	  21	  21	  19	  20	  30
								 871	  19	  21	  23	  24	  48	  38	  58	  13	   9	  13	   8	  10	   8	   7	   6	   9
								 886	  18	  20	  18	  23	  45	  30	  53	  37	  27	  39	  29	  49	  54	  62	  67	  89
								 882	  17	  18	  21	  23	  45	  35	  56	  28	  20	  29	  20	  29	  28	  30	  30	  42
								 877	  18	  20	  21	  24	  45	  37	  56	  20	  14	  19	  12	  16	  13	  10	  10	  13
								 871	  18	  20	  22	  24	  46	  36	  54	  12	   9	  11	   7	   8	   6	   4	   3	   4
								 890	  18	  20	  17	  22	  45	  30	  53	  29	  24	  34	  22	  34	  34	  30	  29	  42
								 885	  17	  18	  20	  22	  44	  33	  54	  27	  20	  27	  18	  26	  20	  20	  16	  18
								 880	  16	  18	  21	  21	  42	  33	  51	  22	  16	  21	  13	  17	  12	   8	   6	   6
								 876	  18	  18	  20	  21	  42	  32	  48	  15	  11	  13	   8	  10	   6	   4	   2	   2
								 896	  15	  20	  20	  15	  45	  30	  50	  29	  25	  34	  20	  34	  34	  25	  20	  29
								 886	  15	  19	  19	  21	  41	  34	  50	  29	  22	  29	  19	  29	  22	  19	  14	  16
								 884	  16	  18	  20	  21	  41	  33	  49	  23	  18	  23	  14	  21	  16	  11	   8	   7
								 879	  18	  17	  20	  21	  42	  32	  48	  16	  11	  14	   9	  11	   8	   5	   3	   3
								 896	  15	  20	  18	  20	  43	  30	  50	  33	  22	  38	  23	  38	  40	  35	  30	  35
								 890	  15	  18	  18	  21	  41	  32	  50	  30	  24	  31	  21	  33	  30	  26	  22	  22
								 887	  15	  17	  20	  21	  40	  32	  48	  25	  19	  26	  16	  24	  21	  15	  10	   9
								 883	  18	  17	  20	  21	  42	  33	  47	  17	  12	  15	   9	  13	  10	   7	   4	   3
								 896	  15	  20	  15	  25	  40	  30	  50	  36	  20	  41	  25	  41	  46	  46	  41	  41
								 894	  15	  17	  17	  22	  41	  31	  50	  30	  25	  34	  24	  37	  37	  34	  30	  29
								 892	  15	  17	  20	  20	  41	  32	  48	  25	  19	  25	  17	  25	  25	  20	  16	  14
								 885	  17	  18	  20	  21	  42	  33	  49	  17	  12	  16	  10	  14	  12	   9	   6	   5
								 901	  15	  18	  18	  23	  40	  33	  48	  35	  23	  38	  23	  40	  43	  45	  38	  43
								 898	  15	  18	  18	  21	  40	  32	  50	  30	  24	  32	  22	  36	  38	  35	  32	  31
								 896	  15	  17	  19	  20	  41	  32	  49	  26	  19	  25	  18	  27	  29	  26	  22	  19
								 887	  17	  19	  20	  21	  43	  33	  50	  18	  13	  16	  10	  15	  13	  12	   8	   7
								 906	  15	  15	  20	  20	  40	  35	  45	  35	  25	  35	  20	  40	  40	  45	  35	  45
								 901	  15	  19	  19	  21	  39	  32	  50	  30	  23	  31	  21	  34	  39	  36	  33	  33
								 898	  16	  17	  20	  20	  41	  32	  49	  25	  18	  24	  16	  25	  25	  22	  18	  15
								 889	  17	  19	  20	  21	  43	  33	  50	  18	  13	  16	  10	  14	  13	  10	   7	   6
								 904	  18	  15	  20	  20	  43	  33	  48	  34	  22	  34	  22	  37	  39	  37	  37	  42
								 903	  16	  18	  19	  21	  40	  32	  50	  29	  22	  30	  21	  33	  36	  33	  30	  30
								 901	  17	  16	  20	  21	  40	  32	  50	  24	  18	  24	  15	  24	  22	  19	  14	  12
								 892	  18	  18	  19	  21	  43	  33	  49	  17	  12	  16	  10	  14	  12	   9	   6	   4
								 901	  20	  15	  20	  20	  45	  30	  50	  33	  19	  33	  24	  33	  38	  29	  38	  38
								 905	  17	  17	  19	  21	  41	  32	  51	  29	  21	  29	  21	  32	  33	  30	  27	  27
								 902	  17	  16	  20	  21	  41	  33	  50	  26	  19	  25	  16	  24	  22	  18	  13	  12
								 892	  18	  18	  19	  21	  42	  33	  49	  22	  15	  19	  12	  16	  13	   9	   6	   5
								 908	  20	  15	  20	  20	  42	  33	  57	  34	  23	  38	  28	  41	  39	  43	  39	  49
								 908	  17	  17	  19	  22	  42	  34	  54	  33	  25	  34	  25	  37	  37	  33	  29	  29
								 903	  17	  16	  20	  21	  41	  35	  51	  27	  21	  26	  17	  24	  21	  17	  13	  12
								 891	  18	  17	  19	  22	  42	  34	  49	  26	  18	  23	  13	  18	  14	  10	   7	   5
								 916	  20	  15	  23	  23	  45	  38	  65	  39	  27	  42	  30	  52	  52	  59	  61	  88
								 914	  19	  17	  21	  24	  48	  39	  64	  39	  30	  43	  31	  47	  49	  48	  47	  56
								 910	  17	  18	  21	  22	  47	  38	  60	  41	  31	  43	  29	  44	  40	  33	  27	  25
								 903	  19	  18	  21	  23	  46	  37	  58	  32	  23	  31	  19	  25	  20	  14	  10	   9
								1119	  24	  18	  30	  30	  61	  49	  85	  53	  36	  53	  36	  71	  77	  83	 101	 148
								1195	  27	  22	  31	  33	  69	  58	  96	  56	  42	  63	  45	  71	  76	  80	  83	 107
								 927	  24	  24	  29	  33	  71	  62	 108	  96	  72	 103	  73	 117	 122	 120	 118	 145
								 912	  25	  24	  29	  34	  73	  67	 121	  94	  68	  90	  56	  80	  71	  59	  54	  63
								1127	  15	  30	  25	  30	  50	  50	  75	  46	  37	  60	  37	  64	  51	  41	  28	  28
								1079	  31	  24	  31	  27	  51	  46	  77	  43	  35	  52	  38	  55	  45	  28	  18	  17
								1088	  10	  24	  26	  28	  53	  45	  73	  40	  31	  47	  33	  50	  40	  25	  14	  10
								1087	  49	  22	  21	  21	  51	  45	  71	  31	  23	  33	  22	  33	  26	  15	   8	   5
								1112	  25	  28	  25	  30	  53	  48	  78	  50	  41	  65	  46	  74	  62	  48	  31	  36
								1074	  30	  25	  29	  28	  54	  47	  77	  47	  39	  59	  43	  66	  55	  36	  24	  21
								1088	  10	  24	  26	  28	  53	  45	  73	  40	  31	  47	  33	  50	  40	  25	  14	  10
								1087	  49	  22	  21	  21	  51	  45	  71	  31	  23	  33	  22	  33	  26	  15	   8	   5
								1097	  35	  25	  25	  30	  55	  45	  80	  55	  45	  69	  55	  84	  74	  55	  35	  45
								1069	  29	  26	  27	  29	  56	  48	  77	  52	  42	  66	  47	  76	  66	  44	  29	  26
								1075	  20	  27	  28	  28	  54	  46	  76	  40	  31	  47	  33	  51	  43	  31	  23	  17
								1084	  44	  22	  22	  23	  52	  45	  75	  30	  23	  32	  22	  32	  26	  17	  12	   9
								1092	  33	  25	  28	  30	  55	  48	  78	  57	  47	  77	  57	  97	  87	  75	  55	  60
								1066	  29	  26	  28	  30	  57	  49	  79	  52	  43	  65	  48	  81	  77	  60	  47	  42
								1061	  29	  29	  29	  29	  54	  47	  78	  39	  31	  46	  32	  51	  45	  36	  31	  24
								1081	  38	  22	  24	  25	  53	  45	  79	  30	  22	  32	  22	  31	  25	  18	  15	  14
								1087	  30	  25	  30	  30	  55	  50	  75	  60	  50	  85	  60	 110	 100	  95	  75	  75
								1062	  29	  26	  29	  31	  58	  50	  80	  53	  43	  64	  50	  85	  87	  77	  66	  58
								1060	  29	  28	  29	  31	  55	  48	  79	  38	  30	  44	  31	  48	  43	  34	  31	  34
								1075	  41	  21	  24	  25	  52	  47	  80	  29	  21	  31	  21	  30	  24	  17	  14	  16
								1082	  33	  25	  28	  28	  55	  48	  73	  63	  50	  86	  61	 114	 114	 114	  99	 129
								1062	  29	  26	  30	  31	  57	  49	  80	  49	  41	  62	  45	  78	  78	  72	  68	  82
								1058	  30	  26	  28	  33	  56	  49	  80	  37	  29	  43	  30	  46	  40	  31	  30	  44
								1069	  44	  20	  23	  25	  52	  48	  80	  27	  21	  29	  20	  29	  23	  16	  13	  17
								1077	  35	  25	  25	  25	  55	  45	  70	  66	  51	  87	  61	 117	 127	 132	 122	 183
								1062	  29	  26	  31	  31	  56	  48	  80	  46	  38	  60	  41	  71	  70	  66	  70	 106
								1060	  30	  25	  28	  31	  56	  48	  79	  36	  28	  41	  29	  43	  38	  28	  25	  35
								1069	  44	  20	  23	  25	  52	  47	  79	  26	  20	  28	  19	  27	  22	  15	  11	  14
								1080	  32	  22	  25	  25	  52	  45	  70	  59	  47	  76	  57	 100	 106	 105	 105	 142
								1075	  20	  23	  29	  31	  52	  46	  76	  45	  36	  56	  39	  63	  60	  52	  54	  79
								1062	  29	  24	  28	  29	  56	  47	  78	  35	  27	  40	  28	  41	  35	  25	  21	  27
								1069	  44	  21	  23	  24	  52	  46	  78	  25	  19	  27	  18	  26	  20	  13	  10	  10
								1084	  28	  23	  23	  28	  50	  43	  73	  53	  43	  65	  53	  80	  83	  75	  80	 110
								1079	  21	  22	  27	  29	  50	  44	  73	  45	  36	  53	  38	  58	  51	  40	  39	  53
								1070	  29	  21	  27	  26	  52	  44	  72	  36	  29	  40	  27	  40	  30	  20	  16	  19
								1070	  41	  17	  24	  23	  51	  44	  79	  29	  22	  30	  20	  27	  18	  11	   8	   8
								1088	  28	  22	  22	  28	  50	  42	  73	  48	  41	  60	  48	  68	  66	  55	  58	  81
								1080	  26	  22	  26	  27	  51	  44	  71	  46	  37	  53	  38	  57	  48	  36	  31	  37
								1077	  28	  22	  24	  26	  51	  43	  70	  38	  29	  42	  28	  40	  30	  18	  13	  13
								1071	  40	  19	  21	  23	  48	  44	  76	  32	  24	  33	  21	  29	  20	  11	   7	   6
								1092	  35	  15	  25	  25	  50	  45	  70	  45	  45	  60	  45	  65	  60	  45	  45	  45
								1084	  27	  21	  26	  26	  51	  43	  70	  46	  36	  56	  40	  58	  51	  36	  28	  30
								1082	  28	  22	  24	  26	  50	  42	  69	  39	  30	  43	  28	  41	  32	  22	  16	  15
								1076	  40	  18	  22	  24	  47	  44	  76	  31	  23	  31	  20	  28	  19	  12	   8	   7
								1099	  35	  15	  25	  25	  50	  45	  68	  50	  40	  65	  45	  68	  65	  53	  53	  58
								1090	  28	  21	  26	  26	  50	  43	  69	  47	  38	  57	  41	  60	  54	  43	  37	  38
								1087	  28	  21	  24	  26	  49	  42	  68	  39	  31	  44	  29	  43	  35	  25	  19	  17
								1080	  39	  16	  22	  24	  46	  44	  76	  30	  22	  30	  20	  27	  19	  13	   9	   8
								1107	  35	  15	  25	  25	  50	  45	  65	  56	  35	  71	  45	  71	  71	  61	  61	  71
								1096	  29	  21	  26	  26	  50	  43	  68	  47	  39	  57	  42	  63	  57	  49	  46	  46
								1093	  30	  21	  25	  25	  49	  42	  68	  39	  31	  44	  30	  44	  36	  27	  22	  23
								1086	  40	  17	  22	  23	  47	  44	  77	  30	  22	  30	  20	  27	  20	  14	  10	   9
								1112	  33	  20	  23	  25	  50	  45	  65	  53	  41	  66	  48	  74	  76	  71	  79	  99
								1103	  31	  21	  27	  25	  50	  43	  68	  47	  40	  57	  42	  64	  61	  55	  53	  61
								1099	  31	  21	  26	  24	  49	  42	  68	  39	  31	  45	  30	  45	  37	  29	  25	  29
								1093	  41	  17	  23	  23	  48	  44	  78	  29	  22	  30	  20	  28	  21	  15	  11	  11
								1117	  30	  25	  20	  25	  50	  45	  65	  51	  46	  61	  51	  76	  81	  81	  97	 127
								1110	  32	  21	  27	  24	  50	  43	  67	  47	  40	  57	  42	  66	  64	  61	  61	  76
								1103	  33	  22	  25	  25	  49	  42	  68	  39	  31	  44	  31	  45	  38	  31	  28	  32
								1095	  41	  19	  22	  23	  48	  44	  78	  30	  22	  30	  20	  28	  22	  16	  12	  12
								1119	  33	  25	  20	  25	  50	  43	  65	  51	  43	  61	  46	  74	  74	  74	  84	 107
								1113	  34	  21	  27	  25	  50	  42	  68	  48	  39	  57	  42	  65	  63	  59	  57	  71
								1108	  35	  22	  25	  25	  49	  42	  67	  39	  30	  44	  31	  45	  39	  33	  31	  35
								1097	  41	  20	  22	  23	  47	  44	  79	  30	  22	  30	  20	  28	  23	  17	  14	  14
								1122	  35	  25	  20	  25	  50	  40	  65	  51	  41	  61	  41	  71	  66	  66	  71	  87
								1117	  36	  21	  26	  26	  50	  41	  68	  48	  38	  57	  42	  63	  62	  57	  53	  67
								1112	  37	  22	  26	  25	  49	  42	  68	  43	  33	  48	  33	  49	  42	  34	  31	  33
								1100	  41	  21	  22	  23	  48	  44	  78	  39	  28	  39	  25	  35	  27	  19	  15	  14
								1132	  38	  22	  23	  28	  50	  43	  68	  54	  41	  68	  44	  75	  73	  66	  75	  93
								1124	  42	  22	  27	  27	  51	  43	  73	  53	  42	  63	  46	  70	  64	  58	  54	  65
								1116	  38	  22	  26	  25	  49	  42	  69	  47	  36	  53	  36	  53	  45	  35	  31	  31
								1103	  41	  21	  22	  23	  48	  45	  77	  47	  34	  47	  30	  41	  30	  21	  16	  15
								1147	  45	  23	  28	  30	  58	  48	  80	  69	  59	  93	  67	 120	 134	 137	 156	 213
								1136	  50	  26	  30	  30	  58	  50	  85	  94	  77	 118	  88	 148	 158	 155	 152	 183
								1130	  47	  26	  28	  28	  56	  49	  79	  79	  62	  89	  63	  96	  83	  66	  53	  57
								1120	  49	  23	  25	  26	  53	  50	  94	  95	  70	  97	  63	  88	  66	  44	  32	  32
								1157	  50	  25	  30	  30	  65	  50	  90	  82	  77	 115	  88	 165	 192	 208	 236	 329
								1146	  56	  29	  32	  32	  65	  55	  94	 133	 110	 170	 128	 224	 249	 252	 249	 303
								1164	  85	  47	  53	  52	 108	 100	 189	 620	 436	 592	 395	 610	 573	 508	 489	 610
								1147	  76	  44	  48	  54	 132	 143	 389	 135	  99	 136	  89	 124	  93	  62	  46	  46
								1272	  50	  25	  40	  25	  65	  50	  90	  62	  48	  76	  57	  90	  81	  57	  43	  43
								1214	  48	  27	  31	  34	  58	  53	  86	  55	  44	  67	  50	  80	  69	  44	  28	  23
								1214	  37	  26	  29	  32	  58	  50	  85	  48	  37	  57	  41	  65	  57	  38	  23	  15
								1245	  48	  22	  24	  26	  52	  47	  91	  41	  31	  45	  31	  46	  38	  25	  14	   9
								1259	  48	  25	  35	  30	  65	  53	  88	  66	  54	  83	  63	 102	  95	  71	  51	  51
								1212	  43	  28	  31	  35	  60	  54	  87	  58	  47	  73	  55	  90	  82	  56	  38	  31
								1214	  37	  26	  29	  32	  58	  50	  85	  48	  37	  57	  41	  65	  57	  38	  23	  15
								1245	  48	  22	  24	  26	  52	  47	  91	  41	  31	  45	  31	  46	  38	  25	  14	   9
								1247	  45	  25	  30	  35	  65	  55	  85	  70	  60	  90	  70	 114	 109	  85	  60	  60
								1209	  38	  29	  31	  36	  62	  55	  89	  61	  50	  79	  60	 100	  95	  68	  48	  39
								1207	  38	  27	  30	  33	  60	  52	  87	  47	  37	  56	  40	  65	  57	  41	  30	  27
								1233	  47	  22	  25	  27	  53	  49	  93	  41	  31	  44	  31	  46	  38	  25	  17	  15
								1239	  43	  28	  30	  33	  68	  53	  88	  72	  60	  95	  72	 127	 127	 102	  85	  85
								1206	  37	  29	  32	  36	  63	  56	  90	  60	  50	  78	  59	  99	  97	  78	  66	  67
								1200	  38	  28	  30	  35	  63	  53	  88	  46	  37	  55	  40	  64	  57	  43	  36	  39
								1222	  45	  22	  26	  28	  54	  50	  95	  40	  31	  44	  31	  46	  38	  26	  19	  21
								1232	  40	  30	  30	  30	  70	  50	  90	  75	  60	 100	  75	 140	 145	 120	 110	 110
								1202	  36	  29	  32	  36	  65	  56	  91	  59	  49	  76	  59	  98	 100	  89	  84	  95
								1197	  39	  29	  30	  34	  63	  54	  89	  45	  36	  53	  39	  62	  55	  41	  34	  40
								1213	  44	  24	  26	  28	  56	  50	  95	  39	  30	  42	  30	  45	  37	  25	  18	  20
								1229	  38	  28	  30	  30	  68	  50	  85	  73	  61	  96	  78	 136	 144	 126	 124	 154
								1201	  36	  28	  32	  35	  63	  56	  89	  57	  47	  74	  56	  93	  92	  80	  76	  95
								1193	  40	  29	  31	  33	  64	  54	  89	  43	  35	  52	  38	  60	  52	  38	  31	  41
								1205	  43	  26	  26	  28	  57	  51	  96	  37	  28	  41	  29	  43	  36	  24	  17	  19
								1227	  35	  25	  30	  30	  65	  50	  80	  71	  61	  91	  81	 132	 142	 132	 137	 198
								1201	  36	  27	  31	  34	  62	  55	  87	  56	  45	  72	  53	  88	  84	  72	  67	  96
								1196	  38	  28	  30	  34	  60	  52	  87	  44	  35	  52	  37	  59	  51	  37	  29	  35
								1205	  40	  26	  26	  28	  56	  50	  96	  37	  28	  40	  28	  42	  34	  23	  16	  16
								1230	  32	  28	  27	  27	  62	  50	  80	  64	  57	  88	  67	 118	 118	 115	 116	 150
								1202	  38	  26	  29	  33	  59	  50	  84	  56	  45	  70	  51	  84	  77	  61	  56	  75
								1199	  36	  27	  29	  34	  56	  51	  84	  45	  35	  53	  37	  58	  49	  35	  27	  29
								1205	  37	  26	  25	  27	  56	  50	  95	  36	  27	  39	  27	  40	  32	  21	  15	  14
								1237	  30	  30	  25	  28	  60	  50	  80	  60	  53	  83	  60	 105	  98	  90	  90	 113
								1212	  37	  25	  27	  31	  59	  48	  82	  56	  46	  69	  50	  81	  71	  52	  45	  56
								1210	  34	  24	  28	  28	  58	  49	  81	  46	  36	  54	  37	  57	  46	  29	  21	  22
								1208	  37	  24	  25	  27	  54	  48	  93	  44	  33	  47	  31	  46	  34	  19	  13	  12
								1244	  32	  28	  25	  32	  58	  50	  80	  60	  52	  80	  58	  98	  88	  73	  70	  90
								1224	  35	  23	  27	  29	  59	  48	  82	  56	  46	  70	  50	  81	  70	  50	  40	  47
								1218	  37	  24	  27	  28	  56	  47	  79	  47	  37	  54	  39	  57	  45	  28	  19	  17
								1212	  38	  25	  24	  26	  53	  48	  91	  46	  34	  48	  32	  47	  34	  19	  11	  10
								1247	  35	  25	  25	  35	  55	  50	  80	  60	  55	  80	  55	  95	  85	  70	  60	  70
								1230	  38	  22	  27	  29	  56	  48	  80	  57	  45	  72	  52	  82	  74	  52	  42	  45
								1226	  37	  24	  27	  28	  56	  47	  78	  47	  37	  55	  39	  58	  47	  30	  22	  21
								1224	  34	  24	  24	  26	  53	  48	  92	  42	  31	  44	  30	  43	  32	  18	  12	  11
								1259	  30	  25	  25	  33	  58	  48	  78	  64	  53	  81	  58	  99	  91	  76	  69	  84
								1237	  41	  23	  27	  29	  56	  47	  80	  57	  46	  73	  53	  83	  75	  57	  48	  55
								1234	  38	  24	  26	  28	  55	  46	  78	  47	  37	  55	  40	  59	  48	  33	  25	  25
								1236	  31	  23	  24	  26	  53	  47	  92	  39	  29	  41	  27	  40	  29	  18	  12	  11
								1272	  25	  25	  25	  30	  60	  45	  75	  67	  52	  82	  62	 103	  98	  82	  77	  98
								1245	  44	  24	  26	  29	  56	  46	  79	  58	  47	  73	  54	  85	  76	  63	  54	  64
								1244	  40	  24	  26	  27	  55	  46	  77	  47	  37	  55	  39	  60	  50	  36	  28	  29
								1236	  38	  22	  24	  26	  53	  47	  92	  39	  29	  41	  28	  40	  31	  19	  14	  13
								1274	  35	  25	  25	  30	  58	  48	  73	  67	  49	  85	  62	 103	 103	  93	  90	 131
								1255	  46	  25	  26	  29	  56	  47	  77	  58	  47	  74	  54	  86	  81	  69	  64	  79
								1254	  42	  24	  26	  27	  55	  46	  77	  47	  38	  55	  39	  61	  51	  38	  32	  33
								1237	  46	  22	  23	  26	  53	  47	  92	  38	  29	  41	  28	  40	  32	  21	  15	  15
								1277	  45	  25	  25	  30	  55	  50	  70	  67	  46	  87	  62	 103	 108	 103	 103	 164
								1266	  48	  26	  26	  29	  55	  48	  75	  58	  47	  74	  54	  88	  86	  76	  74	  93
								1259	  46	  25	  26	  27	  55	  46	  77	  48	  38	  56	  40	  61	  53	  41	  36	  40
								1245	  42	  25	  23	  26	  52	  47	  92	  40	  30	  42	  28	  41	  34	  23	  18	  18
								1282	  45	  25	  25	  30	  55	  50	  73	  64	  51	  84	  59	 100	 102	  97	 100	 148
								1271	  51	  26	  27	  29	  55	  48	  76	  59	  48	  75	  55	  94	  85	  78	  77	  95
								1263	  51	  26	  26	  27	  55	  46	  76	  48	  38	  57	  40	  62	  56	  44	  39	  47
								1254	  39	  27	  23	  26	  52	  48	  93	  42	  31	  43	  29	  42	  35	  26	  21	  22
								1287	  45	  25	  25	  30	  55	  50	  75	  61	  56	  82	  56	  97	  97	  92	  97	 133
								1276	  55	  26	  27	  29	  55	  48	  77	  60	  48	  75	  57	  99	  84	  81	  79	  98
								1270	  55	  26	  27	  28	  55	  46	  78	  60	  47	  70	  50	  77	  67	  53	  45	  51
								1253	  45	  27	  23	  26	  53	  48	  93	  66	  49	  67	  45	  65	  51	  35	  26	  27
								1287	  58	  28	  25	  30	  58	  47	  78	  63	  61	  84	  65	 110	 103	 102	 103	 140
								1288	  65	  28	  30	  30	  59	  50	  83	  73	  60	  94	  68	 116	 107	  95	  90	 109
								1277	  58	  27	  27	  28	  56	  47	  80	  71	  56	  83	  60	  92	  79	  61	  50	  55
								1253	  51	  26	  23	  25	  54	  48	  94	  90	  67	  91	  61	  87	  66	  44	  31	  31
								1297	  70	  33	  30	  33	  68	  50	  93	 104	  89	 135	 109	 196	 220	 238	 259	 355
								1308	  86	  36	  36	  37	  73	  62	 104	 306	 230	 345	 254	 429	 458	 442	 438	 544
								1300	  79	  35	  33	  35	  69	  60	 104	 188	 145	 212	 150	 240	 224	 182	 150	 158
								1271	  59	  31	  30	  32	  66	  63	 130	 206	 151	 208	 140	 203	 158	 103	  74	  74
								1520	  87	  41	  41	  41	  87	  64	 122	 167	 132	 215	 174	 319	 389	 430	 479	 659
								1824	 139	  59	  57	  59	 116	  99	 170	 734	 545	 811	 598	1013	1101	1078	1078	1344
								1363	 192	 108	 117	 121	 269	 271	 610	 334	 257	 378	 268	 427	 399	 324	 268	 280
								3938	 182	  96	  93	  98	 206	 196	 403	 637	 467	 645	 434	 630	 489	 319	 230	 230
								1325	  60	  40	  35	  40	  75	  65	 105	  73	  69	 113	  83	 152	 142	 113	  69	  59
								1373	  92	  36	  36	  34	  73	  60	  99	  77	  62	 100	  78	 131	 124	  93	  57	  44
								1292	  87	  34	  33	  34	  68	  58	  97	  64	  50	  75	  55	  89	  79	  49	  27	  16
								1357	  54	  31	  29	  31	  69	  59	  99	  65	  50	  76	  56	  90	  80	  50	  28	  17
								1305	  60	  40	  35	  40	  80	  70	 110	  78	  78	 123	  88	 162	 167	 123	  93	  78
								1392	  61	  39	  34	  41	  77	  65	 106	  78	  64	 102	  80	 137	 135	 103	  70	  65
								1314	  60	  36	  37	  39	  70	  61	 100	  63	  50	  75	  55	  90	  83	  59	  35	  22
								1349	  50	  31	  31	  32	  70	  61	 100	  63	  50	  76	  55	  90	  84	  59	  35	  22
								1305	  50	  35	  40	  45	  85	  70	 105	  88	  73	 127	  93	 171	 186	 161	 113	 108
								1375	  61	  36	  41	  39	  80	  67	 114	  75	  63	 101	  79	 137	 145	 113	  94	  85
								1302	  57	  36	  37	  38	  78	  61	 104	  61	  45	  78	  53	  88	  83	  61	  43	  33
								1341	  48	  31	  31	  32	  78	  61	 105	  62	  45	  79	  54	  89	  83	  62	  43	  34
								1285	  55	  45	  35	  40	  85	  70	 110	  89	  74	 123	  98	 187	 202	 187	 153	 153
								1365	  60	  38	  38	  43	  82	  68	 111	  74	  63	  99	  75	 133	 136	 116	 103	 119
								1285	  61	  37	  37	  38	  76	  63	 105	  59	  48	  71	  52	  86	  80	  59	  45	  45
								1334	  49	  31	  30	  32	  77	  64	 106	  60	  48	  72	  53	  87	  81	  60	  45	  46
								1285	  60	  25	  50	  40	  80	  70	 110	  83	  78	 122	  97	 180	 200	 195	 190	 180
								1356	  60	  36	  41	  41	  82	  68	 114	  70	  59	  95	  73	 126	 129	 111	  92	 126
								1283	  56	  37	  37	  39	  76	  64	 104	  57	  47	  69	  51	  84	  76	  55	  42	  51
								1333	  46	  30	  29	  31	  77	  65	 106	  58	  47	  69	  52	  85	  77	  56	  43	  52
								1285	  50	  35	  40	  40	  75	  65	 105	  79	  74	 119	  94	 173	 193	 183	 193	 252
								1358	  56	  36	  41	  39	  84	  68	 113	  71	  56	  93	  68	 122	 121	  99	  84	 105
								1279	  52	  36	  36	  38	  76	  62	 104	  57	  46	  68	  51	  81	  74	  53	  39	  47
								1332	  47	  29	  28	  30	  78	  63	 106	  58	  47	  70	  52	  83	  75	  54	  40	  48
								1285	  50	  35	  35	  40	  70	  65	 100	  74	  79	 103	  89	 152	 162	 157	 152	 221
								1361	  55	  36	  34	  43	  80	  67	 109	  69	  56	  92	  67	 117	 116	  91	  72	  87
								1284	  50	  36	  34	  37	  73	  61	 103	  58	  42	  72	  50	  80	  72	  49	  34	  38
								1336	  47	  28	  28	  30	  74	  62	 105	  59	  43	  74	  51	  82	  74	  50	  35	  38
								1290	  50	  35	  35	  25	  75	  70	  95	  79	  64	 104	  79	 144	 149	 124	 109	 149
								1363	  55	  32	  39	  36	  75	  63	 106	  72	  59	  89	  68	 116	 110	  86	  64	  72
								1280	  56	  34	  33	  35	  70	  58	  98	  59	  46	  71	  50	  82	  73	  48	  30	  31
								1347	  45	  28	  27	  29	  72	  60	 101	  61	  48	  73	  51	  85	  75	  49	  31	  31
								1305	  50	  35	  25	  40	  70	  65	 100	  73	  63	 102	  78	 136	 131	 107	  88	 102
								1370	  56	  32	  32	  38	  70	  61	 101	  72	  57	  94	  71	 118	 113	  82	  62	  62
								1291	  52	  32	  31	  35	  68	  57	  96	  61	  48	  72	  52	  85	  72	  47	  26	  25
								1348	  54	  27	  27	  29	  70	  59	  99	  63	  49	  74	  54	  87	  74	  48	  27	  26
								1310	  50	  35	  30	  40	  70	  65	  90	  75	  60	 110	  80	 134	 139	 105	  85	  85
								1380	  58	  31	  34	  32	  72	  60	  97	  70	  62	  95	  70	 122	 115	  85	  64	  62
								1301	  53	  32	  31	  33	  66	  56	  94	  63	  50	  72	  53	  84	  73	  48	  27	  22
								1361	  52	  28	  27	  28	  68	  58	  97	  65	  51	  74	  55	  87	  75	  49	  28	  22
								1320	  60	  35	  30	  60	  45	  55	  95	  75	  65	 105	  85	 140	 140	 110	  95	  90
								1392	  63	  31	  32	  34	  68	  58	  96	  73	  61	  97	  73	 124	 117	  90	  68	  70
								1306	  62	  33	  30	  32	  67	  55	  93	  64	  48	  76	  52	  86	  76	  47	  29	  23
								1372	  55	  27	  27	  28	  69	  57	  96	  66	  50	  78	  53	  88	  78	  49	  30	  23
								1335	  65	  35	  30	  35	  70	  60	  95	  75	  65	 105	  85	 144	 134	 125	 100	 125
								1402	  68	  32	  31	  36	  68	  56	  96	  73	  61	  97	  71	 126	 117	  95	  75	  80
								1316	  67	  33	  31	  32	  65	  55	  93	  62	  49	  74	  53	  85	  75	  49	  30	  28
								1380	  61	  29	  26	  28	  67	  57	  96	  64	  50	  76	  54	  88	  78	  51	  31	  28
								1350	  70	  30	  35	  35	  65	  60	 105	  79	  64	  99	  84	 138	 148	 118	 123	 148
								1419	  73	  32	  32	  32	  68	  58	  92	  72	  60	  92	  73	 125	 121	  96	  82	  96
								1335	  64	  35	  30	  33	  64	  55	  93	  60	  48	  73	  50	  83	  73	  50	  33	  31
								1391	  64	  30	  27	  28	  66	  57	  96	  62	  49	  75	  51	  86	  75	  52	  34	  32
								1350	  75	  40	  30	  35	  70	  55	  95	  85	  60	 110	  75	 139	 144	 129	 134	 174
								1418	  92	  34	  32	  34	  68	  58	  92	  70	  60	  94	  75	 122	 120	  99	  93	 111
								1346	  70	  35	  31	  33	  64	  54	  92	  59	  47	  70	  51	  80	  71	  47	  34	  35
								1402	  65	  31	  27	  28	  66	  56	  94	  60	  49	  71	  52	  82	  73	  49	  35	  36
								1365	  80	  45	  30	  30	  70	  55	  90	  75	  60	 111	  75	 141	 146	 131	 136	 181
								1438	  91	  38	  31	  29	  73	  55	  96	  74	  60	  96	  74	 127	 122	 102	  98	 122
								1356	  75	  35	  32	  33	  65	  53	  90	  59	  46	  69	  49	  79	  69	  47	  35	  39
								1409	  68	  32	  28	  29	  66	  54	  92	  61	  47	  71	  50	  81	  71	  48	  36	  40
								1370	  85	  40	  30	  35	  70	  60	  90	  75	  65	 100	  80	 129	 139	 120	 125	 169
								1445	  97	  36	  34	  34	  68	  56	  94	  76	  62	  97	  78	 125	 126	 106	  95	 118
								1360	  81	  34	  34	  32	  65	  53	  91	  58	  47	  69	  48	  76	  67	  47	  32	  38
								1415	  73	  32	  28	  29	  67	  54	  93	  59	  48	  70	  50	  78	  69	  48	  33	  39
								1384	  90	  35	  35	  45	  60	  60	  90	  75	  65	 101	  80	 131	 136	 131	 116	 166
								1453	 108	  36	  34	  36	  68	  56	  94	  82	  67	 107	  78	 136	 134	 107	  96	 116
								1368	  87	  36	  33	  33	  65	  54	  90	  59	  46	  69	  48	  76	  64	  44	  32	  35
								1424	  79	  36	  30	  30	  66	  55	  92	  60	  47	  71	  49	  78	  66	  45	  33	  36
								1394	 105	  45	  35	  35	  70	  60	 105	  90	  74	 126	  95	 174	 184	 169	 169	 205
								1469	 114	  39	  32	  38	  73	  55	  97	 126	 104	 164	 128	 223	 230	 203	 177	 194
								1378	  95	  37	  35	  32	  66	  54	  92	  71	  54	  82	  59	  92	  77	  52	  35	  36
								1432	 108	  48	  44	  48	  70	  58	  98	  76	  58	  88	  63	  98	  82	  56	  37	  38
								1414	 144	  50	  45	  55	  90	  75	 129	 220	 175	 298	 240	 441	 525	 571	 629	 875
								1484	 143	  48	  39	  43	  79	  68	 114	 700	 531	 769	 572	 975	1057	1016	 993	1208
								1393	 113	  44	  38	  40	  78	  65	 112	 184	 143	 213	 156	 261	 255	 209	 164	 167
								1497	 240	 205	 246	 305	 119	 100	 171	 281	 219	 326	 239	 400	 390	 320	 251	 255
								1464	 244	 115	 100	  95	 179	 149	 244	3502	2565	3602	2529	4257	4512	4148	3657	3957
								1522	 239	 102	  89	  87	 171	 145	 256	 906	 687	 995	 740	1261	1368	1314	1285	1563
								1458	 220	 117	 111	 118	 252	 234	 475	 291	 227	 337	 248	 414	 404	 331	 260	 264
								1458	 220	 117	 111	 118	 252	 234	 475	 291	 227	 337	 248	 414	 404	 331	 260	 264
								1518	 140	  40	  55	  45	  90	  70	 130	 103	  83	 142	 113	 201	 216	 176	 122	 108
								1466	 181	  51	  41	  39	  82	  67	 115	  92	  75	 122	  96	 169	 175	 139	  96	  75
								1437	 180	  47	  39	  38	  75	  62	 108	  83	  65	  98	  73	 120	 115	  83	  48	  30
								1407	  89	  37	  32	  32	  69	  57	  99	  76	  60	  90	  67	 110	 106	  76	  44	  28
								1474	 160	  50	  45	  50	  95	  75	 135	 102	  83	 161	 112	 214	 244	 200	 146	 136
								1509	 125	  50	  46	  44	  89	  75	 123	  89	  77	 119	  96	 168	 180	 150	 114	 100
								1474	 131	  47	  41	  42	  80	  65	 113	  82	  65	  97	  72	 120	 118	  90	  58	  44
								1402	  80	  37	  32	  32	  73	  60	 103	  75	  59	  89	  66	 109	 108	  82	  53	  40
								1479	 130	  50	  45	  50	 100	  75	 135	 107	  93	 146	 122	 229	 253	 234	 190	 175
								1485	 125	  50	  46	  48	  92	  75	 130	  87	  73	 118	  95	 166	 177	 147	 126	 129
								1461	 119	  48	  42	  42	  82	  68	 116	  81	  64	  96	  71	 119	 116	  89	  64	  57
								1393	  75	  36	  32	  32	  75	  62	 106	  74	  58	  88	  65	 109	 106	  82	  58	  52
								1479	 110	  50	  45	  45	 100	  75	 130	 103	  88	 152	 123	 231	 260	 250	 221	 236
								1480	 108	  51	  44	  48	  94	  79	 130	  85	  71	 117	  93	 162	 173	 148	 118	 135
								1453	 110	  47	  42	  42	  83	  68	 117	  79	  63	  95	  70	 118	 114	  89	  61	  63
								1384	  75	  35	  32	  31	  77	  63	 108	  73	  58	  87	  64	 108	 105	  82	  56	  58
								1474	 105	  50	  45	  40	  95	  75	 120	 104	  94	 138	 123	 222	 252	 247	 232	 276
								1472	 104	  50	  48	  44	  94	  77	 130	  84	  70	 115	  89	 159	 167	 140	 112	 123
								1450	 103	  46	  42	  42	  83	  68	 117	  79	  63	  94	  69	 116	 113	  85	  59	  60
								1382	  73	  34	  30	  31	  76	  63	 108	  73	  58	  87	  64	 107	 104	  79	  54	  56
								1479	 105	  40	  45	  45	  85	  75	 120	  94	  84	 143	 113	 212	 232	 222	 207	 266
								1468	 103	  46	  44	  48	  91	  75	 125	  84	  71	 112	  90	 156	 162	 136	  99	 118
								1446	 101	  46	  40	  41	  81	  67	 115	  79	  63	  94	  69	 116	 112	  84	  56	  54
								1366	  69	  34	  29	  31	  74	  62	 105	  72	  57	  86	  63	 106	 102	  77	  51	  50
								1479	 100	  50	  35	  45	  85	  70	 120	  94	  79	 139	 114	 193	 223	 188	 174	 223
								1472	  96	  46	  41	  43	  89	  70	 121	  86	  71	 113	  91	 157	 162	 133	  99	 102
								1447	 100	  44	  38	  40	  78	  66	 113	  80	  64	  96	  71	 118	 113	  83	  53	  49
								1381	  80	  34	  29	  31	  73	  62	 105	  74	  59	  90	  66	 110	 105	  77	  49	  45
								1484	 110	  40	  40	  40	  85	  70	 120	  94	  84	 128	 109	 193	 207	 163	 153	 173
								1473	 104	  39	  39	  43	  82	  70	 115	  88	  71	 114	  91	 161	 162	 129	  96	  96
								1454	  97	  42	  37	  38	  77	  63	 112	  81	  64	  98	  72	 119	 114	  81	  52	  42
								1396	  76	  34	  29	  30	  72	  60	 105	  76	  60	  92	  67	 112	 107	  76	  49	  40
								1459	 105	  40	  40	  40	  80	  70	 110	  90	  80	 124	 109	 184	 189	 159	 129	 144
								1588	 104	  43	  38	  41	  82	  67	 115	  87	  72	 118	  93	 160	 163	 131	  94	  91
								1456	 106	  42	  36	  38	  75	  63	 109	  82	  67	  99	  73	 121	 115	  82	  51	  40
								1519	  77	  34	  30	  30	  75	  63	 110	  82	  67	  99	  73	 122	 115	  82	  51	  40
								1494	 140	  40	  40	  35	  80	  75	 110	  86	  86	 136	 106	 191	 201	 166	 131	 151
								1603	 113	  43	  38	  39	  80	  67	 111	  86	  73	 120	  90	 161	 166	 132	  95	  93
								1431	 101	  40	  35	  37	  73	  61	 107	  83	  66	  98	  72	 120	 115	  80	  50	  39
								1526	  83	  35	  29	  29	  76	  63	 111	  86	  68	 102	  75	 124	 119	  83	  51	  40
								1523	 130	  50	  35	  40	  85	  65	 115	  95	  80	 135	 105	 191	 201	 176	 135	 150
								1617	 121	  39	  41	  39	  80	  65	 111	  87	  73	 118	  94	 160	 167	 133	 102	 101
								1480	 120	  42	  36	  35	  74	  62	 106	  82	  64	  99	  72	 120	 115	  81	  50	  41
								1537	  89	  36	  29	  29	  74	  62	 107	  83	  64	  99	  72	 120	 116	  82	  51	  41
								1533	 145	  50	  40	  40	  75	  70	 110	  95	  80	 130	 110	 191	 211	 170	 145	 170
								1627	 132	  43	  39	  39	  77	  65	 110	  88	  72	 115	  91	 162	 165	 136	 107	 112
								1492	 128	  44	  37	  37	  72	  61	 106	  81	  64	  96	  71	 118	 112	  83	  52	  44
								1547	  94	  37	  30	  29	  72	  61	 106	  81	  64	  96	  71	 118	 112	  83	  52	  44
								1543	 165	  50	  45	  35	  75	  70	 110	  96	  81	 131	 106	 186	 206	 176	 166	 196
								1634	 152	  46	  38	  41	  79	  65	 106	  87	  74	 114	  92	 156	 164	 135	 112	 125
								1511	 133	  46	  37	  36	  72	  60	 105	  81	  63	  94	  69	 113	 110	  79	  53	  49
								1549	 109	  38	  30	  30	  72	  60	 105	  81	  62	  94	  69	 113	 109	  79	  52	  49
								1548	 185	  50	  40	  40	  80	  65	 105	  86	  81	 132	 107	 188	 209	 183	 173	 234
								1653	 163	  48	  41	  39	  77	  65	 106	  89	  73	 120	  89	 162	 167	 141	 117	 141
								1520	 148	  47	  37	  37	  71	  60	 105	  81	  63	  94	  68	 111	 107	  77	  52	  53
								1563	 108	  39	  31	  30	  70	  59	 103	  80	  62	  93	  68	 110	 105	  76	  51	  52
								1563	 190	  50	  45	  35	  85	  65	 110	  91	  81	 131	 106	 187	 197	 187	 182	 257
								1656	 181	  51	  39	  39	  79	  65	 108	  91	  77	 119	  95	 165	 172	 149	 128	 154
								1520	 165	  53	  36	  37	  71	  60	 103	  82	  63	  94	  68	 111	 104	  77	  53	  56
								1572	 110	  40	  32	  30	  70	  59	 102	  81	  62	  93	  67	 109	 103	  76	  53	  55
								1553	 220	  60	  45	  40	  85	  55	 110	  92	  82	 133	 107	 189	 209	 189	 184	 255
								1667	 192	  55	  41	  41	  79	  63	 106	  96	  79	 126	  97	 173	 175	 150	 130	 171
								1531	 173	  53	  37	  38	  71	  60	 103	  83	  65	  96	  70	 113	 106	  77	  56	  57
								1579	 118	  43	  33	  31	  69	  59	 101	  82	  64	  95	  69	 111	 105	  76	  55	  56
								1578	 220	  70	  40	  40	  80	  70	 105	  99	  89	 136	 110	 204	 219	 193	 188	 261
								1674	 210	  55	  43	  41	  79	  67	 108	 111	  93	 151	 115	 204	 212	 175	 143	 163
								1535	 190	  56	  39	  38	  71	  60	 104	  88	  68	 103	  74	 121	 111	  80	  54	  60
								1588	 129	  48	  38	  37	  71	  60	 103	  87	  68	 102	  73	 120	 110	  79	  53	  59
								1588	 270	  75	  45	  50	  90	  75	 120	 141	 113	 180	 163	 281	 326	 315	 304	 400
								1687	 229	  63	  44	  43	  84	  68	 113	 219	 179	 271	 222	 382	 417	 387	 352	 379
								1537	 214	  63	  42	  40	  76	  63	 112	 125	  95	 141	 102	 170	 159	 117	  80	  80
								1597	 179	  81	  76	  85	  81	  68	 119	 133	 101	 151	 109	 181	 169	 124	  85	  85
								1598	 305	 100	  75	  70	 130	 110	 180	 628	 513	 760	 601	1078	1282	1361	1432	1971
								1711	 274	  80	  56	  55	 104	  86	 144	2065	1303	1675	1123	1792	1809	1652	1559	1896
								1567	 248	  78	  60	  57	 113	  96	 175	 421	 311	 452	 324	 536	 540	 454	 379	 401
								1567	 248	  78	  60	  57	 113	  96	 175	 421	 311	 452	 324	 536	 540	 454	 379	 401
								1648	 490	 225	 155	 145	 265	 205	 340	4565	3181	4272	2878	4626	4656	4131	3777	4312
								1745	 433	 209	 163	 157	 301	 255	 453	3058	1929	2481	1662	2653	2679	2446	2308	2808
								1638	 487	 306	 288	 314	 686	 659	1306	1000	 738	1073	 769	1272	1282	1078	 900	 953
								1638	 487	 306	 288	 314	 686	 659	1306	1000	 738	1073	 769	1272	1282	1078	 900	 953
								2463	1104	 375	  90	  45	  85	  65	 105	  79	  84	 126	 112	 214	 261	 242	 191	 186
								2435	1087	 310	  86	  58	  87	  63	 103	  85	  73	 119	  98	 182	 206	 184	 138	 111
								2321	 746	 141	  71	  54	  84	  59	  92	  67	  52	  79	  58	  99	 104	  85	  54	  33
								2144	 334	  91	  58	  45	  67	  47	  73	  54	  42	  63	  46	  79	  83	  68	  43	  26
								2448	 999	 300	  70	  55	  85	  70	 105	  90	  80	 137	 113	 236	 260	 250	 198	 184
								2399	1022	 284	  91	  62	  98	  67	 111	  86	  73	 120	  98	 185	 212	 189	 146	 120
								2310	 709	 142	  76	  58	  90	  63	  96	  66	  52	  79	  59	 100	 105	  88	  59	  41
								2123	 320	  89	  58	  45	  72	  50	  76	  53	  42	  63	  47	  80	  84	  71	  47	  33
								2433	 909	 235	  70	  50	  80	  75	 110	  96	  86	 138	 119	 239	 277	 263	 210	 201
								2380	 933	 240	  86	  58	  98	  72	 113	  89	  72	 124	 101	 189	 218	 194	 152	 132
								2298	 652	 133	  74	  58	  91	  65	 100	  66	  52	  79	  60	 102	 108	  92	  62	  46
								2105	 300	  89	  55	  44	  73	  52	  81	  54	  42	  64	  48	  83	  87	  74	  50	  37
								2413	 844	 185	  65	  50	  85	  65	 115	  93	  88	 151	 127	 253	 302	 283	 244	 234
								2367	 849	 209	  72	  60	  94	  74	 113	  87	  75	 123	 100	 191	 217	 205	 161	 154
								2286	 602	 125	  71	  57	  91	  65	 103	  64	  51	  78	  59	 104	 111	  94	  66	  50
								2099	 279	  87	  54	  46	  74	  53	  84	  52	  41	  63	  48	  85	  91	  77	  54	  41
								2403	 784	 165	  50	  55	  80	  65	 120	  98	  88	 147	 128	 251	 315	 300	 256	 275
								2355	 794	 185	  68	  55	  96	  74	 116	  88	  77	 129	 107	 205	 227	 202	 154	 145
								2277	 560	 121	  67	  56	  91	  66	 105	  63	  51	  79	  59	 102	 108	  91	  66	  56
								2097	 272	  85	  53	  43	  75	  55	  87	  52	  42	  65	  49	  84	  89	  75	  54	  47
								2383	 749	 150	  50	  45	  85	  65	 115	 103	  88	 157	 138	 270	 344	 349	 324	 364
								2349	 751	 159	  65	  55	  94	  72	 118	  74	  64	 114	  95	 189	 234	 229	 201	 201
								2266	 530	 115	  63	  56	  90	  66	 105	  55	  47	  76	  59	 110	 117	  97	  67	  54
								2084	 265	  83	  53	  44	  75	  55	  87	  46	  39	  64	  50	  92	  98	  81	  56	  45
								2383	 694	 130	  45	  50	  75	  65	 115	  79	  79	 133	 114	 222	 281	 267	 247	 296
								2351	 708	 145	  62	  55	  92	  74	 121	  69	  60	 103	  86	 166	 189	 174	 138	 141
								2261	 506	 112	  62	  53	  90	  68	 108	  49	  41	  66	  52	  96	 107	  95	  73	  68
								2086	 249	  77	  50	  41	  76	  57	  90	  41	  34	  55	  43	  80	  90	  80	  61	  57
								2383	 694	 120	  40	  40	  70	  60	 100	  83	  72	 129	 108	 222	 258	 242	 217	 242
								2343	 678	 125	  56	  48	  86	  68	 111	  76	  67	 115	  96	 186	 220	 197	 144	 128
								2250	 481	 106	  58	  49	  84	  64	 101	  55	  47	  75	  61	 110	 123	 101	  67	  52
								2097	 245	  77	  49	  41	  72	  55	  86	  47	  40	  64	  52	  93	 105	  86	  57	  45
								2393	 704	 130	  40	  35	  65	  55	  95	  83	  67	 125	 109	 202	 249	 228	 187	 208
								2356	 678	 128	  55	  43	  84	  58	 104	  73	  66	 113	  93	 181	 214	 192	 143	 134
								2259	 482	 103	  55	  47	  78	  60	  95	  56	  46	  75	  61	 113	 126	 104	  68	  48
								2098	 249	  75	  47	  39	  66	  51	  81	  48	  39	  64	  52	  96	 108	  89	  58	  41
								2393	 729	 130	  40	  35	  65	  60	  85	  74	  68	 116	 100	 205	 237	 216	 174	 169
								2361	 691	 133	  53	  43	  75	  60	  98	  73	  64	 110	  93	 178	 208	 187	 139	 125
								2256	 493	  99	  53	  46	  77	  57	  91	  53	  45	  71	  57	 108	 121	 100	  63	  44
								2102	 252	  76	  47	  38	  66	  49	  78	  45	  38	  61	  49	  92	 103	  85	  54	  38
								2398	 764	 135	  45	  35	  65	  50	  90	  75	  70	 118	 102	 193	 236	 214	 161	 166
								2368	 722	 137	  51	  44	  75	  56	  96	  75	  67	 113	  94	 177	 209	 181	 136	 129
								2255	 503	  97	  56	  46	  76	  55	  89	  52	  45	  72	  58	 108	 119	 100	  62	  43
								2107	 260	  74	  48	  38	  65	  47	  76	  45	  38	  62	  50	  93	 102	  86	  53	  37
								2403	 809	 155	  50	  35	  65	  50	  85	  82	  66	 115	  99	 198	 230	 208	 165	 176
								2370	 755	 152	  55	  44	  75	  56	  92	  81	  70	 120	  99	 187	 219	 185	 124	 115
								2263	 521	 100	  56	  47	  75	  55	  88	  54	  47	  73	  59	 108	 119	  98	  60	  42
								2114	 266	  78	  48	  39	  64	  47	  75	  46	  40	  62	  50	  92	 101	  83	  51	  36
								2408	 869	 180	  45	  40	  65	  45	  90	  73	  68	 124	  96	 192	 231	 203	 158	 164
								2380	 799	 163	  58	  46	  75	  56	  92	  86	  74	 126	 102	 203	 226	 193	 136	 110
								2265	 547	 105	  59	  48	  77	  55	  88	  55	  47	  75	  60	 109	 121	  96	  57	  38
								2117	 281	  80	  48	  41	  65	  46	  75	  47	  40	  63	  51	  93	 103	  81	  48	  32
								2413	 929	 200	  55	  35	  65	  60	  80	  81	  75	 122	 104	 197	 238	 215	 174	 192
								2384	 852	 183	  62	  50	  79	  56	  92	  90	  77	 132	 112	 207	 242	 204	 152	 130
								2274	 577	 108	  62	  49	  78	  56	  88	  56	  47	  75	  60	 111	 121	  97	  57	  38
								2121	 295	  82	  52	  42	  66	  47	  74	  47	  40	  64	  51	  93	 102	  82	  48	  32
								2433	 954	 235	  60	  40	  70	  50	  90	  91	  66	 139	 109	 218	 260	 236	 199	 236
								2385	 892	 216	  65	  53	  82	  58	  98	  94	  86	 145	 118	 228	 257	 225	 166	 171
								2281	 602	 115	  65	  51	  81	  57	  91	  58	  49	  79	  64	 117	 126	 101	  62	  46
								2123	 310	  89	  55	  46	  68	  48	  77	  49	  41	  67	  54	  99	 106	  85	  52	  39
								2438	1004	 260	  70	  40	  75	  55	  90	  90	  83	 141	 122	 237	 275	 269	 230	 288
								2397	 927	 226	  72	  55	  87	  63	 101	 113	  92	 163	 131	 255	 285	 244	 184	 199
								2286	 626	 124	  70	  55	  86	  63	  99	  65	  54	  86	  69	 126	 136	 109	  67	  57
								2127	 321	  94	  60	  51	  72	  53	  83	  55	  45	  72	  58	 106	 114	  92	  56	  48
								2428	1034	 295	  80	  50	  70	  55	 105	 106	  92	 169	 127	 268	 310	 282	 260	 331
								2385	 974	 243	  80	  55	  96	  68	 108	 133	 115	 195	 157	 300	 335	 279	 199	 195
								2290	 652	 130	  76	  58	  95	  71	 112	  75	  62	  97	  80	 143	 153	 121	  74	  62
								2128	 333	 103	  70	  62	  80	  59	  94	  63	  52	  82	  67	 120	 129	 102	  62	  52
								2443	1054	 320	  85	  50	  85	  60	 105	 137	 128	 197	 162	 333	 368	 333	 273	 316
								2396	 999	 262	  84	  65	 104	  75	 123	 180	 150	 253	 201	 377	 420	 347	 244	 219
								2295	 673	 142	  84	  67	 110	  83	 134	  93	  76	 122	  97	 172	 181	 140	  79	  57
								2130	 354	 118	  86	  81	  93	  71	 114	  79	  65	 103	  82	 146	 154	 119	  67	  49
								2433	1089	 345	 100	  55	  90	  75	 125	 199	 169	 279	 249	 448	 548	 518	 478	 548
								2396	1030	 298	  99	  72	 120	  87	 139	 259	 215	 356	 283	 532	 610	 547	 449	 449
								2302	 704	 151	  98	  76	 135	 106	 175	 131	 106	 169	 129	 231	 237	 181	 111	  77
								2132	 391	 150	 127	 124	 119	  93	 154	 115	  93	 148	 113	 203	 208	 159	  97	  68
								2428	1089	 350	 105	  65	 120	  95	 150	 434	 339	 542	 447	 827	 962	 922	 881	1071
								2397	1083	 327	 115	  89	 147	 113	 192	 605	 460	 681	 529	 958	1059	 977	 832	 882
								2294	 750	 178	 126	 105	 196	 162	 274	 193	 159	 243	 190	 344	 372	 319	 247	 242
								2294	 750	 178	 126	 105	 196	 162	 274	 193	 159	 243	 190	 344	 372	 319	 247	 242
								3933	3143	2229	1049	 430	 380	 195	 255	 169	 149	 253	 205	 418	 539	 591	 571	 603
								3737	2488	1377	 404	 219	 275	 164	 228	 166	 139	 224	 179	 334	 393	 390	 354	 343
								3399	1567	 361	 187	 137	 189	 116	 154	  71	  56	  83	  61	 104	 108	 101	  90	  79
								2935	 725	 199	 101	  54	 134	  82	 109	  50	  40	  59	  44	  74	  77	  71	  64	  56
								3858	2949	1874	 770	 315	 300	 165	 220	 163	 145	 246	 207	 427	 537	 607	 603	 669
								3856	2351	1198	 400	 231	 299	 188	 248	 131	 114	 197	 162	 302	 341	 347	 334	 336
								3379	1448	 409	 201	 144	 194	 114	 148	  58	  46	  70	  52	  91	  98	  94	  87	  84
								3062	 606	 178	  82	  46	 138	  81	 105	  41	  33	  50	  37	  65	  70	  67	  62	  60
								3853	3048	1389	 590	 235	 245	 145	 200	 149	 140	 226	 199	 403	 530	 607	 607	 693
								3784	2234	1027	 334	 198	 272	 168	 233	 118	 104	 181	 152	 307	 381	 377	 333	 345
								3365	1346	 334	 176	 130	 179	 108	 142	  61	  49	  76	  56	  97	 106	 104	  98	  95
								3053	 564	 148	  82	  51	 130	  79	 104	  44	  36	  55	  41	  71	  77	  76	  71	  69
								3783	2774	1364	 465	 190	 215	 135	 195	 158	 139	 240	 211	 432	 576	 629	 614	 648
								3779	2109	 881	 282	 178	 243	 156	 222	 109	  93	 161	 135	 271	 362	 421	 422	 399
								3323	1244	 308	 158	 118	 166	 105	 137	  57	  48	  77	  59	 106	 117	 111	 102	 100
								3025	 515	 143	  79	  58	 123	  78	 102	  42	  35	  57	  44	  78	  86	  82	  75	  74
								3773	2664	1259	 400	 170	 195	 125	 185	 133	 123	 209	 185	 398	 555	 673	 730	 887
								3740	2050	 777	 250	 157	 226	 145	 207	  99	  87	 147	 123	 241	 311	 347	 372	 477
								3325	1163	 275	 146	 110	 157	  99	 133	  52	  43	  69	  55	 101	 122	 129	 123	 116
								2990	 496	 132	  75	  54	 117	  74	  99	  39	  32	  51	  41	  76	  91	  96	  92	  87
								3763	2584	1119	 340	 145	 185	 115	 175	 113	 108	 187	 158	 335	 458	 532	 557	 695
								3725	1983	 715	 231	 145	 212	 142	 202	 103	  83	 146	 121	 244	 312	 342	 339	 350
								3294	1145	 253	 137	 105	 153	  98	 137	  49	  41	  65	  51	  92	 109	 117	 117	 127
								3006	 445	 123	  67	  55	 115	  73	 103	  37	  30	  48	  38	  69	  82	  87	  88	  95
								3738	2689	 915	 305	 135	 170	 105	 165	 132	 110	 198	 165	 352	 478	 539	 533	 572
								3687	1902	 654	 205	 132	 192	 125	 183	 109	  98	 162	 137	 270	 348	 399	 391	 387
								3263	1122	 198	 126	  96	 141	  91	 129	  57	  47	  75	  59	 107	 125	 131	 124	 114
								3263	1122	 198	 126	  96	 141	  91	 129	  57	  47	  75	  59	 107	 125	 131	 124	 114
								3723	2719	 910	 305	 135	 160	 105	 160	 127	 110	 197	 168	 348	 487	 545	 550	 597
								3709	1899	 614	 192	 128	 181	 120	 176	 119	 105	 172	 137	 275	 355	 398	 409	 419
								3256	1115	 190	 121	  92	 135	  88	 123	  60	  49	  78	  61	 112	 132	 140	 132	 117
								3256	1115	 190	 121	  92	 135	  88	 123	  60	  49	  78	  61	 112	 132	 140	 132	 117
								3728	2599	1104	 325	 135	 165	 100	 155	 123	 106	 182	 159	 335	 459	 517	 512	 570
								3721	1904	 621	 192	 127	 178	 118	 175	 126	 111	 175	 143	 287	 366	 390	 388	 393
								3265	1094	 224	 120	  93	 134	  87	 121	  60	  50	  76	  61	 110	 131	 138	 131	 118
								3265	1094	 224	 120	  93	 134	  87	 121	  60	  50	  76	  61	 110	 131	 138	 131	 118
								3748	2649	1149	 345	 140	 170	 105	 155	  97	 128	 177	 158	 323	 438	 481	 481	 505
								3678	1952	 654	 200	 123	 178	 116	 171	 136	 112	 193	 153	 297	 383	 415	 388	 353
								3276	1089	 223	 119	  91	 132	  85	 121	  63	  51	  81	  62	 113	 132	 138	 130	 114
								3276	1089	 223	 119	  91	 132	  85	 121	  63	  51	  81	  62	 113	 132	 138	 130	 114
								3748	2669	1219	 370	 150	 175	 110	 155	 130	 109	 198	 171	 348	 464	 512	 478	 478
								3731	1944	 674	 204	 127	 183	 115	 175	 145	 125	 190	 167	 318	 400	 425	 394	 340
								3249	1117	 228	 121	  90	 131	  84	 118	  64	  53	  83	  64	 115	 133	 136	 127	 103
								3249	1117	 228	 121	  90	 131	  84	 118	  64	  53	  83	  64	 115	 133	 136	 127	 103
								3713	2749	1284	 410	 160	 185	 115	 155	 142	 120	 217	 172	 382	 501	 554	 501	 494
								3704	2010	 712	 210	 132	 186	 120	 175	 153	 132	 210	 174	 339	 426	 456	 411	 342
								3268	1143	 239	 124	  93	 135	  85	 119	  65	  51	  82	  64	 115	 132	 136	 120	  95
								3268	1143	 239	 124	  93	 135	  85	 119	  65	  51	  82	  64	 115	 132	 136	 120	  95
								3743	2789	1379	 460	 175	 195	 120	 170	 147	 124	 232	 193	 387	 518	 573	 518	 511
								3725	2034	 746	 219	 137	 195	 123	 178	 167	 142	 233	 186	 365	 460	 488	 444	 362
								3258	1185	 248	 130	  97	 140	  89	 124	  68	  55	  87	  66	 121	 138	 142	 126	  96
								3258	1185	 248	 130	  97	 140	  89	 124	  68	  55	  87	  66	 121	 138	 142	 126	  96
								3693	2844	1449	 485	 195	 205	 130	 180	 166	 148	 262	 227	 454	 593	 654	 602	 593
								3661	2094	 796	 234	 144	 200	 132	 186	 187	 158	 253	 207	 407	 506	 548	 499	 414
								3243	1212	 258	 134	 103	 150	  97	 135	  72	  59	  91	  71	 128	 145	 149	 131	 100
								3243	1212	 258	 134	 103	 150	  97	 135	  72	  59	  91	  71	 128	 145	 149	 131	 100
								3683	2844	1509	 525	 205	 220	 135	 195	 204	 184	 301	 262	 514	 689	 747	 699	 699
								3697	2103	 809	 243	 151	 212	 140	 205	 214	 174	 271	 234	 451	 555	 619	 572	 515
								3260	1230	 278	 146	 112	 167	 108	 149	  76	  61	  95	  74	 131	 153	 154	 134	 104
								3260	1230	 278	 146	 112	 167	 108	 149	  76	  61	  95	  74	 131	 153	 154	 134	 104
								3718	2859	1569	 575	 220	 245	 140	 215	 256	 205	 338	 297	 583	 778	 829	 798	 829
								3646	2188	 847	 255	 161	 231	 154	 233	 251	 193	 315	 251	 501	 633	 701	 657	 647
								3250	1272	 321	 139	 125	 191	 125	 173	  84	  67	 103	  81	 144	 166	 169	 148	 117
								3250	1272	 321	 139	 125	 191	 125	 173	  84	  67	 103	  81	 144	 166	 169	 148	 117
								3683	2894	1629	 600	 240	 265	 175	 240	 312	 267	 423	 345	 702	 924	1002	 980	1091
								3642	2193	 903	 275	 175	 257	 173	 267	 305	 229	 364	 298	 561	 724	 803	 783	 817
								3231	1308	 319	 175	 144	 222	 146	 201	  97	  75	 117	  89	 162	 187	 188	 168	 143
								3231	1308	 319	 175	 144	 222	 146	 201	  97	  75	 117	  89	 162	 187	 188	 168	 143
								3698	2829	1644	 620	 260	 295	 185	 285	 430	 344	 540	 430	 871	1129	1252	1264	1522
								3689	2185	 924	 296	 192	 291	 205	 315	 397	 290	 429	 347	 655	 841	 937	 930	1019
								3278	1301	 349	 203	 169	 269	 179	 245	 111	  84	 130	 100	 180	 209	 215	 191	 176
								3278	1301	 349	 203	 169	 269	 179	 245	 111	  84	 130	 100	 180	 209	 215	 191	 176
								3718	2964	1699	 645	 320	 310	 215	 330	 695	 504	 736	 586	1131	1430	1567	1607	2030
								3646	2243	 975	 322	 210	 339	 245	 392	 612	 399	 569	 434	 832	1045	1161	1161	1332
								3259	1401	 435	 249	 192	 316	 220	 313	  87	  71	 113	  90	 167	 196	 201	 179	 176
								3259	1401	 435	 249	 192	 316	 220	 313	  87	  71	 113	  90	 167	 196	 201	 179	 176
								3718	3203	2224	1304	 630	 720	 520	 820	3483	1938	2148	1270	2004	2135	2148	2122	2593
								3632	2281	 987	 340	 238	 388	 299	 479	1024	 595	 799	 575	1053	1292	1409	1379	1584
								3233	1467	 464	 362	 266	 442	 309	 437	  96	  78	 124	  98	 182	 214	 219	 196	 192
								3233	1467	 464	 362	 266	 442	 309	 437	  96	  78	 124	  98	 182	 214	 219	 196	 192
						>;
		};
};
