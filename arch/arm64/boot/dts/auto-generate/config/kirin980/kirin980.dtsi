/**
 * Note: any file.dtsi or node in this file will be compile into all config.dts
 *so, if your node or file.dtsi will not use on some products, please don't put it here
 */
/include/ "kirin980_spmi.dtsi"
/include/ "kirin980_hwspinlock.dtsi"
/include/ "kirin980_pm_clk_monitor.dtsi"
/include/ "kirin980_ddr.dtsi"
/include/ "kirin980_bootdevice.dtsi"
/include/ "kirin980_mmc.dtsi"
/include/ "kirin980_ufs.dtsi"
/include/ "kirin980_ipc.dtsi"
/include/ "kirin980_ao_ipc.dtsi"
/include/ "kirin980_usb.dtsi"
/include/ "kirin980_ion.dtsi"
/include/ "kirin980_i2c.dtsi"
/include/ "kirin980_hw_vote.dtsi"
/include/ "kirin980_memory.dtsi"
/include/ "kirin980_efuse.dtsi"
/include/ "kirin980_earlymount.dtsi"
/include/ "kirin980_earlymount_huawei.dtsi"
/include/ "kirin980_qos.dtsi"
/include/ "kirin980_uart.dtsi"
/include/ "kirin980_spi.dtsi"
/include/ "kirin980_mntn.dtsi"
/include/ "kirin980_jtag.dtsi"
/include/ "hisi_6421v700_pmic_spmi.dtsi"
/include/ "hisi_6421v700_pmic_mntn_spmi.dtsi"
/include/ "kirin980_syscounter.dtsi"
/include/ "kirin980_contexthub.dtsi"
/include/ "kirin980_pmu.dtsi"
/include/ "kirin980_camera3.dtsi"
/include/ "huawei-sensor.dtsi"
/include/ "kirin980_ddrflux.dtsi"
/include/ "kirin980_hisee.dtsi"
/include/ "fastboot_6421v700_mntn.dtsi"
/include/ "fastboot_pmic.dtsi"
/include/ "kirin980_pcie.dtsi"
/include/ "kirin980_bl31_kernel_share_mem.dtsi"
/include/ "kirin980_timekeeper.dtsi"
/include/ "kirin980_dmsspt.dtsi"
/include/ "kirin980_hhee.dtsi"
/include/ "kirin980_secs.dtsi"
/include/ "kirin980_vowifi_proxy.dtsi"
/include/ "kirin980_pmu_dump.dtsi"
/include/ "kirin980_freqdump.dtsi"
/include/ "kirin980_subpmu.dtsi"
/include/ "kirin980_hkip_atkinfo.dtsi"
/include/ "kirin980_ads.dtsi"
