/* DO NOT EDIT - Automatically generated by python */
/ {
		desayyatl_3400_22k_4400:desayyatl_3400_22k_4400 {
			fcc = <3400>;
			default_rbatt_mohm = <100>;
			identify_type = "id_volt";
			id_identify_min = <751>;
			id_identify_max = <1235>;
			id_voltage_min = <949>;
			id_voltage_max = <1051>;
			vbat_max = <4400>;
			temp_para = 
						"-32767","0","-1","0","4100","0",
						"0","5","-1","340","4400","0",
						"5","10","-1","1020","4400","3",
						"10","45","-1","-1","4400","3",
						"45","50","-1","1190","4100","3",
						"50","32767","-1","0","4100","0";
			vbat_para = 
						"-32767","3400","-1","820","0",
						"3400","32767","-1","-1","0";
			segment_para = 
						"-32767","4150","3400","4208","50",
						"4150","4450","2380","4400","0";
			batt_brand = "desayyatl";
			fcc_temp = <3513 3515 3522 3558 3534 3495>;
			fcc_sf_x = <0 100 200 300 400 500 600 700 800 1000 1500>;
			fcc_sf_y = <100 96 94 92 90 88 87 84 81 75 50>;
			fcc_sf_cols = <11>;
			pc_sf_rows = <1>;
			pc_sf_cols = <1>;
			pc_sf_row_entries = <0>;
			pc_sf_percent = <100>;
			pc_sf_sf = <100>;
			rbatt_sf_rows = <28>;
			rbatt_sf_cols = <6>;
			rbatt_sf_percent = <100 95 90 85 80 75 70 65 60 55 50 45 40 35 30 25 20 15 10 9 8 7 6 5 4 3 2 1>;
			rbatt_sf_sf = <
			               1952 1215 537 111 91 85
			               1947 1214 536 110 91 85
			               1801 1181 526 108 91 86
			               1676 1137 505 108 91 86
			               1605 1103 499 109 92 88
			               1559 1096 503 113 94 89
			               1430 1050 518 118 98 90
			               1389 988 487 127 101 92
			               1372 978 482 137 110 97
			               1350 951 446 126 109 97
			               1368 944 433 106 91 87
			               1413 977 436 106 91 87
			               1464 1045 454 109 92 88
			               1521 1113 500 113 95 91
			               1583 1185 552 114 97 91
			               1653 1268 603 109 93 88
			               1726 1358 671 109 93 91
			               1830 1452 766 113 95 90
			               2863 1500 696 118 101 97
			               3035 1610 743 120 101 100
			               3238 1748 798 122 104 101
			               3471 1880 866 125 107 103
			               3755 2060 942 124 105 102
			               4024 2271 1042 123 104 98
			               4296 2373 1132 126 104 100
			               4621 2608 1270 135 108 103
			               5032 3112 1494 152 114 107
			               5877 3569 1800 244 141 117
			              >;
			pc_temp_ocv_rows = <29>;
			pc_temp_ocv_cols = <6>;
			pc_temp_ocv_percent = <100 95 90 85 80 75 70 65 60 55 50 45 40 35 30 25 20 15 10 9 8 7 6 5 4 3 2 1>;
			pc_temp_ocv_ocv = <
			                   4400 4398 4396 4395 4392 4388
			                   4301 4312 4320 4326 4320 4314
			                   4232 4245 4258 4265 4260 4254
			                   4170 4186 4198 4206 4202 4196
			                   4118 4130 4143 4149 4145 4141
			                   4070 4083 4092 4096 4091 4087
			                   3992 4022 4041 4045 4042 4038
			                   3939 3959 3981 3995 3994 3993
			                   3897 3917 3938 3952 3953 3950
			                   3858 3873 3889 3903 3905 3903
			                   3831 3837 3851 3861 3861 3860
			                   3815 3815 3823 3834 3834 3833
			                   3801 3802 3802 3813 3813 3812
			                   3789 3792 3791 3795 3796 3794
			                   3777 3782 3782 3779 3778 3773
			                   3763 3770 3771 3761 3755 3745
			                   3741 3751 3752 3741 3734 3722
			                   3719 3723 3723 3713 3708 3695
			                   3696 3692 3692 3690 3683 3671
			                   3691 3690 3689 3688 3682 3670
			                   3687 3687 3686 3686 3680 3669
			                   3682 3683 3683 3683 3678 3666
			                   3674 3676 3678 3673 3672 3658
			                   3658 3662 3662 3648 3653 3634
			                   3629 3631 3627 3603 3614 3595
			                   3581 3579 3573 3544 3561 3542
			                   3514 3506 3501 3465 3490 3473
			                   3410 3402 3395 3348 3388 3373
			                   3200 3200 3200 3200 3200 3200
			                  >;
		};
};
