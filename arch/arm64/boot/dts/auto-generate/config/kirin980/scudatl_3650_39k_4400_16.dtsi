/* DO NOT EDIT - Automatically generated by python */
/ {
		scudatl_3650_39k_4400_16:scudatl_3650_39k_4400_16 {
			fcc = <3650>;
			default_rbatt_mohm = <100>;
			identify_type = "id_volt";
			id_identify_min = <1235>;
			id_identify_max = <1759>;
			id_voltage_min = <1420>;
			id_voltage_max = <1562>;
			vbat_max = <4400>;
			temp_para = 
						"-32767","0","-1","0","4100","0",
						"0","5","-1","365","4400","0",
						"5","10","-1","1095","4400","3",
						"10","45","-1","-1","4400","3",
						"45","50","-1","1277","4100","3",
						"50","32767","-1","0","4100","0";
			vbat_para = 
						"-32767","3400","-1","820","0",
						"3400","32767","-1","-1","0";
			segment_para = 
						"-32767","4150","3650","4208","50",
						"4150","4450","2555","4400","0";
			batt_brand = "scudatl";
			fcc_temp = <3562 3556 3557 3566 3559 3473>;
			fcc_sf_x = <0 100 200 300 400 500 600 700 800 1000 1500>;
			fcc_sf_y = <100 96 94 92 90 88 87 84 81 75 50>;
			fcc_sf_cols = <11>;
			pc_sf_rows = <1>;
			pc_sf_cols = <1>;
			pc_sf_row_entries = <0>;
			pc_sf_percent = <100>;
			pc_sf_sf = <100>;
			rbatt_sf_rows = <28>;
			rbatt_sf_cols = <6>;
			rbatt_sf_percent = <100 95 90 85 80 75 70 65 60 55 50 45 40 35 30 25 20 15 10 9 8 7 6 5 4 3 2 1>;
			rbatt_sf_sf = <
			               1851 1188 470 128 103 94
			               1830 1181 470 129 103 94
			               1687 1135 469 132 105 95
			               1575 1084 474 135 107 97
			               1513 1070 480 141 111 99
			               1383 1022 513 149 116 102
			               1347 917 468 156 121 106
			               1325 911 453 165 129 113
			               1299 899 427 149 130 105
			               1305 890 415 124 103 95
			               1329 903 409 123 102 96
			               1371 935 419 128 106 98
			               1422 976 447 131 110 102
			               1477 1023 487 138 117 106
			               1542 1081 536 137 112 101
			               1621 1151 597 130 105 98
			               1715 1228 667 131 107 99
			               1840 1320 761 134 108 98
			               2034 1456 931 140 111 101
			               2077 1486 968 141 112 102
			               2557 1396 756 141 113 103
			               3006 1429 739 139 114 103
			               3338 1620 845 137 112 102
			               3669 1830 941 138 107 100
			               4002 2041 1059 136 109 100
			               4435 2242 1229 141 111 117
			               5047 2611 1477 153 115 153
			               6031 3285 1886 313 127 106
			              >;
			pc_temp_ocv_rows = <29>;
			pc_temp_ocv_cols = <6>;
			pc_temp_ocv_percent = <100 95 90 85 80 75 70 65 60 55 50 45 40 35 30 25 20 15 10 9 8 7 6 5 4 3 2 1>;
			pc_temp_ocv_ocv = <
			                   4336 4334 4333 4326 4321 4297
			                   4246 4253 4262 4266 4262 4241
			                   4181 4189 4201 4210 4207 4187
			                   4124 4131 4148 4156 4153 4135
			                   4074 4088 4097 4105 4101 4085
			                   3996 4034 4051 4058 4053 4039
			                   3948 3960 3986 4008 4006 3996
			                   3909 3920 3941 3966 3966 3956
			                   3869 3881 3897 3916 3920 3907
			                   3842 3847 3860 3872 3872 3867
			                   3821 3823 3830 3844 3844 3840
			                   3805 3808 3808 3821 3822 3819
			                   3793 3796 3795 3802 3803 3801
			                   3781 3787 3786 3787 3788 3784
			                   3767 3777 3776 3772 3770 3761
			                   3754 3766 3766 3754 3748 3735
			                   3739 3747 3748 3736 3730 3715
			                   3724 3723 3720 3709 3703 3690
			                   3701 3702 3697 3690 3684 3670
			                   3696 3698 3692 3687 3681 3665
			                   3690 3693 3686 3685 3679 3661
			                   3681 3687 3681 3681 3676 3656
			                   3670 3678 3675 3672 3670 3648
			                   3650 3662 3659 3647 3650 3628
			                   3619 3632 3626 3605 3611 3588
			                   3570 3583 3577 3549 3558 3539
			                   3499 3513 3509 3473 3490 3474
			                   3391 3409 3409 3360 3387 3374
			                   3200 3200 3200 3200 3200 3200
			                  >;
		};
};
