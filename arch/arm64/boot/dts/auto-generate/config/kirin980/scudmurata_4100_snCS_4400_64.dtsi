/* DO NOT EDIT - Automatically generated by python */
/ {
		scudmurata_4100_snCS_4400_64:scudmurata_4100_snCS_4400_64 {
			fcc = <4100>;
			default_rbatt_mohm = <100>;
			identify_type = "id_sn";
			id_sn = "CS";
			vbat_max = <4400>;
			temp_para = 
						"-32767","0","-1","0","4100","0",
						"0","5","-1","410","4400","0",
						"5","10","-1","1230","4400","3",
						"10","45","-1","-1","4400","3",
						"45","50","-1","1435","4100","3",
						"50","32767","-1","0","4100","0";
			vbat_para = 
						"-32767","3400","-1","820","0",
						"3400","32767","-1","-1","0";
			segment_para = 
						"-32767","4150","4100","4208","50",
						"4150","4450","2870","4400","0";
			batt_brand = "scudmurata";
			fcc_temp = <4071 4063 4062 4083 4070 4033>;
			fcc_sf_x = <0 100 200 300 400 500 600 700 800 1000 1500>;
			fcc_sf_y = <100 96 94 92 90 88 87 84 81 75 50>;
			fcc_sf_cols = <11>;
			pc_sf_rows = <1>;
			pc_sf_cols = <1>;
			pc_sf_row_entries = <0>;
			pc_sf_percent = <100>;
			pc_sf_sf = <100>;
			rbatt_sf_rows = <28>;
			rbatt_sf_cols = <6>;
			rbatt_sf_percent = <100 95 90 85 80 75 70 65 60 55 50 45 40 35 30 25 20 15 10 9 8 7 6 5 4 3 2 1>;
			rbatt_sf_sf = <
			               1479 731 357 124 91 77
			               1473 741 364 126 93 79
			               1452 745 369 130 94 80
			               1435 741 373 134 96 81
			               1427 736 379 139 99 82
			               1403 739 381 147 104 84
			               1391 730 370 156 110 87
			               1384 727 361 161 120 95
			               1381 727 356 144 110 90
			               1382 732 355 130 95 82
			               1396 738 358 127 93 80
			               1428 751 363 129 93 80
			               1473 776 369 133 96 82
			               1529 812 379 138 102 87
			               1593 854 395 139 97 82
			               1677 903 416 132 95 80
			               1803 964 441 134 97 84
			               1986 1082 471 135 97 82
			               3418 1308 470 142 106 90
			               3607 1373 480 145 106 93
			               3877 1469 500 145 108 94
			               4189 1593 524 151 110 92
			               4539 1725 558 154 108 88
			               4975 1921 599 156 111 92
			               5825 2129 648 169 116 104
			               6860 2445 735 184 129 111
			               8942 2743 916 207 149 113
			               13954 3800 1225 250 185 138
			              >;
			pc_temp_ocv_rows = <29>;
			pc_temp_ocv_cols = <6>;
			pc_temp_ocv_percent = <100 95 90 85 80 75 70 65 60 55 50 45 40 35 30 25 20 15 10 9 8 7 6 5 4 3 2 1>;
			pc_temp_ocv_ocv = <
			                   4334 4333 4333 4327 4322 4315
			                   4255 4268 4273 4269 4264 4258
			                   4188 4207 4214 4212 4207 4202
			                   4126 4147 4157 4156 4152 4147
			                   4071 4088 4103 4103 4100 4095
			                   4012 4034 4050 4053 4050 4046
			                   3959 3981 3993 4007 4005 4001
			                   3911 3933 3945 3962 3962 3960
			                   3870 3891 3904 3913 3915 3913
			                   3836 3855 3869 3873 3873 3872
			                   3807 3825 3839 3844 3843 3842
			                   3785 3801 3815 3821 3821 3819
			                   3766 3783 3795 3803 3803 3800
			                   3748 3766 3779 3787 3787 3784
			                   3730 3750 3765 3771 3766 3757
			                   3710 3733 3750 3750 3743 3731
			                   3690 3709 3729 3731 3724 3711
			                   3668 3682 3698 3702 3696 3683
			                   3635 3657 3673 3677 3671 3659
			                   3622 3648 3668 3673 3667 3656
			                   3611 3639 3662 3668 3662 3651
			                   3596 3630 3655 3660 3654 3644
			                   3579 3618 3644 3645 3638 3628
			                   3553 3600 3624 3613 3606 3596
			                   3525 3566 3589 3567 3561 3553
			                   3484 3513 3533 3509 3504 3500
			                   3421 3449 3458 3435 3431 3432
			                   3329 3349 3358 3341 3342 3336
			                   3200 3200 3200 3200 3200 3200
			                  >;
		};
};
