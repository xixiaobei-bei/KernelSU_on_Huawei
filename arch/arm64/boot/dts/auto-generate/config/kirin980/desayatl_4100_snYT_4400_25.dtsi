/* DO NOT EDIT - Automatically generated by python */
/ {
		desayatl_4100_snYT_4400_25:desayatl_4100_snYT_4400_25 {
			fcc = <4100>;
			default_rbatt_mohm = <100>;
			identify_type = "id_sn";
			id_sn = "YT";
			vbat_max = <4400>;
			temp_para = 
						"-32767","0","-1","0","4100","0",
						"0","5","-1","410","4400","0",
						"5","10","-1","1230","4400","3",
						"10","45","-1","-1","4400","3",
						"45","50","-1","1435","4100","3",
						"50","32767","-1","0","4100","0";
			vbat_para = 
						"-32767","3400","-1","820","0",
						"3400","32767","-1","-1","0";
			segment_para = 
						"-32767","4150","4100","4208","50",
						"4150","4450","2870","4400","0";
			batt_brand = "desayatl";
			fcc_temp = <4146 4099 4106 4091 4085 4045>;
			fcc_sf_x = <0 100 200 300 400 500 600 700 800 1000 1500>;
			fcc_sf_y = <100 96 94 92 90 88 87 84 81 75 50>;
			fcc_sf_cols = <11>;
			pc_sf_rows = <1>;
			pc_sf_cols = <1>;
			pc_sf_row_entries = <0>;
			pc_sf_percent = <100>;
			pc_sf_sf = <100>;
			rbatt_sf_rows = <28>;
			rbatt_sf_cols = <6>;
			rbatt_sf_percent = <100 95 90 85 80 75 70 65 60 55 50 45 40 35 30 25 20 15 10 9 8 7 6 5 4 3 2 1>;
			rbatt_sf_sf = <
			               1251 856 372 93 74 68
			               1240 853 371 93 75 68
			               1205 843 366 92 75 69
			               1163 833 359 93 76 70
			               1136 833 361 95 77 71
			               1136 837 382 99 80 72
			               1070 801 404 104 82 74
			               1010 786 385 113 87 77
			               1009 809 368 118 90 78
			               996 794 356 102 81 71
			               1005 716 351 92 76 71
			               1043 733 347 93 76 71
			               1091 770 353 95 78 72
			               1152 827 378 99 81 74
			               1227 899 417 101 82 77
			               1319 989 444 95 76 72
			               1429 1101 486 92 76 72
			               1550 1227 569 94 76 73
			               1912 1126 453 106 89 78
			               2067 1223 452 106 89 88
			               2286 1351 479 107 91 88
			               2471 1482 506 109 94 87
			               2764 1627 558 112 91 85
			               3029 1751 585 114 93 88
			               3343 1960 617 120 105 98
			               3776 2208 665 130 119 102
			               4303 2590 755 134 132 105
			               4866 2576 939 152 153 126
			              >;
			pc_temp_ocv_rows = <29>;
			pc_temp_ocv_cols = <6>;
			pc_temp_ocv_percent = <100 95 90 85 80 75 70 65 60 55 50 45 40 35 30 25 20 15 10 9 8 7 6 5 4 3 2 1>;
			pc_temp_ocv_ocv = <
			                   4377 4369 4371 4368 4364 4359
			                   4296 4297 4307 4310 4309 4302
			                   4231 4235 4247 4253 4252 4246
			                   4169 4177 4191 4196 4195 4191
			                   4113 4125 4137 4141 4141 4136
			                   4068 4076 4086 4089 4089 4085
			                   3999 4014 4033 4040 4040 4037
			                   3933 3952 3973 3993 3994 3992
			                   3896 3910 3927 3948 3948 3946
			                   3857 3870 3885 3897 3898 3895
			                   3828 3835 3850 3860 3862 3861
			                   3810 3813 3824 3835 3836 3835
			                   3797 3800 3803 3815 3815 3814
			                   3785 3790 3790 3798 3797 3795
			                   3772 3780 3780 3782 3779 3775
			                   3756 3767 3769 3762 3753 3742
			                   3738 3748 3750 3740 3731 3719
			                   3719 3723 3721 3715 3706 3694
			                   3695 3694 3694 3691 3683 3672
			                   3688 3689 3691 3690 3682 3670
			                   3682 3685 3688 3688 3680 3668
			                   3673 3678 3684 3685 3677 3664
			                   3660 3670 3677 3679 3667 3653
			                   3636 3651 3658 3658 3642 3626
			                   3599 3619 3619 3619 3601 3586
			                   3546 3564 3564 3567 3548 3534
			                   3476 3490 3491 3497 3478 3464
			                   3379 3388 3387 3393 3375 3363
			                   3200 3200 3200 3200 3200 3200
			                  >;
		};
};
