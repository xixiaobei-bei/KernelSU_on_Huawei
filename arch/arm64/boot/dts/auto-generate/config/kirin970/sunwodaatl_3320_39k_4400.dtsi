/* DO NOT EDIT - Automatically generated by python */
/ {
		sunwodaatl_3320_39k_4400:sunwodaatl_3320_39k_4400 {
			fcc = <3320>;
			default_rbatt_mohm = <100>;
			identify_type = "id_volt";
			id_identify_min = <1235>;
			id_identify_max = <1759>;
			id_voltage_min = <1420>;
			id_voltage_max = <1562>;
			vbat_max = <4400>;
			temp_para = 
						"-32767","0","-1","0","4100","0",
						"0","5","-1","332","4400","0",
						"5","10","-1","996","4400","3",
						"10","45","-1","-1","4400","3",
						"45","50","-1","1162","4100","3",
						"50","32767","-1","0","4100","0";
			vbat_para = 
						"-32767","3400","-1","820","0",
						"3400","32767","-1","-1","0";
			segment_para = 
						"-32767","4150","3320","4208","50",
						"4150","4450","2324","4400","0";
			batt_brand = "sunwodaatl";
			fcc_temp = <3272 3267 3275 3288 3286 3255>;
			fcc_sf_x = <0 100 200 300 400 500 600 700 800 1000 1500>;
			fcc_sf_y = <100 96 94 92 90 88 87 84 81 75 50>;
			fcc_sf_cols = <11>;
			pc_sf_rows = <1>;
			pc_sf_cols = <1>;
			pc_sf_row_entries = <0>;
			pc_sf_percent = <100>;
			pc_sf_sf = <100>;
			rbatt_sf_rows = <28>;
			rbatt_sf_cols = <6>;
			rbatt_sf_percent = <100 95 90 85 80 75 70 65 60 55 50 45 40 35 30 25 20 15 10 9 8 7 6 5 4 3 2 1>;
			rbatt_sf_sf = <
			               1940 1267 534 125 99 90
			               1940 1267 534 125 99 90
			               1876 1229 492 126 101 90
			               1817 1178 491 129 103 92
			               1798 1196 490 134 106 93
			               1613 1126 538 141 111 96
			               1575 1026 488 150 116 100
			               1551 1015 478 160 124 104
			               1527 991 453 161 132 109
			               1543 979 433 126 104 95
			               1580 999 430 120 100 91
			               1636 1041 438 124 102 92
			               1702 1102 467 130 107 96
			               1783 1174 511 136 113 100
			               1893 1255 569 137 112 96
			               2022 1362 643 129 104 94
			               2182 1465 725 128 103 95
			               2383 1573 841 132 104 94
			               2654 1726 1042 136 108 98
			               2711 1760 1086 137 109 99
			               3228 1714 837 137 111 101
			               3646 1786 877 136 109 101
			               4021 1969 1000 134 107 98
			               4382 2152 1117 129 102 94
			               4868 2335 1235 129 104 97
			               5356 2578 1436 137 108 97
			               6018 2955 1674 136 112 98
			               7107 3543 2121 156 117 101
			              >;
			pc_temp_ocv_rows = <29>;
			pc_temp_ocv_cols = <6>;
			pc_temp_ocv_percent = <100 95 90 85 80 75 70 65 60 55 50 45 40 35 30 25 20 15 10 9 8 7 6 5 4 3 2 1>;
			pc_temp_ocv_ocv = <
			                   4355 4354 4353 4345 4341 4334
			                   4254 4266 4286 4283 4281 4275
			                   4182 4197 4217 4226 4224 4219
			                   4125 4135 4160 4170 4169 4164
			                   4083 4096 4107 4116 4115 4111
			                   3991 4033 4064 4069 4065 4062
			                   3943 3966 3997 4017 4017 4016
			                   3902 3924 3952 3975 3977 3974
			                   3863 3882 3905 3931 3934 3931
			                   3836 3846 3864 3880 3882 3883
			                   3817 3823 3832 3848 3850 3850
			                   3802 3809 3810 3825 3826 3825
			                   3789 3798 3796 3806 3807 3806
			                   3775 3789 3786 3790 3791 3789
			                   3764 3778 3777 3775 3773 3765
			                   3750 3766 3766 3758 3750 3739
			                   3736 3746 3746 3740 3731 3717
			                   3721 3721 3717 3712 3703 3689
			                   3694 3702 3693 3691 3684 3671
			                   3688 3698 3689 3688 3680 3669
			                   3680 3694 3683 3686 3679 3667
			                   3669 3689 3677 3683 3676 3663
			                   3655 3683 3669 3676 3668 3654
			                   3635 3667 3651 3657 3646 3630
			                   3608 3634 3616 3618 3606 3590
			                   3565 3584 3566 3565 3554 3539
			                   3500 3515 3495 3495 3485 3472
			                   3400 3415 3397 3394 3385 3374
			                   3200 3200 3200 3200 3200 3200
			                  >;
		};
};
