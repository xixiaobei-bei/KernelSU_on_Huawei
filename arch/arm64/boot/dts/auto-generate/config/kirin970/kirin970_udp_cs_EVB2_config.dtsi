
/**
 * Copyright (C) 2014 Hisilicon Ltd.
 *
 *  This program is free software; you can redistribute it and/or modify
 *  it under the terms of the GNU General Public License version 2 as
 *  publishhed by the Free Software Foundation.
 */

/include/ "kirin970_udp_cs_config.dtsi"
/ {
	hisi,boardid = <6 0 1 2>;
	hisi,boardname = "kirin970_udp_cs_EVB2";
	hisi,product_id = <0x39F5FC12>;
};
