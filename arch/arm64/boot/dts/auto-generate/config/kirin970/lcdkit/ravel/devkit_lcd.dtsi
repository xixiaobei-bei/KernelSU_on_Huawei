/*---------------------------------------------------------------------------
 * This file is autogenerated file using huawei LCD parser. Please do not edit it.
 * Update input XML file to add a new entry or update variable in this file
 * Parser location: vendor/huawei/chipset_common/devkit/lcdkit/tools 
 *---------------------------------------------------------------------------*/


/include/ "ravel_auo_otm1901a_5p2_1080p_video_default.dtsi"
/include/ "ravel_samsung_sofef00_6p95_1080plus_cmd.dtsi"
/include/ "ravel_samsung_v2_ea8074_6p01_1080plus_cmd.dtsi"