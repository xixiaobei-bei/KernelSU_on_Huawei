/*---------------------------------------------------------------------------
 * This file is autogenerated file using huawei LCD parser. Please do not edit it.
 * Update input XML file to add a new entry or update variable in this file
 * Parser location: vendor/huawei/chipset_common/devkit/lcdkit/tools 
 *---------------------------------------------------------------------------*/


/include/ "charlotte_tugl_auo_otm1901a_5p2_1080p_video_default.dtsi"
/include/ "charlotte_tugl_samsung_ea8074_clt_6p10_1080plus_cmd.dtsi"
/include/ "charlotte_tugl_samsung_ea8074_clt_temp_6p01_1080plus_cmd.dtsi"