/*---------------------------------------------------------------------------
 * This file is autogenerated file using huawei LCD parser. Please do not edit it.
 * Update input XML file to add a new entry or update variable in this file
 * Parser location: vendor/huawei/chipset_common/devkit/lcdkit/tools 
 *---------------------------------------------------------------------------*/


/include/ "col_auo_otm1901a_5p2_1080p_video_default_1.dtsi"
/include/ "col_auo_otm1911a_5p84_1080p_video.dtsi"
/include/ "col_boe_otm1911a_5p84_1080p_video.dtsi"
/include/ "col_ctc_otm1911a_5p84_1080p_video.dtsi"
/include/ "col_jdi_otm1911a_5p84_1080p_video.dtsi"
/include/ "col_tm_hx8399c_5p84_1080p_video.dtsi"
/include/ "col_tm_otm1911a_5p84_1080p_video.dtsi"