/*---------------------------------------------------------------------------
 * This file is autogenerated file using huawei LCD parser. Please do not edit it.
 * Update input XML file to add a new entry or update variable in this file
 * Parser location: vendor/huawei/chipset_common/devkit/lcdkit/tools 
 *---------------------------------------------------------------------------*/


/include/ "emily_tugl_auo_otm1901a_5p2_1080p_video_default_1.dtsi"
/include/ "emily_tugl_auo_otm1901a_5p2_1080p_video_default_2.dtsi"
/include/ "emily_tugl_boe_hx83112a_5p82_1080plus_video.dtsi"
/include/ "emily_tugl_boe_hx83112e_5p82_1080plus_cmd.dtsi"
/include/ "emily_tugl_jdi_hx83112a_5p82_1080plus_video.dtsi"
/include/ "emily_tugl_jdi_hx83112c_5p82_1080plus_cmd.dtsi"
/include/ "emily_tugl_jdi_hx83112c_cut2_5p82_1080plus_cmd.dtsi"
/include/ "emily_tugl_jdi_td4336_5p82_1080plus_cmd.dtsi"
/include/ "emily_tugl_lg_hx83112a_5p82_1080plus_video.dtsi"
/include/ "emily_tugl_lg_nt36772a_5p82_1080plus_cmd.dtsi"
/include/ "emily_tugl_sharp_hx83112a_5p82_1080plus_video.dtsi"
/include/ "emily_tugl_sharp_hx83112c_5p82_1080plus_cmd.dtsi"
/include/ "emily_tugl_sharp_hx83112c_cut2_5p82_1080plus_cmd.dtsi"
/include/ "emily_tugl_sharp_td4336_5p82_1080plus_cmd.dtsi"
/include/ "emily_tugl_sharp_v3_hx83112a_5p82_1080plus_video.dtsi"