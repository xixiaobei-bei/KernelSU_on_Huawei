/{
    gpu: mali@E82C0000 {
        compatible = "arm,malit6xx", "arm,mali-midgard";
        #cooling-cells = <3>; /* min followed by max */
        gpu_outstanding = <0x0>;
        reg = <0x0 0xE82C0000 0x0 0x4000>;
        interrupts = <0 258 4 0 259 4 0 260 4>;
	interrupt-names = "JOB", "MMU", "GPU";
	clocks = <&clk_g3d>;
	gpu-supply = <&g3d>;
	operating-points = <
		/* <frequency> <voltage>*/
		103750	550000
		150909	650000
		237143	650000
		332000	650000
		415000	750000
		550000	750000
		667000	850000
		767000	950000
	>;
	system-coherency=<1>;
		gpu-bound-detection-enable = "enable";
		gpu-bound-check-threshold = <300>;
    };
};
