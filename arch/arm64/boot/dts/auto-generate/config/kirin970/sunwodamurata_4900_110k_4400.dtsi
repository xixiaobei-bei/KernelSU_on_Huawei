/* DO NOT EDIT - Automatically generated by python */
/ {
		sunwodamurata_4900_110k_4400:sunwodamurata_4900_110k_4400 {
			fcc = <4900>;
			default_rbatt_mohm = <100>;
			identify_type = "id_volt";
			id_identify_min = <2281>;
			id_identify_max = <2786>;
			id_voltage_min = <2426>;
			id_voltage_max = <2631>;
			vbat_max = <4400>;
			temp_para = 
						"-32767","0","-1","0","4100","0",
						"0","5","-1","490","4400","0",
						"5","10","-1","1470","4400","3",
						"10","45","-1","-1","4400","3",
						"45","50","-1","1715","4100","3",
						"50","32767","-1","0","4100","0";
			vbat_para = 
						"-32767","3400","-1","820","0",
						"3400","32767","-1","-1","0";
			segment_para = 
						"-32767","4150","4900","4208","50",
						"4150","4450","3430","4400","0";
			batt_brand = "sunwodamurata";
			fcc_temp = <4947 4969 5026 5033 5029 4985>;
			fcc_sf_x = <0 100 200 300 400 500 600 700 800 1000 1500>;
			fcc_sf_y = <100 96 94 92 90 88 87 84 81 75 50>;
			fcc_sf_cols = <11>;
			pc_sf_rows = <1>;
			pc_sf_cols = <1>;
			pc_sf_row_entries = <0>;
			pc_sf_percent = <100>;
			pc_sf_sf = <100>;
			rbatt_sf_rows = <28>;
			rbatt_sf_cols = <6>;
			rbatt_sf_percent = <100 95 90 85 80 75 70 65 60 55 50 45 40 35 30 25 20 15 10 9 8 7 6 5 4 3 2 1>;
			rbatt_sf_sf = <
			               1084 561 299 101 84 78
			               1084 562 299 101 84 78
			               1089 577 308 103 85 79
			               1085 579 316 106 87 80
			               1066 579 318 109 89 80
			               1056 581 316 113 91 82
			               1046 579 315 120 94 83
			               1040 573 308 125 100 87
			               1044 583 307 122 101 89
			               1050 594 305 108 91 82
			               1065 605 308 103 85 79
			               1100 623 313 103 85 79
			               1142 659 321 106 87 79
			               1196 701 336 109 89 82
			               1266 755 360 111 90 84
			               1350 819 387 110 87 79
			               1478 908 426 108 87 81
			               1701 1078 487 109 88 82
			               2595 1224 469 108 88 82
			               2995 1335 489 108 88 82
			               3490 1519 528 111 89 83
			               4182 1767 586 112 90 84
			               5285 2089 658 114 90 85
			               6542 2585 781 116 90 84
			               9777 3399 915 119 89 83
			               19210 4788 1106 121 93 84
			               37712 8450 1506 127 94 86
			               68903 20275 2387 147 106 92
			              >;
			pc_temp_ocv_rows = <29>;
			pc_temp_ocv_cols = <6>;
			pc_temp_ocv_percent = <100 95 90 85 80 75 70 65 60 55 50 45 40 35 30 25 20 15 10 9 8 7 6 5 4 3 2 1>;
			pc_temp_ocv_ocv = <
			                   4384 4382 4382 4373 4369 4362
			                   4286 4294 4300 4303 4301 4293
			                   4212 4228 4237 4241 4240 4233
			                   4147 4163 4176 4182 4181 4175
			                   4083 4101 4117 4125 4125 4118
			                   4023 4042 4058 4071 4071 4066
			                   3969 3987 4003 4021 4022 4017
			                   3919 3934 3951 3974 3977 3974
			                   3876 3891 3907 3927 3932 3930
			                   3837 3854 3868 3882 3884 3882
			                   3804 3822 3836 3848 3849 3847
			                   3781 3795 3809 3822 3823 3821
			                   3761 3776 3786 3802 3803 3800
			                   3741 3759 3770 3785 3786 3783
			                   3724 3744 3756 3770 3768 3763
			                   3705 3726 3738 3752 3745 3734
			                   3688 3701 3717 3730 3723 3711
			                   3663 3672 3686 3701 3695 3684
			                   3629 3640 3652 3669 3664 3653
			                   3614 3629 3644 3664 3660 3650
			                   3597 3618 3635 3658 3655 3645
			                   3576 3607 3627 3651 3648 3639
			                   3564 3593 3615 3641 3638 3628
			                   3539 3573 3599 3622 3615 3603
			                   3506 3543 3572 3582 3575 3562
			                   3458 3493 3522 3528 3521 3510
			                   3397 3416 3451 3458 3452 3443
			                   3312 3320 3347 3359 3356 3351
			                   3200 3200 3200 3200 3200 3200
			                  >;
		};
};
