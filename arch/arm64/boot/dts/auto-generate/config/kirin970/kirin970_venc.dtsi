/*
 *
 * Copyright (C) 2014- Hisilicon Ltd.
 *
 * This program is free software; you can redistribute it and/or modify
 * it under the terms of the GNU General Public License version 2 as
 * publishhed by the Free Software Foundation.
 */

/ {
  venc{
        compatible = "hisi,kirin970-venc";
        reg = <0x0 0xe8880000 0x0 0x40000>;
        interrupts = <0 296 4>, <0 297 4>, <0 298 4>;
        clocks = <&clk_gate_venc &venc_volt_hold>;
        clock-names = "clk_venc", "venc_volt_hold";
        enc_clk_rate = <554000000>, <450000000>, <238000000>;
        ldo_venc-supply = <&venc>;
        venc_qos_mode = <0x2>;
        status = "ok";
        iommu_info {
            start-addr = <0x40000>;
            size = <0xE0000000>;
        };
      };
};
