/* DO NOT EDIT - Automatically generated by python */
/ {
		scudlg_3900_200k_4400_25:scudlg_3900_200k_4400_25 {
			fcc = <3900>;
			default_rbatt_mohm = <100>;
			identify_type = "id_volt";
			id_identify_min = <2786>;
			id_identify_max = <3312>;
			id_voltage_min = <2941>;
			id_voltage_max = <3167>;
			vbat_max = <4400>;
			temp_para = 
						"-32767","0","-1","0","4100","0",
						"0","5","-1","390","4400","0",
						"5","10","-1","1170","4400","3",
						"10","45","-1","-1","4400","3",
						"45","50","-1","1365","4100","3",
						"50","32767","-1","0","4100","0";
			vbat_para = 
						"-32767","3400","-1","820","0",
						"3400","32767","-1","-1","0";
			segment_para = 
						"-32767","4150","3900","4208","50",
						"4150","4450","2730","4400","0";
			batt_brand = "scudlg";
			fcc_temp = <3889 3883 3894 3920 3866 3838>;
			fcc_sf_x = <0 100 200 300 400 500 600 700 800 1000 1500>;
			fcc_sf_y = <100 96 94 92 90 88 87 84 81 75 50>;
			fcc_sf_cols = <11>;
			pc_sf_rows = <1>;
			pc_sf_cols = <1>;
			pc_sf_row_entries = <0>;
			pc_sf_percent = <100>;
			pc_sf_sf = <100>;
			rbatt_sf_rows = <28>;
			rbatt_sf_cols = <6>;
			rbatt_sf_percent = <100 95 90 85 80 75 70 65 60 55 50 45 40 35 30 25 20 15 10 9 8 7 6 5 4 3 2 1>;
			rbatt_sf_sf = <
			               1680 794 329 92 71 60
			               1643 794 331 93 71 60
			               1505 793 340 96 72 61
			               1419 792 345 99 74 62
			               1379 797 362 105 78 64
			               1264 765 378 112 83 66
			               1234 699 338 120 85 68
			               1236 711 330 131 92 73
			               1224 699 318 119 93 73
			               1218 688 308 96 75 63
			               1246 691 305 91 70 61
			               1296 712 305 94 72 62
			               1361 749 309 97 75 65
			               1443 798 323 100 78 67
			               1543 866 348 98 77 66
			               1658 962 379 96 70 61
			               1800 1109 424 96 71 61
			               1989 1325 503 95 72 62
			               2620 1120 424 97 73 64
			               3139 1233 453 96 73 64
			               3717 1409 505 99 73 63
			               4349 1665 570 101 74 64
			               5078 1864 641 102 76 63
			               5845 2212 739 104 71 63
			               6588 2653 837 116 73 65
			               7338 3233 986 350 81 69
			               8063 4067 1395 604 116 69
			               9330 5095 1925 702 285 151
			              >;
			pc_temp_ocv_rows = <29>;
			pc_temp_ocv_cols = <6>;
			pc_temp_ocv_percent = <100 95 90 85 80 75 70 65 60 55 50 45 40 35 30 25 20 15 10 9 8 7 6 5 4 3 2 1>;
			pc_temp_ocv_ocv = <
			                   4323 4322 4320 4320 4305 4298
			                   4233 4244 4249 4257 4243 4238
			                   4168 4184 4192 4201 4187 4182
			                   4112 4130 4138 4146 4134 4129
			                   4063 4078 4089 4098 4084 4078
			                   3980 4014 4035 4045 4036 4031
			                   3926 3944 3963 3992 3988 3987
			                   3892 3912 3927 3955 3951 3948
			                   3857 3876 3890 3910 3908 3907
			                   3826 3841 3856 3865 3863 3861
			                   3806 3814 3828 3836 3834 3832
			                   3793 3797 3806 3814 3812 3811
			                   3781 3786 3789 3797 3796 3793
			                   3771 3776 3779 3782 3781 3779
			                   3760 3767 3771 3769 3766 3761
			                   3748 3755 3760 3754 3747 3734
			                   3735 3741 3744 3735 3728 3714
			                   3717 3724 3721 3707 3703 3690
			                   3691 3703 3696 3689 3681 3669
			                   3683 3696 3693 3687 3680 3668
			                   3673 3689 3689 3684 3678 3666
			                   3660 3684 3684 3679 3675 3663
			                   3645 3673 3674 3664 3667 3655
			                   3626 3656 3656 3630 3646 3632
			                   3595 3627 3621 3581 3606 3594
			                   3552 3580 3565 3532 3552 3545
			                   3492 3515 3490 3477 3481 3477
			                   3403 3415 3359 3381 3382 3382
			                   3200 3200 3200 3200 3200 3200
			                  >;
		};
};
