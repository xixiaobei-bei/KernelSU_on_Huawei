/* DO NOT EDIT - Automatically generated by python */
/ {
		scudlg_3900_200k_4400:scudlg_3900_200k_4400 {
			fcc = <3900>;
			default_rbatt_mohm = <100>;
			identify_type = "id_volt";
			id_identify_min = <2786>;
			id_identify_max = <3312>;
			id_voltage_min = <2941>;
			id_voltage_max = <3167>;
			vbat_max = <4400>;
			temp_para = 
						"-32767","0","-1","0","4100","0",
						"0","5","-1","390","4400","0",
						"5","10","-1","1170","4400","3",
						"10","45","-1","-1","4400","3",
						"45","50","-1","1365","4100","3",
						"50","32767","-1","0","4100","0";
			vbat_para = 
						"-32767","3400","-1","820","0",
						"3400","32767","-1","-1","0";
			segment_para = 
						"-32767","4150","3900","4208","50",
						"4150","4450","2730","4400","0";
			batt_brand = "scudlg";
			fcc_temp = <3939 3941 3958 3995 3941 3915>;
			fcc_sf_x = <0 100 200 300 400 500 600 700 800 1000 1500>;
			fcc_sf_y = <100 96 94 92 90 88 87 84 81 75 50>;
			fcc_sf_cols = <11>;
			pc_sf_rows = <1>;
			pc_sf_cols = <1>;
			pc_sf_row_entries = <0>;
			pc_sf_percent = <100>;
			pc_sf_sf = <100>;
			rbatt_sf_rows = <28>;
			rbatt_sf_cols = <6>;
			rbatt_sf_percent = <100 95 90 85 80 75 70 65 60 55 50 45 40 35 30 25 20 15 10 9 8 7 6 5 4 3 2 1>;
			rbatt_sf_sf = <
			               1680 794 329 92 71 60
			               1679 794 329 92 71 60
			               1532 795 337 95 71 60
			               1421 790 345 98 73 61
			               1406 798 348 103 76 63
			               1272 787 391 111 82 65
			               1233 695 339 116 84 68
			               1237 713 332 130 90 71
			               1226 702 321 127 98 76
			               1215 689 308 97 77 64
			               1240 689 305 91 70 61
			               1289 707 305 93 71 62
			               1352 743 308 96 75 64
			               1435 792 320 100 77 67
			               1535 859 346 99 79 67
			               1649 953 376 96 70 61
			               1791 1097 420 96 70 61
			               1980 1313 497 95 72 62
			               2559 1107 424 98 74 64
			               3074 1213 446 97 73 64
			               3654 1376 497 98 73 63
			               4284 1648 562 101 74 64
			               5019 1835 633 102 76 63
			               5798 2181 730 104 72 63
			               6549 2622 832 114 72 65
			               7311 3199 976 327 80 69
			               8040 4037 1377 598 111 69
			               9286 5077 1916 701 277 148
			              >;
			pc_temp_ocv_rows = <29>;
			pc_temp_ocv_cols = <6>;
			pc_temp_ocv_percent = <100 95 90 85 80 75 70 65 60 55 50 45 40 35 30 25 20 15 10 9 8 7 6 5 4 3 2 1>;
			pc_temp_ocv_ocv = <
			                   4348 4347 4345 4345 4330 4323
			                   4250 4261 4268 4278 4264 4259
			                   4182 4198 4208 4219 4206 4202
			                   4119 4142 4153 4164 4151 4147
			                   4082 4092 4099 4111 4098 4094
			                   3991 4032 4057 4064 4052 4044
			                   3933 3951 3972 4001 3998 3999
			                   3898 3919 3934 3965 3961 3958
			                   3863 3882 3898 3922 3921 3919
			                   3829 3846 3861 3872 3870 3868
			                   3808 3817 3832 3840 3838 3837
			                   3794 3799 3808 3818 3816 3814
			                   3782 3787 3791 3799 3798 3796
			                   3771 3777 3780 3784 3783 3781
			                   3761 3768 3772 3771 3769 3764
			                   3749 3756 3761 3756 3749 3736
			                   3736 3742 3745 3736 3730 3716
			                   3718 3725 3722 3709 3704 3691
			                   3692 3704 3697 3689 3681 3669
			                   3684 3697 3693 3687 3680 3668
			                   3674 3689 3690 3685 3678 3666
			                   3661 3685 3685 3680 3676 3663
			                   3647 3675 3676 3667 3669 3656
			                   3628 3658 3658 3634 3650 3635
			                   3597 3630 3623 3585 3609 3598
			                   3554 3583 3568 3535 3556 3548
			                   3494 3517 3493 3480 3484 3480
			                   3405 3417 3362 3384 3384 3384
			                   3200 3200 3200 3200 3200 3200
			                  >;
		};
};
