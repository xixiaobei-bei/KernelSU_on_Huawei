/*
 *  Copyright (C) 2012-2013 Linaro Ltd.
 *
 *  This program is free software; you can redistribute it and/or modify
 *  it under the terms of the GNU General Public License version 2 as
 *  publishhed by the Free Software Foundation.
 */

/{
	subpmu_dieid {
		compatible = "hisilicon,subpmu-dieid";
		status = "ok";

		hi6422_1 {
			pmu-type = "Hi6422v300";
			bus-type = "spmi";
			slave-id = <1>;
		};

		hi6423_1 {
			pmu-type = "Hi6423v100";
			bus-type = "spmi";
			slave-id = <6>;
		};
	};
};
