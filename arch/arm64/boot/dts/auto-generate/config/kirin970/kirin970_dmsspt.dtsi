/*
 * Hisilicon Ltd. Hi3670 SoC
 *
 * Copyright (C) 2012-2016 Hisilicon Ltd.
 *
 * This program is free software; you can redistribute it and/or modify
 * it under the terms of the GNU General Public License version 2 as
 * publishhed by the Free Software Foundation.
 */

/ {
	hisi_dmsspt@fffc0000{
		compatible = "hisilicon,kirin970-dmsspt";
		reg = <0x0 0xfffc0000 0x0 0x8000>;
		interrupts = <0 318 4>;
		status = "ok";
	};
};
