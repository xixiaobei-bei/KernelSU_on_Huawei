/* DO NOT EDIT - Automatically generated by python */
/ {
		desaylg_3320_68k_4400:desaylg_3320_68k_4400 {
			fcc = <3320>;
			default_rbatt_mohm = <100>;
			identify_type = "id_volt";
			id_identify_min = <1759>;
			id_identify_max = <2281>;
			id_voltage_min = <1956>;
			id_voltage_max = <2135>;
			vbat_max = <4400>;
			temp_para = 
						"-32767","0","-1","0","4100","0",
						"0","5","-1","332","4400","0",
						"5","10","-1","996","4400","3",
						"10","45","-1","-1","4400","3",
						"45","50","-1","1162","4100","3",
						"50","32767","-1","0","4100","0";
			vbat_para = 
						"-32767","3400","-1","820","0",
						"3400","32767","-1","-1","0";
			segment_para = 
						"-32767","4150","3320","4208","50",
						"4150","4450","2324","4400","0";
			batt_brand = "desaylg";
			fcc_temp = <3330 3314 3310 3294 3307 3289>;
			fcc_sf_x = <0 100 200 300 400 500 600 700 800 1000 1500>;
			fcc_sf_y = <100 96 94 92 90 88 87 84 81 75 50>;
			fcc_sf_cols = <11>;
			pc_sf_rows = <1>;
			pc_sf_cols = <1>;
			pc_sf_row_entries = <0>;
			pc_sf_percent = <100>;
			pc_sf_sf = <100>;
			rbatt_sf_rows = <28>;
			rbatt_sf_cols = <6>;
			rbatt_sf_percent = <100 95 90 85 80 75 70 65 60 55 50 45 40 35 30 25 20 15 10 9 8 7 6 5 4 3 2 1>;
			rbatt_sf_sf = <
			               2214 1338 582 132 86 66
			               2213 1338 582 132 86 66
			               2080 1270 587 128 88 67
			               1996 1202 584 129 88 69
			               1868 1233 633 136 92 71
			               1766 1036 606 152 96 74
			               1747 1023 522 146 102 76
			               1725 996 537 163 109 82
			               1751 970 503 164 118 86
			               1824 957 470 131 93 72
			               1916 1005 451 120 86 68
			               2021 1065 479 119 86 70
			               2143 1145 524 122 90 72
			               2274 1239 587 125 96 76
			               2400 1342 677 125 95 76
			               2514 1448 776 123 86 69
			               2624 1562 907 124 86 69
			               2756 1665 1082 130 88 68
			               3810 1790 1266 143 90 73
			               4723 1794 882 137 93 73
			               5267 2051 1001 130 88 73
			               5773 2346 1117 131 89 73
			               6239 2599 1301 135 87 73
			               6757 2864 1462 133 87 73
			               7309 3141 1588 134 93 75
			               7931 3404 1771 141 96 79
			               8853 3793 2187 164 113 155
			               10600 4403 2661 215 144 419
			              >;
			pc_temp_ocv_rows = <29>;
			pc_temp_ocv_cols = <6>;
			pc_temp_ocv_percent = <100 95 90 85 80 75 70 65 60 55 50 45 40 35 30 25 20 15 10 9 8 7 6 5 4 3 2 1>;
			pc_temp_ocv_ocv = <
			                   4356 4345 4342 4333 4329 4321
			                   4231 4241 4253 4264 4263 4256
			                   4156 4171 4189 4203 4207 4200
			                   4098 4110 4132 4149 4152 4146
			                   4018 4079 4091 4097 4100 4094
			                   3946 3984 4030 4056 4052 4045
			                   3902 3942 3964 3993 4004 4001
			                   3859 3900 3930 3962 3966 3960
			                   3831 3860 3886 3921 3926 3920
			                   3816 3826 3845 3872 3875 3872
			                   3804 3810 3813 3840 3842 3840
			                   3794 3799 3798 3817 3819 3817
			                   3784 3791 3789 3799 3801 3799
			                   3775 3783 3782 3784 3785 3783
			                   3764 3775 3775 3771 3770 3764
			                   3750 3762 3762 3757 3750 3736
			                   3733 3745 3744 3739 3730 3716
			                   3712 3718 3719 3712 3704 3688
			                   3677 3700 3692 3688 3680 3669
			                   3666 3692 3685 3686 3680 3667
			                   3653 3685 3679 3684 3678 3665
			                   3638 3680 3671 3681 3675 3661
			                   3618 3671 3662 3675 3668 3649
			                   3593 3655 3646 3657 3648 3622
			                   3563 3628 3616 3620 3607 3579
			                   3522 3583 3569 3568 3555 3524
			                   3463 3516 3508 3498 3487 3453
			                   3366 3412 3411 3395 3386 3360
			                   3200 3200 3200 3200 3200 3200
			                  >;
		};
};
