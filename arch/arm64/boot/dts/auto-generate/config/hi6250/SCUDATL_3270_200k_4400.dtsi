/* DO NOT EDIT - Automatically generated by python */
/ {
		SCUDATL_3270_200k_4400:SCUDATL_3270_200k_4400 {
			fcc = <3270>;
			default_rbatt_mohm = <100>;
			identify_type = "id_volt";
			id_identify_min = <2786>;
			id_identify_max = <3312>;
			id_voltage_min = <2941>;
			id_voltage_max = <3167>;
			vbat_max = <4400>;
			temp_para = 
						"-32767","0","-1","0","4100","0",
						"0","5","-1","327","4400","0",
						"5","10","-1","981","4400","3",
						"10","45","-1","-1","4400","3",
						"45","50","-1","1144","4100","3",
						"50","32767","-1","0","4100","0";
			vbat_para = 
						"-32767","3400","-1","820","0",
						"3400","32767","-1","-1","0";
			segment_para = 
						"-32767","4150","3270","4208","50",
						"4150","4450","2289","4400","0";
			batt_brand = "SCUDATL";
			fcc_temp = <3328 3306 3302 3324 3305 3287>;
			fcc_sf_x = <0 100 200 300 400 500 600 700 800 1000 1500>;
			fcc_sf_y = <100 96 94 92 90 88 87 84 81 75 50>;
			fcc_sf_cols = <11>;
			pc_sf_rows = <1>;
			pc_sf_cols = <1>;
			pc_sf_row_entries = <0>;
			pc_sf_percent = <100>;
			pc_sf_sf = <100>;
			rbatt_sf_rows = <28>;
			rbatt_sf_cols = <6>;
			rbatt_sf_percent = <100 95 90 85 80 75 70 65 60 55 50 45 40 35 30 25 20 15 10 9 8 7 6 5 4 3 2 1>;
			rbatt_sf_sf = <
			               2372 1356 611 151 113 99
			               2367 1355 611 151 113 99
			               2159 1328 620 154 114 100
			               2008 1280 621 159 118 102
			               1932 1236 612 164 121 104
			               1835 1242 660 174 126 107
			               1693 1096 622 186 133 110
			               1681 1049 561 199 141 116
			               1658 1041 549 191 150 123
			               1638 1024 531 155 121 105
			               1674 1015 519 147 111 100
			               1725 1063 520 149 114 102
			               1793 1125 546 154 119 105
			               1875 1195 592 161 125 110
			               1970 1281 649 161 125 110
			               2086 1381 720 156 115 102
			               2237 1489 807 154 112 100
			               2436 1619 930 153 114 101
			               3481 1437 730 151 115 103
			               3827 1552 773 153 114 103
			               4145 1726 798 154 117 104
			               4479 1898 881 154 116 105
			               4893 2137 982 157 115 105
			               5329 2363 1082 155 116 103
			               5864 2636 1184 157 114 103
			               6519 2958 1283 172 117 105
			               7331 3464 1515 200 120 108
			               8590 4365 1998 337 136 110
			              >;
			pc_temp_ocv_rows = <29>;
			pc_temp_ocv_cols = <6>;
			pc_temp_ocv_percent = <100 95 90 85 80 75 70 65 60 55 50 45 40 35 30 25 20 15 10 9 8 7 6 5 4 3 2 1>;
			pc_temp_ocv_ocv = <
			                   4391 4382 4378 4372 4365 4359
			                   4287 4295 4302 4309 4304 4299
			                   4212 4227 4241 4250 4245 4241
			                   4151 4166 4183 4193 4188 4184
			                   4102 4111 4125 4137 4133 4129
			                   4039 4072 4084 4083 4080 4077
			                   3957 3990 4020 4034 4031 4028
			                   3917 3935 3955 3984 3984 3983
			                   3878 3898 3914 3937 3941 3940
			                   3840 3860 3874 3887 3888 3888
			                   3817 3825 3840 3853 3854 3853
			                   3800 3807 3813 3827 3828 3828
			                   3786 3795 3796 3806 3808 3807
			                   3774 3783 3785 3789 3791 3789
			                   3760 3773 3775 3773 3773 3770
			                   3746 3760 3763 3757 3752 3741
			                   3731 3741 3745 3737 3731 3719
			                   3711 3719 3719 3711 3706 3694
			                   3686 3697 3691 3688 3682 3671
			                   3679 3691 3688 3687 3681 3670
			                   3671 3686 3684 3685 3679 3668
			                   3660 3680 3681 3681 3677 3665
			                   3646 3671 3676 3674 3671 3660
			                   3627 3654 3664 3650 3656 3641
			                   3599 3626 3635 3607 3620 3605
			                   3557 3578 3583 3549 3568 3554
			                   3492 3508 3511 3470 3499 3487
			                   3387 3403 3404 3351 3397 3389
			                   3200 3200 3200 3200 3200 3200
			                  >;
		};
};
