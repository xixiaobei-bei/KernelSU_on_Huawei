/* DO NOT EDIT - Automatically generated by python */
/ {
		SWDATLFL_2900_39k_4400:SWDATLFL_2900_39k_4400 {
			fcc = <2900>;
			default_rbatt_mohm = <100>;
			identify_type = "id_volt";
			id_identify_min = <1235>;
			id_identify_max = <1759>;
			id_voltage_min = <1420>;
			id_voltage_max = <1562>;
			vbat_max = <4400>;
			temp_para = 
						"-32767","0","-1","0","4100","0",
						"0","5","-1","290","4400","0",
						"5","10","-1","870","4400","3",
						"10","45","-1","-1","4400","3",
						"45","50","-1","1015","4100","3",
						"50","32767","-1","0","4100","0";
			vbat_para = 
						"-32767","3400","-1","820","0",
						"3400","32767","-1","-1","0";
			segment_para = 
						"-32767","4150","2900","4208","50",
						"4150","4450","2030","4400","0";
			batt_brand = "SWDATLFL";
			fcc_temp = <2906 2912 2912 2925 2919 2900>;
			fcc_sf_x = <0 100 200 300 400 500 600 700 800 1000 1500>;
			fcc_sf_y = <100 96 94 92 90 88 87 84 81 75 50>;
			fcc_sf_cols = <11>;
			pc_sf_rows = <1>;
			pc_sf_cols = <1>;
			pc_sf_row_entries = <0>;
			pc_sf_percent = <100>;
			pc_sf_sf = <100>;
			rbatt_sf_rows = <28>;
			rbatt_sf_cols = <6>;
			rbatt_sf_percent = <100 95 90 85 80 75 70 65 60 55 50 45 40 35 30 25 20 15 10 9 8 7 6 5 4 3 2 1>;
			rbatt_sf_sf = <
			               2628 1085 702 169 128 113
			               2627 1085 702 169 128 113
			               2433 1078 701 171 129 114
			               2258 1051 691 174 131 115
			               2203 1042 674 179 135 117
			               2058 1066 725 186 139 119
			               1930 993 686 200 145 123
			               1906 933 643 212 153 129
			               1869 937 620 214 166 136
			               1871 931 595 170 136 118
			               1908 935 598 161 126 114
			               1960 962 606 163 128 115
			               2023 1006 657 168 133 118
			               2102 1064 717 172 139 123
			               2194 1132 799 175 142 125
			               2307 1202 893 169 128 117
			               2441 1303 1007 163 127 114
			               2621 1442 1169 167 129 115
			               3241 1510 1163 169 131 119
			               4123 1445 1001 167 131 117
			               4528 1571 1105 167 131 118
			               4945 1728 1217 169 132 118
			               5383 1902 1372 174 133 119
			               5847 2131 1573 165 131 116
			               6359 2378 1731 172 131 117
			               6948 2650 1939 179 133 120
			               7764 3061 2357 188 138 123
			               9131 3676 2979 390 154 128
			              >;
			pc_temp_ocv_rows = <29>;
			pc_temp_ocv_cols = <6>;
			pc_temp_ocv_percent = <100 95 90 85 80 75 70 65 60 55 50 45 40 35 30 25 20 15 10 9 8 7 6 5 4 3 2 1>;
			pc_temp_ocv_ocv = <
			                   4381 4380 4376 4369 4362 4356
			                   4274 4297 4295 4306 4300 4295
			                   4202 4233 4232 4247 4242 4238
			                   4136 4172 4174 4190 4185 4181
			                   4093 4117 4116 4135 4130 4127
			                   4022 4073 4074 4082 4078 4075
			                   3953 4003 4011 4033 4029 4026
			                   3913 3941 3957 3984 3983 3983
			                   3873 3903 3912 3941 3942 3941
			                   3843 3866 3868 3887 3888 3887
			                   3824 3835 3836 3854 3853 3854
			                   3808 3814 3810 3829 3829 3828
			                   3794 3798 3797 3808 3809 3808
			                   3781 3787 3786 3791 3792 3791
			                   3767 3776 3776 3776 3775 3773
			                   3753 3762 3765 3758 3752 3741
			                   3736 3746 3746 3738 3731 3719
			                   3718 3722 3719 3712 3707 3694
			                   3694 3698 3690 3689 3682 3671
			                   3687 3691 3684 3687 3681 3669
			                   3678 3686 3681 3685 3680 3668
			                   3669 3680 3675 3682 3677 3665
			                   3657 3671 3667 3675 3672 3658
			                   3639 3657 3653 3652 3654 3640
			                   3611 3629 3623 3609 3616 3601
			                   3567 3582 3571 3552 3563 3550
			                   3500 3516 3501 3475 3493 3482
			                   3397 3416 3399 3360 3390 3381
			                   3200 3200 3200 3200 3200 3200
			                  >;
		};
};
