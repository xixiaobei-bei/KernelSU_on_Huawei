/*---------------------------------------------------------------------------
 * This file is autogenerated file using huawei LCD parser. Please do not edit it.
 * Update input XML file to add a new entry or update variable in this file
 * Parser location: vendor/huawei/chipset_common/devkit/lcdkit/tools 
 *---------------------------------------------------------------------------*/


/include/ "warsaw_va_auo_td4310_5p2_1080p_video.dtsi"
/include/ "warsaw_va_boe_td4300_5p2_1080p_video.dtsi"
/include/ "warsaw_va_ebbg_nt35596s_5p2_1080p_video.dtsi"
/include/ "warsaw_va_jdi_ili7807e_5p2_1080p_video.dtsi"
/include/ "warsaw_va_tm_ft8716_5p2_1080p_video.dtsi"