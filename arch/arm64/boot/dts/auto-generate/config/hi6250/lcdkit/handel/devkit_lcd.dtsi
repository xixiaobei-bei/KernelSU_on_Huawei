/*---------------------------------------------------------------------------
 * This file is autogenerated file using huawei LCD parser. Please do not edit it.
 * Update input XML file to add a new entry or update variable in this file
 * Parser location: vendor/huawei/chipset_common/devkit/lcdkit/tools 
 *---------------------------------------------------------------------------*/


/include/ "handel_auo1_nt51021_8p0_1200p_video.dtsi"
/include/ "handel_boe_nt51021_8p0_1200p_video.dtsi"
/include/ "handel_truly_nt51021_8p0_1200p_video.dtsi"