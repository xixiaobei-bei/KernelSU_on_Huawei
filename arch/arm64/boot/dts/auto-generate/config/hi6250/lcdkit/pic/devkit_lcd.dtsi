/*---------------------------------------------------------------------------
 * This file is autogenerated file using huawei LCD parser. Please do not edit it.
 * Update input XML file to add a new entry or update variable in this file
 * Parser location: vendor/huawei/chipset_common/devkit/lcdkit/tools 
 *---------------------------------------------------------------------------*/


/include/ "pic_boe_td4300_5p0_1080p_video.dtsi"
/include/ "pic_ctc_td4310_5p0_1080p_video.dtsi"
/include/ "pic_lg_td4300_5p0_1080p_video.dtsi"
/include/ "pic_tianma_td4300_5p0_1080p_video.dtsi"