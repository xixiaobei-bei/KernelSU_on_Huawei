/*---------------------------------------------------------------------------
 * This file is autogenerated file using huawei LCD parser. Please do not edit it.
 * Update input XML file to add a new entry or update variable in this file
 * Parser location: vendor/huawei/chipset_common/devkit/lcdkit/tools 
 *---------------------------------------------------------------------------*/


/include/ "bond_v3_boe_nt35532_5p5_1080p_video.dtsi"
/include/ "bond_v3_inx_nt35532_5p5_1080p_video.dtsi"
/include/ "bond_v3_tm_otm1911a_5p5_1080p_video.dtsi"