/* DO NOT EDIT - Automatically generated by python */
/ {
		SCUDSONY_2900_470k_4400:SCUDSONY_2900_470k_4400 {
			fcc = <2900>;
			default_rbatt_mohm = <100>;
			identify_type = "id_volt";
			id_identify_min = <3312>;
			id_identify_max = <3767>;
			id_voltage_min = <3407>;
			id_voltage_max = <3696>;
			vbat_max = <4400>;
			temp_para = 
						"-32767","0","-1","0","4100","0",
						"0","5","-1","290","4400","0",
						"5","10","-1","870","4400","3",
						"10","45","-1","-1","4400","3",
						"45","50","-1","1015","4100","3",
						"50","32767","-1","0","4100","0";
			vbat_para = 
						"-32767","3400","-1","820","0",
						"3400","32767","-1","-1","0";
			segment_para = 
						"-32767","4150","2900","4208","50",
						"4150","4450","2030","4400","0";
			batt_brand = "SCUDSONY";
			fcc_temp = <2952 2959 2971 3002 2993 2979>;
			fcc_sf_x = <0 100 200 300 400 500 600 700 800 1000 1500>;
			fcc_sf_y = <100 96 94 92 90 88 87 84 81 75 50>;
			fcc_sf_cols = <11>;
			pc_sf_rows = <1>;
			pc_sf_cols = <1>;
			pc_sf_row_entries = <0>;
			pc_sf_percent = <100>;
			pc_sf_sf = <100>;
			rbatt_sf_rows = <28>;
			rbatt_sf_cols = <6>;
			rbatt_sf_percent = <100 95 90 85 80 75 70 65 60 55 50 45 40 35 30 25 20 15 10 9 8 7 6 5 4 3 2 1>;
			rbatt_sf_sf = <
			               1923 969 515 187 132 114
			               1922 969 515 188 132 114
			               1907 990 529 192 133 114
			               1868 998 536 196 135 115
			               1842 1004 550 201 138 117
			               1793 1008 567 209 142 119
			               1778 990 573 217 148 121
			               1760 985 558 229 155 126
			               1762 984 537 220 155 128
			               1785 1000 526 195 138 118
			               1829 1026 531 186 133 116
			               1892 1086 547 187 133 116
			               1971 1164 580 192 135 117
			               2074 1255 626 197 140 120
			               2217 1376 690 200 139 119
			               2408 1538 774 200 134 115
			               2694 1763 893 208 135 117
			               3324 2097 1109 224 139 118
			               6832 3150 1289 212 138 119
			               7783 3521 1440 219 140 119
			               8986 4001 1639 228 142 120
			               10413 4605 1902 237 144 123
			               12464 5418 2247 249 147 124
			               17147 6607 2683 260 145 122
			               31587 8263 3296 267 147 123
			               65356 11197 4237 294 152 126
			               128958 24853 6119 344 163 131
			               228797 61447 11030 478 193 141
			              >;
			pc_temp_ocv_rows = <29>;
			pc_temp_ocv_cols = <6>;
			pc_temp_ocv_percent = <100 95 90 85 80 75 70 65 60 55 50 45 40 35 30 25 20 15 10 9 8 7 6 5 4 3 2 1>;
			pc_temp_ocv_ocv = <
			                   4381 4379 4377 4367 4362 4358
			                   4277 4288 4296 4298 4296 4293
			                   4199 4220 4231 4239 4237 4235
			                   4130 4157 4170 4181 4180 4177
			                   4068 4097 4113 4125 4124 4122
			                   4005 4040 4060 4072 4072 4070
			                   3954 3982 4008 4022 4024 4022
			                   3907 3931 3956 3976 3978 3978
			                   3868 3886 3907 3928 3932 3933
			                   3838 3850 3865 3881 3885 3886
			                   3813 3820 3831 3847 3851 3852
			                   3791 3800 3807 3822 3826 3826
			                   3770 3783 3789 3801 3806 3805
			                   3750 3767 3774 3784 3789 3787
			                   3732 3750 3760 3767 3768 3764
			                   3713 3731 3742 3747 3743 3733
			                   3692 3705 3716 3724 3721 3710
			                   3666 3672 3681 3693 3693 3684
			                   3631 3633 3638 3664 3665 3656
			                   3619 3623 3630 3659 3662 3652
			                   3607 3613 3621 3654 3657 3648
			                   3592 3601 3612 3646 3650 3641
			                   3575 3588 3600 3634 3638 3630
			                   3554 3573 3583 3613 3613 3604
			                   3525 3548 3553 3573 3571 3563
			                   3474 3502 3503 3518 3517 3511
			                   3398 3431 3434 3447 3446 3443
			                   3297 3330 3338 3348 3350 3349
			                   3200 3200 3200 3200 3200 3200
			                  >;
		};
};
