/* DO NOT EDIT - Automatically generated by python */
/ {
		SUNWODAATLB_6500_68k_4350:SUNWODAATLB_6500_68k_4350 {
			fcc = <6500>;
			default_rbatt_mohm = <100>;
			identify_type = "id_volt";
			id_identify_min = <1759>;
			id_identify_max = <2281>;
			id_voltage_min = <1956>;
			id_voltage_max = <2135>;
			vbat_max = <4350>;
			temp_para = 
						"-32767","0","-1","0","4100","0",
						"0","5","-1","650","4350","0",
						"5","10","-1","1950","4350","3",
						"10","45","-1","-1","4350","3",
						"45","50","-1","2275","4100","3",
						"50","32767","-1","0","4100","0";
			vbat_para = 
						"-32767","3400","-1","820","0",
						"3400","32767","-1","-1","0";
			segment_para = 
						"-32767","4150","6500","4208","50",
						"4150","4450","4550","4350","0";
			batt_brand = "SUNWODAATLB";
			fcc_temp = <6763 6747 6770 6743 6783 6704>;
			fcc_sf_x = <0 100 200 300 400 500 600 700 800 1000 1500>;
			fcc_sf_y = <100 96 94 92 90 88 87 84 81 75 50>;
			fcc_sf_cols = <11>;
			pc_sf_rows = <1>;
			pc_sf_cols = <1>;
			pc_sf_row_entries = <0>;
			pc_sf_percent = <100>;
			pc_sf_sf = <100>;
			rbatt_sf_rows = <28>;
			rbatt_sf_cols = <6>;
			rbatt_sf_percent = <100 95 90 85 80 75 70 65 60 55 50 45 40 35 30 25 20 15 10 9 8 7 6 5 4 3 2 1>;
			rbatt_sf_sf = <
			               1211 428 217 70 60 56
			               1206 428 218 70 60 56
			               1080 427 221 71 61 57
			               1007 421 225 72 62 57
			               948 427 230 73 63 58
			               844 420 245 76 64 59
			               827 374 217 79 66 60
			               813 370 203 85 69 61
			               801 367 198 87 73 63
			               823 362 191 74 67 60
			               849 364 189 69 60 57
			               881 385 190 69 60 58
			               915 412 199 71 61 58
			               957 441 218 72 63 60
			               1006 479 244 71 63 59
			               1059 525 279 70 61 56
			               1117 588 324 71 60 57
			               1211 676 391 71 61 58
			               2139 653 328 71 60 57
			               2377 722 356 71 61 58
			               2570 805 393 70 61 59
			               2858 876 446 72 62 60
			               3145 985 526 71 61 59
			               3510 1140 617 70 61 58
			               3901 1263 717 71 62 58
			               4411 1501 871 73 62 59
			               5062 1804 1086 75 63 60
			               6440 2455 1561 79 67 62
			              >;
			pc_temp_ocv_rows = <29>;
			pc_temp_ocv_cols = <6>;
			pc_temp_ocv_percent = <100 95 90 85 80 75 70 65 60 55 50 45 40 35 30 25 20 15 10 9 8 7 6 5 4 3 2 1>;
			pc_temp_ocv_ocv = <
			                   4341 4339 4337 4332 4331 4320
			                   4231 4255 4256 4266 4264 4256
			                   4159 4194 4197 4207 4206 4199
			                   4106 4138 4142 4152 4150 4144
			                   4051 4088 4092 4099 4098 4092
			                   3959 4033 4043 4051 4048 4043
			                   3919 3960 3977 4001 4001 3998
			                   3879 3919 3931 3961 3962 3958
			                   3842 3884 3892 3921 3921 3918
			                   3822 3850 3856 3873 3876 3872
			                   3808 3822 3827 3841 3841 3840
			                   3796 3806 3805 3818 3818 3817
			                   3784 3792 3791 3801 3801 3799
			                   3771 3782 3783 3787 3786 3784
			                   3759 3770 3774 3773 3771 3765
			                   3741 3757 3762 3759 3752 3739
			                   3724 3738 3745 3741 3733 3719
			                   3707 3716 3720 3716 3709 3694
			                   3680 3691 3690 3691 3684 3671
			                   3672 3686 3686 3690 3683 3670
			                   3661 3683 3681 3688 3681 3669
			                   3652 3676 3677 3686 3679 3667
			                   3634 3668 3670 3681 3674 3661
			                   3615 3655 3657 3667 3660 3644
			                   3582 3624 3628 3631 3625 3605
			                   3539 3578 3579 3578 3574 3555
			                   3480 3508 3506 3508 3506 3488
			                   3390 3404 3404 3405 3407 3390
			                   3200 3200 3200 3200 3200 3200
			                  >;
		};
};
