/* DO NOT EDIT - Automatically generated by python */
/ {
		SCUDATLFL_2900_110k_4400:SCUDATLFL_2900_110k_4400 {
			fcc = <2900>;
			default_rbatt_mohm = <100>;
			identify_type = "id_volt";
			id_identify_min = <2281>;
			id_identify_max = <2786>;
			id_voltage_min = <2426>;
			id_voltage_max = <2631>;
			vbat_max = <4400>;
			temp_para = 
						"-32767","0","-1","0","4100","0",
						"0","5","-1","290","4400","0",
						"5","10","-1","870","4400","3",
						"10","45","-1","-1","4400","3",
						"45","50","-1","1015","4100","3",
						"50","32767","-1","0","4100","0";
			vbat_para = 
						"-32767","3400","-1","820","0",
						"3400","32767","-1","-1","0";
			segment_para = 
						"-32767","4150","2900","4208","50",
						"4150","4450","2030","4400","0";
			batt_brand = "SCUDATLFL";
			fcc_temp = <2906 2913 2923 2929 2917 2902>;
			fcc_sf_x = <0 100 200 300 400 500 600 700 800 1000 1500>;
			fcc_sf_y = <100 96 94 92 90 88 87 84 81 75 50>;
			fcc_sf_cols = <11>;
			pc_sf_rows = <1>;
			pc_sf_cols = <1>;
			pc_sf_row_entries = <0>;
			pc_sf_percent = <100>;
			pc_sf_sf = <100>;
			rbatt_sf_rows = <28>;
			rbatt_sf_cols = <6>;
			rbatt_sf_percent = <100 95 90 85 80 75 70 65 60 55 50 45 40 35 30 25 20 15 10 9 8 7 6 5 4 3 2 1>;
			rbatt_sf_sf = <
			               2646 1482 406 154 119 106
			               2645 1482 406 154 119 106
			               2419 1458 411 157 120 107
			               2249 1404 414 160 121 108
			               2176 1370 427 166 125 110
			               2081 1364 436 174 129 112
			               1898 1213 453 188 135 116
			               1892 1196 418 199 144 120
			               1873 1192 392 204 157 129
			               1848 1173 376 161 128 112
			               1880 1175 370 150 118 107
			               1926 1225 372 150 120 109
			               1990 1283 377 156 123 111
			               2069 1349 383 161 129 115
			               2164 1433 395 162 130 117
			               2281 1533 413 156 119 108
			               2434 1654 426 151 118 108
			               2631 1815 452 155 120 108
			               3167 1770 438 158 122 109
			               3831 1671 435 155 123 113
			               4229 1843 443 155 123 113
			               4606 2030 456 155 125 112
			               5032 2264 497 160 125 113
			               5536 2544 504 155 123 111
			               6132 2848 488 163 122 109
			               6857 3256 535 176 124 112
			               7905 3940 613 247 128 116
			               10688 5136 714 809 167 160
			              >;
			pc_temp_ocv_rows = <29>;
			pc_temp_ocv_cols = <6>;
			pc_temp_ocv_percent = <100 95 90 85 80 75 70 65 60 55 50 45 40 35 30 25 20 15 10 9 8 7 6 5 4 3 2 1>;
			pc_temp_ocv_ocv = <
			                   4379 4378 4378 4369 4362 4355
			                   4279 4292 4308 4306 4299 4294
			                   4208 4228 4248 4248 4241 4236
			                   4146 4166 4191 4191 4184 4179
			                   4103 4113 4136 4135 4130 4125
			                   4044 4066 4084 4082 4077 4073
			                   3956 3979 4028 4033 4028 4025
			                   3916 3934 3964 3983 3983 3981
			                   3880 3897 3922 3940 3941 3939
			                   3844 3859 3883 3888 3888 3886
			                   3821 3827 3850 3854 3853 3852
			                   3804 3808 3824 3829 3829 3827
			                   3790 3795 3804 3809 3809 3807
			                   3778 3783 3787 3791 3792 3790
			                   3765 3772 3775 3775 3775 3771
			                   3750 3757 3764 3758 3752 3740
			                   3734 3738 3747 3738 3731 3718
			                   3713 3719 3724 3712 3707 3694
			                   3685 3699 3699 3690 3683 3671
			                   3677 3693 3697 3688 3682 3670
			                   3667 3686 3695 3686 3680 3668
			                   3653 3677 3691 3682 3677 3665
			                   3636 3664 3686 3673 3672 3657
			                   3611 3643 3671 3648 3652 3635
			                   3576 3609 3634 3603 3614 3594
			                   3528 3556 3581 3544 3561 3541
			                   3460 3485 3511 3466 3490 3470
			                   3360 3380 3406 3360 3384 3363
			                   3200 3200 3200 3200 3200 3200
			                  >;
		};
};
