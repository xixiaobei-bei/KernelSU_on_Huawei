/* DO NOT EDIT - Automatically generated by python */
/ {
		SUNWODAATL_3270_39k_4400:SUNWODAATL_3270_39k_4400 {
			fcc = <3270>;
			default_rbatt_mohm = <100>;
			identify_type = "id_volt";
			id_identify_min = <1235>;
			id_identify_max = <1759>;
			id_voltage_min = <1420>;
			id_voltage_max = <1562>;
			vbat_max = <4400>;
			temp_para = 
						"-32767","0","-1","0","4100","0",
						"0","5","-1","327","4400","0",
						"5","10","-1","981","4400","3",
						"10","45","-1","-1","4400","3",
						"45","50","-1","1144","4100","3",
						"50","32767","-1","0","4100","0";
			vbat_para = 
						"-32767","3400","-1","820","0",
						"3400","32767","-1","-1","0";
			segment_para = 
						"-32767","4150","3270","4208","50",
						"4150","4450","2289","4400","0";
			batt_brand = "SUNWODAATL";
			fcc_temp = <3292 3300 3298 3317 3302 3283>;
			fcc_sf_x = <0 100 200 300 400 500 600 700 800 1000 1500>;
			fcc_sf_y = <100 96 94 92 90 88 87 84 81 75 50>;
			fcc_sf_cols = <11>;
			pc_sf_rows = <1>;
			pc_sf_cols = <1>;
			pc_sf_row_entries = <0>;
			pc_sf_percent = <100>;
			pc_sf_sf = <100>;
			rbatt_sf_rows = <28>;
			rbatt_sf_cols = <6>;
			rbatt_sf_percent = <100 95 90 85 80 75 70 65 60 55 50 45 40 35 30 25 20 15 10 9 8 7 6 5 4 3 2 1>;
			rbatt_sf_sf = <
			               2334 1212 532 145 111 98
			               2332 1212 532 145 111 98
			               2156 1215 533 148 112 99
			               2005 1190 531 150 115 100
			               1923 1159 529 156 117 102
			               1853 1187 555 162 121 104
			               1662 1058 558 174 126 107
			               1659 1019 500 185 134 111
			               1635 1016 492 188 144 118
			               1608 1001 477 148 120 103
			               1652 993 473 140 110 99
			               1700 1060 471 141 111 99
			               1754 1133 478 146 115 103
			               1818 1211 518 149 120 106
			               1891 1306 568 148 122 109
			               1984 1414 629 145 111 101
			               2091 1526 702 142 110 99
			               2232 1644 799 145 111 100
			               2883 1463 689 145 114 101
			               3253 1549 664 143 112 102
			               3553 1692 700 144 113 101
			               3891 1891 751 146 115 102
			               4260 2088 840 145 114 102
			               4654 2362 936 146 113 101
			               5116 2552 998 148 111 101
			               5716 2929 1110 154 117 102
			               6541 3396 1319 168 117 104
			               7802 4178 1672 290 121 106
			              >;
			pc_temp_ocv_rows = <29>;
			pc_temp_ocv_cols = <6>;
			pc_temp_ocv_percent = <100 95 90 85 80 75 70 65 60 55 50 45 40 35 30 25 20 15 10 9 8 7 6 5 4 3 2 1>;
			pc_temp_ocv_ocv = <
			                   4385 4383 4380 4372 4365 4360
			                   4280 4299 4305 4308 4304 4300
			                   4208 4234 4245 4250 4245 4242
			                   4147 4174 4187 4192 4188 4186
			                   4102 4117 4132 4137 4132 4130
			                   4053 4078 4085 4083 4080 4078
			                   3959 3992 4025 4034 4031 4029
			                   3919 3938 3958 3984 3984 3985
			                   3880 3901 3917 3940 3942 3943
			                   3839 3862 3877 3888 3889 3888
			                   3820 3824 3844 3853 3854 3855
			                   3805 3807 3817 3828 3830 3829
			                   3792 3795 3796 3808 3809 3808
			                   3780 3785 3785 3791 3792 3791
			                   3766 3774 3776 3775 3776 3773
			                   3752 3760 3765 3758 3753 3742
			                   3736 3740 3748 3738 3733 3720
			                   3716 3718 3721 3713 3709 3696
			                   3692 3695 3692 3690 3684 3673
			                   3685 3690 3689 3689 3683 3672
			                   3676 3684 3685 3687 3682 3670
			                   3666 3678 3681 3684 3679 3668
			                   3652 3669 3675 3676 3675 3661
			                   3632 3654 3661 3654 3659 3643
			                   3601 3622 3629 3613 3621 3607
			                   3554 3573 3577 3557 3570 3557
			                   3487 3502 3505 3482 3503 3491
			                   3386 3396 3399 3371 3404 3393
			                   3200 3200 3200 3200 3200 3200
			                  >;
		};
};
