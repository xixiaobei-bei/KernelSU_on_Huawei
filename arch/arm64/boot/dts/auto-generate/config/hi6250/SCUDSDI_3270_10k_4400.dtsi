/* DO NOT EDIT - Automatically generated by python */
/ {
		SCUDSDI_3270_10k_4400:SCUDSDI_3270_10k_4400 {
			fcc = <3270>;
			default_rbatt_mohm = <100>;
			identify_type = "id_volt";
			id_identify_min = <0>;
			id_identify_max = <751>;
			id_voltage_min = <496>;
			id_voltage_max = <553>;
			vbat_max = <4400>;
			temp_para = 
						"-32767","0","-1","0","4100","0",
						"0","5","-1","327","4400","0",
						"5","10","-1","981","4400","3",
						"10","45","-1","-1","4400","3",
						"45","50","-1","1144","4100","3",
						"50","32767","-1","0","4100","0";
			vbat_para = 
						"-32767","3400","-1","820","0",
						"3400","32767","-1","-1","0";
			segment_para = 
						"-32767","4150","3270","4208","50",
						"4150","4450","2289","4400","0";
			batt_brand = "SCUDSDI";
			fcc_temp = <3406 3403 3395 3396 3395 3386>;
			fcc_sf_x = <0 100 200 300 400 500 600 700 800 1000 1500>;
			fcc_sf_y = <100 96 94 92 90 88 87 84 81 75 50>;
			fcc_sf_cols = <11>;
			pc_sf_rows = <1>;
			pc_sf_cols = <1>;
			pc_sf_row_entries = <0>;
			pc_sf_percent = <100>;
			pc_sf_sf = <100>;
			rbatt_sf_rows = <28>;
			rbatt_sf_cols = <6>;
			rbatt_sf_percent = <100 95 90 85 80 75 70 65 60 55 50 45 40 35 30 25 20 15 10 9 8 7 6 5 4 3 2 1>;
			rbatt_sf_sf = <
			               1795 1399 761 167 116 102
			               1789 1394 761 167 116 102
			               1655 1277 755 168 117 101
			               1546 1173 738 170 119 102
			               1515 1101 719 175 122 105
			               1453 1055 726 183 127 107
			               1287 900 612 192 133 110
			               1281 858 577 198 138 114
			               1272 859 558 207 147 120
			               1280 844 526 176 138 116
			               1328 851 506 156 115 102
			               1392 915 513 156 114 102
			               1473 988 560 159 118 105
			               1568 1078 638 163 124 109
			               1669 1166 727 164 124 108
			               1775 1243 816 162 117 104
			               1885 1314 893 163 115 103
			               2020 1397 973 170 117 104
			               3020 1368 698 152 112 103
			               3174 1451 736 155 116 103
			               3318 1551 795 157 116 104
			               3496 1663 845 156 117 106
			               3664 1794 910 161 119 108
			               3846 1907 998 164 119 105
			               3982 2015 1084 161 116 104
			               4207 2114 1158 173 130 131
			               4420 2180 1249 213 178 113
			               4771 2327 1184 195 138 105
			              >;
			pc_temp_ocv_rows = <29>;
			pc_temp_ocv_cols = <6>;
			pc_temp_ocv_percent = <100 95 90 85 80 75 70 65 60 55 50 45 40 35 30 25 20 15 10 9 8 7 6 5 4 3 2 1>;
			pc_temp_ocv_ocv = <
			                   4380 4376 4372 4363 4359 4354
			                   4264 4272 4278 4286 4289 4286
			                   4196 4206 4216 4229 4230 4227
			                   4136 4153 4160 4174 4175 4172
			                   4095 4104 4107 4121 4121 4119
			                   4041 4059 4065 4071 4071 4068
			                   3949 3975 3991 4021 4025 4021
			                   3906 3922 3942 3968 3975 3979
			                   3866 3888 3904 3936 3940 3938
			                   3831 3851 3867 3889 3894 3893
			                   3809 3820 3834 3850 3852 3851
			                   3793 3804 3809 3825 3827 3826
			                   3778 3791 3794 3805 3807 3805
			                   3766 3781 3785 3789 3791 3789
			                   3755 3770 3775 3776 3774 3770
			                   3745 3757 3764 3761 3754 3745
			                   3735 3741 3746 3743 3735 3722
			                   3725 3722 3723 3717 3708 3695
			                   3703 3701 3696 3690 3682 3671
			                   3698 3698 3692 3688 3681 3669
			                   3694 3695 3690 3687 3679 3668
			                   3689 3691 3688 3684 3677 3666
			                   3681 3687 3683 3681 3674 3661
			                   3668 3676 3673 3673 3665 3647
			                   3644 3653 3653 3648 3636 3612
			                   3606 3614 3614 3600 3587 3562
			                   3546 3551 3556 3536 3523 3493
			                   3446 3449 3457 3436 3423 3392
			                   3200 3200 3200 3200 3200 3200
			                  >;
		};
};
