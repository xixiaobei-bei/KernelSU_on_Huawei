/* DO NOT EDIT - Automatically generated by python */
/ {
		desayatl_7350_39k_4400:desayatl_7350_39k_4400 {
			fcc = <7350>;
			default_rbatt_mohm = <100>;
			identify_type = "id_volt";
			id_identify_min = <1235>;
			id_identify_max = <1759>;
			id_voltage_min = <1420>;
			id_voltage_max = <1562>;
			vbat_max = <4400>;
			temp_para = 
						"-32767","0","-1","0","4100","0",
						"0","5","-1","735","4400","0",
						"5","10","-1","2205","4400","3",
						"10","45","-1","-1","4400","3",
						"45","50","-1","2572","4100","3",
						"50","32767","-1","0","4100","0";
			vbat_para = 
						"-32767","3400","-1","820","0",
						"3400","32767","-1","-1","0";
			segment_para = 
						"-32767","4150","7350","4208","50",
						"4150","4450","5145","4400","0";
			batt_brand = "desayatl";
			fcc_temp = <7362 7425 7448 7453 7434 7371>;
			fcc_sf_x = <0 100 200 300 400 500 600 700 800 1000 1500>;
			fcc_sf_y = <100 96 94 92 90 88 87 84 81 75 50>;
			fcc_sf_cols = <11>;
			pc_sf_rows = <1>;
			pc_sf_cols = <1>;
			pc_sf_row_entries = <0>;
			pc_sf_percent = <100>;
			pc_sf_sf = <100>;
			rbatt_sf_rows = <28>;
			rbatt_sf_cols = <6>;
			rbatt_sf_percent = <100 95 90 85 80 75 70 65 60 55 50 45 40 35 30 25 20 15 10 9 8 7 6 5 4 3 2 1>;
			rbatt_sf_sf = <
			               994 732 252 90 77 74
			               994 731 252 90 77 74
			               923 679 248 90 77 76
			               851 629 247 91 78 75
			               833 593 248 93 80 76
			               779 580 259 96 81 77
			               753 506 252 100 83 78
			               741 501 222 105 86 80
			               734 494 218 108 91 83
			               738 484 213 91 80 76
			               757 488 212 88 77 74
			               779 509 214 87 77 75
			               808 535 218 90 79 75
			               842 565 234 92 81 77
			               886 600 258 92 82 79
			               931 639 285 91 78 75
			               999 684 320 90 78 77
			               1083 745 373 92 78 75
			               1259 737 342 91 79 74
			               1619 790 357 91 79 76
			               1793 902 390 92 79 77
			               1980 1030 438 94 80 78
			               2224 1146 497 94 82 76
			               2434 1281 551 93 80 73
			               2733 1470 593 93 79 79
			               3076 1691 700 96 80 73
			               3536 2010 890 99 82 79
			               4443 2544 1233 118 90 81
			              >;
			pc_temp_ocv_rows = <29>;
			pc_temp_ocv_cols = <6>;
			pc_temp_ocv_percent = <100 95 90 85 80 75 70 65 60 55 50 45 40 35 30 25 20 15 10 9 8 7 6 5 4 3 2 1>;
			pc_temp_ocv_ocv = <
			                   4376 4378 4377 4369 4364 4357
			                   4273 4284 4298 4303 4300 4294
			                   4202 4215 4235 4244 4241 4237
			                   4133 4155 4176 4186 4183 4179
			                   4088 4100 4123 4130 4128 4124
			                   4013 4054 4075 4077 4075 4072
			                   3956 3968 4012 4028 4027 4024
			                   3910 3927 3948 3980 3981 3980
			                   3870 3887 3909 3938 3940 3939
			                   3837 3849 3870 3885 3886 3885
			                   3815 3821 3838 3851 3851 3851
			                   3798 3805 3813 3825 3827 3826
			                   3782 3792 3793 3806 3807 3806
			                   3768 3779 3781 3789 3790 3789
			                   3755 3766 3772 3774 3774 3772
			                   3735 3751 3760 3759 3752 3741
			                   3721 3733 3741 3740 3732 3722
			                   3705 3714 3716 3715 3708 3696
			                   3675 3695 3692 3690 3683 3672
			                   3668 3688 3687 3689 3682 3671
			                   3658 3681 3682 3687 3681 3669
			                   3644 3675 3676 3685 3678 3667
			                   3632 3663 3667 3679 3674 3661
			                   3610 3643 3648 3664 3659 3644
			                   3580 3613 3612 3627 3621 3608
			                   3537 3566 3558 3573 3568 3557
			                   3475 3495 3486 3501 3500 3491
			                   3388 3396 3376 3393 3401 3396
			                   3200 3200 3200 3200 3200 3200
			                  >;
			vol_dec0=  <400>;
			pc_temp_ocv_ocv0 = < 
			                   3976 3978 3977 3969 3964 3957
			                   3968 3974 3967 3960 3956 3950
			                   3961 3971 3957 3950 3948 3943
			                   3942 3942 3938 3932 3922 3917
			                   3906 3910 3908 3894 3886 3882
			                   3874 3879 3879 3867 3861 3859
			                   3846 3850 3853 3846 3842 3839
			                   3826 3827 3831 3827 3825 3823
			                   3810 3812 3813 3813 3811 3810
			                   3796 3800 3796 3801 3799 3798
			                   3783 3790 3787 3789 3788 3786
			                   3772 3780 3779 3779 3778 3775
			                   3761 3770 3772 3769 3763 3755
			                   3748 3759 3763 3758 3749 3737
			                   3733 3746 3751 3745 3735 3723
			                   3722 3732 3734 3729 3719 3706
			                   3709 3717 3716 3709 3700 3689
			                   3687 3703 3697 3690 3684 3672
			                   3659 3680 3679 3684 3678 3666
			                   3646 3675 3674 3682 3675 3662
			                   3638 3667 3667 3676 3666 3654
			                   3624 3654 3655 3660 3651 3636
			                   3606 3635 3632 3636 3626 3612
			                   3582 3611 3599 3602 3592 3579
			                   3549 3573 3558 3561 3552 3541
			                   3503 3521 3508 3510 3505 3495
			                   3446 3455 3439 3446 3442 3439
			                   3362 3360 3338 3350 3350 3353
			                   3200 3200 3200 3200 3200 3200
			                  >;
		};
};
