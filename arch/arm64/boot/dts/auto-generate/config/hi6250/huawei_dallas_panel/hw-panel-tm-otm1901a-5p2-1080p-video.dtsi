/* Copyright (c) 2013, The Linux Foundation. All rights reserved.
 *
 * This program is free software; you can redistribute it and/or modify
 * it under the terms of the GNU General Public License version 2 and
 * only version 2 as published by the Free Software Foundation.
 *
 * This program is distributed in the hope that it will be useful,
 * but WITHOUT ANY WARRANTY; without even the implied warranty of
 * MERCHANTABILITY or FITNESS FOR A PARTICULAR PURPOSE.  See the
 * GNU General Public License for more details.
 */

/*---------------------------------------------------------------------------
 * This file is autogenerated file using gcdb parser. Please do not edit it.
 * Update input XML file to add a new entry or update variable in this file
 * VERSION = "1.0"
 *---------------------------------------------------------------------------*/
/{
	dss_tm_otm1901a_5p2_1080p_video:tm_otm1901a_5p2_1080p_video {
		compatible = "hisilicon,tm_otm1901a_5p2_1080p_video";
		hisilicon,dss-panel-name = "TM_OTM1901A 5.2' VIDEO TFT 1080 x 1920";
		hisilicon,dss-panel-xres = <1080>;
		hisilicon,dss-panel-yres = <1920>;
		hisilicon,dss-panel-width = <65>;
		hisilicon,dss-panel-height = <115>;
		hisilicon,dss-panel-orientation = <1>;
		hisilicon,dss-panel-bpp = <2>;
		hisilicon,dss-panel-bgrfmt = <0>;
		hisilicon,dss-panel-bl-type = <8>;
		hisilicon,dss-panel-blmin = <3>;
		hisilicon,dss-panel-blmax = <255>;
		hisilicon,dss-panel-bl-def = <102>;
		hisilicon,dss-panel-type = <8>;
		hisilicon,dss-panel-ifbc-type = <0>;
		hisilicon,dss-panel-bl-pwm-preci-type = <0>;
		hisilicon,dss-panel-frc-enable = <0>;
		hisilicon,dss-panel-esd-enable = <1>;
		hisilicon,dss-panel-pxl-clk = <144>;
		hisilicon,dss-panel-pxl-clk-div = <1>;
		hisilicon,dss-panel-dirt-updt-support = <0>;
		hisilicon,dss-panel-dsi-upt-support = <0>;
		hisilicon,dss-panel-vsyn-ctr-type = <0>;
		hisilicon,dss-panel-step-support = <1>;
		hisilicon,dss-panel-esd-skip-mipi-check = <1>;
		hisilicon,dss-ldi-h-back-porch = <10>;
		hisilicon,dss-ldi-h-front-porch = <120>;
		hisilicon,dss-ldi-h-pulse-width = <8>;
		hisilicon,dss-ldi-v-back-porch = <30>;
		hisilicon,dss-ldi-v-front-porch = <10>;
		hisilicon,dss-ldi-v-pulse-width = <10>;
		hisilicon,dss-ldi-hsync-plr = <0>;
		hisilicon,dss-ldi-vsync-plr = <0>;
		hisilicon,dss-ldi-pixel-clk-plr = <0>;
		hisilicon,dss-ldi-data-en-plr = <0>;
		hisilicon,dss-ldi-dpi-a-overlap-size = <0>;
		hisilicon,dss-ldi-dpi-b-overlap-size = <0>;
		hisilicon,dss-sbl-stren-limit = <128>;
		hisilicon,dss-sbl-cal-a = <60>;
		hisilicon,dss-sbl-cal-b = <95>;
		hisilicon,dss-sbl-cal-c = <5>;
		hisilicon,dss-sbl-cal-d = <1>;
		hisilicon,dss-sbl-tf-ctl = <5>;
		hisilicon,dss-sbl-blmin = <480>;
		hisilicon,dss-sbl-blmax = <4096>;
		hisilicon,dss-sbl-bl-scale = <0xff>;
		hisilicon,dss-sbl-am-light-min = <14>;
		hisilicon,dss-sbl-filter-a = <1738>;
		hisilicon,dss-sbl-filter-b = <6>;
		hisilicon,dss-sbl-logo-left = <0>;
		hisilicon,dss-sbl-logo-top = <0>;
		hisilicon,dss-mipi-vc = <0>;
		hisilicon,dss-mipi-lane-nums = <3>;
		hisilicon,dss-mipi-color-mode = <5>;
		hisilicon,dss-mipi-dsi-bit-clk = <490>;
		hisilicon,dss-mipi-burst-mode = <2>;
		hisilicon,dss-mipi-max-esc-clk = <9>;
		hisilicon,dss-mipi-dsi-bit-clk-val-a = <471>;
		hisilicon,dss-mipi-dsi-bit-clk-val-b = <480>;
		hisilicon,dss-mipi-dsi-bit-clk-val-c = <490>;
		hisilicon,dss-mipi-dsi-bit-clk-val-d = <500>;
		hisilicon,dss-mipi-dsi-bit-clk-val-e = <0>;
		hisilicon,dss-mipi-dsi-bit-clk-upt = <490>;
		hisilicon,dss-mipi-rg-vcm-adjust = <5>;
		hisilicon,dss-mipi-non-continue-enable = <1>;
		hisilicon,dss-mipi-clk-post-adjust = <30>;
		hisilicon,dss-dirt-left-align = <2>;
		hisilicon,dss-dirt-right-align = <2>;
		hisilicon,dss-dirt-top-align = <2>;
		hisilicon,dss-dirt-bott-align = <2>;
		hisilicon,dss-dirt-width-align = <2>;
		hisilicon,dss-dirt-height-align = <2>;
		hisilicon,dss-dirt-width-min = <2>;
		hisilicon,dss-dirt-height-min = <2>;
		hisilicon,dss-dirt-top-start = <0xffff>;
		hisilicon,dss-dirt-bott-start = <0xffff>;
		lcd-ctrl-tp-power = <0>;
		lock-cmd-support = <0>;
		read-power-status = <1>;
		esd-set-backlight = <1>;
		pt-station-test-support = <1>;
		power-on-sequence = <0 0 0 0 0 5 5 5 5 1 10 25 0>;
		power-off-sequence = <5 5 5 0 3 0>;
		hisilicon,dss-color-temp-support = <0>;
		hisilicon,dss-prefix-ce-support = <0>;
		hisilicon,dss-prefix-sharp-one-d-support = <0>;
		hisilicon,dss-prefix-sharp-two-d-support = <0>;
		hisilicon,dss-sbl-support = <0>;
		hisilicon,dss-gamma-support = <1>;
		hisilicon,dss-gmp-support = <0>;
		hisilicon,dss-xcc-support = <1>;
		hisilicon,dss-comform-mode-support = <1>;
		hisilicon,dss-acm-support = <1>;
		hisilicon,dss-acm-ce-support = <1>;
		hisilicon,dss-acm-valid-num = <7>;
		hisilicon,dss-acm-r_hh0 = <0x80>;
		hisilicon,dss-acm-r_lh0 = <0x12>;
		hisilicon,dss-acm-r_hh1 = <0xfd>;
		hisilicon,dss-acm-r_lh1 = <0x81>;
		hisilicon,dss-acm-r_hh2 = <0x17f>;
		hisilicon,dss-acm-r_lh2 = <0xfe>;
		hisilicon,dss-acm-r_hh3 = <0x1ff>;
		hisilicon,dss-acm-r_lh3 = <0x180>;
		hisilicon,dss-acm-r_hh4 = <0x27f>;
		hisilicon,dss-acm-r_lh4 = <0x200>;
		hisilicon,dss-acm-r_hh5 = <0x3bf>;
		hisilicon,dss-acm-r_lh5 = <0x280>;
		hisilicon,dss-acm-r_hh6 = <0x3f7>;
		hisilicon,dss-acm-r_lh6 = <0x3c0>;

		hisilicon,dss-on-cmds = <
					0x29 0x00 0x0a 0x00 0x02 0x00 0x00
				0x29 0x00 0x0a 0x01 0x05 0xFF 0x19 0x01 0x01 0x00
				0x29 0x00 0x0a 0x00 0x02 0x00 0x80
				0x29 0x00 0x0a 0x01 0x03 0xFF 0x19 0x01
				0x29 0x00 0x0a 0x00 0x02 0x00 0x00
				0x29 0x00 0x0a 0x00 0x02 0x1C 0x33
				0x29 0x00 0x0a 0x00 0x02 0x00 0xB0
				0x29 0x00 0x0a 0x00 0x02 0xCA 0x01
				0x29 0x00 0x0a 0x00 0x02 0x00 0xB1
				0x29 0x00 0x0a 0x00 0x02 0xCA 0x01
				0x29 0x00 0x0a 0x00 0x02 0x00 0xB3
				0x29 0x00 0x0a 0x00 0x02 0xCA 0x40
				0x29 0x00 0x0a 0x00 0x02 0x00 0x00
				0x29 0x00 0x0a 0x00 0x03 0xD8 0x17 0x17
				0x29 0x00 0x0a 0x00 0x02 0x00 0x00
				0x29 0x00 0x0a 0x00 0x19 0xE1 0x21 0x27 0x2b 0x31 0x36 0x39 0x42 0x50 0x57 0x68 0x73 0x7c 0x7c 0x75 0x6e 0x5d 0x4a 0x37 0x2c 0x25 0x1c 0x12 0x0d 0x0a
				0x29 0x00 0x0a 0x00 0x02 0x00 0x00
				0x29 0x00 0x0a 0x00 0x19 0xE2 0x21 0x27 0x2b 0x31 0x36 0x39 0x42 0x50 0x57 0x68 0x73 0x7c 0x7c 0x75 0x6e 0x5d 0x4a 0x37 0x2c 0x25 0x1c 0x12 0x0d 0x0a
				0x29 0x00 0x0a 0x00 0x02 0x00 0x00
				0x29 0x00 0x0a 0x00 0x19 0xE3 0x30 0x33 0x36 0x3b 0x3f 0x43 0x4a 0x55 0x5d 0x6b 0x75 0x7e 0x7a 0x74 0x6d 0x5d 0x4a 0x38 0x2c 0x25 0x1d 0x12 0x0d 0x0a
				0x29 0x00 0x0a 0x00 0x02 0x00 0x00
				0x29 0x00 0x0a 0x00 0x19 0xE4 0x30 0x33 0x36 0x3b 0x3f 0x43 0x4a 0x55 0x5d 0x6b 0x75 0x7e 0x7a 0x74 0x6d 0x5d 0x4a 0x38 0x2c 0x25 0x1d 0x12 0x0d 0x0a
				0x29 0x00 0x0a 0x00 0x02 0x00 0x00
				0x29 0x00 0x0a 0x00 0x19 0xE5 0x0f 0x15 0x1a 0x22 0x26 0x2c 0x36 0x47 0x4f 0x61 0x6e 0x79 0x7e 0x76 0x6f 0x5d 0x49 0x37 0x2b 0x24 0x1c 0x11 0x0d 0x0a
				0x29 0x00 0x0a 0x00 0x02 0x00 0x00
				0x29 0x00 0x0a 0x00 0x19 0xE6 0x0f 0x15 0x1a 0x22 0x26 0x2c 0x36 0x47 0x4f 0x61 0x6e 0x79 0x7e 0x76 0x6f 0x5d 0x49 0x37 0x2b 0x24 0x1c 0x11 0x0d 0x0a
				0x29 0x00 0x0a 0x00 0x02 0x00 0xA0
				0x29 0x00 0x0a 0x00 0x0D 0xD6 0x00 0x01 0x01 0x06 0x0c 0x07 0x00 0xfc 0xfe 0x02 0x02 0x00
				0x29 0x00 0x0a 0x00 0x02 0x00 0xB0
				0x29 0x00 0x0a 0x00 0x0D 0xD6 0x29 0x11 0x00 0x0c 0x00 0x0c 0x86 0x3a 0x27 0x2d 0x36 0x13
				0x29 0x00 0x0a 0x00 0x02 0x00 0xC0
				0x29 0x00 0x0a 0x00 0x0D 0xD6 0x33 0x17 0x00 0x01 0x80 0xa9 0xa9 0x7d 0x69 0x4c 0x49 0x23
				0x29 0x00 0x0a 0x00 0x02 0x00 0xD0
				0x29 0x00 0x0a 0x00 0x0D 0xD6 0x03 0x04 0x13 0x0c 0x13 0x29 0x35 0x45 0x54 0x1a 0x20 0x54
				0x29 0x00 0x0a 0x00 0x02 0x00 0x00
				0x29 0x00 0x0a 0x00 0x04 0xFF 0xFF 0xFF 0xFF
				0x15 0x00 0x0a 0x00 0x02 0x51 0x00
				0x15 0x00 0x0A 0x00 0x02 0x53 0x24
				0x15 0x00 0x0A 0x00 0x02 0x55 0x01
				0x15 0x00 0x0A 0x00 0x02 0x5E 0x28
				0x15 0x00 0x0A 0x00 0x02 0x81 0x83
				0x05 0x00 0x0a 0x00 0x02 0x13 0x00
				0x05 0x00 0x78 0x01 0x02 0x11 0x00
				0x05 0x00 0x14 0x01 0x02 0x29 0x00>;
		hisilicon,dss-off-cmds = <
					0x05 0x00 0x0a 0x01 0x02 0x22 0x00
				0x05 0x00 0x14 0x01 0x02 0x28 0x00
				0x05 0x00 0x78 0x01 0x02 0x10 0x00>;
		hisilicon,dss-esd-reg = <
					0x0a 0x0d>;
		hisilicon,dss-esd-value = <
					0x9c 0x00>;
		hisilicon,dss-mipi-check-reg = <
					0x0a 0x0b 0x0c 0x0d>;
		hisilicon,dss-mipi-check-value = <
					0x9c 0x00 0x07 0x00>;
		hisilicon,dss-cabc-off-mode = <
					0x15 0x00 0x0a 0x00 0x02 0x55 0x00>;
		hisilicon,dss-cabc-ui-mode = <
					0x15 0x00 0x0a 0x00 0x02 0x55 0x01
			0x15 0x00 0x0a 0x00 0x02 0x53 0x24>;
		hisilicon,dss-cabc-still-mode = <
					0x15 0x00 0x0a 0x00 0x02 0x55 0x02
			0x15 0x00 0x0a 0x00 0x02 0x53 0x24>;
		hisilicon,dss-cabc-moving-mode = <
					0x15 0x00 0x0a 0x00 0x02 0x55 0x03
			0x15 0x00 0x0a 0x00 0x02 0x53 0x2C>;
		hisilicon,dss-dot-inversion = <
					0x29 0x00 0x0a 0x00 0x02 0x00 0x00
				0x29 0x00 0x0a 0x00 0x04 0xFF 0x19 0x01 0x01
				0x29 0x00 0x0a 0x00 0x02 0x00 0x80
				0x29 0x00 0x0a 0x00 0x03 0xFF 0x19 0x01
				0x29 0x00 0x0a 0x00 0x02 0x00 0xB3
				0x29 0x00 0x0a 0x00 0x02 0xC0 0x00
				0x29 0x00 0x0a 0x00 0x02 0x00 0x00
				0x29 0x00 0x0a 0x00 0x02 0xFB 0x01
				0x29 0x00 0x0a 0x00 0x02 0x00 0x00
				0x29 0x00 0x0a 0x00 0x04 0xFF 0xFF 0xFF 0xFF>;
		hisilicon,dss-column-inversion = <
					0x29 0x00 0x0a 0x00 0x02 0x00 0x00
				0x29 0x00 0x0a 0x00 0x04 0xFF 0x19 0x01 0x01
				0x29 0x00 0x0a 0x00 0x02 0x00 0x80
				0x29 0x00 0x0a 0x00 0x03 0xFF 0x19 0x01
				0x29 0x00 0x0a 0x00 0x02 0x00 0xB3
				0x29 0x00 0x0a 0x00 0x02 0xC0 0xCC
				0x29 0x00 0x0a 0x00 0x02 0x00 0x00
				0x29 0x00 0x0a 0x00 0x02 0xFB 0x01
				0x29 0x00 0x0a 0x00 0x02 0x00 0x00
				0x29 0x00 0x0a 0x00 0x04 0xFF 0xFF 0xFF 0xFF>;
		hisilicon,dss-forword-scan = <
					0x29 0x00 0x0a 0x00 0x02 0x00 0x00
				0x29 0x00 0x0a 0x00 0x04 0xFF 0x19 0x01 0x01
				0x29 0x00 0x0a 0x00 0x02 0x00 0x80
				0x29 0x00 0x0a 0x00 0x03 0xFF 0x19 0x01
				0x29 0x00 0x0a 0x00 0x02 0x00 0xB4
				0x29 0x00 0x0a 0x00 0x02 0xC0 0x80
				0x29 0x00 0x0a 0x00 0x02 0x00 0x00
				0x29 0x00 0x0a 0x00 0x02 0xFB 0x01
				0x29 0x00 0x0a 0x00 0x02 0x00 0x00
				0x29 0x00 0x0a 0x00 0x04 0xFF 0xFF 0xFF 0xFF>;
		hisilicon,dss-revert-scan = <
					0x29 0x00 0x0a 0x00 0x02 0x00 0x00
				0x29 0x00 0x0a 0x00 0x04 0xFF 0x19 0x01 0x01
				0x29 0x00 0x0a 0x00 0x02 0x00 0x80
				0x29 0x00 0x0a 0x00 0x03 0xFF 0x19 0x01
				0x29 0x00 0x0a 0x00 0x02 0x00 0xB4
				0x29 0x00 0x0a 0x00 0x02 0xC0 0xD0
				0x29 0x00 0x0a 0x00 0x02 0x00 0x00
				0x29 0x00 0x0a 0x00 0x02 0xFB 0x01
				0x29 0x00 0x0a 0x00 0x02 0x00 0x00
				0x29 0x00 0x0a 0x00 0x04 0xFF 0xFF 0xFF 0xFF>;
		gpios = <&gpio1 7 0>, <&gpio2 4 0>, <&gpio2 5 0>, <&gpio0 0 0>, <&gpio0 0 0>, <&gpio3 0 0>;
		lcdanalog-vcc = <3100000>;
		lcdio-vcc = <1800000>;
		lcd-bias = <5000000>;
		lcd-vsp = <5000000>;
		lcd-vsn = <5000000>;
		lcdio-vcc-supply = <&ldo4>;
		lcdanalog-vcc-supply = <&ldo17>;
		lcd_backlight-supply = <&schg_boost2>;
		vcc_lcdbias-supply = <&schg_boost4>;
		lcd_vsp-supply = <&schg_ldo3>;
		lcd_vsn-supply = <&schg_cpn1>;
		pinctrl-names = "default","idle";
		pinctrl-0 = <&gpio015_pmx_func &gpio020_pmx_func &gpio021_pmx_func &gpio024_pmx_func &gpio015_cfg_func &gpio020_cfg_func &gpio021_cfg_func &gpio024_cfg_func>;
		pinctrl-1 = <&gpio015_pmx_idle &gpio020_pmx_idle &gpio021_pmx_idle &gpio024_pmx_idle &gpio015_cfg_idle &gpio020_cfg_idle &gpio021_cfg_idle &gpio024_cfg_idle>;
		status = "disabled";
	};
};
