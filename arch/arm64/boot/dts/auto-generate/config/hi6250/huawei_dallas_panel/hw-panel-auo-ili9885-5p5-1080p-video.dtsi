/* Copyright (c) 2013, The Linux Foundation. All rights reserved.
 *
 * This program is free software; you can redistribute it and/or modify
 * it under the terms of the GNU General Public License version 2 and
 * only version 2 as published by the Free Software Foundation.
 *
 * This program is distributed in the hope that it will be useful,
 * but WITHOUT ANY WARRANTY; without even the implied warranty of
 * MERCHANTABILITY or FITNESS FOR A PARTICULAR PURPOSE.  See the
 * GNU General Public License for more details.
 */

/*---------------------------------------------------------------------------
 * This file is autogenerated file using gcdb parser. Please do not edit it.
 * Update input XML file to add a new entry or update variable in this file
 * VERSION = "1.0"
 *---------------------------------------------------------------------------*/
/{
	dss_auo_ili9885_5p5_1080p_video:auo_ili9885_5p5_1080p_video {
		compatible = "hisilicon,auo_ili9885_5p5_1080p_video";
		hisilicon,dss-panel-name = "AUO_ILI9885 5.5' VIDEO TFT 1080 x 1920";
		hisilicon,dss-panel-xres = <1080>;
		hisilicon,dss-panel-yres = <1920>;
		hisilicon,dss-panel-width = <68>;
		hisilicon,dss-panel-height = <121>;
		hisilicon,dss-panel-orientation = <1>;
		hisilicon,dss-panel-bpp = <2>;
		hisilicon,dss-panel-bgrfmt = <0>;
		hisilicon,dss-panel-bl-type = <8>;
		hisilicon,dss-panel-blmin = <3>;
		hisilicon,dss-panel-blmax = <255>;
		hisilicon,dss-panel-bl-def = <102>;
		hisilicon,dss-panel-type = <8>;
		hisilicon,dss-panel-ifbc-type = <0>;
		hisilicon,dss-panel-bl-pwm-preci-type = <0>;
		hisilicon,dss-panel-frc-enable = <0>;
		hisilicon,dss-panel-esd-enable = <0>;
		hisilicon,dss-panel-pxl-clk = <144>;
		hisilicon,dss-panel-pxl-clk-div = <1>;
		hisilicon,dss-panel-dirt-updt-support = <0>;
		hisilicon,dss-panel-dsi-upt-support = <0>;
		hisilicon,dss-panel-vsyn-ctr-type = <0>;
		hisilicon,dss-panel-step-support = <1>;
		hisilicon,dss-panel-esd-skip-mipi-check = <1>;
		hisilicon,dss-ldi-h-back-porch = <10>;
		hisilicon,dss-ldi-h-front-porch = <122>;
		hisilicon,dss-ldi-h-pulse-width = <8>;
		hisilicon,dss-ldi-v-back-porch = <16>;
		hisilicon,dss-ldi-v-front-porch = <24>;
		hisilicon,dss-ldi-v-pulse-width = <8>;
		hisilicon,dss-ldi-hsync-plr = <0>;
		hisilicon,dss-ldi-vsync-plr = <0>;
		hisilicon,dss-ldi-pixel-clk-plr = <0>;
		hisilicon,dss-ldi-data-en-plr = <0>;
		hisilicon,dss-ldi-dpi-a-overlap-size = <0>;
		hisilicon,dss-ldi-dpi-b-overlap-size = <0>;
		hisilicon,dss-sbl-stren-limit = <128>;
		hisilicon,dss-sbl-cal-a = <60>;
		hisilicon,dss-sbl-cal-b = <95>;
		hisilicon,dss-sbl-cal-c = <5>;
		hisilicon,dss-sbl-cal-d = <1>;
		hisilicon,dss-sbl-tf-ctl = <5>;
		hisilicon,dss-sbl-blmin = <480>;
		hisilicon,dss-sbl-blmax = <4096>;
		hisilicon,dss-sbl-bl-scale = <0xff>;
		hisilicon,dss-sbl-am-light-min = <14>;
		hisilicon,dss-sbl-filter-a = <1738>;
		hisilicon,dss-sbl-filter-b = <6>;
		hisilicon,dss-sbl-logo-left = <0>;
		hisilicon,dss-sbl-logo-top = <0>;
		hisilicon,dss-sbl-variance-intensity-space = <145>;
		hisilicon,dss-sbl-slope-max = <54>;
		hisilicon,dss-sbl-slope-min = <160>;
		hisilicon,dss-mipi-vc = <0>;
		hisilicon,dss-mipi-lane-nums = <3>;
		hisilicon,dss-mipi-color-mode = <5>;
		hisilicon,dss-mipi-dsi-bit-clk = <490>;
		hisilicon,dss-mipi-burst-mode = <2>;
		hisilicon,dss-mipi-max-esc-clk = <9>;
		hisilicon,dss-mipi-dsi-bit-clk-val-a = <471>;
		hisilicon,dss-mipi-dsi-bit-clk-val-b = <480>;
		hisilicon,dss-mipi-dsi-bit-clk-val-c = <490>;
		hisilicon,dss-mipi-dsi-bit-clk-val-d = <500>;
		hisilicon,dss-mipi-dsi-bit-clk-val-e = <0>;
		hisilicon,dss-mipi-dsi-bit-clk-upt = <490>;
		hisilicon,dss-mipi-rg-vcm-adjust = <5>;
		hisilicon,dss-mipi-non-continue-enable = <1>;
		hisilicon,dss-mipi-clk-post-adjust = <30>;
		hisilicon,dss-dirt-left-align = <2>;
		hisilicon,dss-dirt-right-align = <2>;
		hisilicon,dss-dirt-top-align = <2>;
		hisilicon,dss-dirt-bott-align = <2>;
		hisilicon,dss-dirt-width-align = <2>;
		hisilicon,dss-dirt-height-align = <2>;
		hisilicon,dss-dirt-width-min = <2>;
		hisilicon,dss-dirt-height-min = <2>;
		hisilicon,dss-dirt-top-start = <0xffff>;
		hisilicon,dss-dirt-bott-start = <0xffff>;
		lcd-ctrl-tp-power = <0>;
		lock-cmd-support = <0>;
		read-power-status = <1>;
		esd-set-backlight = <0>;
		pt-station-test-support = <1>;
		power-on-sequence = <0 0 0 0 0 5 5 5 5 1 10 25 0>;
		power-off-sequence = <5 5 5 0 3 0>;
		hisilicon,dss-color-temp-support = <0>;
		hisilicon,dss-prefix-ce-support = <0>;
		hisilicon,dss-prefix-sharp-one-d-support = <0>;
		hisilicon,dss-prefix-sharp-two-d-support = <0>;
		hisilicon,dss-sbl-support = <1>;
		hisilicon,dss-gamma-support = <1>;
		hisilicon,dss-gmp-support = <0>;
		hisilicon,dss-xcc-support = <1>;
		hisilicon,dss-comform-mode-support = <1>;
		hisilicon,dss-acm-support = <0>;
		hisilicon,dss-acm-ce-support = <0>;
		hisilicon,dss-acm-valid-num = <7>;
		hisilicon,dss-acm-r_hh0 = <0x7f>;
		hisilicon,dss-acm-r_lh0 = <0x0>;
		hisilicon,dss-acm-r_hh1 = <0xff>;
		hisilicon,dss-acm-r_lh1 = <0x80>;
		hisilicon,dss-acm-r_hh2 = <0x17f>;
		hisilicon,dss-acm-r_lh2 = <0x100>;
		hisilicon,dss-acm-r_hh3 = <0x1ff>;
		hisilicon,dss-acm-r_lh3 = <0x180>;
		hisilicon,dss-acm-r_hh4 = <0x27f>;
		hisilicon,dss-acm-r_lh4 = <0x200>;
		hisilicon,dss-acm-r_hh5 = <0x2ff>;
		hisilicon,dss-acm-r_lh5 = <0x280>;
		hisilicon,dss-acm-r_hh6 = <0x37f>;
		hisilicon,dss-acm-r_lh6 = <0x300>;

		hisilicon,dss-on-cmds = <
					0x29 0x00 0x0a 0x00 0x04 0xB0 0x98 0x85 0x0A
			0x29 0x00 0x0a 0x00 0x08 0xC4 0x70 0x19 0x23 0x00 0x0F 0x0F 0x00
			0x29 0x00 0x0a 0x00 0x06 0xCE 0x11 0x22 0x34 0x20 0x00
			0x29 0x00 0x0a 0x00 0x07 0xD0 0x55 0x05 0x34 0x66 0x62 0x00
			0x29 0x00 0x0a 0x00 0x05 0xD2 0x03 0x03 0x2A 0x22
			0x29 0x00 0x0a 0x00 0x0A 0xD3 0x33 0x33 0x05 0x03 0x59 0x59 0x22 0x26 0x22
			0x29 0x00 0x0a 0x00 0x08 0xEC 0x76 0x1E 0x32 0x00 0x44 0x00 0x02
			0x29 0x00 0x0a 0x00 0x09 0xEF 0x8F 0x05 0x52 0x13 0xE1 0x33 0x5b 0x09
			0x29 0x00 0x0a 0x00 0x0D 0xD6 0x00 0x00 0x08 0x17 0x23 0x65 0x77 0x44 0x87 0x00 0x00 0x09
			0x29 0x00 0x0a 0x00 0x24 0xEB 0x9B 0xC7 0x73 0x00 0x58 0x55 0x55 0x55 0x55 0x54 0x00 0x00 0x00 0x00 0x00 0x25 0x4D 0x0F 0xFF 0xFF 0xFF 0xFF 0xFF 0x55 0x55 0x55 0x55 0x32 0x77 0x55 0x43 0x45 0x5E 0xFF 0x55
			0x29 0x00 0x0a 0x00 0x4A 0xE5 0x36 0x36 0xA1 0xF6 0xF6 0x47 0x07 0x55 0x15 0x63 0x23 0x71 0x31 0x6E 0x36 0x85 0x36 0x36 0x36 0x36 0x36 0x36 0xA8 0xF6 0xF6 0x4E 0x0E 0x5C 0x1C 0x6A 0x2A 0x78 0x38 0x76 0x35 0x8C 0x36 0x36 0x36 0x36 0x18 0x70 0x61 0x00 0x4E 0xBB 0x70 0x80 0x00 0x4E 0xBB 0xF7 0x00 0x4E 0xBB 0x00 0x00 0x00 0x00 0x00 0x00 0x00 0x00 0x00 0x00 0x00 0x00 0x00 0x00 0x00 0x00 0x00 0x07
			0x29 0x00 0x0a 0x00 0x43 0xEA 0x51 0x00 0x00 0x00 0x00 0x00 0x00 0x40 0x00 0x00 0x00 0x00 0x00 0x00 0x0F 0x00 0x00 0x00 0x96 0x95 0x10 0x11 0x00 0x0A 0x00 0x0F 0x00 0x00 0x00 0x70 0x01 0x10 0x00 0x40 0x80 0xC0 0x00 0x00 0x01 0x23 0x45 0x67 0x89 0xAB 0xCD 0xEF 0xCC 0xCC 0x22 0x33 0x33 0x00 0x11 0x00 0x11 0x00 0x11 0x00 0x11 0xCC 0xDD 0x22 0xCC 0xCC 0xCC 0xCC
			0x29 0x00 0x0a 0x00 0x18 0xED 0x00 0x01 0x00 0x00 0x00 0x00 0x00 0x00 0x00 0x00 0x00 0x00 0x00 0x00 0x00 0x00 0x00 0x00 0x00 0x00 0x00 0x00 0x40
			0x29 0x00 0x0a 0x00 0x14 0xEE 0x22 0x10 0x02 0x02 0x0F 0x40 0x00 0x07 0x00 0x04 0x00 0x00 0xC0 0xB9 0x77 0x00 0x55 0x05 0x1F
			0x29 0x00 0x0a 0x00 0x02 0xB0 0x11
			0x29 0x00 0x0a 0x00 0x03 0x51 0x00 0x00
			0x15 0x00 0x0a 0x00 0x02 0x53 0x24
			0x15 0x00 0x0a 0x00 0x02 0x55 0x01
			0x29 0x00 0x0a 0x00 0x03 0x5E 0x00 0x00
			0x05 0x00 0x78 0x01 0x02 0x11 0x00
			0x05 0x00 0x14 0x01 0x02 0x29 0x00>;
		hisilicon,dss-off-cmds = <
					0x05 0x00 0x14 0x01 0x02 0x28 0x00
			0x05 0x00 0x78 0x01 0x02 0x10 0x00>;
		hisilicon,dss-esd-reg = <
					0x0a 0x0d>;
		hisilicon,dss-esd-value = <
					0x9c 0x00>;
		hisilicon,dss-mipi-check-reg = <
					0x0a>;
		hisilicon,dss-mipi-check-value = <
					0x9c>;
		hisilicon,dss-cabc-off-mode = <
					0x15 0x00 0x0a 0x00 0x02 0x55 0x00>;
		hisilicon,dss-cabc-ui-mode = <
					0x15 0x00 0x0a 0x00 0x02 0x55 0x01
				0x15 0x00 0x0a 0x00 0x02 0x53 0x24>;
		hisilicon,dss-cabc-still-mode = <
					0x15 0x00 0x0a 0x00 0x02 0x55 0x02
					0x15 0x00 0x0a 0x00 0x02 0x53 0x2C>;
		hisilicon,dss-cabc-moving-mode = <
					0x15 0x00 0x0a 0x00 0x02 0x55 0x03
			0x15 0x00 0x0a 0x00 0x02 0x53 0x2C>;
		hisilicon,dss-dot-inversion = <
					0x29 0x00 0x0a 0x00 0x04 0xB0 0x98 0x85 0x0A
				0x29 0x00 0x0a 0x00 0x06 0xC2 0x10 0x07 0x80 0x18 0x18
				0x29 0x00 0x0a 0x00 0x02 0xB0 0x11>;
		hisilicon,dss-column-inversion = <
					0x29 0x00 0x0a 0x00 0x04 0xB0 0x98 0x85 0x0A
				0x29 0x00 0x0a 0x00 0x06 0xC2 0x10 0xF7 0x80 0x18 0x18
				0x29 0x00 0x0a 0x00 0x02 0xB0 0x11>;
		hisilicon,dss-forword-scan = <
					0x29 0x00 0x0a 0x00 0x04 0xB0 0x98 0x85 0x0A
				0x29 0x00 0x0a 0x00 0x04 0xC1 0x00 0x00 0x00
				0x29 0x00 0x0a 0x00 0x02 0xB0 0x11>;
		hisilicon,dss-revert-scan = <
					0x29 0x00 0x0a 0x00 0x04 0xB0 0x98 0x85 0x0A
				0x29 0x00 0x0a 0x00 0x04 0xC1 0x00 0x00 0x01
				0x29 0x00 0x0a 0x00 0x02 0xB0 0x11>;
		gpios = <&gpio1 7 0>, <&gpio2 4 0>, <&gpio2 5 0>, <&gpio0 0 0>, <&gpio0 0 0>, <&gpio9 5 0>;
		lcdanalog-vcc = <3100000>;
		lcdio-vcc = <1800000>;
		lcd-bias = <5400000>;
		lcd-vsp = <5400000>;
		lcd-vsn = <5400000>;
		lcdio-vcc-supply = <&ldo4>;
		lcdanalog-vcc-supply = <&ldo17>;
		lcd_backlight-supply = <&schg_boost2>;
		vcc_lcdbias-supply = <&schg_boost4>;
		lcd_vsp-supply = <&schg_ldo3>;
		lcd_vsn-supply = <&schg_cpn1>;
		pinctrl-names = "default","idle";
		pinctrl-0 = <&gpio015_pmx_func &gpio020_pmx_func &gpio021_pmx_func &gpio077_pmx_func &gpio015_cfg_func &gpio020_cfg_func &gpio021_cfg_func &gpio077_cfg_func>;
		pinctrl-1 = <&gpio015_pmx_idle &gpio020_pmx_idle &gpio021_pmx_idle &gpio077_pmx_idle &gpio015_cfg_idle &gpio020_cfg_idle &gpio021_cfg_idle &gpio077_cfg_idle>;
		status = "disabled";
	};
};
