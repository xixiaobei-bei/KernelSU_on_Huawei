/* DO NOT EDIT - Automatically generated by python */
/ {
		DESAYLGA_2900_200k_4400:DESAYLGA_2900_200k_4400 {
			fcc = <2900>;
			default_rbatt_mohm = <100>;
			identify_type = "id_volt";
			id_identify_min = <2786>;
			id_identify_max = <3312>;
			id_voltage_min = <2941>;
			id_voltage_max = <3167>;
			vbat_max = <4400>;
			temp_para = 
						"-32767","0","-1","0","4100","0",
						"0","5","-1","290","4400","0",
						"5","10","-1","870","4400","3",
						"10","45","-1","-1","4400","3",
						"45","50","-1","1015","4100","3",
						"50","32767","-1","0","4100","0";
			vbat_para = 
						"-32767","3400","-1","820","0",
						"3400","32767","-1","-1","0";
			segment_para = 
						"-32767","4150","2900","4208","50",
						"4150","4450","2030","4400","0";
			batt_brand = "DESAYLGA";
			fcc_temp = <2842 2816 2818 2820 2842 2769>;
			fcc_sf_x = <0 100 200 300 400 500 600 700 800 1000 1500>;
			fcc_sf_y = <100 96 94 92 90 88 87 84 81 75 50>;
			fcc_sf_cols = <11>;
			pc_sf_rows = <1>;
			pc_sf_cols = <1>;
			pc_sf_row_entries = <0>;
			pc_sf_percent = <100>;
			pc_sf_sf = <100>;
			rbatt_sf_rows = <28>;
			rbatt_sf_cols = <6>;
			rbatt_sf_percent = <100 95 90 85 80 75 70 65 60 55 50 45 40 35 30 25 20 15 10 9 8 7 6 5 4 3 2 1>;
			rbatt_sf_sf = <
			               2678 1899 1098 162 91 77
			               2678 1899 1098 162 91 77
			               2494 1789 1088 164 92 79
			               2428 1737 1053 166 95 82
			               2200 1715 1050 172 100 84
			               2118 1620 1034 175 104 87
			               2054 1472 929 185 112 91
			               2050 1411 910 196 119 97
			               2082 1377 856 189 123 87
			               2130 1392 820 153 90 79
			               2196 1429 839 150 91 79
			               2274 1481 884 157 97 83
			               2368 1547 947 161 105 88
			               2462 1624 1023 169 108 89
			               2576 1715 1109 170 101 85
			               2719 1792 1191 162 97 80
			               2886 1871 1280 163 95 79
			               3097 1975 1400 162 89 78
			               3455 2159 1585 190 102 81
			               5545 2254 1606 193 105 82
			               6192 2986 1510 183 103 84
			               6502 3164 1606 179 99 80
			               6730 3338 1709 179 100 76
			               7005 3382 1751 177 101 86
			               7202 3446 1694 195 106 88
			               7472 3561 1650 246 116 125
			               7899 3909 1659 268 127 217
			               8610 4232 1904 221 192 256
			              >;
			pc_temp_ocv_rows = <29>;
			pc_temp_ocv_cols = <6>;
			pc_temp_ocv_percent = <100 95 90 85 80 75 70 65 60 55 50 45 40 35 30 25 20 15 10 9 8 7 6 5 4 3 2 1>;
			pc_temp_ocv_ocv = <
			                   4364 4353 4352 4349 4344 4318
			                   4252 4256 4268 4289 4289 4265
			                   4174 4186 4203 4234 4235 4213
			                   4118 4137 4145 4181 4182 4161
			                   4016 4092 4103 4130 4130 4111
			                   3957 4031 4054 4080 4080 4064
			                   3905 3962 3983 4035 4034 4020
			                   3873 3909 3938 3984 3989 3978
			                   3852 3867 3889 3937 3940 3926
			                   3837 3842 3847 3888 3889 3884
			                   3822 3825 3824 3856 3858 3855
			                   3809 3813 3810 3832 3834 3830
			                   3793 3801 3800 3811 3813 3810
			                   3778 3787 3790 3793 3794 3789
			                   3761 3773 3778 3777 3773 3762
			                   3746 3752 3757 3758 3751 3736
			                   3729 3728 3733 3735 3727 3708
			                   3709 3709 3711 3697 3685 3680
			                   3676 3692 3689 3686 3680 3664
			                   3669 3688 3685 3685 3678 3662
			                   3657 3683 3679 3683 3675 3660
			                   3643 3675 3673 3678 3670 3653
			                   3623 3662 3664 3668 3653 3631
			                   3597 3637 3648 3640 3619 3598
			                   3560 3597 3617 3599 3575 3556
			                   3510 3542 3565 3548 3520 3505
			                   3443 3472 3493 3481 3448 3441
			                   3349 3374 3391 3381 3349 3349
			                   3200 3200 3200 3200 3200 3200
			                  >;
		};
};
