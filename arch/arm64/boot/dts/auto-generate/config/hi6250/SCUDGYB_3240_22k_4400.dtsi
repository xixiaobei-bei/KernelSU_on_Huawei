/* DO NOT EDIT - Automatically generated by python */
/ {
		SCUDGYB_3240_22k_4400:SCUDGYB_3240_22k_4400 {
			fcc = <3240>;
			default_rbatt_mohm = <100>;
			identify_type = "id_volt";
			id_identify_min = <751>;
			id_identify_max = <1235>;
			id_voltage_min = <939>;
			id_voltage_max = <1059>;
			vbat_max = <4400>;
			temp_para = 
						"-32767","0","-1","0","4100","0",
						"0","5","-1","324","4400","0",
						"5","10","-1","972","4400","3",
						"10","45","-1","-1","4400","3",
						"45","50","-1","1134","4100","3",
						"50","32767","-1","0","4100","0";
			vbat_para = 
						"-32767","3400","-1","820","0",
						"3400","32767","-1","-1","0";
			segment_para = 
						"-32767","4150","3240","4208","50",
						"4150","4450","2268","4400","0";
			batt_brand = "SCUDGYB";
			fcc_temp = <3241 3239 3248 3243 3239 3224>;
			fcc_sf_x = <0 100 200 300 400 500 600 700 800 1000 1500>;
			fcc_sf_y = <100 96 94 92 90 88 87 84 81 75 50>;
			fcc_sf_cols = <11>;
			pc_sf_rows = <1>;
			pc_sf_cols = <1>;
			pc_sf_row_entries = <0>;
			pc_sf_percent = <100>;
			pc_sf_sf = <100>;
			rbatt_sf_rows = <28>;
			rbatt_sf_cols = <6>;
			rbatt_sf_percent = <100 95 90 85 80 75 70 65 60 55 50 45 40 35 30 25 20 15 10 9 8 7 6 5 4 3 2 1>;
			rbatt_sf_sf = <
			               2559 1812 575 189 124 103
			               2559 1812 575 189 124 103
			               2345 1678 562 188 123 103
			               2216 1568 546 186 121 103
			               2128 1509 540 183 122 104
			               2037 1429 554 185 123 104
			               1952 1369 542 194 126 106
			               1921 1329 515 203 132 109
			               1903 1314 497 217 148 118
			               1895 1299 478 176 124 105
			               1923 1312 470 164 117 102
			               1967 1356 473 163 118 102
			               2033 1415 487 166 118 103
			               2114 1486 508 172 123 106
			               2206 1569 541 171 125 108
			               2309 1651 590 169 117 102
			               2431 1736 646 172 117 102
			               2575 1844 731 185 120 103
			               2885 2001 822 205 123 104
			               5126 2498 725 193 124 107
			               5627 2779 759 183 123 108
			               6040 3108 806 186 124 108
			               6472 3381 875 188 126 107
			               6934 3724 958 192 122 105
			               7460 4075 985 193 122 105
			               8016 4453 1071 207 127 105
			               8685 4942 1261 230 131 108
			               9760 5693 1511 376 142 111
			              >;
			pc_temp_ocv_rows = <29>;
			pc_temp_ocv_cols = <6>;
			pc_temp_ocv_percent = <100 95 90 85 80 75 70 65 60 55 50 45 40 35 30 25 20 15 10 9 8 7 6 5 4 3 2 1>;
			pc_temp_ocv_ocv = <
			                   4385 4382 4382 4371 4365 4359
			                   4267 4272 4299 4304 4302 4297
			                   4188 4197 4237 4247 4244 4240
			                   4128 4131 4178 4190 4187 4183
			                   4072 4080 4125 4135 4133 4129
			                   4011 4020 4077 4083 4081 4077
			                   3951 3967 4020 4035 4033 4030
			                   3906 3919 3967 3989 3988 3985
			                   3870 3879 3920 3945 3946 3944
			                   3841 3846 3878 3890 3891 3890
			                   3821 3822 3844 3854 3856 3855
			                   3805 3807 3818 3828 3830 3829
			                   3790 3794 3799 3808 3810 3809
			                   3776 3781 3786 3791 3793 3791
			                   3760 3767 3774 3774 3775 3771
			                   3742 3750 3761 3756 3750 3740
			                   3723 3729 3742 3736 3729 3717
			                   3697 3709 3716 3708 3703 3691
			                   3664 3686 3691 3683 3679 3670
			                   3656 3679 3686 3682 3678 3667
			                   3647 3669 3682 3680 3677 3665
			                   3632 3659 3678 3676 3674 3662
			                   3615 3644 3670 3666 3667 3654
			                   3593 3623 3655 3640 3645 3629
			                   3564 3592 3621 3596 3604 3590
			                   3523 3545 3569 3539 3550 3539
			                   3465 3477 3501 3462 3481 3471
			                   3375 3380 3404 3353 3380 3373
			                   3200 3200 3200 3200 3200 3200
			                  >;
			vol_dec1=  <50>;
			pc_temp_ocv_ocv1 = <
			                   4335 4332 4332 4321 4315 4309
			                   4235 4239 4264 4263 4258 4253
			                   4165 4170 4205 4208 4203 4199
			                   4108 4112 4151 4155 4151 4146
			                   4052 4058 4102 4104 4100 4096
			                   3992 4002 4051 4056 4052 4049
			                   3938 3951 3998 4011 4008 4005
			                   3896 3907 3949 3968 3967 3964
			                   3863 3870 3905 3920 3919 3918
			                   3836 3840 3867 3875 3875 3874
			                   3818 3819 3836 3845 3846 3845
			                   3802 3804 3813 3821 3823 3822
			                   3788 3792 3796 3803 3805 3803
			                   3773 3779 3783 3786 3788 3786
			                   3758 3764 3772 3770 3769 3765
			                   3740 3748 3759 3753 3746 3735
			                   3721 3727 3739 3732 3725 3714
			                   3695 3707 3714 3705 3701 3688
			                   3663 3684 3689 3682 3679 3668
			                   3655 3677 3685 3681 3678 3667
			                   3644 3667 3681 3679 3676 3665
			                   3630 3657 3676 3674 3672 3661
			                   3612 3641 3668 3661 3662 3651
			                   3590 3620 3651 3632 3636 3623
			                   3560 3588 3616 3587 3595 3583
			                   3519 3541 3564 3530 3543 3532
			                   3462 3473 3496 3455 3473 3465
			                   3372 3376 3400 3347 3374 3368
			                   3200 3200 3200 3200 3200 3200
			                  >;
			vol_dec2=  <200>;
			pc_temp_ocv_ocv2 = <
			                   4185 4182 4182 4171 4165 4159
			                   4144 4143 4163 4140 4131 4126
			                   4098 4099 4116 4098 4088 4083
			                   4045 4047 4074 4056 4047 4042
			                   3989 3995 4024 4016 4009 4004
			                   3939 3949 3977 3978 3972 3968
			                   3899 3907 3934 3939 3934 3931
			                   3867 3873 3896 3892 3888 3886
			                   3840 3843 3863 3861 3859 3858
			                   3822 3822 3835 3837 3837 3836
			                   3807 3808 3814 3818 3818 3817
			                   3794 3796 3798 3801 3802 3801
			                   3780 3784 3786 3787 3788 3786
			                   3767 3772 3776 3773 3772 3768
			                   3751 3758 3765 3758 3751 3741
			                   3734 3741 3750 3741 3734 3722
			                   3714 3722 3730 3720 3713 3701
			                   3689 3703 3707 3696 3692 3681
			                   3658 3680 3686 3681 3677 3666
			                   3649 3671 3682 3679 3675 3664
			                   3637 3662 3678 3674 3672 3661
			                   3622 3650 3672 3665 3665 3652
			                   3604 3633 3662 3644 3646 3631
			                   3581 3609 3638 3608 3613 3599
			                   3550 3576 3599 3563 3570 3559
			                   3509 3527 3547 3507 3518 3510
			                   3452 3461 3482 3432 3451 3446
			                   3362 3365 3388 3330 3354 3354
			                   3200 3200 3200 3200 3200 3200
			                  >;
		};
};
