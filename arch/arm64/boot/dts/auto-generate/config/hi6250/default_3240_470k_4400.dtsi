/* DO NOT EDIT - Automatically generated by python */
/ {
		default_3240_470k_4400:default_3240_470k_4400 {
			fcc = <3240>;
			default_rbatt_mohm = <100>;
			identify_type = "id_volt";
			id_identify_min = <3312>;
			id_identify_max = <3767>;
			id_voltage_min = <3407>;
			id_voltage_max = <3696>;
			vbat_max = <4400>;
			temp_para = 
						"-32767","0","-1","0","4100","0",
						"0","5","-1","324","4400","0",
						"5","10","-1","972","4400","3",
						"10","45","-1","-1","4400","3",
						"45","50","-1","1134","4100","3",
						"50","32767","-1","0","4100","0";
			vbat_para = 
						"-32767","3400","-1","820","0",
						"3400","32767","-1","-1","0";
			segment_para = 
						"-32767","4150","3240","4208","50",
						"4150","4450","2268","4400","0";
			batt_brand = "default";
			fcc_temp = <3384 3387 3383 3400 3383 3374>;
			fcc_sf_x = <0 100 200 300 400 500 600 700 800 1000 1500>;
			fcc_sf_y = <100 96 94 92 90 88 87 84 81 75 50>;
			fcc_sf_cols = <11>;
			pc_sf_rows = <1>;
			pc_sf_cols = <1>;
			pc_sf_row_entries = <0>;
			pc_sf_percent = <100>;
			pc_sf_sf = <100>;
			rbatt_sf_rows = <28>;
			rbatt_sf_cols = <6>;
			rbatt_sf_percent = <100 95 90 85 80 75 70 65 60 55 50 45 40 35 30 25 20 15 10 9 8 7 6 5 4 3 2 1>;
			rbatt_sf_sf = <
			               2323 1412 671 150 110 96
			               2316 1411 670 150 110 96
			               2146 1380 660 148 110 97
			               2010 1335 646 149 111 97
			               1923 1307 642 152 113 99
			               1817 1280 664 157 115 100
			               1683 1169 626 169 121 103
			               1665 1140 600 182 130 108
			               1643 1125 585 180 139 114
			               1647 1115 572 150 125 108
			               1684 1142 575 139 109 97
			               1722 1206 597 140 109 97
			               1766 1271 640 144 112 99
			               1817 1344 698 147 116 102
			               1882 1428 764 148 115 101
			               1968 1518 842 146 110 97
			               2084 1617 934 146 110 98
			               2250 1741 1065 152 111 99
			               3860 2144 1005 145 109 99
			               4137 2344 1109 146 110 99
			               4429 2585 1237 148 112 102
			               4752 2839 1380 150 114 104
			               5140 3156 1557 154 115 103
			               5645 3537 1785 156 114 100
			               6343 4013 2058 179 113 101
			               7243 4707 2503 273 135 134
			               8373 5476 3042 302 176 124
			               12170 6795 3938 346 159 113
			              >;
			pc_temp_ocv_rows = <29>;
			pc_temp_ocv_cols = <6>;
			pc_temp_ocv_percent = <100 95 90 85 80 75 70 65 60 55 50 45 40 35 30 25 20 15 10 9 8 7 6 5 4 3 2 1>;
			pc_temp_ocv_ocv = <
			                   4381 4379 4376 4369 4361 4356
			                   4270 4283 4289 4301 4294 4291
			                   4198 4214 4225 4241 4235 4232
			                   4139 4153 4166 4183 4177 4174
			                   4088 4100 4110 4127 4121 4119
			                   4026 4048 4062 4074 4068 4067
			                   3951 3973 3998 4024 4020 4019
			                   3908 3925 3944 3977 3975 3975
			                   3870 3884 3899 3931 3933 3932
			                   3839 3847 3860 3881 3885 3885
			                   3820 3821 3829 3847 3847 3847
			                   3804 3805 3806 3822 3823 3822
			                   3789 3792 3792 3803 3803 3802
			                   3774 3780 3781 3786 3788 3786
			                   3759 3768 3772 3773 3772 3766
			                   3744 3751 3760 3758 3753 3742
			                   3727 3731 3741 3740 3734 3721
			                   3707 3712 3713 3711 3708 3695
			                   3683 3689 3684 3689 3684 3672
			                   3676 3683 3681 3688 3683 3671
			                   3667 3680 3678 3686 3681 3670
			                   3655 3673 3674 3683 3679 3668
			                   3639 3663 3667 3677 3675 3663
			                   3617 3645 3653 3656 3662 3646
			                   3590 3616 3623 3616 3627 3608
			                   3553 3577 3579 3566 3578 3559
			                   3484 3514 3514 3497 3514 3493
			                   3381 3403 3407 3392 3417 3392
			                   3200 3200 3200 3200 3200 3200
			                  >;
		};
};
