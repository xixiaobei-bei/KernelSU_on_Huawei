/* DO NOT EDIT - Automatically generated by python */
/ {
		SWDSONY_2850_110k_4400:SWDSONY_2850_110k_4400 {
			fcc = <2850>;
			default_rbatt_mohm = <100>;
			identify_type = "id_volt";
			id_identify_min = <2281>;
			id_identify_max = <2786>;
			id_voltage_min = <2426>;
			id_voltage_max = <2631>;
			vbat_max = <4400>;
			temp_para = 
						"-32767","0","-1","0","4100","0",
						"0","5","-1","285","4400","0",
						"5","10","-1","855","4400","3",
						"10","45","-1","-1","4400","3",
						"45","50","-1","997","4100","3",
						"50","32767","-1","0","4100","0";
			vbat_para = 
						"-32767","3400","-1","820","0",
						"3400","32767","-1","-1","0";
			segment_para = 
						"-32767","4150","2850","4208","50",
						"4150","4450","1995","4400","0";
			batt_brand = "SWDSONY";
			fcc_temp = <2842 2849 2861 2900 2880 2866>;
			fcc_sf_x = <0 100 200 300 400 500 600 700 800 1000 1500>;
			fcc_sf_y = <100 96 94 92 90 88 87 84 81 75 50>;
			fcc_sf_cols = <11>;
			pc_sf_rows = <1>;
			pc_sf_cols = <1>;
			pc_sf_row_entries = <0>;
			pc_sf_percent = <100>;
			pc_sf_sf = <100>;
			rbatt_sf_rows = <28>;
			rbatt_sf_cols = <6>;
			rbatt_sf_percent = <100 95 90 85 80 75 70 65 60 55 50 45 40 35 30 25 20 15 10 9 8 7 6 5 4 3 2 1>;
			rbatt_sf_sf = <
			               1594 763 446 147 110 95
			               1594 763 446 147 110 95
			               1627 781 458 151 112 97
			               1615 791 470 156 115 97
			               1638 789 482 164 118 100
			               1638 813 509 171 123 103
			               1573 786 500 181 128 105
			               1595 791 479 190 136 110
			               1594 794 471 176 139 113
			               1612 799 470 152 115 98
			               1644 812 470 151 112 96
			               1694 836 479 155 113 98
			               1752 874 500 162 117 99
			               1829 926 532 167 123 103
			               1936 976 570 167 123 101
			               2068 1060 625 162 116 98
			               2295 1139 672 163 118 100
			               2704 1315 772 165 117 101
			               4082 1826 858 168 120 102
			               5015 1759 801 170 119 102
			               6036 1969 840 170 118 100
			               7029 2262 923 177 121 105
			               8640 2679 1044 178 122 102
			               10777 3304 1239 178 120 101
			               14022 4292 1440 190 124 104
			               21293 6019 1797 289 133 107
			               35487 10258 2493 548 203 137
			               51074 21922 4051 677 314 293
			              >;
			pc_temp_ocv_rows = <29>;
			pc_temp_ocv_cols = <6>;
			pc_temp_ocv_percent = <100 95 90 85 80 75 70 65 60 55 50 45 40 35 30 25 20 15 10 9 8 7 6 5 4 3 2 1>;
			pc_temp_ocv_ocv = <
			                   4359 4357 4354 4349 4341 4335
			                   4273 4281 4285 4285 4278 4273
			                   4205 4218 4223 4225 4219 4214
			                   4137 4158 4164 4167 4162 4157
			                   4082 4098 4108 4112 4107 4103
			                   4031 4047 4058 4060 4056 4053
			                   3963 3987 4003 4011 4009 4006
			                   3917 3939 3950 3965 3965 3963
			                   3872 3896 3904 3917 3920 3919
			                   3837 3858 3866 3873 3874 3872
			                   3808 3825 3833 3843 3844 3842
			                   3785 3800 3806 3820 3820 3818
			                   3762 3780 3786 3801 3801 3798
			                   3742 3764 3771 3783 3785 3782
			                   3727 3747 3757 3766 3767 3759
			                   3708 3733 3744 3746 3742 3729
			                   3689 3708 3719 3724 3721 3708
			                   3664 3673 3685 3694 3693 3681
			                   3624 3640 3645 3666 3663 3652
			                   3613 3632 3639 3661 3659 3648
			                   3600 3622 3632 3655 3654 3643
			                   3580 3611 3623 3646 3646 3636
			                   3562 3596 3610 3632 3634 3622
			                   3541 3576 3593 3600 3608 3591
			                   3514 3545 3559 3554 3566 3549
			                   3467 3493 3506 3500 3513 3496
			                   3400 3418 3437 3440 3447 3428
			                   3320 3328 3358 3356 3357 3342
			                   3200 3200 3200 3200 3200 3200
			                  >;
			vol_dec1=  <50>;
			pc_temp_ocv_ocv1 = <
			                   4309 4307 4304 4299 4291 4285
			                   4235 4242 4243 4240 4234 4228
			                   4169 4182 4185 4184 4178 4173
			                   4110 4124 4129 4130 4125 4120
			                   4059 4071 4079 4079 4075 4070
			                   4002 4017 4028 4031 4028 4024
			                   3945 3965 3976 3986 3985 3982
			                   3901 3920 3928 3940 3942 3940
			                   3860 3881 3888 3895 3898 3896
			                   3828 3846 3853 3860 3861 3859
			                   3802 3817 3823 3834 3834 3832
			                   3779 3794 3799 3813 3813 3811
			                   3758 3776 3782 3795 3796 3793
			                   3739 3760 3768 3779 3780 3776
			                   3723 3744 3754 3762 3760 3752
			                   3705 3729 3739 3742 3738 3725
			                   3686 3704 3714 3720 3717 3704
			                   3661 3670 3680 3690 3689 3678
			                   3620 3638 3643 3664 3662 3651
			                   3609 3629 3637 3659 3657 3647
			                   3595 3619 3630 3652 3652 3641
			                   3577 3608 3621 3643 3644 3633
			                   3559 3593 3608 3625 3629 3617
			                   3538 3572 3589 3591 3600 3584
			                   3509 3539 3553 3546 3558 3542
			                   3462 3487 3500 3493 3505 3489
			                   3395 3412 3432 3434 3441 3423
			                   3316 3325 3355 3351 3353 3339
			                   3200 3200 3200 3200 3200 3200
			                  >;
			vol_dec2=  <200>;
			pc_temp_ocv_ocv2 = <
			                   4159 4157 4154 4149 4141 4135
			                   4126 4120 4119 4114 4107 4101
			                   4078 4079 4078 4069 4064 4058
			                   4033 4032 4033 4028 4024 4019
			                   3974 3982 3986 3988 3986 3982
			                   3930 3940 3942 3948 3949 3945
			                   3890 3902 3903 3908 3911 3907
			                   3855 3869 3871 3872 3873 3870
			                   3826 3839 3842 3846 3846 3844
			                   3802 3814 3817 3825 3826 3823
			                   3781 3793 3797 3809 3809 3806
			                   3761 3777 3782 3793 3794 3791
			                   3744 3763 3769 3779 3781 3776
			                   3730 3748 3757 3764 3764 3756
			                   3714 3737 3746 3747 3743 3730
			                   3697 3717 3727 3730 3726 3713
			                   3677 3690 3700 3707 3705 3691
			                   3650 3660 3666 3677 3677 3666
			                   3611 3629 3636 3657 3656 3645
			                   3599 3620 3630 3651 3651 3640
			                   3582 3610 3622 3643 3644 3633
			                   3566 3598 3610 3629 3632 3620
			                   3548 3581 3595 3602 3610 3593
			                   3527 3559 3570 3564 3576 3558
			                   3494 3522 3531 3520 3535 3516
			                   3446 3467 3479 3473 3484 3464
			                   3381 3394 3416 3416 3423 3402
			                   3306 3316 3346 3335 3340 3322
			                   3200 3200 3200 3200 3200 3200
			                  >;
		};
};
