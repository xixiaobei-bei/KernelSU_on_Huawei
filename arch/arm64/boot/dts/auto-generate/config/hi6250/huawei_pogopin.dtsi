

  /{

	huawei_pogopin_charger: huawei_pogopin_charger{
		compatible = "huawei,pogopin";
		usb_switch_gpio = <&gpio27 1 0>;	/*gpio217*/
		power_switch_gpio = <&gpio22 1 0>;	/*gpio177*/
		switch_power_gpio = <&gpio26 0 0>;	/*gpio208*/
		typec_int_gpio = <&gpio29 0 0>;		/*gpio219-232*/
		pogopin_int_gpio =<&gpio29 1 0>;	/*gpio220-233*/
		buck_boost_gpio = <&gpio26 7 0>; 	/*gpio215*/
		status = "disable";
	};

	pogopin_otg_by_id {
		compatible = "huawei,pogopin-otg-by-id";
		otg_adc_channel = <7>;
		otg-gpio = <&gpio27 0 0>;
		sampling_time_optimize = <0>;
		status = "disable";
	};

  };
