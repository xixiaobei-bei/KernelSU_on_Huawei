/* DO NOT EDIT - Automatically generated by python */
/ {
		SCUDATL_2900_39k_4400:SCUDATL_2900_39k_4400 {
			fcc = <2900>;
			default_rbatt_mohm = <100>;
			identify_type = "id_volt";
			id_identify_min = <1235>;
			id_identify_max = <1759>;
			id_voltage_min = <1420>;
			id_voltage_max = <1562>;
			vbat_max = <4400>;
			temp_para = 
						"-32767","0","-1","0","4100","0",
						"0","5","-1","290","4400","0",
						"5","10","-1","870","4400","3",
						"10","45","-1","-1","4400","3",
						"45","50","-1","1015","4100","3",
						"50","32767","-1","0","4100","0";
			vbat_para = 
						"-32767","3400","-1","820","0",
						"3400","32767","-1","-1","0";
			segment_para = 
						"-32767","4150","2900","4208","50",
						"4150","4450","2030","4400","0";
			batt_brand = "SCUDATL";
			fcc_temp = <2823 2818 2816 2831 2824 2797>;
			fcc_sf_x = <0 100 200 300 400 500 600 700 800 1000 1500>;
			fcc_sf_y = <100 96 94 92 90 88 87 84 81 75 50>;
			fcc_sf_cols = <11>;
			pc_sf_rows = <1>;
			pc_sf_cols = <1>;
			pc_sf_row_entries = <0>;
			pc_sf_percent = <100>;
			pc_sf_sf = <100>;
			rbatt_sf_rows = <28>;
			rbatt_sf_cols = <6>;
			rbatt_sf_percent = <100 95 90 85 80 75 70 65 60 55 50 45 40 35 30 25 20 15 10 9 8 7 6 5 4 3 2 1>;
			rbatt_sf_sf = <
			               2443 1393 682 143 110 94
			               2443 1393 682 143 110 94
			               2384 1379 687 145 112 96
			               2282 1349 680 149 114 98
			               2161 1339 692 155 118 101
			               1973 1283 690 164 123 104
			               1910 1146 650 174 130 107
			               1888 1088 618 189 140 114
			               1855 1066 575 164 132 107
			               1853 1058 557 141 114 98
			               1895 1068 554 136 109 96
			               1947 1114 566 140 113 98
			               2015 1184 602 145 118 102
			               2104 1278 653 151 125 106
			               2204 1392 716 150 119 102
			               2340 1526 792 141 111 96
			               2541 1687 885 140 111 96
			               2789 1874 1019 141 111 95
			               3109 2102 1271 152 118 100
			               3185 2154 1340 155 121 103
			               3260 2206 1410 159 125 107
			               3701 2185 1376 157 122 110
			               4441 2105 1090 150 116 104
			               5015 2392 1216 143 114 98
			               5622 2666 1304 146 127 101
			               6258 2924 1489 152 193 133
			               7023 3246 1636 158 212 170
			               8509 3412 1419 206 120 149
			              >;
			pc_temp_ocv_rows = <29>;
			pc_temp_ocv_cols = <6>;
			pc_temp_ocv_percent = <100 95 90 85 80 75 70 65 60 55 50 45 40 35 30 25 20 15 10 9 8 7 6 5 4 3 2 1>;
			pc_temp_ocv_ocv = <
			                   4357 4351 4352 4346 4343 4332
			                   4262 4273 4283 4287 4285 4276
			                   4193 4209 4225 4230 4228 4221
			                   4141 4154 4168 4175 4173 4166
			                   4083 4107 4120 4121 4119 4114
			                   3996 4047 4070 4072 4070 4064
			                   3942 3973 4006 4021 4021 4018
			                   3903 3924 3954 3976 3979 3975
			                   3864 3884 3905 3925 3929 3926
			                   3835 3849 3865 3882 3884 3883
			                   3817 3821 3834 3851 3852 3852
			                   3802 3804 3811 3827 3828 3827
			                   3789 3792 3797 3807 3809 3807
			                   3777 3782 3788 3791 3792 3790
			                   3763 3770 3778 3774 3772 3765
			                   3748 3755 3766 3756 3749 3737
			                   3732 3736 3745 3737 3729 3715
			                   3715 3716 3717 3710 3703 3690
			                   3686 3694 3693 3690 3684 3669
			                   3678 3689 3690 3688 3682 3667
			                   3670 3685 3686 3686 3680 3665
			                   3661 3678 3682 3683 3677 3663
			                   3646 3665 3674 3676 3669 3655
			                   3625 3645 3659 3654 3649 3631
			                   3596 3612 3626 3615 3613 3593
			                   3555 3566 3579 3561 3566 3545
			                   3492 3506 3514 3489 3503 3483
			                   3395 3400 3396 3381 3402 3388
			                   3200 3200 3200 3200 3200 3200
			                  >;
		};
};
