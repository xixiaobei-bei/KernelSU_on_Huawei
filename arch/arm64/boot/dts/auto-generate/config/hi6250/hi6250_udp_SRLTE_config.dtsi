
/**
 * Copyright (C) 2014 Hisilicon Ltd.
 *
 *  This program is free software; you can redistribute it and/or modify
 *  it under the terms of the GNU General Public License version 2 as
 *  publishhed by the Free Software Foundation.
 */

/include/ "hi6250_udp_default_config.dtsi"
/ {
	hisi,boardid = <4 0 9 7>;
	hisi,boardname = "hi6250_udp_SRLTE";
	hisi,product_id = <0x3BF5FC97>;
};
