/* DO NOT EDIT - Automatically generated by python */
/ {
		desaysony_3400_110k_4400:desaysony_3400_110k_4400 {
			fcc = <3400>;
			default_rbatt_mohm = <100>;
			id_identify_min = <2281>;
			id_identify_max = <2786>;
			id_voltage_min = <2426>;
			id_voltage_max = <2631>;
			vbat_max = <4400>;
			temp_para = 
						"-32767","0","-1","0","4100","0",
						"0","5","-1","340","4400","0",
						"5","10","-1","1020","4400","3",
						"10","45","-1","-1","4400","3",
						"45","50","-1","1190","4100","3",
						"50","32767","-1","0","4100","0";
			vbat_para = 
						"-32767","3400","-1","820","0",
						"3400","32767","-1","-1","0";
			segment_para = 
						"-32767","4150","3400","4208","50",
						"4150","4450","2380","4400","0";
			batt_brand = "desaysony";
			fcc_temp = <3462 3467 3490 3545 3522 3493>;
			fcc_sf_x = <0 100 200 300 400 500>;
			fcc_sf_y = <100 96 94 92 90 88>;
			fcc_sf_cols = <6>;
			pc_sf_rows = <1>;
			pc_sf_cols = <1>;
			pc_sf_row_entries = <0>;
			pc_sf_percent = <100>;
			pc_sf_sf = <100>;
			rbatt_sf_rows = <28>;
			rbatt_sf_cols = <6>;
			rbatt_sf_percent = <100 95 90 85 80 75 70 65 60 55 50 45 40 35 30 25 20 15 10 9 8 7 6 5 4 3 2 1>;
			rbatt_sf_sf = <
			               1291 629 342 137 107 95
			               1291 629 343 137 107 95
			               1307 655 358 140 108 96
			               1309 666 369 146 110 97
			               1321 660 383 151 114 99
			               1343 688 395 161 118 101
			               1275 638 401 173 125 104
			               1295 617 368 182 133 110
			               1315 633 352 171 134 113
			               1330 640 345 148 116 101
			               1346 653 351 140 108 97
			               1386 681 358 142 110 97
			               1457 717 369 147 113 99
			               1543 760 387 151 118 102
			               1683 814 411 153 117 102
			               1849 892 447 149 111 98
			               2073 1000 488 147 111 99
			               2388 1212 553 166 111 98
			               3001 1518 548 148 110 98
			               3103 1700 577 147 112 98
			               3228 1930 623 151 113 99
			               3512 2210 686 155 116 100
			               3876 2569 764 156 114 99
			               4385 3126 886 159 112 99
			               5656 3901 1051 172 117 101
			               7859 5234 1360 232 131 105
			               16246 7801 2056 310 132 160
			               38614 16968 3024 311 263 179
			              >;
			pc_temp_ocv_rows = <29>;
			pc_temp_ocv_cols = <6>;
			pc_temp_ocv_percent = <100 95 90 85 80 75 70 65 60 55 50 45 40 35 30 25 20 15 10 9 8 7 6 5 4 3 2 1>;
			pc_temp_ocv_ocv = <
			                   4386 4384 4381 4374 4367 4360
			                   4297 4307 4311 4311 4306 4300
			                   4222 4245 4251 4253 4248 4243
			                   4156 4186 4192 4195 4190 4187
			                   4097 4123 4136 4138 4135 4131
			                   4049 4076 4081 4085 4082 4079
			                   3976 4010 4029 4035 4033 4031
			                   3926 3952 3969 3986 3987 3986
			                   3883 3909 3920 3936 3939 3940
			                   3846 3868 3879 3890 3892 3891
			                   3811 3834 3846 3855 3857 3857
			                   3782 3808 3818 3829 3831 3831
			                   3760 3788 3796 3808 3810 3810
			                   3739 3772 3779 3789 3793 3791
			                   3723 3755 3765 3772 3772 3767
			                   3704 3738 3751 3752 3747 3737
			                   3685 3712 3728 3729 3724 3712
			                   3664 3677 3691 3704 3694 3684
			                   3641 3643 3656 3673 3669 3659
			                   3634 3635 3650 3669 3666 3656
			                   3624 3627 3644 3664 3662 3652
			                   3613 3618 3637 3657 3655 3646
			                   3598 3604 3626 3645 3643 3633
			                   3580 3585 3608 3620 3615 3604
			                   3549 3554 3575 3578 3572 3561
			                   3499 3506 3522 3525 3516 3507
			                   3430 3437 3460 3460 3445 3441
			                   3329 3348 3356 3364 3354 3350
			                   3200 3200 3200 3200 3200 3200
			                  >;
			vol_dec1=  <16>;
			pc_temp_ocv_ocv1 = <
			                   4370 4368 4365 4358 4351 4344
			                   4284 4295 4298 4297 4291 4286
			                   4211 4234 4238 4239 4234 4229
			                   4147 4174 4181 4182 4178 4174
			                   4091 4116 4125 4127 4124 4120
			                   4039 4066 4073 4075 4072 4069
			                   3970 4001 4020 4026 4025 4022
			                   3921 3946 3962 3978 3979 3978
			                   3879 3904 3915 3928 3931 3931
			                   3842 3864 3875 3884 3886 3886
			                   3808 3831 3843 3851 3853 3853
			                   3780 3806 3816 3826 3829 3828
			                   3758 3787 3794 3806 3808 3808
			                   3738 3771 3778 3787 3791 3789
			                   3722 3755 3764 3770 3770 3764
			                   3703 3737 3750 3750 3746 3735
			                   3684 3710 3727 3728 3723 3711
			                   3664 3676 3690 3703 3693 3682
			                   3641 3642 3655 3672 3669 3659
			                   3634 3634 3650 3668 3666 3656
			                   3624 3626 3644 3663 3661 3651
			                   3612 3617 3636 3656 3655 3645
			                   3597 3603 3625 3644 3642 3631
			                   3579 3584 3607 3618 3613 3601
			                   3548 3553 3573 3576 3569 3558
			                   3498 3504 3520 3523 3514 3504
			                   3429 3436 3458 3458 3443 3439
			                   3328 3347 3355 3362 3353 3348
			                   3200 3200 3200 3200 3200 3200
			                  >;
			vol_dec2=  <48>;
			pc_temp_ocv_ocv2 = <
			                   4338 4336 4333 4326 4319 4312
			                   4258 4270 4272 4269 4262 4256
			                   4190 4212 4215 4213 4207 4202
			                   4129 4152 4159 4158 4153 4148
			                   4078 4101 4106 4105 4101 4097
			                   4019 4045 4056 4056 4053 4049
			                   3957 3984 4000 4009 4007 4005
			                   3911 3934 3947 3961 3963 3963
			                   3872 3894 3903 3913 3915 3914
			                   3835 3856 3867 3873 3875 3875
			                   3802 3825 3837 3844 3846 3846
			                   3776 3802 3811 3821 3823 3823
			                   3755 3784 3791 3802 3804 3803
			                   3736 3768 3776 3784 3788 3786
			                   3720 3753 3763 3768 3766 3759
			                   3701 3735 3748 3747 3742 3732
			                   3683 3707 3724 3726 3721 3709
			                   3662 3673 3687 3700 3690 3680
			                   3640 3641 3654 3671 3668 3658
			                   3632 3633 3648 3667 3665 3655
			                   3622 3625 3643 3662 3660 3650
			                   3611 3615 3635 3654 3653 3643
			                   3596 3601 3623 3640 3639 3627
			                   3577 3582 3604 3613 3608 3596
			                   3545 3549 3568 3571 3564 3553
			                   3495 3500 3516 3519 3509 3499
			                   3426 3433 3455 3454 3438 3435
			                   3325 3345 3352 3359 3349 3345
			                   3200 3200 3200 3200 3200 3200
			                  >;
			vol_dec3=  <192>;
			pc_temp_ocv_ocv3 = <
			                   4194 4192 4189 4182 4175 4168
			                   4153 4157 4153 4143 4135 4127
			                   4101 4112 4111 4097 4090 4083
			                   4060 4068 4066 4054 4048 4042
			                   3994 4010 4018 4013 4009 4004
			                   3945 3958 3967 3971 3969 3967
			                   3904 3919 3924 3929 3928 3926
			                   3869 3883 3887 3890 3890 3887
			                   3835 3851 3858 3859 3860 3859
			                   3805 3824 3832 3836 3837 3836
			                   3780 3803 3809 3817 3818 3817
			                   3761 3786 3792 3800 3802 3801
			                   3742 3772 3778 3785 3788 3786
			                   3728 3758 3765 3770 3769 3763
			                   3710 3743 3754 3753 3748 3738
			                   3693 3724 3738 3734 3729 3717
			                   3676 3695 3711 3714 3707 3696
			                   3657 3664 3673 3685 3678 3667
			                   3634 3633 3648 3666 3664 3654
			                   3624 3626 3643 3661 3659 3650
			                   3614 3617 3636 3655 3653 3643
			                   3602 3605 3626 3644 3641 3630
			                   3587 3591 3612 3624 3617 3605
			                   3565 3568 3588 3589 3582 3570
			                   3530 3532 3548 3547 3538 3527
			                   3479 3482 3498 3499 3485 3477
			                   3412 3418 3437 3435 3418 3415
			                   3315 3331 3338 3346 3334 3330
			                   3200 3200 3200 3200 3200 3200
			                  >;
		};
};
