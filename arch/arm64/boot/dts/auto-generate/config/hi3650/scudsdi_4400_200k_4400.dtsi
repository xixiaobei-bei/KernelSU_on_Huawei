/* DO NOT EDIT - Automatically generated by python */
/ {
		scudsdi_4400_200k_4400:scudsdi_4400_200k_4400 {
			fcc = <4400>;
			default_rbatt_mohm = <100>;
			id_identify_min = <2786>;
			id_identify_max = <3312>;
			id_voltage_min = <2941>;
			id_voltage_max = <3167>;
			vbat_max = <4400>;
			temp_para = 
						"-32767","0","-1","0","4100","0",
						"0","5","-1","440","4400","0",
						"5","10","-1","1320","4400","3",
						"10","45","-1","-1","4400","3",
						"45","50","-1","1540","4100","3",
						"50","32767","-1","0","4100","0";
			vbat_para = 
						"-32767","3400","-1","820","0",
						"3400","32767","-1","-1","0";
			segment_para = 
						"-32767","4150","4400","4208","50",
						"4150","4450","3080","4400","0";
			batt_brand = "scudsdi";
			fcc_temp = <4577 4574 4574 4589 4568 4543>;
			fcc_sf_x = <0 100 200 300 400 500>;
			fcc_sf_y = <100 96 94 92 90 88>;
			fcc_sf_cols = <6>;
			pc_sf_rows = <1>;
			pc_sf_cols = <1>;
			pc_sf_row_entries = <0>;
			pc_sf_percent = <100>;
			pc_sf_sf = <100>;
			rbatt_sf_rows = <28>;
			rbatt_sf_cols = <6>;
			rbatt_sf_percent = <100 95 90 85 80 75 70 65 60 55 50 45 40 35 30 25 20 15 10 9 8 7 6 5 4 3 2 1>;
			rbatt_sf_sf = <
			               1670 1032 451 122 95 86
			               1665 1031 451 122 95 86
			               1524 997 458 123 95 86
			               1403 958 458 124 96 87
			               1333 900 461 128 97 87
			               1280 865 480 136 100 88
			               1149 757 452 146 105 89
			               1163 735 401 149 108 93
			               1154 737 405 151 112 96
			               1150 731 392 128 103 93
			               1200 727 387 119 94 86
			               1268 744 386 119 93 86
			               1339 801 400 121 95 87
			               1409 872 442 124 97 89
			               1475 947 493 124 97 88
			               1540 1017 546 123 94 86
			               1612 1094 599 123 95 88
			               1723 1195 675 126 96 88
			               2563 1164 561 121 95 87
			               2706 1238 584 123 95 88
			               2874 1328 620 128 96 91
			               3076 1416 682 124 97 91
			               3277 1551 754 128 99 91
			               3474 1624 813 128 97 89
			               3738 1791 858 127 97 88
			               4020 1941 919 132 97 90
			               4464 2200 1010 139 101 92
			               5332 2567 1226 207 122 93
			              >;
			pc_temp_ocv_rows = <29>;
			pc_temp_ocv_cols = <6>;
			pc_temp_ocv_percent = <100 95 90 85 80 75 70 65 60 55 50 45 40 35 30 25 20 15 10 9 8 7 6 5 4 3 2 1>;
			pc_temp_ocv_ocv = <
			                   4390 4387 4385 4374 4365 4358
			                   4275 4288 4297 4306 4300 4295
			                   4206 4219 4235 4247 4241 4237
			                   4144 4162 4178 4190 4184 4180
			                   4092 4102 4124 4135 4129 4125
			                   4039 4051 4074 4084 4077 4073
			                   3944 3969 4007 4036 4030 4025
			                   3906 3923 3940 3974 3978 3981
			                   3862 3891 3907 3937 3938 3937
			                   3820 3856 3871 3888 3889 3890
			                   3799 3821 3840 3852 3851 3851
			                   3785 3792 3812 3826 3826 3825
			                   3774 3777 3791 3806 3806 3804
			                   3763 3765 3779 3789 3789 3787
			                   3752 3755 3769 3774 3772 3766
			                   3740 3745 3756 3758 3752 3741
			                   3726 3733 3738 3740 3732 3719
			                   3710 3720 3717 3712 3706 3692
			                   3682 3699 3696 3689 3682 3669
			                   3674 3694 3692 3688 3680 3668
			                   3664 3688 3688 3687 3679 3667
			                   3652 3681 3684 3684 3677 3664
			                   3638 3671 3678 3678 3673 3660
			                   3617 3652 3663 3662 3661 3645
			                   3588 3624 3638 3623 3627 3610
			                   3545 3579 3596 3566 3574 3560
			                   3484 3516 3531 3488 3504 3492
			                   3392 3413 3431 3365 3398 3390
			                   3200 3200 3200 3200 3200 3200
			                  >;
			vol_dec1=  <16>;
			pc_temp_ocv_ocv1 = <
			                   4374 4371 4369 4358 4349 4342
			                   4266 4277 4286 4293 4286 4281
			                   4198 4211 4225 4235 4228 4224
			                   4138 4153 4169 4179 4172 4168
			                   4088 4097 4117 4125 4118 4114
			                   4027 4040 4066 4077 4069 4064
			                   3941 3964 3996 4023 4019 4017
			                   3902 3920 3936 3970 3972 3974
			                   3858 3887 3903 3930 3931 3930
			                   3818 3853 3868 3882 3883 3884
			                   3798 3818 3838 3848 3848 3847
			                   3785 3791 3810 3824 3823 3822
			                   3773 3776 3789 3804 3804 3802
			                   3762 3765 3779 3788 3788 3786
			                   3752 3754 3768 3773 3770 3764
			                   3740 3744 3756 3757 3750 3739
			                   3726 3732 3737 3739 3731 3718
			                   3710 3720 3717 3711 3705 3691
			                   3681 3699 3696 3689 3682 3669
			                   3673 3693 3692 3688 3680 3668
			                   3663 3687 3688 3686 3679 3666
			                   3652 3680 3683 3684 3677 3664
			                   3637 3670 3677 3678 3672 3659
			                   3616 3651 3663 3661 3660 3644
			                   3587 3623 3637 3621 3625 3608
			                   3544 3578 3594 3564 3572 3557
			                   3483 3514 3529 3485 3502 3490
			                   3391 3412 3430 3363 3396 3389
			                   3200 3200 3200 3200 3200 3200
			                  >;
			vol_dec2=  <48>;
			pc_temp_ocv_ocv2 = <
			                   4342 4339 4337 4326 4317 4310
			                   4248 4256 4265 4267 4258 4253
			                   4183 4195 4207 4211 4203 4198
			                   4125 4136 4152 4157 4149 4144
			                   4080 4086 4104 4104 4097 4093
			                   4004 4019 4049 4064 4053 4045
			                   3933 3952 3976 3999 3999 4001
			                   3895 3913 3929 3962 3962 3960
			                   3850 3881 3894 3914 3915 3915
			                   3814 3847 3862 3872 3871 3871
			                   3796 3812 3833 3842 3841 3840
			                   3783 3788 3806 3819 3819 3817
			                   3772 3774 3787 3801 3800 3798
			                   3761 3763 3778 3785 3785 3783
			                   3751 3753 3767 3771 3767 3760
			                   3739 3743 3755 3755 3748 3736
			                   3725 3732 3736 3737 3729 3716
			                   3709 3719 3716 3709 3703 3689
			                   3680 3698 3695 3689 3681 3669
			                   3672 3693 3691 3688 3680 3667
			                   3662 3686 3687 3686 3678 3666
			                   3650 3679 3683 3683 3676 3663
			                   3636 3669 3676 3676 3671 3658
			                   3614 3649 3661 3657 3656 3640
			                   3585 3620 3634 3616 3620 3604
			                   3541 3575 3591 3559 3568 3553
			                   3481 3511 3526 3481 3497 3485
			                   3389 3409 3427 3359 3393 3386
			                   3200 3200 3200 3200 3200 3200
			                  >;
			vol_dec3=  <192>;
			pc_temp_ocv_ocv3 = <
			                   4198 4195 4193 4182 4173 4166
			                   4163 4171 4175 4150 4139 4130
			                   4118 4116 4127 4107 4093 4086
			                   4077 4076 4085 4070 4055 4044
			                   4004 4002 4029 4018 4008 4005
			                   3935 3947 3957 3972 3971 3969
			                   3900 3912 3924 3940 3935 3931
			                   3859 3882 3892 3895 3893 3891
			                   3820 3851 3862 3861 3858 3856
			                   3800 3818 3835 3837 3834 3832
			                   3788 3793 3810 3818 3815 3813
			                   3777 3778 3791 3802 3800 3797
			                   3767 3768 3780 3788 3786 3783
			                   3756 3758 3772 3774 3771 3765
			                   3747 3749 3761 3761 3754 3743
			                   3735 3739 3748 3746 3737 3723
			                   3721 3728 3729 3726 3718 3705
			                   3706 3716 3711 3698 3691 3677
			                   3675 3694 3692 3688 3680 3667
			                   3667 3689 3688 3686 3678 3666
			                   3656 3682 3684 3684 3676 3664
			                   3644 3674 3679 3679 3673 3659
			                   3628 3660 3669 3667 3663 3648
			                   3606 3639 3650 3637 3637 3621
			                   3575 3608 3621 3594 3597 3582
			                   3531 3562 3576 3538 3545 3532
			                   3471 3498 3511 3461 3477 3466
			                   3380 3397 3414 3342 3378 3370
			                   3200 3200 3200 3200 3200 3200
			                  >;
		};
};
