/* DO NOT EDIT - Automatically generated by python */
/ {
		scudatl_3600_22k_4400:scudatl_3600_22k_4400 {
			fcc = <3600>;
			default_rbatt_mohm = <100>;
			id_identify_min = <751>;
			id_identify_max = <1235>;
			id_voltage_min = <949>;
			id_voltage_max = <1051>;
			vbat_max = <4400>;
			temp_para = 
						"-32767","0","-1","0","4100","0",
						"0","5","-1","360","4400","0",
						"5","10","-1","1080","4400","3",
						"10","45","-1","-1","4400","3",
						"45","50","-1","1260","4100","3",
						"50","32767","-1","0","4100","0";
			vbat_para = 
						"-32767","3400","-1","820","0",
						"3400","32767","-1","-1","0";
			segment_para = 
						"-32767","4150","3600","4208","50",
						"4150","4450","2520","4400","0";
			batt_brand = "scudatl";
			fcc_temp = <3647 3647 3646 3669 3648 3631>;
			fcc_sf_x = <0 100 200 300 400 500>;
			fcc_sf_y = <100 96 94 92 90 88>;
			fcc_sf_cols = <6>;
			pc_sf_rows = <1>;
			pc_sf_cols = <1>;
			pc_sf_row_entries = <0>;
			pc_sf_percent = <100>;
			pc_sf_sf = <100>;
			rbatt_sf_rows = <28>;
			rbatt_sf_cols = <6>;
			rbatt_sf_percent = <100 95 90 85 80 75 70 65 60 55 50 45 40 35 30 25 20 15 10 9 8 7 6 5 4 3 2 1>;
			rbatt_sf_sf = <
			               1732 774 351 117 96 89
			               1730 774 351 117 96 89
			               1600 768 350 119 97 90
			               1481 755 353 122 100 91
			               1423 745 359 126 102 93
			               1398 774 377 132 105 95
			               1231 740 403 142 111 98
			               1221 666 355 154 119 103
			               1218 676 335 157 128 111
			               1190 668 324 123 105 95
			               1208 657 322 116 96 91
			               1256 678 319 117 98 91
			               1307 730 323 121 101 94
			               1366 793 337 125 107 97
			               1436 868 367 126 107 99
			               1527 960 404 121 98 92
			               1642 1082 444 117 97 91
			               1805 1268 508 117 98 91
			               2110 1069 458 119 99 94
			               2449 1167 453 120 99 93
			               2767 1288 479 121 100 95
			               3154 1474 518 121 102 95
			               3524 1671 573 122 102 95
			               4060 1914 635 118 100 92
			               4651 2269 675 122 99 93
			               5450 2685 759 129 102 95
			               6613 3455 937 135 105 95
			               8835 4863 1471 270 119 107
			              >;
			pc_temp_ocv_rows = <29>;
			pc_temp_ocv_cols = <6>;
			pc_temp_ocv_percent = <100 95 90 85 80 75 70 65 60 55 50 45 40 35 30 25 20 15 10 9 8 7 6 5 4 3 2 1>;
			pc_temp_ocv_ocv = <
			                   4389 4386 4383 4376 4371 4364
			                   4306 4315 4318 4317 4312 4306
			                   4236 4254 4258 4258 4254 4248
			                   4170 4194 4200 4200 4196 4191
			                   4119 4135 4144 4143 4140 4135
			                   4078 4089 4093 4089 4086 4082
			                   3979 4023 4040 4040 4037 4032
			                   3932 3948 3967 3988 3989 3987
			                   3895 3913 3924 3942 3946 3944
			                   3852 3875 3885 3889 3891 3889
			                   3822 3837 3852 3855 3856 3854
			                   3805 3811 3823 3830 3830 3829
			                   3790 3796 3801 3809 3810 3808
			                   3776 3785 3787 3792 3793 3790
			                   3762 3773 3778 3776 3776 3772
			                   3749 3759 3768 3759 3754 3742
			                   3737 3739 3750 3738 3732 3720
			                   3725 3718 3724 3712 3707 3695
			                   3703 3701 3698 3690 3683 3672
			                   3696 3696 3694 3689 3682 3671
			                   3687 3691 3692 3687 3681 3670
			                   3678 3686 3689 3684 3679 3667
			                   3662 3677 3684 3676 3674 3662
			                   3641 3659 3671 3650 3659 3642
			                   3609 3628 3639 3605 3625 3603
			                   3560 3576 3586 3546 3574 3551
			                   3493 3505 3513 3466 3507 3482
			                   3394 3403 3408 3345 3408 3382
			                   3200 3200 3200 3200 3200 3200
			                  >;
			vol_dec1=  <16>;
			pc_temp_ocv_ocv1 = <
			                   4373 4370 4367 4360 4355 4348
			                   4293 4302 4304 4302 4297 4291
			                   4225 4242 4245 4244 4240 4234
			                   4162 4182 4188 4187 4183 4177
			                   4113 4127 4134 4131 4128 4123
			                   4063 4078 4084 4079 4076 4071
			                   3972 4010 4027 4030 4028 4023
			                   3928 3943 3960 3981 3982 3980
			                   3890 3908 3918 3933 3936 3935
			                   3848 3870 3880 3884 3886 3884
			                   3820 3834 3848 3851 3852 3851
			                   3804 3809 3821 3827 3828 3826
			                   3789 3795 3800 3807 3808 3806
			                   3775 3784 3786 3790 3792 3789
			                   3761 3773 3777 3775 3774 3770
			                   3748 3758 3767 3758 3752 3741
			                   3736 3738 3748 3737 3731 3719
			                   3725 3717 3723 3711 3706 3694
			                   3703 3700 3697 3690 3683 3672
			                   3695 3695 3694 3689 3682 3671
			                   3686 3690 3692 3687 3681 3670
			                   3677 3685 3689 3684 3679 3667
			                   3661 3676 3683 3676 3674 3661
			                   3640 3658 3669 3648 3657 3640
			                   3607 3626 3636 3603 3622 3601
			                   3559 3574 3583 3544 3571 3549
			                   3491 3503 3510 3464 3504 3480
			                   3393 3401 3406 3344 3407 3380
			                   3200 3200 3200 3200 3200 3200
			                  >;
			vol_dec2=  <48>;
			pc_temp_ocv_ocv2 = <
			                   4341 4338 4335 4328 4323 4316
			                   4268 4276 4276 4272 4267 4261
			                   4202 4217 4220 4216 4211 4205
			                   4145 4159 4165 4161 4157 4151
			                   4102 4111 4114 4108 4104 4099
			                   4033 4055 4065 4059 4056 4051
			                   3960 3985 4002 4010 4009 4006
			                   3919 3932 3947 3965 3967 3964
			                   3880 3898 3907 3915 3917 3915
			                   3842 3861 3871 3873 3875 3873
			                   3817 3828 3841 3844 3845 3844
			                   3801 3806 3816 3822 3823 3821
			                   3787 3793 3797 3803 3804 3802
			                   3773 3782 3784 3787 3789 3786
			                   3759 3771 3776 3772 3770 3764
			                   3747 3756 3765 3756 3749 3738
			                   3736 3736 3746 3734 3729 3716
			                   3724 3716 3720 3708 3704 3692
			                   3701 3699 3696 3690 3683 3672
			                   3693 3694 3694 3688 3682 3671
			                   3685 3690 3691 3686 3680 3669
			                   3675 3684 3688 3682 3678 3666
			                   3659 3674 3682 3673 3672 3659
			                   3637 3655 3666 3643 3653 3635
			                   3604 3621 3631 3597 3617 3595
			                   3555 3570 3579 3538 3567 3544
			                   3488 3499 3506 3458 3500 3475
			                   3391 3399 3403 3340 3403 3376
			                   3200 3200 3200 3200 3200 3200
			                  >;
			vol_dec3=  <192>;
			pc_temp_ocv_ocv3 = <
			                   4197 4194 4191 4184 4179 4172
			                   4161 4154 4154 4140 4133 4126
			                   4116 4115 4112 4093 4088 4082
			                   4082 4069 4069 4052 4047 4040
			                   3992 4009 4015 4009 4006 4002
			                   3944 3947 3959 3970 3969 3966
			                   3910 3917 3922 3928 3928 3925
			                   3873 3884 3888 3886 3886 3883
			                   3840 3851 3860 3857 3857 3855
			                   3817 3824 3834 3834 3835 3833
			                   3803 3806 3813 3816 3817 3815
			                   3790 3794 3796 3801 3802 3799
			                   3777 3784 3785 3787 3788 3785
			                   3764 3774 3778 3774 3773 3767
			                   3753 3763 3770 3760 3754 3742
			                   3742 3746 3756 3743 3736 3724
			                   3732 3727 3735 3722 3717 3703
			                   3720 3712 3711 3697 3693 3682
			                   3694 3694 3693 3688 3682 3670
			                   3686 3690 3691 3686 3680 3669
			                   3679 3685 3688 3682 3678 3666
			                   3666 3678 3684 3675 3673 3660
			                   3650 3663 3674 3651 3660 3642
			                   3625 3642 3650 3615 3632 3610
			                   3589 3602 3611 3568 3594 3569
			                   3540 3551 3557 3508 3544 3518
			                   3473 3480 3486 3429 3480 3452
			                   3380 3386 3388 3322 3388 3359
			                   3200 3200 3200 3200 3200 3200
			                  >;
		};
};
