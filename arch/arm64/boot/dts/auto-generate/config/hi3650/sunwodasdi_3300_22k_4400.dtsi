/* DO NOT EDIT - Automatically generated by python */
/ {
		sunwodasdi_3300_22k_4400:sunwodasdi_3300_22k_4400 {
			fcc = <3300>;
			default_rbatt_mohm = <100>;
			id_identify_min = <751>;
			id_identify_max = <1235>;
			id_voltage_min = <949>;
			id_voltage_max = <1051>;
			vbat_max = <4400>;
			temp_para = 
						"-32767","0","-1","0","4100","0",
						"0","5","-1","330","4400","0",
						"5","10","-1","990","4400","3",
						"10","45","-1","-1","4400","3",
						"45","50","-1","1155","4100","3",
						"50","32767","-1","0","4100","0";
			vbat_para = 
						"-32767","3400","-1","820","0",
						"3400","32767","-1","-1","0";
			segment_para = 
						"-32767","4150","3300","4208","50",
						"4150","4450","2310","4400","0";
			batt_brand = "sunwodasdi";
			fcc_temp = <3381 3385 3374 3449 3373 3359>;
			fcc_sf_x = <0 100 200 300 400 500>;
			fcc_sf_y = <100 96 94 92 90 88>;
			fcc_sf_cols = <6>;
			pc_sf_rows = <1>;
			pc_sf_cols = <1>;
			pc_sf_row_entries = <0>;
			pc_sf_percent = <100>;
			pc_sf_sf = <100>;
			rbatt_sf_rows = <28>;
			rbatt_sf_cols = <6>;
			rbatt_sf_percent = <100 95 90 85 80 75 70 65 60 55 50 45 40 35 30 25 20 15 10 9 8 7 6 5 4 3 2 1>;
			rbatt_sf_sf = <
			               2012 1536 778 192 136 118
			               2010 1535 778 192 136 118
			               1907 1461 776 192 137 120
			               1796 1380 768 194 139 121
			               1739 1302 763 199 142 122
			               1702 1278 801 211 146 125
			               1520 1078 709 227 152 128
			               1535 1055 650 224 163 133
			               1529 1060 647 218 169 140
			               1517 1042 617 189 149 133
			               1566 1043 607 178 134 119
			               1626 1108 614 178 135 120
			               1692 1182 669 181 138 123
			               1772 1260 743 184 142 126
			               1852 1333 807 184 143 129
			               1951 1402 798 185 138 120
			               2072 1478 843 186 134 119
			               2229 1594 1010 189 135 120
			               3260 1566 895 180 138 122
			               3440 1658 937 180 138 123
			               3585 1788 995 183 135 126
			               3770 1912 1060 186 139 127
			               3991 2042 1134 189 141 127
			               4232 2174 1224 189 136 124
			               4418 2299 1287 191 137 124
			               4760 2444 1333 197 140 125
			               5131 2776 1453 214 147 128
			               5677 3211 1656 406 167 135
			              >;
			pc_temp_ocv_rows = <29>;
			pc_temp_ocv_cols = <6>;
			pc_temp_ocv_percent = <100 95 90 85 80 75 70 65 60 55 50 45 40 35 30 25 20 15 10 9 8 7 6 5 4 3 2 1>;
			pc_temp_ocv_ocv = <
			                   4382 4378 4373 4377 4354 4350
			                   4270 4279 4285 4311 4290 4288
			                   4204 4215 4223 4252 4232 4231
			                   4143 4159 4168 4195 4176 4175
			                   4095 4105 4114 4140 4122 4121
			                   4047 4066 4076 4089 4070 4070
			                   3947 3968 4000 4041 4022 4023
			                   3909 3922 3938 3973 3975 3979
			                   3870 3889 3903 3936 3937 3938
			                   3833 3852 3866 3891 3887 3890
			                   3813 3820 3834 3855 3850 3851
			                   3798 3805 3807 3829 3825 3825
			                   3781 3793 3794 3807 3805 3805
			                   3766 3779 3783 3789 3788 3787
			                   3752 3763 3772 3773 3772 3770
			                   3739 3748 3759 3760 3754 3744
			                   3726 3732 3742 3742 3733 3721
			                   3708 3718 3718 3713 3707 3696
			                   3686 3702 3697 3690 3682 3671
			                   3678 3696 3694 3689 3681 3670
			                   3667 3691 3691 3687 3680 3669
			                   3654 3683 3687 3685 3678 3667
			                   3639 3672 3680 3681 3674 3663
			                   3621 3655 3668 3668 3662 3651
			                   3591 3626 3643 3630 3628 3619
			                   3553 3580 3597 3574 3576 3569
			                   3495 3518 3528 3495 3503 3502
			                   3396 3416 3422 3377 3394 3400
			                   3200 3200 3200 3200 3200 3200
			                  >;
			vol_dec1=  <16>;
			pc_temp_ocv_ocv1 = <
			                   4366 4362 4357 4361 4338 4334
			                   4261 4270 4274 4298 4276 4274
			                   4196 4207 4214 4240 4219 4218
			                   4137 4151 4160 4184 4165 4163
			                   4090 4101 4109 4130 4112 4111
			                   4035 4053 4066 4082 4061 4061
			                   3944 3962 3992 4027 4013 4015
			                   3905 3919 3934 3968 3969 3972
			                   3866 3885 3899 3929 3929 3930
			                   3831 3849 3862 3886 3882 3884
			                   3812 3819 3832 3852 3847 3848
			                   3797 3804 3806 3826 3823 3823
			                   3780 3792 3793 3805 3803 3803
			                   3765 3778 3782 3787 3786 3786
			                   3751 3763 3772 3772 3771 3768
			                   3739 3747 3759 3759 3753 3742
			                   3726 3732 3742 3741 3732 3720
			                   3708 3717 3717 3711 3706 3695
			                   3685 3702 3697 3690 3682 3671
			                   3677 3696 3694 3689 3681 3670
			                   3666 3690 3691 3687 3680 3669
			                   3653 3683 3687 3685 3678 3667
			                   3638 3672 3680 3681 3674 3663
			                   3620 3654 3667 3667 3661 3649
			                   3590 3624 3642 3628 3626 3617
			                   3552 3579 3596 3571 3573 3567
			                   3494 3517 3527 3493 3501 3499
			                   3395 3415 3421 3376 3392 3398
			                   3200 3200 3200 3200 3200 3200
			                  >;
			vol_dec2=  <48>;
			pc_temp_ocv_ocv2 = <
			                   4334 4330 4325 4329 4306 4302
			                   4243 4250 4253 4271 4248 4246
			                   4181 4191 4196 4215 4194 4192
			                   4125 4136 4142 4161 4142 4139
			                   4081 4093 4099 4108 4091 4089
			                   4013 4028 4045 4068 4043 4042
			                   3936 3952 3975 4000 3997 3999
			                   3898 3912 3926 3958 3958 3959
			                   3860 3878 3890 3915 3914 3915
			                   3828 3842 3856 3875 3872 3872
			                   3810 3816 3826 3845 3841 3841
			                   3795 3802 3804 3821 3818 3818
			                   3778 3790 3791 3801 3800 3799
			                   3764 3777 3781 3784 3784 3783
			                   3750 3761 3770 3770 3768 3763
			                   3738 3746 3758 3757 3751 3740
			                   3725 3730 3740 3740 3730 3718
			                   3707 3717 3716 3709 3703 3692
			                   3684 3701 3696 3690 3682 3671
			                   3676 3695 3693 3688 3681 3670
			                   3665 3689 3690 3687 3680 3669
			                   3651 3682 3686 3685 3677 3666
			                   3637 3670 3679 3680 3673 3661
			                   3619 3651 3666 3665 3658 3646
			                   3589 3621 3640 3624 3621 3612
			                   3550 3576 3593 3566 3569 3562
			                   3492 3514 3524 3488 3496 3495
			                   3393 3412 3419 3372 3387 3395
			                   3200 3200 3200 3200 3200 3200
			                  >;
			vol_dec3=  <192>;
			pc_temp_ocv_ocv3 = <
			                   4190 4186 4181 4185 4162 4158
			                   4158 4165 4166 4153 4129 4122
			                   4117 4118 4115 4108 4086 4079
			                   4077 4085 4085 4072 4043 4038
			                   4008 4009 4020 4016 4003 4000
			                   3937 3946 3960 3968 3966 3965
			                   3901 3910 3920 3935 3932 3928
			                   3866 3879 3888 3896 3890 3888
			                   3832 3846 3857 3863 3856 3854
			                   3814 3819 3829 3838 3833 3832
			                   3800 3806 3806 3818 3815 3813
			                   3784 3794 3794 3801 3799 3797
			                   3771 3783 3784 3786 3785 3783
			                   3757 3769 3775 3773 3771 3767
			                   3745 3754 3764 3761 3756 3745
			                   3734 3740 3752 3748 3739 3726
			                   3721 3726 3732 3727 3719 3706
			                   3702 3714 3710 3698 3692 3681
			                   3679 3696 3694 3688 3681 3670
			                   3670 3692 3691 3687 3680 3668
			                   3658 3685 3688 3685 3678 3666
			                   3645 3676 3682 3681 3674 3662
			                   3630 3662 3673 3670 3664 3652
			                   3609 3641 3656 3642 3639 3629
			                   3579 3608 3626 3598 3598 3590
			                   3539 3563 3579 3541 3546 3541
			                   3480 3501 3511 3462 3475 3475
			                   3383 3399 3409 3352 3368 3378
			                   3200 3200 3200 3200 3200 3200
			                  >;
		};
};
