/* DO NOT EDIT - Automatically generated by python */
/ {
		sunwodaatl_4000_200k_4400:sunwodaatl_4000_200k_4400 {
			fcc = <4000>;
			default_rbatt_mohm = <100>;
			id_identify_min = <2786>;
			id_identify_max = <3312>;
			id_voltage_min = <2941>;
			id_voltage_max = <3167>;
			vbat_max = <4400>;
			temp_para = 
						"-32767","0","-1","0","4100","0",
						"0","5","-1","400","4400","0",
						"5","10","-1","1200","4400","3",
						"10","45","-1","-1","4400","3",
						"45","50","-1","1400","4100","3",
						"50","32767","-1","0","4100","0";
			vbat_para = 
						"-32767","3400","-1","820","0",
						"3400","32767","-1","-1","0";
			segment_para = 
						"-32767","4150","4000","4208","50",
						"4150","4450","2800","4400","0";
			batt_brand = "sunwodaatl";
			fcc_temp = <4009 4007 4009 4027 4014 3979>;
			fcc_sf_x = <0 100 200 300 400 500>;
			fcc_sf_y = <100 96 94 92 90 88>;
			fcc_sf_cols = <6>;
			pc_sf_rows = <1>;
			pc_sf_cols = <1>;
			pc_sf_row_entries = <0>;
			pc_sf_percent = <100>;
			pc_sf_sf = <100>;
			rbatt_sf_rows = <28>;
			rbatt_sf_cols = <6>;
			rbatt_sf_percent = <100 95 90 85 80 75 70 65 60 55 50 45 40 35 30 25 20 15 10 9 8 7 6 5 4 3 2 1>;
			rbatt_sf_sf = <
			               1825 1047 443 125 97 87
			               1821 1046 443 125 97 87
			               1661 1029 444 128 98 87
			               1544 989 440 132 100 88
			               1456 952 442 137 103 90
			               1401 939 447 143 107 92
			               1267 855 451 154 111 95
			               1256 804 393 162 118 100
			               1240 799 391 156 120 102
			               1234 788 376 126 101 90
			               1248 785 373 122 96 88
			               1284 810 376 124 98 88
			               1331 854 384 128 102 91
			               1397 914 406 132 106 94
			               1486 995 442 133 105 94
			               1582 1085 494 128 98 88
			               1689 1178 564 126 98 88
			               1816 1277 649 128 98 87
			               2429 1139 521 122 97 87
			               2593 1217 544 123 97 89
			               2826 1303 569 123 97 91
			               3026 1423 615 127 100 92
			               3244 1554 683 129 100 92
			               3484 1695 747 125 98 90
			               3720 1828 800 129 98 89
			               4084 1979 826 132 99 92
			               4488 2260 956 139 101 92
			               5234 2723 1170 188 112 94
			              >;
			pc_temp_ocv_rows = <29>;
			pc_temp_ocv_cols = <6>;
			pc_temp_ocv_percent = <100 95 90 85 80 75 70 65 60 55 50 45 40 35 30 25 20 15 10 9 8 7 6 5 4 3 2 1>;
			pc_temp_ocv_ocv = <
			                   4390 4386 4384 4375 4369 4362
			                   4287 4300 4309 4313 4309 4302
			                   4212 4231 4246 4254 4251 4244
			                   4152 4169 4187 4196 4193 4187
			                   4096 4112 4133 4139 4137 4132
			                   4043 4064 4080 4085 4083 4079
			                   3959 3993 4027 4036 4033 4030
			                   3918 3935 3957 3985 3987 3984
			                   3878 3895 3916 3939 3940 3939
			                   3844 3858 3876 3887 3889 3887
			                   3820 3827 3843 3853 3854 3853
			                   3804 3808 3817 3828 3828 3827
			                   3789 3795 3797 3807 3808 3806
			                   3774 3782 3784 3789 3790 3788
			                   3761 3770 3773 3773 3772 3767
			                   3748 3755 3761 3756 3749 3738
			                   3732 3737 3743 3737 3729 3716
			                   3714 3717 3719 3710 3704 3691
			                   3689 3694 3692 3688 3681 3670
			                   3680 3688 3688 3687 3680 3668
			                   3673 3682 3684 3685 3678 3667
			                   3664 3676 3679 3682 3675 3664
			                   3651 3667 3672 3675 3670 3658
			                   3633 3652 3658 3654 3653 3639
			                   3603 3624 3630 3613 3615 3601
			                   3562 3577 3582 3558 3563 3551
			                   3498 3509 3514 3484 3495 3484
			                   3402 3410 3414 3372 3393 3386
			                   3200 3200 3200 3200 3200 3200
			                  >;
			vol_dec1=  <16>;
			pc_temp_ocv_ocv1 = <
			                   4374 4370 4368 4359 4353 4346
			                   4276 4288 4297 4298 4294 4288
			                   4204 4221 4235 4240 4237 4231
			                   4145 4160 4177 4183 4180 4174
			                   4090 4106 4124 4128 4125 4120
			                   4032 4054 4072 4076 4073 4069
			                   3955 3985 4015 4026 4025 4021
			                   3914 3931 3952 3978 3980 3977
			                   3874 3891 3911 3930 3932 3930
			                   3841 3855 3872 3882 3883 3882
			                   3819 3825 3840 3850 3850 3850
			                   3803 3806 3815 3825 3826 3825
			                   3788 3794 3795 3805 3806 3804
			                   3773 3782 3783 3788 3789 3787
			                   3761 3770 3772 3772 3770 3765
			                   3747 3754 3760 3755 3748 3737
			                   3731 3736 3742 3736 3728 3715
			                   3714 3716 3718 3709 3703 3690
			                   3689 3694 3692 3688 3681 3669
			                   3680 3688 3688 3687 3679 3668
			                   3672 3682 3684 3685 3678 3666
			                   3664 3676 3679 3681 3675 3663
			                   3651 3666 3671 3673 3669 3656
			                   3632 3651 3657 3652 3651 3636
			                   3602 3622 3629 3611 3613 3599
			                   3561 3575 3580 3556 3561 3548
			                   3497 3508 3512 3482 3493 3482
			                   3401 3408 3412 3371 3392 3384
			                   3200 3200 3200 3200 3200 3200
			                  >;
			vol_dec2=  <48>;
			pc_temp_ocv_ocv2 = <
			                   4342 4338 4336 4327 4321 4314
			                   4253 4264 4271 4269 4264 4258
			                   4187 4200 4212 4213 4209 4203
			                   4129 4141 4157 4159 4154 4149
			                   4079 4093 4105 4106 4102 4097
			                   4011 4034 4057 4058 4053 4049
			                   3946 3969 3992 4007 4008 4004
			                   3905 3921 3941 3964 3965 3962
			                   3867 3883 3900 3912 3913 3912
			                   3837 3847 3864 3871 3872 3871
			                   3816 3820 3834 3843 3843 3842
			                   3801 3804 3810 3820 3820 3819
			                   3786 3792 3793 3801 3802 3800
			                   3772 3780 3781 3785 3786 3784
			                   3760 3768 3771 3770 3766 3759
			                   3746 3753 3758 3753 3745 3734
			                   3730 3734 3740 3734 3726 3713
			                   3713 3715 3716 3707 3700 3688
			                   3687 3693 3691 3688 3680 3669
			                   3678 3687 3687 3686 3679 3668
			                   3671 3681 3683 3684 3677 3666
			                   3662 3675 3678 3680 3674 3663
			                   3649 3665 3670 3672 3667 3654
			                   3631 3649 3654 3647 3647 3632
			                   3600 3620 3625 3606 3607 3593
			                   3558 3572 3576 3551 3556 3544
			                   3494 3505 3508 3477 3488 3477
			                   3399 3405 3408 3367 3388 3381
			                   3200 3200 3200 3200 3200 3200
			                  >;
			vol_dec3=  <192>;
			pc_temp_ocv_ocv3 = <
			                   4198 4194 4192 4183 4177 4170
			                   4163 4163 4160 4144 4136 4129
			                   4114 4113 4117 4097 4091 4084
			                   4070 4073 4071 4056 4048 4043
			                   3999 4008 4023 4011 4009 4004
			                   3943 3952 3961 3972 3971 3967
			                   3906 3913 3925 3930 3928 3925
			                   3870 3878 3888 3888 3886 3884
			                   3841 3846 3857 3858 3856 3855
			                   3820 3822 3832 3835 3834 3832
			                   3805 3806 3810 3816 3815 3814
			                   3792 3795 3794 3800 3800 3798
			                   3777 3784 3784 3786 3786 3784
			                   3766 3773 3774 3772 3769 3763
			                   3754 3761 3764 3758 3751 3739
			                   3741 3745 3751 3741 3733 3721
			                   3726 3728 3733 3722 3715 3703
			                   3709 3710 3708 3696 3689 3677
			                   3681 3688 3687 3686 3679 3667
			                   3674 3682 3684 3684 3677 3666
			                   3666 3677 3679 3680 3674 3663
			                   3656 3669 3673 3674 3669 3656
			                   3642 3657 3662 3656 3654 3640
			                   3620 3637 3641 3624 3624 3610
			                   3589 3604 3607 3582 3584 3571
			                   3545 3555 3557 3528 3533 3522
			                   3482 3489 3490 3457 3467 3458
			                   3388 3392 3394 3352 3371 3365
			                   3200 3200 3200 3200 3200 3200
			                  >;
		};
};
