/* DO NOT EDIT - Automatically generated by python */
/ {
		scudatl_2900_39k_4400:scudatl_2900_39k_4400 {
			fcc = <2900>;
			default_rbatt_mohm = <100>;
			id_identify_min = <1235>;
			id_identify_max = <1759>;
			id_voltage_min = <1420>;
			id_voltage_max = <1562>;
			vbat_max = <4400>;
			temp_para = 
						"-32767","0","-1","0","4100","0",
						"0","5","-1","290","4400","0",
						"5","10","-1","870","4400","3",
						"10","45","-1","-1","4400","3",
						"45","50","-1","1015","4100","3",
						"50","32767","-1","0","4100","0";
			vbat_para = 
						"-32767","3400","-1","820","0",
						"3400","32767","-1","-1","0";
			segment_para = 
						"-32767","4150","2900","4208","50",
						"4150","4450","2030","4400","0";
			batt_brand = "scudatl";
			fcc_temp = <2940 2938 2935 2952 2947 2927>;
			fcc_sf_x = <0 100 200 300 400 500>;
			fcc_sf_y = <100 96 94 92 90 88>;
			fcc_sf_cols = <6>;
			pc_sf_rows = <1>;
			pc_sf_cols = <1>;
			pc_sf_row_entries = <0>;
			pc_sf_percent = <100>;
			pc_sf_sf = <100>;
			rbatt_sf_rows = <28>;
			rbatt_sf_cols = <6>;
			rbatt_sf_percent = <100 95 90 85 80 75 70 65 60 55 50 45 40 35 30 25 20 15 10 9 8 7 6 5 4 3 2 1>;
			rbatt_sf_sf = <
			               2312 1233 550 132 105 95
			               2309 1233 550 132 105 95
			               2110 1214 544 132 106 94
			               1959 1187 545 134 108 96
			               1849 1151 549 138 110 97
			               1804 1173 579 145 114 99
			               1605 1079 587 155 120 102
			               1596 992 512 168 128 107
			               1587 997 499 175 137 113
			               1583 982 481 139 115 99
			               1615 988 478 128 106 95
			               1676 1024 481 129 105 96
			               1754 1109 496 131 109 98
			               1847 1212 549 135 114 102
			               1952 1336 620 136 115 104
			               2068 1471 710 131 105 95
			               2207 1624 827 129 105 94
			               2394 1764 993 131 106 94
			               3061 1415 774 128 107 96
			               3492 1582 828 129 107 97
			               3975 1807 904 131 107 98
			               4444 2051 1012 133 108 100
			               5047 2350 1188 132 109 102
			               5737 2735 1383 134 108 98
			               6563 3190 1588 135 110 98
			               7637 3817 1925 137 112 101
			               9197 4802 2526 144 119 103
			               12257 6435 3589 167 120 105
			              >;
			pc_temp_ocv_rows = <29>;
			pc_temp_ocv_cols = <6>;
			pc_temp_ocv_percent = <100 95 90 85 80 75 70 65 60 55 50 45 40 35 30 25 20 15 10 9 8 7 6 5 4 3 2 1>;
			pc_temp_ocv_ocv = <
			                   4383 4380 4377 4372 4368 4363
			                   4288 4297 4302 4306 4303 4299
			                   4219 4230 4239 4247 4245 4241
			                   4160 4170 4182 4189 4187 4184
			                   4103 4111 4128 4133 4131 4128
			                   4055 4068 4078 4080 4078 4076
			                   3963 3999 4022 4031 4030 4028
			                   3922 3937 3957 3983 3984 3983
			                   3884 3900 3916 3940 3942 3941
			                   3850 3862 3875 3888 3889 3888
			                   3827 3830 3842 3853 3854 3854
			                   3811 3809 3816 3828 3829 3828
			                   3797 3798 3797 3808 3809 3808
			                   3784 3788 3787 3792 3792 3791
			                   3771 3779 3778 3777 3775 3772
			                   3757 3767 3767 3760 3753 3742
			                   3743 3749 3750 3741 3732 3720
			                   3727 3725 3722 3716 3707 3696
			                   3702 3696 3691 3691 3684 3673
			                   3695 3691 3687 3690 3683 3671
			                   3688 3687 3684 3688 3681 3670
			                   3680 3682 3679 3686 3679 3667
			                   3670 3675 3672 3682 3674 3661
			                   3652 3661 3658 3669 3657 3644
			                   3622 3630 3627 3632 3619 3606
			                   3575 3579 3576 3581 3567 3556
			                   3507 3508 3505 3512 3499 3489
			                   3402 3400 3401 3410 3398 3389
			                   3200 3200 3200 3200 3200 3200
			                  >;
			vol_dec1=  <16>;
			pc_temp_ocv_ocv1 = <
			                   4367 4364 4361 4356 4352 4347
			                   4277 4284 4289 4293 4290 4285
			                   4210 4220 4228 4234 4232 4228
			                   4152 4160 4172 4177 4175 4172
			                   4097 4105 4120 4122 4120 4118
			                   4043 4058 4069 4071 4069 4067
			                   3958 3990 4012 4023 4022 4020
			                   3918 3932 3952 3977 3977 3976
			                   3880 3895 3911 3932 3933 3933
			                   3847 3858 3871 3883 3884 3883
			                   3825 3828 3839 3850 3850 3850
			                   3810 3808 3814 3826 3826 3826
			                   3796 3797 3796 3806 3807 3806
			                   3783 3788 3787 3790 3791 3789
			                   3770 3779 3778 3775 3774 3770
			                   3757 3766 3766 3759 3751 3741
			                   3743 3748 3748 3740 3731 3719
			                   3726 3724 3721 3714 3706 3695
			                   3701 3695 3691 3691 3684 3672
			                   3694 3690 3687 3690 3683 3671
			                   3688 3687 3683 3688 3681 3670
			                   3680 3682 3678 3686 3678 3667
			                   3669 3675 3672 3681 3673 3660
			                   3651 3660 3657 3667 3655 3642
			                   3621 3628 3625 3630 3617 3603
			                   3574 3577 3574 3578 3565 3553
			                   3505 3506 3503 3509 3497 3487
			                   3401 3399 3399 3408 3396 3387
			                   3200 3200 3200 3200 3200 3200
			                  >;
			vol_dec2=  <48>;
			pc_temp_ocv_ocv2 = <
			                   4335 4332 4329 4324 4320 4315
			                   4255 4260 4264 4265 4261 4257
			                   4192 4199 4206 4208 4206 4202
			                   4136 4140 4152 4154 4152 4148
			                   4086 4092 4103 4102 4100 4097
			                   4019 4038 4052 4053 4051 4048
			                   3948 3973 3992 4006 4005 4004
			                   3909 3923 3940 3964 3964 3963
			                   3873 3886 3900 3916 3917 3917
			                   3843 3851 3863 3873 3874 3874
			                   3823 3823 3834 3844 3844 3844
			                   3808 3806 3810 3821 3822 3821
			                   3794 3796 3794 3803 3804 3802
			                   3782 3787 3785 3788 3789 3787
			                   3769 3777 3776 3773 3770 3765
			                   3756 3764 3764 3757 3749 3738
			                   3742 3746 3746 3738 3729 3716
			                   3725 3722 3719 3712 3704 3693
			                   3700 3694 3690 3691 3683 3672
			                   3693 3690 3686 3689 3682 3671
			                   3687 3686 3682 3688 3681 3669
			                   3679 3681 3678 3685 3678 3666
			                   3668 3673 3670 3679 3671 3658
			                   3649 3658 3654 3663 3652 3637
			                   3619 3625 3621 3625 3613 3599
			                   3571 3574 3570 3573 3561 3549
			                   3503 3503 3499 3505 3493 3482
			                   3399 3396 3397 3404 3393 3383
			                   3200 3200 3200 3200 3200 3200
			                  >;
			vol_dec3=  <192>;
			pc_temp_ocv_ocv3 = <
			                   4191 4188 4185 4180 4176 4171
			                   4164 4158 4159 4144 4139 4134
			                   4114 4108 4113 4099 4095 4090
			                   4073 4070 4068 4056 4052 4048
			                   3997 4009 4019 4014 4012 4009
			                   3942 3951 3961 3975 3974 3972
			                   3907 3914 3925 3938 3937 3935
			                   3873 3880 3888 3892 3892 3889
			                   3845 3849 3856 3860 3860 3859
			                   3825 3824 3831 3838 3837 3837
			                   3811 3808 3811 3819 3819 3818
			                   3798 3798 3795 3803 3803 3802
			                   3787 3789 3787 3789 3790 3788
			                   3775 3782 3780 3776 3775 3771
			                   3763 3771 3770 3762 3755 3744
			                   3751 3758 3757 3746 3737 3725
			                   3737 3738 3737 3728 3719 3706
			                   3721 3715 3710 3701 3693 3683
			                   3695 3690 3687 3689 3682 3671
			                   3689 3687 3683 3688 3680 3669
			                   3682 3683 3679 3685 3678 3666
			                   3673 3677 3673 3681 3673 3660
			                   3661 3666 3662 3671 3659 3647
			                   3640 3647 3643 3643 3630 3617
			                   3608 3610 3604 3603 3589 3577
			                   3559 3559 3553 3551 3538 3528
			                   3491 3489 3483 3484 3471 3462
			                   3390 3386 3385 3385 3376 3367
			                   3200 3200 3200 3200 3200 3200
			                  >;
		};
};
