/* DO NOT EDIT - Automatically generated by python */
/ {
		scudatl_3400_39k_4400:scudatl_3400_39k_4400 {
			fcc = <3400>;
			default_rbatt_mohm = <100>;
			id_identify_min = <1235>;
			id_identify_max = <1759>;
			id_voltage_min = <1420>;
			id_voltage_max = <1562>;
			vbat_max = <4400>;
			temp_para = 
						"-32767","0","-1","0","4100","0",
						"0","5","-1","340","4400","0",
						"5","10","-1","1020","4400","3",
						"10","45","-1","-1","4400","3",
						"45","50","-1","1190","4100","3",
						"50","32767","-1","0","4100","0";
			vbat_para = 
						"-32767","3400","-1","820","0",
						"3400","32767","-1","-1","0";
			segment_para = 
						"-32767","4150","3400","4208","50",
						"4150","4450","2380","4400","0";
			batt_brand = "scudatl";
			fcc_temp = <3467 3464 3461 3485 3474 3452>;
			fcc_sf_x = <0 100 200 300 400 500>;
			fcc_sf_y = <100 96 94 92 90 88>;
			fcc_sf_cols = <6>;
			pc_sf_rows = <1>;
			pc_sf_cols = <1>;
			pc_sf_row_entries = <0>;
			pc_sf_percent = <100>;
			pc_sf_sf = <100>;
			rbatt_sf_rows = <28>;
			rbatt_sf_cols = <6>;
			rbatt_sf_percent = <100 95 90 85 80 75 70 65 60 55 50 45 40 35 30 25 20 15 10 9 8 7 6 5 4 3 2 1>;
			rbatt_sf_sf = <
			               1939 983 428 113 94 85
			               1936 983 428 113 94 85
			               1751 968 424 114 95 86
			               1617 948 424 117 96 87
			               1512 923 431 120 99 88
			               1489 947 444 125 102 90
			               1321 891 475 134 107 93
			               1309 804 407 146 114 97
			               1310 814 395 150 122 102
			               1307 802 381 119 100 89
			               1325 806 380 111 94 86
			               1365 827 383 112 95 87
			               1422 886 389 115 98 89
			               1493 959 420 119 103 93
			               1574 1050 462 119 103 93
			               1669 1156 518 114 95 87
			               1783 1290 588 113 95 87
			               1936 1427 687 114 95 86
			               2434 1137 554 113 97 88
			               2774 1261 581 114 97 91
			               3158 1417 616 114 97 89
			               3576 1592 674 118 98 91
			               4073 1813 758 117 98 90
			               4662 2092 851 117 97 88
			               5329 2428 951 116 96 90
			               6178 2876 1110 119 99 91
			               7310 3557 1416 128 101 91
			               8996 4696 1978 169 117 109
			              >;
			pc_temp_ocv_rows = <29>;
			pc_temp_ocv_cols = <6>;
			pc_temp_ocv_percent = <100 95 90 85 80 75 70 65 60 55 50 45 40 35 30 25 20 15 10 9 8 7 6 5 4 3 2 1>;
			pc_temp_ocv_ocv = <
			                   4387 4384 4381 4376 4371 4366
			                   4299 4309 4312 4314 4311 4306
			                   4233 4244 4251 4255 4252 4249
			                   4173 4185 4193 4197 4195 4191
			                   4113 4126 4139 4141 4139 4136
			                   4070 4083 4088 4087 4085 4083
			                   3974 4017 4036 4038 4036 4033
			                   3929 3945 3964 3988 3988 3988
			                   3893 3909 3923 3944 3946 3945
			                   3858 3871 3882 3891 3891 3891
			                   3832 3838 3849 3856 3856 3857
			                   3813 3814 3822 3831 3831 3831
			                   3799 3801 3801 3810 3811 3810
			                   3786 3791 3790 3793 3794 3792
			                   3774 3781 3780 3777 3776 3772
			                   3761 3769 3769 3760 3753 3742
			                   3747 3752 3752 3740 3732 3720
			                   3730 3727 3725 3715 3707 3695
			                   3704 3698 3695 3691 3684 3672
			                   3697 3693 3692 3690 3683 3671
			                   3691 3690 3689 3688 3681 3669
			                   3685 3686 3685 3686 3678 3667
			                   3675 3679 3679 3681 3673 3661
			                   3658 3666 3666 3666 3656 3641
			                   3627 3636 3635 3629 3619 3602
			                   3578 3585 3584 3576 3568 3551
			                   3507 3515 3516 3506 3500 3483
			                   3403 3415 3418 3405 3400 3383
			                   3200 3200 3200 3200 3200 3200
			                  >;
			vol_dec1=  <16>;
			pc_temp_ocv_ocv1 = <
			                   4371 4368 4365 4360 4355 4350
			                   4288 4296 4299 4300 4296 4291
			                   4223 4233 4239 4242 4238 4234
			                   4164 4174 4182 4185 4182 4178
			                   4108 4119 4129 4129 4127 4124
			                   4056 4073 4079 4077 4075 4072
			                   3968 4005 4023 4028 4027 4025
			                   3925 3940 3958 3981 3982 3981
			                   3889 3904 3917 3935 3936 3936
			                   3855 3867 3877 3885 3886 3886
			                   3830 3835 3845 3853 3853 3853
			                   3812 3813 3820 3828 3828 3828
			                   3798 3800 3800 3808 3809 3808
			                   3785 3790 3789 3792 3793 3791
			                   3773 3781 3780 3776 3774 3770
			                   3761 3769 3769 3759 3752 3741
			                   3746 3751 3751 3739 3731 3718
			                   3729 3726 3724 3714 3706 3694
			                   3703 3697 3695 3691 3684 3672
			                   3697 3693 3692 3690 3682 3671
			                   3691 3690 3689 3688 3681 3669
			                   3684 3685 3685 3686 3678 3666
			                   3675 3679 3679 3681 3672 3660
			                   3657 3665 3665 3665 3654 3639
			                   3625 3634 3633 3626 3617 3600
			                   3576 3583 3582 3573 3566 3549
			                   3506 3513 3514 3504 3498 3481
			                   3402 3414 3417 3403 3399 3381
			                   3200 3200 3200 3200 3200 3200
			                  >;
			vol_dec2=  <48>;
			pc_temp_ocv_ocv2 = <
			                   4339 4336 4333 4328 4323 4318
			                   4265 4270 4272 4271 4267 4262
			                   4204 4210 4215 4215 4211 4207
			                   4145 4152 4161 4160 4157 4153
			                   4097 4105 4110 4107 4104 4101
			                   4028 4052 4062 4059 4056 4053
			                   3956 3982 3999 4010 4009 4008
			                   3917 3930 3945 3967 3968 3966
			                   3881 3894 3905 3917 3918 3917
			                   3849 3859 3868 3875 3875 3875
			                   3826 3829 3839 3846 3846 3846
			                   3809 3810 3815 3823 3823 3823
			                   3796 3798 3798 3805 3805 3804
			                   3784 3789 3787 3789 3790 3788
			                   3772 3779 3778 3773 3770 3764
			                   3759 3767 3767 3756 3749 3737
			                   3745 3749 3749 3737 3729 3716
			                   3728 3725 3721 3712 3704 3691
			                   3702 3696 3694 3691 3683 3672
			                   3696 3693 3691 3689 3682 3670
			                   3690 3689 3688 3688 3680 3669
			                   3683 3685 3684 3685 3677 3665
			                   3673 3678 3678 3678 3671 3657
			                   3655 3662 3662 3660 3651 3634
			                   3622 3630 3629 3621 3613 3595
			                   3573 3579 3578 3568 3562 3544
			                   3503 3509 3510 3499 3494 3476
			                   3399 3411 3414 3398 3396 3377
			                   3200 3200 3200 3200 3200 3200
			                  >;
			vol_dec3=  <192>;
			pc_temp_ocv_ocv3 = <
			                   4195 4192 4189 4184 4179 4174
			                   4168 4159 4154 4143 4137 4132
			                   4114 4114 4113 4097 4092 4087
			                   4081 4072 4069 4055 4051 4046
			                   3993 4014 4018 4012 4009 4007
			                   3944 3948 3960 3974 3973 3971
			                   3910 3917 3924 3933 3933 3930
			                   3878 3883 3888 3890 3889 3888
			                   3849 3852 3858 3860 3859 3858
			                   3828 3827 3834 3837 3836 3836
			                   3812 3810 3813 3818 3818 3817
			                   3799 3799 3798 3803 3803 3801
			                   3788 3791 3789 3789 3790 3787
			                   3777 3783 3781 3776 3773 3768
			                   3766 3773 3772 3761 3754 3743
			                   3754 3760 3759 3745 3736 3724
			                   3740 3740 3738 3727 3718 3705
			                   3723 3717 3711 3701 3693 3681
			                   3696 3693 3691 3689 3682 3670
			                   3691 3690 3688 3687 3680 3668
			                   3685 3686 3685 3685 3677 3665
			                   3678 3680 3680 3680 3672 3658
			                   3666 3671 3670 3667 3656 3642
			                   3644 3651 3649 3637 3628 3611
			                   3609 3613 3609 3596 3588 3570
			                   3558 3561 3558 3544 3539 3520
			                   3490 3493 3492 3476 3474 3453
			                   3389 3399 3401 3378 3381 3357
			                   3200 3200 3200 3200 3200 3200
			                  >;
		};
};
