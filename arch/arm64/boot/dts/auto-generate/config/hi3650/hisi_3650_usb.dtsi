

  /{
		hisi_usb@ff200000 {
			compatible = "hisilicon,hi3650-dwc3";
			reg = <0x0 0xff200000 0x0 0x1000 0x0 0xff100000 0x0 0x100000>;
			ranges;
			otgdebugsubsys-supply = <&usbotg>;
			bc_again_flag = <1>;
			bc_unknown_again_flag = <1>;
			clocks = <&clk_gate_abb_192 &aclk_gate_usb3otg>;
			clock-names = "clk_usb3phy_ref", "aclk_usb3otg";

			dwc3@ff100000 {
				compatible = "snps,dwc3";
				reg = <0x0 0xff100000 0x0 0x100000>;
				interrupts = <0 159 4>, <0 161 4>;
				interrupt-names = "irq", "otg_irq";
				maximum-speed = "high-speed";
				snps,phy_quirk;
				otg;
			};
		};
  };
