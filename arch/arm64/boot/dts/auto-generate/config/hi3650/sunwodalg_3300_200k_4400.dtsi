/* DO NOT EDIT - Automatically generated by python */
/ {
		sunwodalg_3300_200k_4400:sunwodalg_3300_200k_4400 {
			fcc = <3300>;
			default_rbatt_mohm = <100>;
			id_identify_min = <2786>;
			id_identify_max = <3312>;
			id_voltage_min = <2941>;
			id_voltage_max = <3167>;
			vbat_max = <4400>;
			temp_para = 
						"-32767","0","-1","0","4100","0",
						"0","5","-1","330","4400","0",
						"5","10","-1","990","4400","3",
						"10","45","-1","-1","4400","3",
						"45","50","-1","1155","4100","3",
						"50","32767","-1","0","4100","0";
			vbat_para = 
						"-32767","3400","-1","820","0",
						"3400","32767","-1","-1","0";
			segment_para = 
						"-32767","4150","3300","4208","50",
						"4150","4450","2310","4400","0";
			batt_brand = "sunwodalg";
			fcc_temp = <3514 3503 3498 3523 3502 3485>;
			fcc_sf_x = <0 100 200 300 400 500>;
			fcc_sf_y = <100 96 94 92 90 88>;
			fcc_sf_cols = <6>;
			pc_sf_rows = <1>;
			pc_sf_cols = <1>;
			pc_sf_row_entries = <0>;
			pc_sf_percent = <100>;
			pc_sf_sf = <100>;
			rbatt_sf_rows = <28>;
			rbatt_sf_cols = <6>;
			rbatt_sf_percent = <100 95 90 85 80 75 70 65 60 55 50 45 40 35 30 25 20 15 10 9 8 7 6 5 4 3 2 1>;
			rbatt_sf_sf = <
			               2104 1264 562 130 96 82
			               2096 1263 562 130 96 82
			               1960 1242 568 131 95 83
			               1854 1215 567 133 97 84
			               1812 1208 582 138 100 85
			               1707 1179 621 146 103 86
			               1580 1033 564 157 109 89
			               1573 1010 518 168 116 93
			               1562 999 506 170 126 100
			               1561 990 486 142 113 95
			               1583 1012 480 124 95 84
			               1639 1066 487 124 96 84
			               1713 1140 519 128 98 86
			               1822 1233 568 130 103 90
			               1936 1352 640 130 103 88
			               2040 1477 735 127 95 84
			               2125 1594 844 126 95 83
			               2231 1705 991 139 96 83
			               2588 2136 888 126 96 84
			               2605 2284 964 129 98 82
			               2766 2487 1040 131 96 82
			               3029 2682 1168 133 97 85
			               3196 2918 1305 137 97 86
			               3255 3154 1504 154 104 86
			               3080 3326 1661 258 111 163
			               2892 3483 1538 249 147 116
			               2629 3926 1888 258 169 88
			               2883 4397 2129 222 155 117
			              >;
			pc_temp_ocv_rows = <29>;
			pc_temp_ocv_cols = <6>;
			pc_temp_ocv_percent = <100 95 90 85 80 75 70 65 60 55 50 45 40 35 30 25 20 15 10 9 8 7 6 5 4 3 2 1>;
			pc_temp_ocv_ocv = <
			                   4385 4381 4378 4372 4364 4359
			                   4269 4278 4288 4304 4298 4294
			                   4192 4207 4224 4244 4238 4235
			                   4129 4147 4165 4187 4181 4178
			                   4083 4098 4114 4131 4126 4123
			                   4017 4044 4067 4081 4074 4071
			                   3941 3960 3997 4029 4026 4023
			                   3902 3916 3940 3976 3980 3979
			                   3865 3876 3899 3937 3938 3937
			                   3834 3840 3859 3887 3890 3890
			                   3811 3817 3828 3850 3850 3850
			                   3797 3803 3806 3825 3825 3824
			                   3785 3793 3793 3805 3805 3804
			                   3775 3783 3784 3789 3790 3788
			                   3763 3774 3776 3775 3774 3769
			                   3750 3761 3765 3762 3754 3743
			                   3736 3743 3747 3743 3735 3722
			                   3723 3721 3721 3719 3709 3695
			                   3701 3697 3693 3691 3683 3672
			                   3696 3693 3690 3689 3682 3670
			                   3692 3690 3686 3688 3681 3669
			                   3684 3686 3682 3685 3679 3667
			                   3675 3681 3674 3681 3674 3661
			                   3662 3670 3662 3667 3659 3642
			                   3634 3646 3643 3635 3624 3610
			                   3593 3598 3596 3588 3577 3560
			                   3526 3529 3534 3521 3513 3490
			                   3422 3413 3426 3414 3412 3390
			                   3200 3200 3200 3200 3200 3200
			                  >;
			vol_dec1=  <16>;
			pc_temp_ocv_ocv1 = <
			                   4369 4365 4362 4356 4348 4343
			                   4259 4268 4277 4290 4284 4280
			                   4184 4198 4215 4232 4226 4223
			                   4124 4140 4157 4175 4170 4167
			                   4077 4093 4108 4121 4116 4113
			                   4007 4032 4057 4073 4065 4062
			                   3938 3955 3988 4018 4017 4015
			                   3899 3912 3935 3972 3974 3972
			                   3862 3872 3894 3929 3932 3930
			                   3832 3838 3856 3881 3883 3883
			                   3810 3815 3825 3846 3846 3846
			                   3796 3802 3804 3822 3823 3822
			                   3784 3792 3793 3803 3804 3802
			                   3775 3782 3783 3787 3788 3786
			                   3763 3773 3775 3774 3773 3768
			                   3750 3761 3765 3761 3753 3742
			                   3736 3742 3747 3742 3734 3721
			                   3722 3720 3720 3718 3708 3694
			                   3701 3697 3693 3691 3683 3671
			                   3696 3693 3690 3689 3682 3670
			                   3691 3690 3685 3688 3681 3669
			                   3684 3686 3681 3685 3678 3666
			                   3675 3681 3673 3680 3673 3661
			                   3661 3669 3662 3666 3657 3641
			                   3633 3644 3641 3634 3622 3609
			                   3593 3596 3595 3586 3575 3558
			                   3525 3527 3532 3519 3511 3488
			                   3422 3412 3425 3412 3410 3389
			                   3200 3200 3200 3200 3200 3200
			                  >;
			vol_dec2=  <48>;
			pc_temp_ocv_ocv2 = <
			                   4337 4333 4330 4324 4316 4311
			                   4238 4246 4256 4264 4257 4253
			                   4167 4182 4196 4207 4201 4197
			                   4114 4126 4141 4153 4147 4144
			                   4065 4084 4097 4100 4095 4092
			                   3988 4009 4039 4059 4048 4043
			                   3930 3945 3971 3995 4000 3999
			                   3892 3904 3926 3963 3962 3959
			                   3856 3865 3885 3915 3919 3917
			                   3828 3832 3849 3868 3869 3869
			                   3808 3813 3820 3839 3840 3839
			                   3795 3801 3801 3818 3818 3817
			                   3783 3791 3791 3800 3800 3799
			                   3774 3781 3782 3785 3786 3784
			                   3762 3772 3775 3773 3770 3764
			                   3749 3760 3764 3759 3751 3738
			                   3735 3741 3745 3740 3732 3719
			                   3721 3719 3718 3715 3706 3692
			                   3700 3696 3692 3690 3683 3671
			                   3696 3692 3689 3689 3682 3670
			                   3691 3689 3685 3687 3680 3669
			                   3683 3686 3680 3684 3678 3666
			                   3674 3680 3672 3679 3672 3660
			                   3660 3668 3661 3662 3654 3638
			                   3631 3642 3638 3629 3618 3605
			                   3591 3594 3592 3581 3571 3554
			                   3523 3525 3529 3514 3507 3484
			                   3420 3410 3423 3408 3407 3384
			                   3200 3200 3200 3200 3200 3200
			                  >;
			vol_dec3=  <192>;
			pc_temp_ocv_ocv3 = <
			                   4193 4189 4186 4180 4172 4167
			                   4150 4159 4165 4147 4139 4134
			                   4109 4112 4118 4102 4094 4089
			                   4062 4077 4081 4064 4052 4046
			                   3988 3996 4017 4012 4010 4006
			                   3933 3942 3957 3973 3973 3970
			                   3897 3904 3920 3938 3937 3934
			                   3863 3868 3882 3895 3896 3894
			                   3834 3837 3849 3858 3857 3856
			                   3814 3816 3823 3835 3834 3833
			                   3799 3804 3805 3816 3815 3814
			                   3788 3794 3794 3800 3800 3798
			                   3778 3786 3785 3787 3787 3785
			                   3769 3777 3778 3776 3774 3768
			                   3757 3767 3770 3764 3757 3746
			                   3745 3753 3757 3749 3740 3727
			                   3732 3735 3737 3731 3720 3707
			                   3716 3714 3711 3702 3694 3680
			                   3697 3693 3690 3689 3682 3670
			                   3693 3691 3686 3687 3680 3669
			                   3687 3687 3683 3685 3678 3666
			                   3679 3684 3676 3681 3674 3661
			                   3670 3676 3667 3669 3663 3645
			                   3655 3663 3656 3645 3637 3619
			                   3623 3630 3624 3609 3598 3582
			                   3582 3582 3580 3561 3555 3530
			                   3514 3513 3515 3493 3489 3462
			                   3414 3400 3411 3390 3394 3365
			                   3200 3200 3200 3200 3200 3200
			                  >;
		};
};
