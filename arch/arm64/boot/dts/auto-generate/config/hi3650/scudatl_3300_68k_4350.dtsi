/* DO NOT EDIT - Automatically generated by python */
/ {
		scudatl_3300_68k_4350:scudatl_3300_68k_4350 {
			fcc = <3300>;
			default_rbatt_mohm = <100>;
			id_identify_min = <1759>;
			id_identify_max = <2281>;
			id_voltage_min = <1956>;
			id_voltage_max = <2135>;
			vbat_max = <4350>;
			temp_para = 
						"-32767","0","-1","0","4100","0",
						"0","5","-1","330","4350","0",
						"5","10","-1","990","4350","3",
						"10","45","-1","-1","4350","3",
						"45","50","-1","1155","4100","3",
						"50","32767","-1","0","4100","0";
			vbat_para = 
						"-32767","3400","-1","820","0",
						"3400","32767","-1","-1","0";
			segment_para = 
						"-32767","4150","3300","4208","50",
						"4150","4450","2310","4350","0";
			batt_brand = "scudatl";
			fcc_temp = <3297 3304 3304 3314 3310 3290>;
			fcc_sf_x = <0 100 200 300 400 500>;
			fcc_sf_y = <100 96 94 92 90 88>;
			fcc_sf_cols = <6>;
			pc_sf_rows = <1>;
			pc_sf_cols = <1>;
			pc_sf_row_entries = <0>;
			pc_sf_percent = <100>;
			pc_sf_sf = <100>;
			rbatt_sf_rows = <28>;
			rbatt_sf_cols = <6>;
			rbatt_sf_percent = <100 95 90 85 80 75 70 65 60 55 50 45 40 35 30 25 20 15 10 9 8 7 6 5 4 3 2 1>;
			rbatt_sf_sf = <
			               2217 1111 455 148 115 103
			               2216 1111 455 148 115 103
			               2055 1114 458 150 117 103
			               1972 1072 463 153 119 105
			               1924 1103 464 158 122 107
			               1692 1093 507 167 127 109
			               1643 954 469 174 132 113
			               1629 979 441 187 141 118
			               1602 959 424 172 143 121
			               1612 944 412 144 116 105
			               1647 954 413 142 115 104
			               1688 1004 412 146 117 106
			               1747 1063 428 150 122 108
			               1815 1130 454 153 127 113
			               1898 1202 488 152 126 109
			               1989 1296 529 148 116 106
			               2098 1396 575 147 117 106
			               2230 1512 628 150 117 106
			               2645 1535 631 152 120 107
			               3236 1487 563 154 120 111
			               3553 1590 576 151 119 112
			               3885 1743 598 151 119 110
			               4285 1921 631 154 121 111
			               4705 2084 668 151 119 106
			               5216 2293 699 152 119 109
			               5940 2590 741 156 122 110
			               6982 3081 838 168 123 111
			               8596 3947 1049 191 129 116
			              >;
			pc_temp_ocv_rows = <29>;
			pc_temp_ocv_cols = <6>;
			pc_temp_ocv_percent = <100 95 90 85 80 75 70 65 60 55 50 45 40 35 30 25 20 15 10 9 8 7 6 5 4 3 2 1>;
			pc_temp_ocv_ocv = <
			                   4333 4332 4330 4322 4318 4312
			                   4239 4259 4263 4259 4257 4253
			                   4172 4201 4206 4203 4202 4198
			                   4127 4139 4152 4149 4148 4144
			                   4092 4100 4100 4097 4096 4093
			                   3993 4053 4058 4050 4049 4045
			                   3941 3962 3990 4001 4001 4001
			                   3902 3929 3943 3961 3962 3960
			                   3862 3890 3902 3912 3917 3916
			                   3834 3851 3865 3868 3869 3869
			                   3816 3821 3836 3840 3842 3842
			                   3801 3805 3811 3819 3820 3819
			                   3789 3794 3796 3801 3802 3801
			                   3778 3783 3785 3786 3787 3786
			                   3766 3771 3776 3772 3770 3764
			                   3753 3757 3765 3756 3749 3737
			                   3738 3739 3747 3738 3730 3717
			                   3720 3719 3720 3713 3705 3692
			                   3694 3700 3695 3690 3683 3671
			                   3687 3694 3693 3689 3682 3670
			                   3677 3689 3691 3687 3680 3669
			                   3665 3683 3688 3684 3677 3666
			                   3652 3675 3683 3678 3671 3658
			                   3633 3658 3669 3660 3651 3637
			                   3601 3627 3637 3622 3613 3599
			                   3556 3579 3586 3568 3562 3548
			                   3490 3510 3515 3496 3493 3481
			                   3387 3406 3412 3388 3393 3382
			                   3200 3200 3200 3200 3200 3200
			                  >;
			vol_dec1=  <16>;
			pc_temp_ocv_ocv1 = <
			                   4317 4316 4314 4306 4302 4296
			                   4228 4247 4250 4246 4243 4239
			                   4165 4189 4194 4190 4189 4185
			                   4122 4132 4141 4137 4136 4132
			                   4078 4092 4092 4087 4086 4083
			                   3986 4038 4045 4041 4039 4036
			                   3936 3957 3982 3994 3994 3993
			                   3898 3923 3936 3953 3954 3952
			                   3859 3884 3897 3905 3909 3908
			                   3832 3847 3861 3864 3865 3865
			                   3815 3819 3833 3838 3839 3838
			                   3800 3804 3810 3817 3818 3817
			                   3789 3793 3794 3800 3801 3799
			                   3777 3782 3784 3784 3786 3784
			                   3766 3770 3775 3770 3769 3762
			                   3752 3756 3764 3755 3747 3736
			                   3738 3738 3746 3737 3728 3716
			                   3719 3718 3719 3712 3704 3691
			                   3694 3699 3695 3690 3683 3671
			                   3686 3694 3693 3688 3682 3670
			                   3676 3688 3691 3687 3680 3668
			                   3664 3683 3688 3684 3677 3665
			                   3652 3675 3682 3678 3671 3657
			                   3632 3657 3668 3659 3650 3635
			                   3600 3626 3635 3619 3611 3596
			                   3554 3578 3584 3566 3560 3546
			                   3489 3509 3513 3494 3492 3479
			                   3386 3404 3410 3387 3392 3380
			                   3200 3200 3200 3200 3200 3200
			                  >;
			vol_dec2=  <48>;
			pc_temp_ocv_ocv2 = <
			                   4285 4284 4282 4274 4270 4264
			                   4206 4223 4224 4218 4215 4210
			                   4151 4164 4171 4165 4163 4158
			                   4112 4117 4120 4115 4112 4108
			                   4051 4076 4076 4068 4066 4061
			                   3973 4007 4021 4021 4020 4018
			                   3927 3947 3966 3980 3980 3978
			                   3889 3912 3924 3937 3939 3936
			                   3853 3874 3886 3891 3893 3893
			                   3829 3840 3854 3856 3857 3857
			                   3812 3816 3827 3832 3833 3832
			                   3798 3802 3806 3813 3814 3812
			                   3787 3791 3792 3796 3798 3796
			                   3776 3781 3783 3782 3783 3780
			                   3764 3768 3774 3768 3765 3758
			                   3751 3754 3762 3753 3745 3733
			                   3737 3736 3743 3734 3726 3713
			                   3718 3717 3717 3710 3702 3689
			                   3692 3698 3694 3689 3683 3671
			                   3685 3693 3693 3688 3681 3670
			                   3674 3687 3690 3686 3679 3668
			                   3663 3682 3687 3683 3676 3664
			                   3650 3673 3681 3676 3669 3654
			                   3629 3655 3665 3655 3647 3630
			                   3597 3623 3631 3615 3607 3591
			                   3552 3574 3580 3561 3555 3541
			                   3486 3505 3510 3490 3488 3474
			                   3384 3402 3408 3384 3389 3376
			                   3200 3200 3200 3200 3200 3200
			                  >;
			vol_dec3=  <192>;
			pc_temp_ocv_ocv3 = <
			                   4141 4140 4138 4130 4126 4120
			                   4128 4117 4109 4099 4095 4087
			                   4098 4083 4076 4061 4055 4047
			                   4018 4032 4027 4019 4015 4010
			                   3959 3959 3976 3983 3980 3975
			                   3920 3930 3937 3946 3945 3939
			                   3885 3896 3902 3905 3905 3902
			                   3852 3862 3869 3868 3867 3865
			                   3830 3833 3844 3844 3844 3842
			                   3814 3814 3822 3825 3825 3824
			                   3801 3802 3804 3809 3809 3807
			                   3790 3792 3792 3795 3796 3794
			                   3780 3783 3783 3782 3783 3779
			                   3770 3772 3776 3770 3768 3760
			                   3758 3760 3767 3758 3750 3738
			                   3745 3745 3753 3743 3734 3721
			                   3731 3728 3731 3722 3714 3701
			                   3712 3712 3708 3700 3693 3682
			                   3686 3693 3693 3688 3681 3669
			                   3678 3688 3690 3686 3679 3667
			                   3667 3683 3688 3683 3676 3664
			                   3657 3676 3683 3678 3670 3656
			                   3642 3663 3671 3662 3653 3638
			                   3619 3640 3648 3631 3622 3607
			                   3585 3606 3610 3589 3581 3568
			                   3539 3557 3560 3536 3531 3518
			                   3474 3490 3493 3465 3466 3453
			                   3374 3390 3395 3364 3376 3358
			                   3200 3200 3200 3200 3200 3200
			                  >;
		};
};
