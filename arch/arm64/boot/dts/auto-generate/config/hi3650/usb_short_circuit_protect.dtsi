/ {
	usb_short_circuit_protect: usb_short_circuit_protect{
		compatible = "huawei,usb_short_circuit_protect";
		gpio_usb_short_circuit_protect = <&gpio15 0 0>;
		adc_channel_uscp = <4>;
		uscp_threshold_tusb = <40>;
		open_mosfet_temp = <10>;
		close_mosfet_temp = <4>;
		interval_switch_temp = <7>;
		status = "disable";
	};
};
