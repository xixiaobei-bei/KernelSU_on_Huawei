/* DO NOT EDIT - Automatically generated by python */
/ {
		desaysony_2900_470k_4400:desaysony_2900_470k_4400 {
			fcc = <2900>;
			default_rbatt_mohm = <100>;
			id_identify_min = <3312>;
			id_identify_max = <3767>;
			id_voltage_min = <3457>;
			id_voltage_max = <3696>;
			vbat_max = <4400>;
			temp_para = 
						"-32767","0","-1","0","4100","0",
						"0","5","-1","290","4400","0",
						"5","10","-1","870","4400","3",
						"10","45","-1","-1","4400","3",
						"45","50","-1","1015","4100","3",
						"50","32767","-1","0","4100","0";
			vbat_para = 
						"-32767","3400","-1","820","0",
						"3400","32767","-1","-1","0";
			segment_para = 
						"-32767","4150","2900","4208","50",
						"4150","4450","2030","4400","0";
			batt_brand = "desaysony";
			fcc_temp = <3029 3027 3029 3045 3030 3014>;
			fcc_sf_x = <0 100 200 300 400 500>;
			fcc_sf_y = <100 96 94 92 90 88>;
			fcc_sf_cols = <6>;
			pc_sf_rows = <1>;
			pc_sf_cols = <1>;
			pc_sf_row_entries = <0>;
			pc_sf_percent = <100>;
			pc_sf_sf = <100>;
			rbatt_sf_rows = <28>;
			rbatt_sf_cols = <6>;
			rbatt_sf_percent = <100 95 90 85 80 75 70 65 60 55 50 45 40 35 30 25 20 15 10 9 8 7 6 5 4 3 2 1>;
			rbatt_sf_sf = <
			               2043 944 393 133 107 97
			               2042 944 393 133 107 97
			               1895 952 398 134 109 98
			               1757 947 400 138 112 99
			               1661 945 416 144 115 102
			               1617 930 430 151 119 104
			               1430 872 455 163 125 108
			               1412 815 402 180 135 112
			               1416 822 374 183 147 121
			               1405 812 361 137 117 103
			               1423 817 360 131 108 99
			               1472 856 365 133 110 99
			               1529 921 370 137 112 102
			               1606 996 386 143 117 107
			               1700 1091 419 142 119 108
			               1818 1210 463 138 108 100
			               1965 1370 515 134 106 98
			               2163 1593 595 137 107 98
			               2437 1409 560 138 110 101
			               2696 1336 515 140 110 103
			               3044 1494 538 140 111 103
			               3435 1687 573 140 112 104
			               3896 1902 643 142 113 103
			               4392 2178 722 141 110 101
			               5108 2531 779 144 110 100
			               6069 3034 905 149 112 103
			               7448 3877 1151 165 117 104
			               10032 5481 1732 399 146 113
			              >;
			pc_temp_ocv_rows = <29>;
			pc_temp_ocv_cols = <6>;
			pc_temp_ocv_percent = <100 95 90 85 80 75 70 65 60 55 50 45 40 35 30 25 20 15 10 9 8 7 6 5 4 3 2 1>;
			pc_temp_ocv_ocv = <
			                   4386 4383 4382 4374 4367 4361
			                   4289 4302 4309 4312 4306 4301
			                   4221 4240 4250 4253 4248 4243
			                   4159 4183 4192 4195 4190 4185
			                   4103 4129 4137 4139 4134 4129
			                   4056 4072 4087 4085 4080 4077
			                   3967 3998 4030 4036 4032 4028
			                   3926 3938 3962 3986 3984 3983
			                   3892 3902 3918 3941 3942 3941
			                   3855 3864 3879 3887 3888 3887
			                   3828 3831 3846 3853 3853 3853
			                   3809 3809 3821 3828 3828 3827
			                   3793 3796 3799 3807 3808 3806
			                   3779 3786 3785 3791 3791 3789
			                   3766 3776 3776 3776 3775 3772
			                   3752 3763 3767 3760 3754 3742
			                   3738 3743 3749 3740 3733 3720
			                   3724 3717 3724 3714 3708 3695
			                   3704 3700 3696 3691 3684 3672
			                   3697 3695 3694 3690 3683 3671
			                   3689 3690 3691 3688 3681 3670
			                   3679 3686 3687 3685 3679 3668
			                   3667 3678 3682 3679 3674 3662
			                   3646 3663 3669 3658 3659 3643
			                   3617 3633 3638 3616 3623 3604
			                   3573 3585 3588 3559 3571 3553
			                   3509 3516 3517 3482 3503 3484
			                   3406 3410 3411 3374 3403 3384
			                   3200 3200 3200 3200 3200 3200
			                  >;
			vol_dec1=  <16>;
			pc_temp_ocv_ocv1 = <
			                   4370 4367 4366 4358 4351 4345
			                   4279 4290 4297 4298 4291 4286
			                   4212 4230 4238 4240 4234 4229
			                   4151 4174 4181 4183 4177 4172
			                   4097 4120 4129 4128 4123 4118
			                   4045 4061 4078 4075 4071 4067
			                   3963 3989 4019 4026 4023 4019
			                   3922 3933 3956 3979 3978 3976
			                   3888 3898 3913 3933 3934 3932
			                   3853 3860 3875 3882 3883 3882
			                   3826 3829 3844 3850 3850 3849
			                   3808 3808 3818 3826 3826 3824
			                   3792 3796 3798 3806 3806 3805
			                   3779 3785 3785 3790 3790 3788
			                   3766 3775 3776 3775 3773 3770
			                   3752 3762 3766 3759 3752 3741
			                   3738 3742 3748 3739 3732 3719
			                   3724 3717 3723 3713 3707 3694
			                   3703 3700 3696 3691 3684 3672
			                   3696 3694 3693 3690 3683 3671
			                   3688 3690 3690 3688 3681 3670
			                   3678 3685 3686 3685 3679 3667
			                   3666 3678 3681 3678 3673 3661
			                   3645 3662 3668 3656 3657 3640
			                   3615 3632 3636 3613 3620 3602
			                   3571 3583 3586 3556 3569 3550
			                   3507 3514 3515 3480 3501 3482
			                   3404 3409 3410 3371 3401 3381
			                   3200 3200 3200 3200 3200 3200
			                  >;
			vol_dec2=  <48>;
			pc_temp_ocv_ocv2 = <
			                   4338 4335 4334 4326 4319 4313
			                   4258 4267 4272 4269 4263 4257
			                   4194 4210 4215 4213 4207 4201
			                   4135 4156 4161 4158 4152 4147
			                   4085 4102 4111 4105 4100 4095
			                   4022 4038 4059 4056 4051 4047
			                   3953 3972 3997 4008 4005 4003
			                   3915 3924 3943 3964 3963 3961
			                   3881 3888 3902 3914 3916 3915
			                   3847 3853 3867 3872 3873 3872
			                   3823 3825 3838 3843 3843 3842
			                   3806 3806 3814 3821 3821 3819
			                   3790 3794 3796 3802 3803 3801
			                   3777 3784 3783 3787 3787 3785
			                   3764 3774 3774 3772 3770 3765
			                   3750 3761 3764 3757 3750 3738
			                   3737 3740 3746 3737 3729 3717
			                   3723 3716 3721 3710 3704 3692
			                   3702 3698 3695 3691 3683 3672
			                   3695 3693 3693 3689 3682 3671
			                   3687 3689 3690 3687 3681 3669
			                   3677 3685 3686 3684 3678 3666
			                   3665 3676 3680 3676 3672 3659
			                   3643 3660 3666 3652 3653 3636
			                   3613 3628 3632 3608 3616 3597
			                   3569 3580 3581 3551 3564 3546
			                   3504 3510 3511 3475 3497 3478
			                   3402 3406 3407 3368 3398 3378
			                   3200 3200 3200 3200 3200 3200
			                  >;
			vol_dec3=  <192>;
			pc_temp_ocv_ocv3 = <
			                   4194 4191 4189 4182 4175 4169
			                   4164 4170 4156 4142 4134 4128
			                   4115 4122 4118 4096 4088 4083
			                   4073 4071 4072 4054 4047 4041
			                   4003 4006 4021 4011 4007 4003
			                   3947 3950 3963 3972 3970 3967
			                   3912 3914 3924 3931 3930 3928
			                   3881 3881 3889 3887 3886 3884
			                   3850 3850 3859 3857 3856 3855
			                   3826 3824 3834 3835 3835 3833
			                   3810 3807 3813 3817 3816 3815
			                   3795 3796 3796 3801 3801 3799
			                   3782 3786 3785 3787 3788 3785
			                   3770 3778 3777 3774 3773 3769
			                   3758 3768 3769 3761 3754 3743
			                   3745 3752 3756 3746 3738 3725
			                   3733 3730 3736 3725 3718 3704
			                   3719 3712 3713 3700 3694 3683
			                   3697 3694 3692 3689 3682 3671
			                   3690 3690 3690 3687 3681 3669
			                   3681 3686 3686 3685 3678 3666
			                   3672 3680 3682 3678 3673 3660
			                   3656 3669 3674 3661 3660 3644
			                   3633 3648 3652 3626 3632 3613
			                   3602 3613 3614 3582 3592 3573
			                   3557 3563 3563 3525 3542 3522
			                   3492 3495 3494 3451 3477 3457
			                   3391 3393 3393 3352 3383 3362
			                   3200 3200 3200 3200 3200 3200
			                  >;
		};
};
