/* DO NOT EDIT - Automatically generated by python */
/ {
		sunwodaatl_4400_39k_4400:sunwodaatl_4400_39k_4400 {
			fcc = <4400>;
			default_rbatt_mohm = <100>;
			id_identify_min = <1235>;
			id_identify_max = <1759>;
			id_voltage_min = <1420>;
			id_voltage_max = <1562>;
			vbat_max = <4400>;
			temp_para = 
						"-32767","0","-1","0","4100","0",
						"0","5","-1","440","4400","0",
						"5","10","-1","1320","4400","3",
						"10","45","-1","-1","4400","3",
						"45","50","-1","1540","4100","3",
						"50","32767","-1","0","4100","0";
			vbat_para = 
						"-32767","3400","-1","820","0",
						"3400","32767","-1","-1","0";
			segment_para = 
						"-32767","4150","4400","4208","50",
						"4150","4450","3080","4400","0";
			batt_brand = "sunwodaatl";
			fcc_temp = <4466 4465 4468 4493 4535 4453>;
			fcc_sf_x = <0 100 200 300 400 500>;
			fcc_sf_y = <100 96 94 92 90 88>;
			fcc_sf_cols = <6>;
			pc_sf_rows = <1>;
			pc_sf_cols = <1>;
			pc_sf_row_entries = <0>;
			pc_sf_percent = <100>;
			pc_sf_sf = <100>;
			rbatt_sf_rows = <28>;
			rbatt_sf_cols = <6>;
			rbatt_sf_percent = <100 95 90 85 80 75 70 65 60 55 50 45 40 35 30 25 20 15 10 9 8 7 6 5 4 3 2 1>;
			rbatt_sf_sf = <
			               1990 1330 573 126 98 87
			               1987 1328 574 126 98 87
			               1843 1269 576 127 98 88
			               1726 1203 565 129 99 89
			               1675 1150 564 132 101 89
			               1601 1128 573 137 104 91
			               1497 1020 564 146 108 93
			               1497 999 516 154 113 96
			               1481 982 510 150 118 101
			               1489 975 500 127 105 89
			               1510 978 500 122 97 88
			               1547 1011 507 123 97 89
			               1592 1050 541 124 98 89
			               1643 1097 582 127 101 92
			               1701 1152 633 128 101 93
			               1770 1214 696 125 98 88
			               1860 1288 773 125 96 88
			               1988 1385 886 128 99 87
			               3256 1528 781 124 97 89
			               3602 1653 826 125 96 90
			               3863 1797 900 126 99 90
			               4163 1982 988 127 100 91
			               4491 2171 1106 129 102 91
			               4859 2374 1227 130 98 88
			               5308 2619 1349 130 95 88
			               5851 2949 1498 134 100 89
			               6574 3415 1757 158 105 91
			               7888 4076 2213 231 184 107
			              >;
			pc_temp_ocv_rows = <29>;
			pc_temp_ocv_cols = <6>;
			pc_temp_ocv_percent = <100 95 90 85 80 75 70 65 60 55 50 45 40 35 30 25 20 15 10 9 8 7 6 5 4 3 2 1>;
			pc_temp_ocv_ocv = <
			                   4390 4386 4384 4375 4378 4362
			                   4283 4295 4309 4316 4321 4307
			                   4208 4225 4246 4258 4264 4251
			                   4138 4164 4185 4200 4206 4194
			                   4092 4106 4130 4144 4150 4139
			                   4031 4060 4080 4090 4095 4086
			                   3951 3978 4021 4041 4045 4037
			                   3911 3932 3956 3990 3996 3992
			                   3870 3892 3914 3942 3950 3946
			                   3840 3855 3873 3891 3898 3892
			                   3819 3825 3839 3857 3860 3858
			                   3803 3807 3811 3831 3834 3832
			                   3788 3793 3796 3809 3812 3810
			                   3774 3782 3784 3792 3794 3792
			                   3759 3768 3773 3775 3775 3771
			                   3743 3752 3759 3758 3753 3740
			                   3725 3734 3739 3739 3732 3718
			                   3701 3713 3714 3712 3706 3692
			                   3671 3689 3688 3689 3683 3670
			                   3661 3683 3683 3688 3682 3669
			                   3649 3674 3678 3686 3680 3668
			                   3635 3665 3672 3684 3678 3665
			                   3617 3653 3664 3678 3672 3659
			                   3594 3633 3650 3662 3655 3640
			                   3563 3601 3622 3624 3617 3602
			                   3521 3556 3575 3571 3564 3550
			                   3461 3492 3507 3501 3494 3481
			                   3371 3396 3411 3399 3395 3381
			                   3200 3200 3200 3200 3200 3200
			                  >;
			vol_dec1=  <16>;
			pc_temp_ocv_ocv1 = <
			                   4374 4370 4368 4359 4362 4346
			                   4272 4283 4296 4301 4306 4292
			                   4199 4215 4234 4243 4249 4236
			                   4132 4155 4176 4187 4193 4181
			                   4085 4100 4122 4133 4137 4127
			                   4021 4048 4071 4080 4085 4075
			                   3947 3972 4011 4032 4035 4028
			                   3907 3927 3950 3982 3988 3983
			                   3867 3888 3909 3933 3941 3936
			                   3838 3852 3869 3885 3892 3886
			                   3818 3823 3836 3853 3856 3854
			                   3802 3805 3810 3828 3831 3829
			                   3787 3793 3795 3807 3810 3808
			                   3774 3781 3783 3790 3792 3790
			                   3758 3768 3772 3774 3773 3768
			                   3743 3752 3758 3757 3751 3739
			                   3725 3733 3738 3738 3731 3716
			                   3700 3712 3713 3711 3704 3691
			                   3670 3688 3688 3689 3683 3670
			                   3661 3682 3682 3687 3682 3669
			                   3648 3674 3678 3686 3680 3668
			                   3634 3665 3672 3683 3677 3665
			                   3616 3652 3663 3677 3672 3658
			                   3593 3632 3648 3660 3654 3638
			                   3562 3600 3620 3622 3615 3599
			                   3520 3554 3573 3568 3562 3547
			                   3460 3491 3505 3499 3492 3478
			                   3370 3394 3409 3397 3393 3379
			                   3200 3200 3200 3200 3200 3200
			                  >;
			vol_dec2=  <48>;
			pc_temp_ocv_ocv2 = <
			                   4342 4338 4336 4327 4330 4314
			                   4251 4260 4271 4271 4276 4261
			                   4180 4196 4211 4216 4220 4206
			                   4121 4138 4156 4162 4166 4153
			                   4071 4088 4105 4109 4113 4102
			                   4003 4026 4053 4061 4064 4054
			                   3939 3961 3991 4012 4015 4009
			                   3898 3918 3938 3966 3972 3967
			                   3862 3880 3898 3915 3922 3916
			                   3834 3845 3861 3874 3879 3875
			                   3815 3820 3830 3846 3849 3847
			                   3800 3803 3807 3823 3825 3823
			                   3786 3791 3793 3803 3806 3804
			                   3772 3779 3782 3787 3789 3786
			                   3757 3766 3770 3771 3770 3762
			                   3741 3750 3756 3754 3748 3735
			                   3723 3732 3736 3735 3728 3713
			                   3699 3711 3712 3709 3702 3688
			                   3669 3687 3686 3688 3682 3670
			                   3659 3681 3681 3687 3681 3669
			                   3647 3673 3677 3685 3680 3667
			                   3632 3663 3671 3682 3677 3664
			                   3614 3650 3662 3675 3670 3656
			                   3591 3629 3646 3655 3649 3633
			                   3560 3597 3616 3616 3609 3593
			                   3518 3551 3569 3563 3556 3541
			                   3458 3487 3502 3494 3487 3473
			                   3369 3392 3406 3393 3389 3375
			                   3200 3200 3200 3200 3200 3200
			                  >;
			vol_dec3=  <192>;
			pc_temp_ocv_ocv3 = <
			                   4198 4194 4192 4183 4186 4170
			                   4153 4164 4163 4141 4139 4123
			                   4110 4112 4116 4095 4094 4080
			                   4061 4073 4071 4054 4053 4039
			                   3995 4002 4019 4011 4010 4001
			                   3938 3951 3960 3971 3973 3965
			                   3900 3912 3923 3928 3930 3921
			                   3865 3878 3887 3888 3890 3883
			                   3838 3846 3855 3858 3860 3856
			                   3819 3822 3827 3836 3837 3834
			                   3804 3806 3807 3817 3818 3815
			                   3791 3794 3794 3801 3803 3800
			                   3778 3783 3784 3787 3789 3785
			                   3765 3772 3774 3773 3771 3764
			                   3751 3759 3763 3758 3753 3739
			                   3736 3743 3746 3743 3735 3720
			                   3717 3725 3727 3723 3715 3701
			                   3693 3706 3704 3698 3689 3677
			                   3662 3682 3681 3687 3681 3668
			                   3652 3675 3678 3685 3679 3666
			                   3639 3667 3672 3682 3676 3664
			                   3624 3657 3665 3676 3671 3657
			                   3605 3641 3655 3663 3655 3639
			                   3581 3617 3634 3633 3624 3607
			                   3549 3583 3600 3593 3584 3566
			                   3506 3536 3551 3540 3531 3515
			                   3448 3474 3485 3474 3465 3449
			                   3361 3381 3393 3375 3369 3357
			                   3200 3200 3200 3200 3200 3200
			                  >;
		};
};
