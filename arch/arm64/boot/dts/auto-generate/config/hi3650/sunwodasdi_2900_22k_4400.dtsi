/* DO NOT EDIT - Automatically generated by python */
/ {
		sunwodasdi_2900_22k_4400:sunwodasdi_2900_22k_4400 {
			fcc = <2900>;
			default_rbatt_mohm = <100>;
			id_identify_min = <751>;
			id_identify_max = <1235>;
			id_voltage_min = <949>;
			id_voltage_max = <1051>;
			vbat_max = <4400>;
			temp_para = 
						"-32767","0","-1","0","4100","0",
						"0","5","-1","290","4400","0",
						"5","10","-1","870","4400","3",
						"10","45","-1","-1","4400","3",
						"45","50","-1","1015","4100","3",
						"50","32767","-1","0","4100","0";
			vbat_para = 
						"-32767","3400","-1","820","0",
						"3400","32767","-1","-1","0";
			segment_para = 
						"-32767","4150","2900","4208","50",
						"4150","4450","2030","4400","0";
			batt_brand = "sunwodasdi";
			fcc_temp = <2934 2933 2965 2951 2931 2909>;
			fcc_sf_x = <0 100 200 300 400 500>;
			fcc_sf_y = <100 96 94 92 90 88>;
			fcc_sf_cols = <6>;
			pc_sf_rows = <1>;
			pc_sf_cols = <1>;
			pc_sf_row_entries = <0>;
			pc_sf_percent = <100>;
			pc_sf_sf = <100>;
			rbatt_sf_rows = <28>;
			rbatt_sf_cols = <6>;
			rbatt_sf_percent = <100 95 90 85 80 75 70 65 60 55 50 45 40 35 30 25 20 15 10 9 8 7 6 5 4 3 2 1>;
			rbatt_sf_sf = <
			               2293 1454 733 160 118 100
			               2291 1453 732 160 118 100
			               2140 1403 720 161 117 101
			               2010 1367 709 164 119 102
			               1938 1319 719 170 122 103
			               1880 1326 753 178 126 105
			               1626 1147 733 199 137 108
			               1625 1053 613 199 141 113
			               1587 1042 594 208 153 123
			               1637 1031 561 168 134 111
			               1708 1021 545 151 115 101
			               1777 1105 545 152 116 100
			               1858 1198 574 156 120 104
			               1947 1298 652 161 126 108
			               2039 1392 744 165 128 110
			               2150 1471 841 162 120 103
			               2290 1557 926 160 117 101
			               2479 1687 1034 162 117 102
			               3489 1591 855 161 120 104
			               3798 1745 903 160 119 108
			               4025 1832 980 162 121 107
			               4162 1990 1057 166 123 108
			               4486 2193 1156 168 121 109
			               4665 2348 1270 165 121 107
			               4969 2427 1298 170 118 107
			               5274 2622 1340 177 124 109
			               5592 2831 1461 196 128 112
			               6244 3224 1716 528 161 123
			              >;
			pc_temp_ocv_rows = <29>;
			pc_temp_ocv_cols = <6>;
			pc_temp_ocv_percent = <100 95 90 85 80 75 70 65 60 55 50 45 40 35 30 25 20 15 10 9 8 7 6 5 4 3 2 1>;
			pc_temp_ocv_ocv = <
			                   4388 4385 4390 4372 4361 4353
			                   4275 4287 4307 4306 4299 4295
			                   4208 4217 4242 4248 4241 4238
			                   4150 4163 4184 4192 4186 4182
			                   4104 4112 4131 4139 4132 4128
			                   4058 4076 4087 4086 4080 4077
			                   3950 3990 4030 4044 4036 4030
			                   3908 3928 3952 3975 3980 3986
			                   3860 3888 3911 3942 3946 3945
			                   3837 3855 3873 3893 3895 3894
			                   3821 3822 3842 3856 3856 3856
			                   3804 3808 3816 3830 3830 3829
			                   3787 3796 3796 3809 3810 3808
			                   3771 3783 3786 3792 3792 3791
			                   3754 3768 3775 3776 3775 3772
			                   3741 3751 3762 3761 3755 3744
			                   3728 3733 3742 3740 3733 3720
			                   3714 3719 3719 3712 3706 3693
			                   3690 3704 3698 3689 3681 3669
			                   3685 3700 3693 3687 3680 3668
			                   3678 3693 3690 3685 3679 3667
			                   3664 3688 3684 3682 3677 3665
			                   3652 3681 3677 3676 3672 3659
			                   3631 3667 3664 3654 3659 3643
			                   3604 3638 3638 3610 3623 3607
			                   3565 3592 3592 3549 3570 3555
			                   3503 3524 3520 3464 3498 3486
			                   3404 3417 3411 3334 3394 3385
			                   3200 3200 3200 3200 3200 3200
			                  >;
			vol_dec1=  <16>;
			pc_temp_ocv_ocv1 = <
			                   4372 4369 4374 4356 4345 4337
			                   4266 4276 4295 4292 4285 4280
			                   4201 4209 4232 4235 4228 4224
			                   4145 4156 4175 4181 4174 4170
			                   4099 4107 4124 4128 4121 4117
			                   4046 4065 4079 4079 4071 4067
			                   3946 3983 4018 4031 4026 4021
			                   3903 3923 3947 3971 3975 3979
			                   3858 3885 3907 3934 3938 3937
			                   3836 3851 3870 3888 3889 3889
			                   3820 3820 3839 3853 3853 3852
			                   3803 3807 3814 3828 3828 3827
			                   3786 3795 3795 3808 3808 3807
			                   3770 3782 3785 3790 3791 3789
			                   3754 3767 3774 3775 3774 3770
			                   3740 3750 3761 3760 3754 3742
			                   3727 3732 3741 3739 3732 3719
			                   3714 3718 3718 3711 3705 3692
			                   3690 3703 3697 3689 3681 3669
			                   3685 3700 3693 3687 3680 3668
			                   3678 3693 3689 3685 3679 3667
			                   3663 3687 3684 3682 3676 3664
			                   3651 3680 3676 3675 3672 3658
			                   3630 3666 3663 3652 3658 3641
			                   3603 3636 3636 3608 3621 3604
			                   3564 3591 3590 3547 3567 3553
			                   3502 3522 3519 3462 3496 3484
			                   3403 3416 3409 3332 3393 3383
			                   3200 3200 3200 3200 3200 3200
			                  >;
			vol_dec2=  <48>;
			pc_temp_ocv_ocv2 = <
			                   4340 4337 4342 4324 4313 4305
			                   4248 4254 4271 4266 4257 4251
			                   4186 4193 4212 4211 4203 4197
			                   4134 4141 4158 4159 4150 4145
			                   4090 4099 4111 4108 4099 4095
			                   4022 4044 4064 4065 4055 4048
			                   3938 3968 3996 4006 4005 4005
			                   3894 3915 3936 3961 3964 3965
			                   3854 3879 3898 3920 3922 3920
			                   3833 3845 3863 3878 3878 3877
			                   3817 3818 3834 3847 3846 3845
			                   3801 3806 3810 3823 3823 3822
			                   3784 3793 3794 3804 3804 3803
			                   3768 3780 3784 3788 3788 3786
			                   3753 3766 3773 3773 3771 3765
			                   3739 3748 3759 3758 3751 3739
			                   3727 3731 3739 3736 3729 3716
			                   3713 3718 3717 3708 3703 3690
			                   3689 3703 3697 3688 3681 3669
			                   3684 3699 3692 3687 3680 3668
			                   3676 3692 3688 3685 3678 3666
			                   3662 3686 3683 3681 3676 3664
			                   3649 3679 3675 3673 3670 3657
			                   3628 3664 3661 3648 3653 3637
			                   3601 3634 3633 3603 3615 3599
			                   3561 3588 3586 3541 3562 3547
			                   3499 3519 3515 3456 3491 3480
			                   3401 3413 3406 3328 3389 3379
			                   3200 3200 3200 3200 3200 3200
			                  >;
			vol_dec3=  <192>;
			pc_temp_ocv_ocv3 = <
			                   4196 4193 4198 4180 4169 4161
			                   4165 4168 4174 4149 4134 4124
			                   4126 4123 4128 4106 4090 4081
			                   4086 4090 4089 4069 4052 4040
			                   4018 4026 4042 4021 4008 4003
			                   3939 3960 3968 3970 3969 3968
			                   3899 3913 3926 3940 3937 3931
			                   3858 3879 3891 3898 3894 3890
			                   3837 3848 3860 3864 3860 3858
			                   3822 3820 3834 3841 3837 3835
			                   3807 3809 3812 3821 3818 3816
			                   3791 3798 3796 3804 3803 3800
			                   3776 3786 3787 3789 3788 3785
			                   3761 3773 3777 3776 3774 3768
			                   3747 3758 3767 3763 3756 3744
			                   3735 3742 3751 3747 3739 3725
			                   3724 3727 3730 3725 3717 3702
			                   3709 3715 3712 3698 3692 3681
			                   3686 3700 3693 3687 3679 3668
			                   3681 3694 3689 3685 3678 3666
			                   3668 3689 3685 3682 3676 3663
			                   3658 3683 3678 3676 3671 3658
			                   3642 3674 3669 3658 3661 3644
			                   3620 3654 3651 3624 3632 3615
			                   3592 3621 3619 3577 3591 3576
			                   3550 3573 3570 3516 3538 3526
			                   3488 3505 3499 3432 3468 3459
			                   3392 3401 3392 3312 3369 3362
			                   3200 3200 3200 3200 3200 3200
			                  >;
		};
};
