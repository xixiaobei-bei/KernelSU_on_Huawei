/ {
	Watt_2900_4400_battery: Watt_2900_4400_battery {
		vbat_max = <4400>;
		compatible = "Watt_2900_4400_battery";
		temp_para =
			"-32767","0","-1","0","4100","0",
			"0","10","-1","870","4400","3",
			"10","50","-1","-1","4400","3",
			"50","32767","-1","0","4400","0";
		segment_para =
			"-32767","4150","2900","4208","50",
			"4150","4450","2030","4400","0";
		vbat_para =
			"-32767","3400","-1","820","0",
			"3400","32767","-1","-1","0";
	};
};
