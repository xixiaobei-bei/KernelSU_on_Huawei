/* DO NOT EDIT - Automatically generated by python */
/ {
		coslightguangyu_3400_68k_4400:coslightguangyu_3400_68k_4400 {
			fcc = <3400>;
			default_rbatt_mohm = <100>;
			id_identify_min = <1759>;
			id_identify_max = <2281>;
			id_voltage_min = <1956>;
			id_voltage_max = <2135>;
			vbat_max = <4400>;
			temp_para = 
						"-32767","0","-1","0","4100","0",
						"0","5","-1","340","4400","0",
						"5","10","-1","1020","4400","3",
						"10","45","-1","-1","4400","3",
						"45","50","-1","1190","4100","3",
						"50","32767","-1","0","4100","0";
			vbat_para = 
						"-32767","3400","-1","820","0",
						"3400","32767","-1","-1","0";
			segment_para = 
						"-32767","4150","3400","4208","50",
						"4150","4450","2380","4400","0";
			batt_brand = "coslightguangyu";
			fcc_temp = <3444 3445 3446 3462 3457 3433>;
			fcc_sf_x = <0 100 200 300 400 500>;
			fcc_sf_y = <100 96 94 92 90 88>;
			fcc_sf_cols = <6>;
			pc_sf_rows = <1>;
			pc_sf_cols = <1>;
			pc_sf_row_entries = <0>;
			pc_sf_percent = <100>;
			pc_sf_sf = <100>;
			rbatt_sf_rows = <28>;
			rbatt_sf_cols = <6>;
			rbatt_sf_percent = <100 95 90 85 80 75 70 65 60 55 50 45 40 35 30 25 20 15 10 9 8 7 6 5 4 3 2 1>;
			rbatt_sf_sf = <
			               2217 1484 816 172 117 101
			               2214 1483 815 172 117 101
			               2045 1414 798 171 116 101
			               1916 1347 767 170 116 101
			               1829 1285 754 170 117 103
			               1759 1274 767 173 119 104
			               1604 1174 744 182 123 105
			               1583 1095 679 186 128 109
			               1557 1085 651 195 135 113
			               1541 1068 632 162 119 103
			               1573 1062 636 150 111 100
			               1613 1108 648 150 112 101
			               1661 1157 688 154 114 103
			               1723 1225 750 157 119 105
			               1799 1304 829 159 121 107
			               1892 1391 921 156 114 101
			               1997 1480 1030 155 112 102
			               2140 1577 1167 163 113 102
			               3342 1751 1121 158 115 103
			               3616 1905 1205 156 115 105
			               3863 2058 1292 162 116 104
			               4115 2231 1406 165 119 106
			               4378 2400 1559 167 119 106
			               4577 2572 1708 166 116 104
			               4835 2700 1766 167 117 104
			               5157 2871 1897 176 120 106
			               5614 3175 2094 189 123 107
			               6295 3617 2432 331 142 114
			              >;
			pc_temp_ocv_rows = <29>;
			pc_temp_ocv_cols = <6>;
			pc_temp_ocv_percent = <100 95 90 85 80 75 70 65 60 55 50 45 40 35 30 25 20 15 10 9 8 7 6 5 4 3 2 1>;
			pc_temp_ocv_ocv = <
			                   4397 4394 4391 4384 4379 4373
			                   4300 4306 4312 4324 4323 4318
			                   4221 4232 4245 4267 4267 4262
			                   4158 4169 4181 4210 4210 4206
			                   4103 4111 4126 4154 4154 4150
			                   4049 4067 4081 4100 4100 4096
			                   3966 4000 4026 4051 4049 4046
			                   3924 3939 3962 3997 4001 4000
			                   3884 3899 3913 3953 3955 3954
			                   3847 3862 3871 3899 3901 3900
			                   3827 3829 3839 3862 3864 3865
			                   3812 3814 3814 3835 3837 3837
			                   3798 3802 3800 3813 3815 3814
			                   3783 3790 3790 3793 3796 3794
			                   3768 3777 3779 3776 3777 3773
			                   3753 3761 3766 3758 3751 3741
			                   3737 3739 3746 3736 3728 3717
			                   3721 3716 3718 3709 3703 3692
			                   3698 3694 3687 3687 3681 3669
			                   3690 3689 3683 3685 3679 3668
			                   3680 3683 3678 3683 3677 3666
			                   3669 3677 3672 3679 3675 3663
			                   3654 3667 3664 3671 3668 3657
			                   3630 3649 3651 3648 3648 3635
			                   3595 3618 3622 3606 3610 3596
			                   3549 3569 3575 3550 3558 3545
			                   3487 3501 3507 3473 3488 3477
			                   3391 3397 3406 3361 3385 3377
			                   3200 3200 3200 3200 3200 3200
			                  >;
			vol_dec1=  <16>;
			pc_temp_ocv_ocv1 = <
			                   4381 4378 4375 4368 4363 4357
			                   4288 4293 4299 4310 4308 4302
			                   4212 4221 4233 4253 4252 4247
			                   4150 4160 4172 4197 4196 4192
			                   4096 4105 4119 4142 4141 4137
			                   4039 4058 4072 4091 4088 4086
			                   3962 3992 4017 4040 4039 4037
			                   3920 3935 3956 3990 3993 3991
			                   3880 3895 3908 3944 3946 3944
			                   3845 3858 3867 3893 3895 3894
			                   3826 3828 3836 3859 3860 3861
			                   3811 3813 3813 3832 3835 3834
			                   3797 3801 3799 3811 3813 3812
			                   3782 3790 3789 3792 3794 3792
			                   3767 3777 3779 3775 3774 3770
			                   3753 3760 3765 3757 3750 3740
			                   3737 3739 3745 3735 3727 3716
			                   3720 3716 3717 3708 3702 3691
			                   3697 3694 3687 3687 3680 3669
			                   3689 3688 3683 3685 3679 3668
			                   3680 3683 3677 3683 3677 3666
			                   3668 3676 3671 3679 3674 3663
			                   3653 3666 3663 3671 3668 3655
			                   3629 3648 3650 3646 3646 3633
			                   3594 3616 3620 3604 3608 3593
			                   3547 3567 3573 3547 3555 3542
			                   3485 3499 3505 3471 3486 3475
			                   3390 3396 3405 3359 3384 3375
			                   3200 3200 3200 3200 3200 3200
			                  >;
			vol_dec2=  <48>;
			pc_temp_ocv_ocv2 = <
			                   4349 4346 4343 4336 4331 4325
			                   4263 4268 4273 4281 4277 4272
			                   4193 4201 4210 4226 4222 4218
			                   4135 4142 4153 4172 4168 4165
			                   4082 4093 4104 4119 4116 4113
			                   4017 4040 4056 4071 4067 4064
			                   3952 3976 3999 4019 4020 4018
			                   3911 3925 3943 3975 3976 3974
			                   3872 3887 3897 3925 3926 3925
			                   3841 3851 3860 3882 3883 3883
			                   3823 3825 3831 3851 3852 3852
			                   3809 3811 3810 3827 3828 3828
			                   3795 3799 3797 3806 3808 3807
			                   3780 3788 3788 3789 3791 3789
			                   3766 3775 3777 3772 3770 3765
			                   3751 3758 3763 3754 3746 3736
			                   3736 3737 3743 3732 3724 3713
			                   3719 3715 3715 3706 3699 3689
			                   3696 3693 3686 3686 3680 3669
			                   3688 3688 3682 3684 3679 3667
			                   3678 3682 3676 3682 3677 3665
			                   3667 3675 3670 3678 3673 3662
			                   3651 3664 3662 3668 3665 3652
			                   3626 3646 3647 3641 3642 3628
			                   3591 3613 3617 3598 3602 3588
			                   3545 3564 3570 3542 3550 3537
			                   3483 3496 3502 3465 3480 3470
			                   3387 3393 3402 3355 3379 3372
			                   3200 3200 3200 3200 3200 3200
			                  >;
			vol_dec3=  <192>;
			pc_temp_ocv_ocv3 = <
			                   4205 4202 4199 4192 4187 4181
			                   4163 4165 4165 4151 4139 4134
			                   4115 4113 4119 4106 4094 4090
			                   4068 4076 4078 4065 4053 4048
			                   3999 4018 4030 4019 4012 4010
			                   3946 3961 3974 3979 3975 3973
			                   3908 3918 3928 3939 3932 3930
			                   3872 3883 3888 3896 3892 3891
			                   3843 3851 3856 3864 3862 3862
			                   3826 3827 3830 3840 3839 3839
			                   3812 3813 3811 3821 3820 3820
			                   3799 3802 3799 3804 3804 3803
			                   3786 3792 3790 3789 3790 3787
			                   3772 3781 3781 3774 3771 3766
			                   3760 3768 3771 3759 3751 3740
			                   3745 3750 3755 3741 3732 3721
			                   3731 3729 3733 3720 3712 3700
			                   3715 3710 3706 3695 3687 3678
			                   3690 3688 3682 3684 3678 3667
			                   3681 3683 3677 3682 3676 3665
			                   3671 3678 3672 3678 3673 3661
			                   3660 3669 3665 3670 3666 3653
			                   3641 3656 3656 3650 3648 3634
			                   3614 3635 3635 3615 3616 3602
			                   3578 3599 3602 3571 3575 3561
			                   3532 3550 3553 3516 3524 3511
			                   3471 3482 3486 3442 3457 3445
			                   3378 3382 3390 3339 3360 3353
			                   3200 3200 3200 3200 3200 3200
			                  >;
		};
};
