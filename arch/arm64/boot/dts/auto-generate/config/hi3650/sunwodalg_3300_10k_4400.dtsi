/* DO NOT EDIT - Automatically generated by python */
/ {
		sunwodalg_3300_10k_4400:sunwodalg_3300_10k_4400 {
			fcc = <3300>;
			default_rbatt_mohm = <100>;
			id_identify_min = <0>;
			id_identify_max = <751>;
			id_voltage_min = <496>;
			id_voltage_max = <553>;
			vbat_max = <4400>;
			temp_para = 
						"-32767","0","-1","0","4100","0",
						"0","5","-1","330","4400","0",
						"5","10","-1","990","4400","3",
						"10","45","-1","-1","4400","3",
						"45","50","-1","1155","4100","3",
						"50","32767","-1","0","4100","0";
			vbat_para = 
						"-32767","3400","-1","820","0",
						"3400","32767","-1","-1","0";
			segment_para = 
						"-32767","4150","3300","4208","50",
						"4150","4450","2310","4400","0";
			batt_brand = "sunwodalg";
			fcc_temp = <3626 3627 3618 3691 3626 3605>;
			fcc_sf_x = <0 100 200 300 400 500>;
			fcc_sf_y = <100 96 94 92 90 88>;
			fcc_sf_cols = <6>;
			pc_sf_rows = <1>;
			pc_sf_cols = <1>;
			pc_sf_row_entries = <0>;
			pc_sf_percent = <100>;
			pc_sf_sf = <100>;
			rbatt_sf_rows = <28>;
			rbatt_sf_cols = <6>;
			rbatt_sf_percent = <100 95 90 85 80 75 70 65 60 55 50 45 40 35 30 25 20 15 10 9 8 7 6 5 4 3 2 1>;
			rbatt_sf_sf = <
			               1994 1403 632 139 97 82
			               1988 1401 633 139 97 82
			               1891 1354 636 138 97 82
			               1798 1309 636 140 99 84
			               1754 1277 642 143 101 85
			               1679 1235 678 151 105 87
			               1571 1104 617 161 110 90
			               1572 1090 559 175 117 94
			               1546 1078 555 170 124 100
			               1536 1056 541 139 110 94
			               1565 1065 533 127 95 83
			               1611 1108 542 126 96 84
			               1680 1170 573 130 98 86
			               1763 1252 628 133 103 90
			               1867 1356 640 133 104 88
			               1986 1470 637 131 95 83
			               2117 1582 729 129 95 82
			               2478 1666 838 125 96 82
			               4284 2219 873 130 94 83
			               4523 2376 928 131 96 84
			               4736 2539 994 134 96 85
			               5009 2708 1064 137 96 84
			               5297 2980 1165 139 97 84
			               5588 3195 1293 164 102 84
			               6081 3532 1520 310 212 127
			               6398 3726 1564 405 188 142
			               6607 3806 1516 439 163 107
			               7652 4680 1666 286 181 110
			              >;
			pc_temp_ocv_rows = <29>;
			pc_temp_ocv_cols = <6>;
			pc_temp_ocv_percent = <100 95 90 85 80 75 70 65 60 55 50 45 40 35 30 25 20 15 10 9 8 7 6 5 4 3 2 1>;
			pc_temp_ocv_ocv = <
			                   4389 4385 4381 4385 4366 4361
			                   4284 4288 4294 4321 4302 4297
			                   4210 4217 4227 4261 4243 4239
			                   4145 4155 4169 4203 4186 4182
			                   4092 4100 4116 4147 4130 4127
			                   4026 4044 4071 4095 4078 4074
			                   3948 3962 4002 4039 4029 4026
			                   3911 3921 3941 3988 3982 3981
			                   3869 3882 3902 3942 3939 3938
			                   3833 3844 3863 3891 3890 3891
			                   3812 3817 3831 3854 3851 3851
			                   3798 3802 3808 3828 3826 3826
			                   3786 3791 3794 3807 3806 3805
			                   3773 3779 3785 3790 3790 3788
			                   3762 3767 3774 3775 3773 3769
			                   3751 3754 3763 3760 3753 3742
			                   3738 3736 3747 3740 3734 3721
			                   3721 3720 3719 3714 3707 3694
			                   3693 3695 3696 3690 3682 3671
			                   3686 3691 3693 3688 3681 3670
			                   3678 3685 3690 3686 3680 3669
			                   3668 3676 3685 3683 3677 3666
			                   3655 3668 3677 3674 3672 3661
			                   3633 3650 3662 3649 3656 3642
			                   3613 3627 3640 3613 3625 3608
			                   3575 3585 3600 3569 3578 3561
			                   3499 3509 3531 3505 3510 3493
			                   3397 3406 3415 3388 3409 3393
			                   3200 3200 3200 3200 3200 3200
			                  >;
			vol_dec1=  <16>;
			pc_temp_ocv_ocv1 = <
			                   4373 4369 4365 4369 4350 4345
			                   4273 4277 4282 4307 4288 4283
			                   4201 4208 4218 4248 4230 4226
			                   4139 4146 4160 4191 4174 4170
			                   4086 4095 4110 4136 4120 4116
			                   4015 4031 4062 4086 4069 4065
			                   3945 3957 3993 4028 4020 4018
			                   3907 3917 3937 3982 3976 3974
			                   3865 3878 3897 3935 3932 3932
			                   3830 3841 3860 3885 3883 3884
			                   3811 3816 3828 3850 3848 3848
			                   3797 3801 3806 3825 3823 3823
			                   3785 3790 3793 3805 3804 3803
			                   3773 3779 3784 3789 3788 3787
			                   3761 3767 3774 3774 3772 3768
			                   3750 3753 3763 3759 3751 3740
			                   3737 3735 3746 3739 3733 3720
			                   3721 3720 3718 3713 3706 3693
			                   3692 3694 3695 3690 3682 3671
			                   3686 3690 3693 3688 3681 3670
			                   3678 3685 3690 3686 3680 3668
			                   3668 3676 3685 3683 3677 3666
			                   3654 3667 3677 3673 3672 3660
			                   3632 3649 3661 3647 3654 3641
			                   3612 3626 3639 3611 3624 3607
			                   3574 3584 3598 3566 3577 3559
			                   3497 3508 3530 3503 3508 3491
			                   3395 3404 3414 3386 3406 3391
			                   3200 3200 3200 3200 3200 3200
			                  >;
			vol_dec2=  <48>;
			pc_temp_ocv_ocv2 = <
			                   4341 4337 4333 4337 4318 4313
			                   4252 4255 4259 4278 4260 4255
			                   4183 4189 4199 4222 4204 4200
			                   4125 4130 4142 4167 4150 4146
			                   4073 4085 4100 4113 4098 4095
			                   3992 4006 4045 4068 4051 4046
			                   3937 3947 3973 4005 4002 4001
			                   3899 3909 3928 3969 3963 3961
			                   3856 3871 3888 3919 3918 3918
			                   3826 3834 3853 3874 3869 3870
			                   3809 3812 3823 3844 3841 3840
			                   3795 3799 3803 3821 3819 3818
			                   3784 3788 3791 3802 3800 3799
			                   3771 3777 3783 3786 3786 3784
			                   3760 3766 3772 3772 3769 3765
			                   3749 3752 3762 3757 3749 3737
			                   3736 3734 3744 3736 3730 3718
			                   3720 3718 3717 3710 3704 3691
			                   3691 3694 3695 3689 3682 3671
			                   3685 3690 3692 3688 3681 3670
			                   3676 3684 3689 3686 3679 3668
			                   3667 3675 3684 3682 3676 3665
			                   3652 3666 3676 3671 3670 3658
			                   3631 3648 3659 3642 3651 3636
			                   3610 3624 3637 3607 3620 3603
			                   3571 3581 3595 3562 3572 3555
			                   3495 3505 3526 3498 3504 3487
			                   3393 3402 3411 3382 3403 3388
			                   3200 3200 3200 3200 3200 3200
			                  >;
			vol_dec3=  <192>;
			pc_temp_ocv_ocv3 = <
			                   4197 4193 4189 4193 4174 4169
			                   4159 4163 4166 4155 4140 4134
			                   4113 4109 4117 4109 4094 4089
			                   4064 4075 4082 4069 4052 4046
			                   3983 3987 4022 4013 4009 4007
			                   3936 3942 3956 3979 3973 3971
			                   3900 3907 3922 3938 3936 3933
			                   3861 3871 3885 3894 3894 3893
			                   3831 3838 3853 3861 3858 3857
			                   3813 3815 3825 3837 3835 3834
			                   3799 3802 3806 3818 3816 3815
			                   3788 3792 3794 3801 3800 3798
			                   3777 3782 3785 3787 3787 3785
			                   3766 3771 3777 3774 3773 3768
			                   3756 3760 3767 3762 3755 3745
			                   3745 3745 3755 3746 3738 3726
			                   3732 3730 3735 3725 3718 3705
			                   3715 3713 3712 3697 3691 3680
			                   3687 3691 3693 3688 3681 3669
			                   3680 3686 3690 3685 3679 3668
			                   3671 3679 3686 3682 3677 3665
			                   3660 3671 3680 3674 3672 3660
			                   3643 3659 3669 3652 3658 3645
			                   3624 3640 3651 3622 3634 3617
			                   3602 3613 3626 3587 3599 3582
			                   3557 3566 3581 3543 3550 3532
			                   3483 3491 3511 3476 3483 3467
			                   3383 3390 3400 3367 3384 3371
			                   3200 3200 3200 3200 3200 3200
			                  >;
		};
};
