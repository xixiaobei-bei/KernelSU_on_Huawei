/* DO NOT EDIT - Automatically generated by python */
/ {
		sunwodalg_3300_10k_4350:sunwodalg_3300_10k_4350 {
			fcc = <3300>;
			default_rbatt_mohm = <100>;
			id_identify_min = <0>;
			id_identify_max = <751>;
			id_voltage_min = <496>;
			id_voltage_max = <553>;
			vbat_max = <4350>;
			temp_para = 
						"-32767","0","-1","0","4100","0",
						"0","5","-1","330","4350","0",
						"5","10","-1","990","4350","3",
						"10","45","-1","-1","4350","3",
						"45","50","-1","1155","4100","3",
						"50","32767","-1","0","4100","0";
			vbat_para = 
						"-32767","3400","-1","820","0",
						"3400","32767","-1","-1","0";
			segment_para = 
						"-32767","4150","3300","4208","50",
						"4150","4450","2310","4350","0";
			batt_brand = "sunwodalg";
			fcc_temp = <3351 3355 3353 3347 3345 3328>;
			fcc_sf_x = <0 100 200 300 400 500>;
			fcc_sf_y = <100 96 94 92 90 88>;
			fcc_sf_cols = <6>;
			pc_sf_rows = <1>;
			pc_sf_cols = <1>;
			pc_sf_row_entries = <0>;
			pc_sf_percent = <100>;
			pc_sf_sf = <100>;
			rbatt_sf_rows = <28>;
			rbatt_sf_cols = <6>;
			rbatt_sf_percent = <100 95 90 85 80 75 70 65 60 55 50 45 40 35 30 25 20 15 10 9 8 7 6 5 4 3 2 1>;
			rbatt_sf_sf = <
			               2242 1283 561 142 93 77
			               2239 1283 561 142 93 77
			               2104 1283 569 143 95 78
			               2095 1231 568 145 96 79
			               2026 1287 597 149 99 81
			               1759 1205 631 165 103 82
			               1720 1046 514 160 108 86
			               1695 1062 500 176 116 90
			               1695 1042 489 158 115 92
			               1740 1029 468 132 94 79
			               1816 1065 464 131 93 78
			               1919 1149 469 134 95 80
			               2041 1266 512 137 100 83
			               2157 1398 579 138 105 86
			               2259 1515 676 135 101 83
			               2345 1613 785 135 92 79
			               2435 1689 887 141 93 78
			               2539 1773 989 153 95 79
			               4147 1880 824 147 96 83
			               4375 1993 861 146 95 78
			               4637 2181 915 148 96 81
			               4872 2321 978 151 96 81
			               5084 2446 1060 154 96 80
			               5288 2614 1127 156 96 81
			               5629 2748 1170 161 100 83
			               5930 2950 1267 172 100 82
			               6389 3224 1439 194 103 84
			               7284 3811 1832 455 168 143
			              >;
			pc_temp_ocv_rows = <29>;
			pc_temp_ocv_cols = <6>;
			pc_temp_ocv_percent = <100 95 90 85 80 75 70 65 60 55 50 45 40 35 30 25 20 15 10 9 8 7 6 5 4 3 2 1>;
			pc_temp_ocv_ocv = <
			                   4335 4335 4333 4323 4319 4314
			                   4216 4241 4256 4258 4258 4256
			                   4137 4179 4197 4203 4203 4201
			                   4105 4113 4144 4150 4149 4147
			                   4063 4086 4096 4099 4098 4096
			                   3958 4028 4055 4058 4050 4048
			                   3912 3942 3975 3993 4000 4003
			                   3869 3904 3930 3960 3963 3962
			                   3836 3864 3890 3912 3916 3916
			                   3816 3828 3853 3869 3871 3871
			                   3801 3807 3823 3840 3842 3842
			                   3787 3794 3800 3819 3820 3819
			                   3775 3782 3789 3800 3802 3801
			                   3763 3770 3780 3784 3786 3784
			                   3751 3756 3770 3769 3768 3763
			                   3738 3743 3756 3755 3747 3736
			                   3723 3730 3737 3735 3726 3714
			                   3703 3715 3712 3709 3701 3689
			                   3677 3696 3693 3688 3681 3669
			                   3667 3688 3690 3686 3679 3668
			                   3657 3683 3686 3684 3678 3666
			                   3646 3675 3682 3681 3674 3663
			                   3630 3663 3676 3673 3666 3654
			                   3606 3644 3661 3649 3643 3630
			                   3577 3612 3628 3609 3604 3591
			                   3535 3567 3579 3555 3553 3542
			                   3477 3503 3511 3482 3485 3474
			                   3400 3419 3421 3389 3386 3378
			                   3200 3200 3200 3200 3200 3200
			                  >;
			vol_dec1=  <16>;
			pc_temp_ocv_ocv1 = <
			                   4319 4319 4317 4307 4303 4298
			                   4206 4231 4244 4245 4244 4241
			                   4133 4169 4187 4191 4190 4187
			                   4101 4110 4136 4139 4138 4135
			                   4051 4078 4090 4091 4088 4085
			                   3953 4017 4041 4045 4039 4039
			                   3908 3937 3968 3988 3993 3995
			                   3866 3900 3924 3952 3955 3954
			                   3834 3860 3885 3905 3909 3909
			                   3815 3826 3849 3865 3867 3866
			                   3800 3806 3821 3838 3839 3839
			                   3787 3793 3799 3816 3818 3817
			                   3774 3781 3788 3798 3800 3799
			                   3763 3769 3779 3783 3784 3782
			                   3751 3756 3769 3768 3766 3760
			                   3737 3743 3755 3753 3745 3734
			                   3723 3729 3736 3734 3725 3713
			                   3703 3714 3712 3708 3700 3688
			                   3676 3695 3692 3688 3681 3669
			                   3666 3687 3689 3686 3679 3668
			                   3657 3683 3686 3684 3677 3666
			                   3646 3675 3682 3680 3674 3662
			                   3630 3662 3676 3672 3665 3652
			                   3605 3643 3660 3648 3641 3627
			                   3576 3611 3627 3607 3602 3589
			                   3534 3566 3577 3553 3551 3539
			                   3476 3502 3509 3481 3483 3472
			                   3399 3418 3420 3387 3385 3376
			                   3200 3200 3200 3200 3200 3200
			                  >;
			vol_dec2=  <48>;
			pc_temp_ocv_ocv2 = <
			                   4287 4287 4285 4275 4271 4266
			                   4185 4211 4221 4219 4217 4213
			                   4126 4148 4168 4167 4165 4161
			                   4092 4103 4118 4117 4114 4111
			                   4028 4064 4077 4076 4067 4064
			                   3944 3993 4015 4019 4019 4020
			                   3900 3928 3955 3977 3980 3979
			                   3860 3891 3914 3937 3939 3938
			                   3831 3852 3876 3892 3893 3893
			                   3813 3822 3842 3857 3858 3858
			                   3798 3803 3815 3832 3833 3833
			                   3785 3791 3797 3812 3813 3812
			                   3773 3780 3787 3795 3797 3795
			                   3762 3767 3778 3780 3781 3778
			                   3750 3754 3768 3766 3763 3756
			                   3737 3742 3753 3751 3743 3731
			                   3722 3728 3734 3731 3722 3710
			                   3702 3713 3710 3705 3698 3686
			                   3675 3694 3692 3687 3680 3669
			                   3665 3686 3689 3686 3679 3667
			                   3656 3682 3685 3683 3677 3665
			                   3645 3673 3681 3680 3673 3661
			                   3628 3660 3674 3670 3664 3649
			                   3603 3640 3657 3644 3636 3622
			                   3575 3608 3623 3603 3597 3584
			                   3532 3562 3573 3549 3547 3534
			                   3474 3500 3506 3477 3479 3467
			                   3397 3415 3416 3384 3382 3373
			                   3200 3200 3200 3200 3200 3200
			                  >;
			vol_dec3=  <192>;
			pc_temp_ocv_ocv3 = <
			                   4143 4143 4141 4131 4127 4122
			                   4121 4115 4115 4105 4097 4090
			                   4089 4092 4087 4073 4057 4049
			                   4024 4046 4045 4021 4014 4011
			                   3945 3969 3976 3981 3980 3977
			                   3904 3922 3935 3949 3945 3940
			                   3865 3887 3901 3909 3906 3902
			                   3835 3851 3867 3871 3869 3867
			                   3816 3823 3838 3846 3845 3843
			                   3803 3805 3814 3826 3825 3823
			                   3790 3794 3798 3809 3809 3807
			                   3779 3783 3788 3794 3795 3793
			                   3767 3772 3780 3781 3781 3778
			                   3757 3760 3772 3769 3765 3758
			                   3745 3749 3760 3756 3747 3736
			                   3733 3736 3746 3742 3732 3719
			                   3717 3724 3724 3720 3711 3697
			                   3698 3709 3704 3696 3688 3677
			                   3669 3688 3689 3685 3678 3667
			                   3660 3683 3686 3683 3677 3665
			                   3650 3677 3682 3680 3673 3661
			                   3638 3666 3677 3672 3665 3651
			                   3619 3651 3665 3653 3644 3630
			                   3595 3628 3641 3620 3613 3600
			                   3564 3594 3604 3578 3573 3561
			                   3521 3548 3554 3525 3523 3512
			                   3465 3489 3491 3456 3458 3446
			                   3387 3402 3401 3368 3369 3358
			                   3200 3200 3200 3200 3200 3200
			                  >;
		};
};
