/* DO NOT EDIT - Automatically generated by python */
/ {
		scudsony_4000_110k_4400:scudsony_4000_110k_4400 {
			fcc = <4000>;
			default_rbatt_mohm = <100>;
			id_identify_min = <2281>;
			id_identify_max = <2786>;
			id_voltage_min = <2426>;
			id_voltage_max = <2631>;
			vbat_max = <4400>;
			temp_para = 
						"-32767","0","-1","0","4100","0",
						"0","5","-1","400","4400","0",
						"5","10","-1","1200","4400","3",
						"10","45","-1","-1","4400","3",
						"45","50","-1","1400","4100","3",
						"50","32767","-1","0","4100","0";
			vbat_para = 
						"-32767","3400","-1","820","0",
						"3400","32767","-1","-1","0";
			segment_para = 
						"-32767","4150","4000","4208","50",
						"4150","4450","2800","4400","0";
			batt_brand = "scudsony";
			fcc_temp = <3951 3975 3999 4041 4023 3997>;
			fcc_sf_x = <0 100 200 300 400 500>;
			fcc_sf_y = <100 96 94 92 90 88>;
			fcc_sf_cols = <6>;
			pc_sf_rows = <1>;
			pc_sf_cols = <1>;
			pc_sf_row_entries = <0>;
			pc_sf_percent = <100>;
			pc_sf_sf = <100>;
			rbatt_sf_rows = <28>;
			rbatt_sf_cols = <6>;
			rbatt_sf_percent = <100 95 90 85 80 75 70 65 60 55 50 45 40 35 30 25 20 15 10 9 8 7 6 5 4 3 2 1>;
			rbatt_sf_sf = <
			               1075 510 286 115 96 88
			               1075 510 286 115 96 88
			               1092 530 298 118 98 89
			               1088 542 311 123 100 91
			               1084 541 325 128 104 92
			               1118 557 333 135 107 94
			               1088 552 345 145 113 97
			               1110 519 313 154 121 102
			               1133 538 306 146 123 105
			               1152 552 306 127 106 94
			               1184 569 315 122 100 92
			               1215 585 325 124 102 93
			               1253 618 333 128 105 95
			               1327 656 353 132 109 98
			               1424 702 377 133 109 98
			               1564 754 407 130 105 95
			               1757 829 440 129 105 96
			               2028 962 487 131 105 96
			               3202 1189 504 130 106 97
			               3530 1318 519 130 105 97
			               3961 1463 551 132 107 98
			               4383 1627 600 137 108 99
			               4936 1831 659 140 108 99
			               5598 2119 708 137 108 97
			               6396 2448 803 139 108 98
			               7392 2953 953 144 110 101
			               8832 3757 1235 169 124 103
			               13890 5178 1779 325 218 203
			              >;
			pc_temp_ocv_rows = <29>;
			pc_temp_ocv_cols = <6>;
			pc_temp_ocv_percent = <100 95 90 85 80 75 70 65 60 55 50 45 40 35 30 25 20 15 10 9 8 7 6 5 4 3 2 1>;
			pc_temp_ocv_ocv = <
			                   4388 4386 4383 4376 4370 4363
			                   4309 4314 4315 4312 4308 4303
			                   4239 4252 4254 4252 4250 4246
			                   4171 4190 4194 4194 4192 4188
			                   4105 4128 4137 4137 4136 4133
			                   4054 4075 4080 4083 4082 4080
			                   3985 4019 4029 4033 4033 4031
			                   3933 3955 3967 3985 3987 3985
			                   3889 3913 3920 3935 3939 3939
			                   3849 3874 3880 3888 3890 3890
			                   3817 3840 3848 3854 3856 3855
			                   3788 3810 3820 3828 3829 3829
			                   3761 3790 3796 3806 3808 3807
			                   3740 3773 3780 3788 3791 3789
			                   3721 3759 3767 3771 3770 3765
			                   3705 3740 3752 3751 3746 3735
			                   3691 3715 3729 3730 3723 3711
			                   3673 3682 3691 3699 3693 3682
			                   3645 3649 3659 3673 3668 3658
			                   3633 3642 3654 3669 3665 3655
			                   3623 3636 3648 3665 3661 3650
			                   3608 3627 3642 3659 3655 3644
			                   3590 3614 3633 3648 3643 3630
			                   3567 3595 3614 3621 3616 3600
			                   3534 3558 3577 3578 3572 3556
			                   3485 3503 3522 3522 3516 3501
			                   3417 3430 3452 3449 3445 3431
			                   3324 3339 3364 3356 3351 3341
			                   3200 3200 3200 3200 3200 3200
			                  >;
			vol_dec1=  <16>;
			pc_temp_ocv_ocv1 = <
			                   4372 4370 4367 4360 4354 4347
			                   4296 4301 4301 4298 4294 4289
			                   4227 4239 4241 4239 4236 4232
			                   4159 4178 4183 4182 4179 4176
			                   4097 4118 4126 4126 4125 4121
			                   4043 4066 4071 4074 4073 4070
			                   3977 4008 4018 4025 4024 4022
			                   3928 3949 3960 3977 3979 3977
			                   3884 3908 3914 3928 3931 3930
			                   3845 3870 3876 3883 3885 3884
			                   3814 3836 3844 3850 3852 3851
			                   3786 3808 3817 3825 3827 3826
			                   3759 3788 3794 3804 3807 3805
			                   3739 3772 3779 3787 3789 3787
			                   3720 3758 3766 3770 3768 3762
			                   3705 3739 3751 3750 3744 3733
			                   3690 3714 3727 3728 3722 3709
			                   3672 3681 3690 3697 3692 3681
			                   3643 3648 3659 3672 3668 3657
			                   3632 3641 3654 3669 3665 3654
			                   3622 3635 3648 3664 3661 3650
			                   3606 3626 3642 3658 3654 3643
			                   3589 3613 3632 3647 3642 3629
			                   3566 3593 3613 3619 3613 3597
			                   3532 3556 3575 3576 3569 3554
			                   3484 3501 3520 3519 3514 3499
			                   3415 3428 3450 3447 3442 3429
			                   3323 3337 3363 3354 3350 3340
			                   3200 3200 3200 3200 3200 3200
			                  >;
			vol_dec2=  <48>;
			pc_temp_ocv_ocv2 = <
			                   4340 4338 4335 4328 4322 4315
			                   4269 4274 4274 4270 4265 4259
			                   4202 4215 4216 4213 4209 4204
			                   4136 4155 4160 4157 4155 4150
			                   4080 4100 4104 4104 4102 4098
			                   4021 4047 4054 4055 4053 4050
			                   3962 3987 3998 4008 4008 4005
			                   3916 3937 3945 3961 3964 3962
			                   3874 3897 3902 3912 3914 3914
			                   3838 3861 3867 3873 3874 3873
			                   3809 3829 3838 3844 3845 3844
			                   3781 3803 3812 3820 3822 3820
			                   3756 3785 3791 3801 3803 3801
			                   3736 3770 3777 3784 3786 3784
			                   3718 3755 3764 3767 3764 3757
			                   3703 3736 3749 3747 3741 3730
			                   3689 3711 3724 3726 3720 3707
			                   3671 3679 3687 3695 3689 3678
			                   3641 3646 3658 3672 3667 3657
			                   3631 3640 3652 3668 3664 3653
			                   3620 3633 3647 3663 3660 3649
			                   3604 3624 3640 3657 3653 3642
			                   3587 3611 3630 3644 3638 3626
			                   3563 3589 3609 3615 3608 3592
			                   3530 3551 3570 3571 3564 3549
			                   3480 3496 3515 3514 3508 3494
			                   3412 3424 3446 3443 3438 3425
			                   3321 3335 3360 3352 3347 3336
			                   3200 3200 3200 3200 3200 3200
			                  >;
			vol_dec3=  <192>;
			pc_temp_ocv_ocv3 = <
			                   4196 4194 4191 4184 4178 4171
			                   4150 4153 4153 4145 4138 4130
			                   4095 4106 4106 4099 4092 4085
			                   4049 4060 4061 4055 4050 4043
			                   3988 4009 4013 4014 4010 4004
			                   3942 3955 3963 3973 3971 3967
			                   3902 3918 3922 3930 3930 3926
			                   3865 3883 3886 3891 3890 3887
			                   3834 3853 3857 3860 3859 3857
			                   3808 3824 3833 3836 3836 3834
			                   3782 3803 3809 3816 3817 3815
			                   3759 3786 3792 3800 3801 3799
			                   3741 3772 3778 3785 3787 3783
			                   3724 3760 3767 3770 3768 3761
			                   3710 3744 3755 3754 3748 3736
			                   3696 3726 3738 3735 3728 3715
			                   3683 3698 3711 3713 3707 3695
			                   3664 3669 3673 3683 3677 3666
			                   3631 3639 3652 3667 3663 3652
			                   3621 3634 3647 3663 3659 3648
			                   3608 3626 3641 3657 3653 3642
			                   3593 3615 3633 3647 3641 3628
			                   3575 3600 3618 3625 3619 3601
			                   3549 3572 3589 3590 3583 3566
			                   3514 3530 3547 3545 3539 3522
			                   3465 3475 3494 3490 3486 3470
			                   3399 3407 3429 3423 3419 3405
			                   3312 3325 3347 3338 3335 3322
			                   3200 3200 3200 3200 3200 3200
			                  >;
		};
};
