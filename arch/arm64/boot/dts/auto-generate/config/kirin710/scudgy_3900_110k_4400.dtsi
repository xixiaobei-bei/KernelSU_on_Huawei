/* DO NOT EDIT - Automatically generated by python */
/ {
		scudgy_3900_110k_4400:scudgy_3900_110k_4400 {
			fcc = <3900>;
			default_rbatt_mohm = <100>;
			identify_type = "id_volt";
			id_identify_min = <2281>;
			id_identify_max = <2786>;
			id_voltage_min = <2426>;
			id_voltage_max = <2631>;
			vbat_max = <4400>;
			temp_para = 
						"-32767","0","-1","0","4100","0",
						"0","5","-1","390","4400","0",
						"5","10","-1","1170","4400","3",
						"10","45","-1","-1","4400","3",
						"45","50","-1","1365","4100","3",
						"50","32767","-1","0","4100","0";
			vbat_para = 
						"-32767","3400","-1","820","0",
						"3400","32767","-1","-1","0";
			segment_para = 
						"-32767","4150","3900","4208","50",
						"4150","4450","2730","4400","0";
			batt_brand = "scudgy";
			fcc_temp = <4002 4002 4000 4023 4009 3967>;
			fcc_sf_x = <0 100 200 300 400 500 600 700 800 1000 1500>;
			fcc_sf_y = <100 96 94 92 90 88 87 84 81 75 50>;
			fcc_sf_cols = <11>;
			pc_sf_rows = <1>;
			pc_sf_cols = <1>;
			pc_sf_row_entries = <0>;
			pc_sf_percent = <100>;
			pc_sf_sf = <100>;
			rbatt_sf_rows = <28>;
			rbatt_sf_cols = <6>;
			rbatt_sf_percent = <100 95 90 85 80 75 70 65 60 55 50 45 40 35 30 25 20 15 10 9 8 7 6 5 4 3 2 1>;
			rbatt_sf_sf = <
			               1925 1372 721 132 102 90
			               1921 1369 721 132 102 90
			               1742 1248 695 129 102 91
			               1623 1160 668 129 102 92
			               1525 1101 653 130 104 93
			               1485 1057 642 134 105 94
			               1367 999 637 143 109 96
			               1357 929 587 149 114 99
			               1349 922 575 157 122 104
			               1350 913 558 140 117 98
			               1356 911 554 123 101 93
			               1371 923 562 123 102 93
			               1412 951 581 126 104 95
			               1457 991 612 131 108 99
			               1519 1044 656 134 109 101
			               1597 1115 715 129 103 93
			               1697 1188 789 126 103 95
			               1826 1290 892 127 104 95
			               3109 1426 775 141 113 108
			               3319 1529 811 141 115 109
			               3552 1669 866 143 119 111
			               3819 1817 941 150 122 113
			               4105 2022 1033 155 122 113
			               4415 2202 1132 154 122 111
			               4705 2352 1209 164 130 121
			               5074 2617 1332 184 144 130
			               5525 2965 1538 210 160 134
			               6814 2797 1842 315 180 149
			              >;
			pc_temp_ocv_rows = <29>;
			pc_temp_ocv_cols = <6>;
			pc_temp_ocv_percent = <100 95 90 85 80 75 70 65 60 55 50 45 40 35 30 25 20 15 10 9 8 7 6 5 4 3 2 1>;
			pc_temp_ocv_ocv = <
			                   4400 4398 4395 4390 4386 4380
			                   4305 4313 4322 4332 4326 4319
			                   4230 4244 4256 4272 4267 4262
			                   4171 4182 4194 4214 4208 4203
			                   4111 4128 4140 4157 4151 4147
			                   4060 4079 4088 4103 4097 4093
			                   3976 4014 4035 4052 4046 4043
			                   3932 3948 3970 3997 3999 3996
			                   3893 3909 3924 3954 3954 3953
			                   3860 3872 3882 3903 3904 3900
			                   3833 3841 3847 3862 3861 3861
			                   3812 3818 3822 3835 3834 3833
			                   3796 3803 3804 3814 3813 3812
			                   3782 3790 3793 3796 3796 3794
			                   3768 3779 3783 3781 3778 3773
			                   3753 3764 3771 3762 3754 3743
			                   3737 3745 3752 3740 3733 3720
			                   3719 3722 3724 3712 3706 3694
			                   3699 3700 3697 3691 3683 3671
			                   3691 3695 3694 3689 3682 3670
			                   3683 3691 3691 3688 3680 3668
			                   3675 3685 3687 3685 3678 3666
			                   3663 3677 3680 3679 3673 3659
			                   3645 3660 3665 3655 3653 3638
			                   3614 3629 3633 3612 3616 3600
			                   3570 3578 3579 3554 3563 3549
			                   3501 3505 3505 3475 3494 3479
			                   3406 3407 3397 3361 3390 3378
			                   3200 3200 3200 3200 3200 3200
			                  >;
		};
};
