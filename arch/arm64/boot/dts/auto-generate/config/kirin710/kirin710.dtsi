/**
 * Note: any file.dtsi or node in this file will be compile into all config.dts
 *so, if your node or file.dtsi will not use on some products, please don't put it here
 */
/include/ "kirin710_spmi.dtsi"
/include/ "kirin710_hwspinlock.dtsi"
/include/ "kirin710_peri_dvfs_volt.dtsi"
/include/ "kirin710_pm_clk_monitor.dtsi"
/include/ "kirin710_ddr.dtsi"
/include/ "kirin710_bootdevice.dtsi"
/include/ "kirin710_mmc.dtsi"
/include/ "kirin710_ufs.dtsi"
/include/ "kirin710_ipc.dtsi"
/include/ "kirin710_ao_ipc.dtsi"
/include/ "kirin710_usb.dtsi"
/include/ "kirin710_ion.dtsi"
/include/ "kirin710_i2c.dtsi"
/include/ "kirin710_gpu.dtsi"
/include/ "kirin710_hw_vote.dtsi"
/include/ "kirin710_memory.dtsi"
/include/ "kirin710_efuse.dtsi"
/include/ "kirin710_earlymount.dtsi"
/include/ "kirin710_earlymount_huawei.dtsi"
/include/ "kirin710_qos.dtsi"
/include/ "kirin710_uart.dtsi"
/include/ "kirin710_spi.dtsi"
/include/ "kirin710_perfstat.dtsi"
/include/ "kirin710_mntn.dtsi"
/include/ "kirin710_jtag.dtsi"
/include/ "hisi_6555v200_pmic_spmi.dtsi"
/include/ "hisi_6555v200_pmic_mntn_spmi.dtsi"
/include/ "kirin710_syscounter.dtsi"
/include/ "kirin710_contexthub.dtsi"
/include/ "kirin710_vdec.dtsi"
/include/ "kirin710_venc.dtsi"
/include/ "kirin710_lowpm.dtsi"
/include/ "kirin710_pmu.dtsi"
/include/ "kirin710_camera3.dtsi"
/include/ "huawei-sensor.dtsi"
/include/ "kirin710_ddrflux.dtsi"
/include/ "kirin710_hisee.dtsi"
/include/ "fastboot_6555v200_mntn.dtsi"
/include/ "fastboot_pmic.dtsi"
/include/ "kirin710_bl31_kernel_share_mem.dtsi"
/include/ "kirin710_ivp.dtsi"
/include/ "kirin710_timekeeper.dtsi"
/include/ "kirin710_dmsspt.dtsi"
/include/ "kirin710_vowifi_proxy.dtsi"
/include/ "kirin710_secs.dtsi"
/include/ "kirin710_pmu_dump.dtsi"
/include/ "kirin710_hhee.dtsi"
/include/ "kirin710_hkip_atkinfo.dtsi"
/include/ "kirin710_subpmu.dtsi"
/include/ "kirin710_ads.dtsi"
/include/ "huawei_step_motor.dtsi"
/include/ "kirin710_pwm.dtsi"
/{

};
