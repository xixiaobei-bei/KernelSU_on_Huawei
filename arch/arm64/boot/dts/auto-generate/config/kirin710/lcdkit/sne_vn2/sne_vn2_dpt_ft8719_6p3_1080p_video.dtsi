/* Copyright (c) 2013, The Linux Foundation. All rights reserved.
 *
 * This program is free software; you can redistribute it and/or modify
 * it under the terms of the GNU General Public License version 2 and
 * only version 2 as published by the Free Software Foundation.
 *
 * This program is distributed in the hope that it will be useful,
 * but WITHOUT ANY WARRANTY; without even the implied warranty of
 * MERCHANTABILITY or FITNESS FOR A PARTICULAR PURPOSE.  See the
 * GNU General Public License for more details.
 */

/*-------------------------------------------------------------------------
 * This file is autogenerated file using gcdb parser. Please do not edit it.
 * Update input XML file to add a new entry or update variable in this file
 * VERSION = 1.1
 *-----------------------------------------------------------------------*/
&huawei_lcd_config {
	dsi_sne_vn2_dpt_ft8719_6p3_1080p_video: lcdkit_sne_vn2_dpt_ft8719_6p3_1080p_video {
		compatible = "dpt_ft8719_6p3_1080p_video";
		hw,lcdkit-panel-name = "DPT_FT8719 6.3' VIDEO TFT 1080 x 2340";
		hw,lcdkit-panel-model = "SNEM_100 600 0 6.3' 1080 x 2340";
		hw,lcdkit-mipi-clk-config-high = <600>;
		hw,lcdkit-mipi-clk-config-low = <562>;
		hw,lcdkit-mipi-clk-config-normal = <562>;
		hw,lcdkit-panel-type = <0x01>;
		hw,lcdkit-panel-xres = <1080>;
		hw,lcdkit-panel-yres = <2340>;
		hw,lcdkit-panel-width = <67>;
		hw,lcdkit-panel-height = <145>;
		hw,lcdkit-panel-on-command = <0x29 0x01 0x00 0x00 0x0a 0x00 0x02 0x00 0x00
0x29 0x01 0x00 0x00 0x0a 0x00 0x04 0xFF 0x87 0x19 0x01
0x29 0x01 0x00 0x00 0x0a 0x00 0x02 0x00 0x80
0x29 0x01 0x00 0x00 0x0a 0x00 0x03 0xFF 0x87 0x19
0x29 0x01 0x00 0x00 0x0a 0x00 0x02 0x00 0xE0
0x29 0x01 0x00 0x00 0x0a 0x00 0x02 0xC3 0x35
0x29 0x01 0x00 0x00 0x0a 0x00 0x02 0x00 0xE4
0x29 0x01 0x00 0x00 0x0a 0x00 0x02 0xC3 0x46
0x29 0x01 0x00 0x00 0x0a 0x00 0x02 0x00 0x00
0x29 0x01 0x00 0x00 0x0a 0x00 0x04 0xFF 0x00 0x00 0x00
0x29 0x01 0x00 0x00 0x0D 0x00 0x03 0x90 0x80 0x44
0x15 0x01 0x00 0x00 0x0a 0x00 0x02 0x51 0xFE
0x15 0x01 0x00 0x00 0x0D 0x00 0x02 0x53 0x24
0x15 0x01 0x00 0x00 0x0a 0x00 0x02 0x55 0x00
0x05 0x01 0x00 0x00 0x64 0x01 0x02 0x11 0x00
0x05 0x01 0x00 0x00 0x00 0x01 0x02 0x29 0x00>;
		hw,lcdkit-panel-on-command-state = "dsi_lp_mode";
		hw,lcdkit-panel-display-on-command = <0x05 0x01 0x00 0x00 0x14 0x01 0x02 0x29 0x00>;
		hw,lcdkit-panel-off-command = <0x05 0x01 0x00 0x00 0x14 0x01 0x02 0x28 0x00
				0x05 0x01 0x00 0x00 0x32 0x01 0x02 0x10 0x00>;
		hw,lcdkit-panel-off-command-state = "dsi_lp_mode";
		hw,lcdkit-panel-backlight-command = <0x15 0x01 0x00 0x00 0x00 0x00 0x02 0x51 0x00>;
		hw,lcdkit-panel-backlight-command-state = "dsi_lp_mode";
		hw,lcdkit-panel-cabc-off-command = <0x15 0x01 0x00 0x00 0x0a 0x00 0x02 0x55 0x00>;
		hw,lcdkit-panel-cabc-off-command-state = "dsi_lp_mode";
		hw,lcdkit-panel-cabc-ui-command = <0x15 0x01 0x00 0x00 0x0a 0x00 0x02 0x55 0x01
			0x15 0x01 0x00 0x00 0x0a 0x00 0x02 0x53 0x24>;
		hw,lcdkit-panel-cabc-ui-command-state = "dsi_lp_mode";
		hw,lcdkit-panel-cabc-still-command = <0x15 0x01 0x00 0x00 0x0a 0x00 0x02 0x55 0x02
			0x15 0x01 0x00 0x00 0x0a 0x00 0x02 0x53 0x2C>;
		hw,lcdkit-panel-cabc-still-command-state = "dsi_lp_mode";
		hw,lcdkit-panel-cabc-moving-command = <0x15 0x01 0x00 0x00 0x0a 0x00 0x02 0x55 0x03
			0x15 0x01 0x00 0x00 0x0a 0x00 0x02 0x53 0x2C>;
		hw,lcdkit-panel-cabc-moving-command-state = "dsi_lp_mode";
		hw,lcdkit-panel-cabc-support = <0>;
		hw,lcdkit-panel-se-support = <0>;
		hw,lcdkit-panel-se-off-command = <0x29 0x01 0x00 0x00 0x0A 0x00 0x03 0x90 0x00 0x44>;
		hw,lcdkit-panel-se-hd-command = <0x29 0x01 0x00 0x00 0x0A 0x00 0x03 0x90 0x80 0x44>;
		hw,lcdkit-panel-se-fhd-command = <0x29 0x01 0x00 0x00 0x0A 0x00 0x03 0x90 0x80 0x44>;
		hw,lcdkit-panel-cabc-switch-support = <1>;
		hw,lcdkit-panel-btb-support = <0>;
		hw,lcdkit-panel-btb-cfg-addr = <0xE896C920>;
		hw,lcdkit-panel-display-on-effect-command = <0x15 0x01 0x00 0x00 0x0a 0x00 0x02 0x55 0x81>;
		hw,lcdkit-panel-ce-support = <0>;
		hw,lcdkit-panel-dot-inversion-command = <0x29 0x01 0x00 0x00 0x0a 0x00 0x02 0x00 0x00
				0x29 0x01 0x00 0x00 0x0a 0x00 0x04 0xFF 0x87 0x19 0x01
				0x29 0x01 0x00 0x00 0x0a 0x00 0x02 0x00 0x80
				0x29 0x01 0x00 0x00 0x0a 0x00 0x03 0xFF 0x87 0x19
				0x29 0x01 0x00 0x00 0x0a 0x00 0x02 0x00 0xE6
				0x29 0x01 0x00 0x00 0x0a 0x00 0x02 0xC0 0x11
				0x29 0x01 0x00 0x00 0x0a 0x00 0x02 0x00 0x80
				0x29 0x01 0x00 0x00 0x0a 0x00 0x03 0xFF 0x00 0x00
				0x29 0x01 0x00 0x00 0x0a 0x00 0x02 0x00 0x00
				0x29 0x01 0x00 0x00 0x0a 0x00 0x04 0xFF 0x00 0x00 0x00>;
		hw,lcdkit-panel-dot-inversion-command-state = "dsi_lp_mode";
		hw,lcdkit-panel-column-inversion-command = <0x29 0x01 0x00 0x00 0x0a 0x00 0x02 0x00 0x00
				0x29 0x01 0x00 0x00 0x0a 0x00 0x04 0xFF 0x87 0x19 0x01
				0x29 0x01 0x00 0x00 0x0a 0x00 0x02 0x00 0x80
				0x29 0x01 0x00 0x00 0x0a 0x00 0x03 0xFF 0x87 0x19
				0x29 0x01 0x00 0x00 0x0a 0x00 0x02 0x00 0xE6
				0x29 0x01 0x00 0x00 0x0a 0x00 0x02 0xC0 0x00
				0x29 0x01 0x00 0x00 0x0a 0x00 0x02 0x00 0x80
				0x29 0x01 0x00 0x00 0x0a 0x00 0x03 0xFF 0x00 0x00
				0x29 0x01 0x00 0x00 0x0a 0x00 0x02 0x00 0x00
				0x29 0x01 0x00 0x00 0x0a 0x00 0x04 0xFF 0x00 0x00 0x00>;
		hw,lcdkit-panel-column-inversion-command-state = "dsi_lp_mode";
		hw,lcdkit-panel-inversion-support = <1>;
		hw,lcdkit-panel-forword-scan-command = <0x29 0x01 0x00 0x00 0x0a 0x00 0x02 0x00 0x00
				0x29 0x01 0x00 0x00 0x0a 0x00 0x04 0xFF 0x87 0x19 0x01
				0x29 0x01 0x00 0x00 0x0a 0x00 0x02 0x00 0x80
				0x29 0x01 0x00 0x00 0x0a 0x00 0x03 0xFF 0x87 0x19
				0x29 0x01 0x00 0x00 0x0a 0x00 0x02 0x00 0xE8
				0x29 0x01 0x00 0x00 0x0a 0x00 0x02 0xC0 0x40
				0x29 0x01 0x00 0x00 0x0a 0x00 0x02 0x00 0x80
				0x29 0x01 0x00 0x00 0x0a 0x00 0x03 0xFF 0x00 0x00
				0x29 0x01 0x00 0x00 0x0a 0x00 0x02 0x00 0x00
				0x29 0x01 0x00 0x00 0x0a 0x00 0x04 0xFF 0x00 0x00 0x00>;
		hw,lcdkit-panel-forword-scan-command-state = "dsi_lp_mode";
		hw,lcdkit-panel-revert-scan-command = <0x29 0x01 0x00 0x00 0x0a 0x00 0x02 0x00 0x00
				0x29 0x01 0x00 0x00 0x0a 0x00 0x04 0xFF 0x87 0x19 0x01
				0x29 0x01 0x00 0x00 0x0a 0x00 0x02 0x00 0x80
				0x29 0x01 0x00 0x00 0x0a 0x00 0x03 0xFF 0x87 0x19
				0x29 0x01 0x00 0x00 0x0a 0x00 0x02 0x00 0xE8
				0x29 0x01 0x00 0x00 0x0a 0x00 0x02 0xC0 0x10
				0x29 0x01 0x00 0x00 0x0a 0x00 0x02 0x00 0x80
				0x29 0x01 0x00 0x00 0x0a 0x00 0x03 0xFF 0x00 0x00
				0x29 0x01 0x00 0x00 0x0a 0x00 0x02 0x00 0x00
				0x29 0x01 0x00 0x00 0x0a 0x00 0x04 0xFF 0x00 0x00 0x00>;
		hw,lcdkit-panel-revert-scan-command-state = "dsi_lp_mode";
		hw,lcdkit-panel-scan-support = <0>;
		hw,lcdkit-panel-display-region-support = <0>;
		hw,lcdkit-panel-checksum-support = <0>;
		hw,lcdkit-panel-esd-reg-command = <0x06 0x01 0x00 0x00 0x0a 0x00 0x01 0x0a
			0x06 0x01 0x00 0x00 0x0a 0x00 0x01 0x0b
			0x06 0x01 0x00 0x00 0x0a 0x00 0x01 0x0d
			0x06 0x01 0x00 0x00 0x0a 0x00 0x01 0x0e
			0x06 0x01 0x00 0x00 0x0a 0x00 0x01 0xac>;
		hw,lcdkit-panel-esd-reg-command-state = "dsi_lp_mode";
		hw,lcdkit-panel-esd-value = <0x9c 0x00 0x00 0x00 0x20>;
		hw,lcdkit-panel-esd-support = <1>;
		hw,lcdkit-panel-check-reg-command = <0x06 0x01 0x00 0x00 0x0a 0x00 0x01 0x0a>;
		hw,lcdkit-panel-check-reg-value = <0x9c>;
		hw,lcdkit-panel-check-reg-command-state = "dsi_lp_mode";
		hw,lcdkit-panel-mipi-check-command = <0x06 0x01 0x00 0x00 0x0a 0x00 0x01 0x05>;
		hw,lcdkit-panel-mipi-check-value = <0x00>;
		hw,lcdkit-panel-mipi-check-command-state = "dsi_lp_mode";
		hw,lcdkit-panel-mipi-check-support = <1>;
		hw,lcdkit-panel-check-reg-support = <1>;
		hw,lcdkit-panel-check-on-value = <0x0a>;
		hw,lcdkit-panel-check-reg-expect-value = <0x9c>;
		hw,lcdkit-panel-check-reg-mask-value = <0xff>;
		hw,lcdkit-panel-bl-maxnit-command = <0x06 0x01 0x00 0x00 0x0a 0x00 0x01 0xf4>;
		hw,lcdkit-panel-bl-maxnit-command-state = <>;
		hw,lcdkit-panel-bl-befreadconfig = <0x29 0x01 0x00 0x00 0x0a 0x00 0x02 0x00 0x00
                            0x29 0x01 0x00 0x00 0x0a 0x00 0x04 0xff 0x87 0x19 0x01
                            0x29 0x01 0x00 0x00 0x0a 0x00 0x02 0x00 0x80
                            0x29 0x01 0x00 0x00 0x0a 0x00 0x03 0xff 0x87 0x19
                            0x15 0x01 0x00 0x00 0x0a 0x00 0x02 0x00 0x01>;
		hw,lcdkit-panel-bl-befreadconfig-state = <>;
		hw,lcdkit-panel-bl-aftreadconfig = <0x29 0x01 0x00 0x00 0x0a 0x00 0x02 0x00 0x80
                           0x29 0x01 0x00 0x00 0x0a 0x00 0x03 0xFF 0x00 0x00
                           0x29 0x01 0x00 0x00 0x0a 0x00 0x02 0x00 0x00
                           0x29 0x01 0x00 0x00 0x0a 0x00 0x04 0xFF 0x00 0x00 0x00>;
		hw,lcdkit-panel-bl-aftreadconfig-state = <>;
		hw,lcdkit-panel-brightness-color-uniform-support = <0>;
		hw,lcdkit-panel-dynamic-gamma-support = <0>;
		hw,lcdkit-panel-mipi-detect-support = <1>;
		hw,lcdkit-panel-dynamic-sram-check-support = <0>;
		hw,lcdkit-panel-fps-updt-support = <0>;
		hw,lcdkit-panel-check-reg-on-support = <1>;
		hw,lcdkit-panel-dis-on-cmds-delay-margin-support = <0>;
		hw,lcdkit-panel-ts-resume-ctrl-mode = <2>;
		hw,lcdkit-panel-dis-on-cmds-delay-margin-time = <102>;
		hw,lcdkit-panel-lptohs-mipi-check-support = <0>;
		hw,lcdkit-panel-acl-ctrl-support = <0>;
		hw,lcdkit-panel-hbm-ctrl-support = <0>;
		hw,lcdkit-panel-vr-support = <0>;
		hw,lcdkit-panel-current-detect-support = <0>;
		hw,lcdkit-panel-lv-detect-support = <0>;
		hw,lcdkit-panel-orientation = <1>;
		hw,lcdkit-panel-bpp = <0>;
		hw,lcdkit-panel-bgrfmt = <0>;
		hw,lcdkit-panel-bl-type = <4>;
		hw,lcdkit-panel-blmin = <100>;
		hw,lcdkit-panel-blmax = <7675>;
		hw,lcdkit-panel-idle2-lcd-reset-low = <0>;
		hw,lcdkit-panel-bl-def = <4000>;
		hw,lcdkit-panel-bl-maxnit = <470>;
		hw,lcdkit-panel-bl-v200 = <0>;
		hw,lcdkit-panel-bl-otm = <0>;
		hw,lcdkit-panel-getblmaxnit-type = <1>;
		hw,lcdkit-panel-cmd-type = <8>;
		hw,lcdkit-panel-ifbctype = <0>;
		hw,lcdkit-panel-frc-enable = <0>;
		hw,lcdkit-panel-esd-skip-mipi-check = <1>;
		hw,lcdkit-panel-pxl-clk = <192>;
		hw,lcdkit-panel-pxl-clk-div = <1>;
		hw,lcdkit-panel-tp-resume-nosync = <0>;
		hw,lcdkit-panel-dirt-updt-support = <0>;
		hw,lcdkit-is-hostprocessing = <0>;
		hw,lcdkit-host-info-all-in-ddic = <0>;
		hw,lcdkit-panel-dsi-upt-support = <1>;
		hw,lcdkit-panel-vsyn-ctr-type = <0>;
		hw,lcdkit-panel-bl-pwm-preci-no-convert = <1>;
		hw,lcdkit-panel-bl-pwm-preci-type = <1>;
		hw,lcdkit-panel-bl-ic-ctrl-type = <10>;
		hw,lcdkit-panel-bl-pwm-out-div-value = <0>;
		hw,lcdkit-panel-step-support = <1>;
		hw,lcdkit-panel-xcc-set-in-isr-support = <0>;
		hw,lcdkit-ldi-hsync-plr = <0>;
		hw,lcdkit-ldi-vsync-plr = <0>;
		hw,lcdkit-ldi-pixel-clk-plr = <0>;
		hw,lcdkit-ldi-data-en-plr = <0>;
		hw,lcdkit-ldi-dpi-a-overlap-size = <0>;
		hw,lcdkit-ldi-dpi-b-overlap-size = <0>;
		hw,lcdkit-sbl-stren-limit = <128>;
		hw,lcdkit-sbl-cal-a = <60>;
		hw,lcdkit-sbl-cal-b = <95>;
		hw,lcdkit-sbl-cal-c = <5>;
		hw,lcdkit-sbl-cal-d = <1>;
		hw,lcdkit-sbl-tf-ctl = <5>;
		hw,lcdkit-sbl-bl-min = <480>;
		hw,lcdkit-sbl-bl-max = <4096>;
		hw,lcdkit-sbl-bl-scale = <0xff>;
		hw,lcdkit-sbl-am-light-min = <14>;
		hw,lcdkit-sbl-filter-a = <1738>;
		hw,lcdkit-sbl-filter-b = <6>;
		hw,lcdkit-sbl-logo-left = <0>;
		hw,lcdkit-sbl-logo-top = <0>;
		hw,lcdkit-sbl-variance-intensity-space = <145>;
		hw,lcdkit-sbl-slope-max = <54>;
		hw,lcdkit-sbl-slope-min = <160>;
		hw,lcdkit-mipi-lane-nums = <3>;
		hw,lcdkit-mipi-color-mode = <5>;
		hw,lcdkit-mipi-vc = <0>;
		hw,lcdkit-mipi-dsi-bit-clk = <562>;
		hw,lcdkit-mipi-burst-mode = <2>;
		hw,lcdkit-mipi-max-esc-clk = <10>;
		hw,lcdkit-mipi-dsi-bit-clk-val-a = <567>;
		hw,lcdkit-mipi-dsi-bit-clk-val-b = <562>;
		hw,lcdkit-mipi-dsi-bit-clk-val-c = <0>;
		hw,lcdkit-mipi-dsi-bit-clk-val-d = <0>;
		hw,lcdkit-mipi-dsi-bit-clk-val-e = <0>;
		hw,lcdkit-mipi-dsi-bit-clk-upt = <562>;
		hw,lcdkit-mipi-rg-vcm-adjust = <1>;
		hw,lcdkit-mipi-rg-lptx-adjust = <0>;
		hw,lcdkit-mipi-rg-sri-adjust = <0>;
		hw,lcdkit-mipi-rg-vcm-clk-adjust = <0>;
		hw,lcdkit-mipi-rg-vcm-data-adjust = <0>;
		hw,lcdkit-mipi-non-continue-enable = <0>;
		hw,lcdkit-mipi-clk-post-adjust = <100>;
		hw,lcdkit-mipi-lp11_flag = <1>;
		hw,lcdkit-mipi-phy_update = <0>;
		hw,lcdkit-mipi-clk-pre-adjust = <0>;
		hw,lcdkit-mipi-clk-t-hs-prepare-adjust = <0>;
		hw,lcdkit-mipi-clk-t-lpx-adjust = <0>;
		hw,lcdkit-mipi-clk-t-hs-trail-adjust = <0>;
		hw,lcdkit-mipi-clk-t-hs-exit-adjust = <0>;
		hw,lcdkit-mipi-clk-t-hs-zero-adjust = <0>;
		hw,lcdkit-mipi-data-t-hs-trail-adjust = <0>;
		hw,lcdkit-mipi-phy-mode = <0>;
		hw,lcdkit-mipi-txoff-rxulps-enable = <0>;
		hw,lcdkit-blpwm-input-disable = <1>;
		hw,lcdkit-dirt-left-align = <2>;
		hw,lcdkit-dirt-right-align = <2>;
		hw,lcdkit-dirt-top-align = <2>;
		hw,lcdkit-dirt-bott-align = <2>;
		hw,lcdkit-dirt-width-align = <2>;
		hw,lcdkit-dirt-height-align = <2>;
		hw,lcdkit-dirt-width-min = <2>;
		hw,lcdkit-dirt-height-min = <2>;
		hw,lcdkit-dirt-top-start = <0xffff>;
		hw,lcdkit-dirt-bott-start = <0xffff>;
		hw,lcdkit-gpios = <&gpio4 4 0>,<&gpio4 5 0>,<&gpio4 7 0>,<&gpio1 7 0>;
		lcdio-vcc-supply = <&ldo4>;
		lcdanalog-vcc-supply = <&ldo17>;
		pinctrl-0 = <&gpio035_pmx_func &gpio045_pmx_func &gpio039_pmx_func &gpio209_pmx_func &gpio035_cfg_func &gpio045_cfg_func &gpio039_cfg_func &gpio209_cfg_func>;
		pinctrl-1 = <&gpio035_pmx_idle &gpio045_pmx_idle &gpio039_pmx_idle &gpio209_pmx_idle &gpio035_cfg_idle &gpio045_cfg_idle &gpio039_cfg_idle &gpio209_cfg_idle>;
		pinctrl-names = "default","idle";
		status = "disabled";
		hw,lcdkit-sbl-support = <0>;
		hw,lcdkit-gamma-support = <1>;
		hw,lcdkit-gmp-support = <1>;
		hw,lcdkit-color-temp-support = <1>;
		hw,lcdkit-color-temp-rectify-support = <0>;
		hw,lcdkit-comform-mode-support = <1>;
		hw,lcdkit-cinema-mode-support = <0>;
		hw,lcdkit-prefix-sharp-two-d-support = <1>;
		hw,lcdkit-xcc-support = <1>;
		hw,lcdkit-prefix-ce-support = <0>;
		hw,lcdkit-prefix-sharp-one-d-support = <0>;
		hw,lcdkit-acm-support = <0>;
		hw,lcdkit-smart-color-mode-support = <0>;
		hw,lcdkit-acm-ce-support = <0>;
		hw,lcdkit-acm-valid-num = <7>;
		hw,lcdkit-r_hh0 = <0x7f>;
		hw,lcdkit-r_lh0 = <0xe>;
		hw,lcdkit-r_hh1 = <0xbe>;
		hw,lcdkit-r_lh1 = <0x80>;
		hw,lcdkit-r_hh2 = <0xff>;
		hw,lcdkit-r_lh2 = <0xbf>;
		hw,lcdkit-r_hh3 = <0x1c0>;
		hw,lcdkit-r_lh3 = <0x100>;
		hw,lcdkit-r_hh4 = <0x27f>;
		hw,lcdkit-r_lh4 = <0x1c1>;
		hw,lcdkit-r_hh5 = <0x323>;
		hw,lcdkit-r_lh5 = <0x280>;
		hw,lcdkit-r_hh6 = <0x381>;
		hw,lcdkit-r_lh6 = <0x324>;
		hw,lcdkit-r_video_hh0 = <0x7f>;
		hw,lcdkit-r_video_lh0 = <0xe>;
		hw,lcdkit-r_video_hh1 = <0xbe>;
		hw,lcdkit-r_video_lh1 = <0x80>;
		hw,lcdkit-r_video_hh2 = <0xff>;
		hw,lcdkit-r_video_lh2 = <0xbf>;
		hw,lcdkit-r_video_hh3 = <0x1c0>;
		hw,lcdkit-r_video_lh3 = <0x100>;
		hw,lcdkit-r_video_hh4 = <0x27f>;
		hw,lcdkit-r_video_lh4 = <0x1c1>;
		hw,lcdkit-r_video_hh5 = <0x323>;
		hw,lcdkit-r_video_lh5 = <0x280>;
		hw,lcdkit-r_video_hh6 = <0x381>;
		hw,lcdkit-r_video_lh6 = <0x324>;
		hw,lcdkit-color-temp-rectify-r = <32768>;
		hw,lcdkit-color-temp-rectify-g = <32768>;
		hw,lcdkit-color-temp-rectify-b = <32768>;
		hw,lcdkit-hiace-support = <1>;
		hw,lcdkit-panel-effect-support = <0>;
		hw,lcdkit-arsr1p-sharpness-support = <1>;
		hw,lcdkit-iglobal-hist-black-pos = <16>;
		hw,lcdkit-iglobal-hist-white-pos = <240>;
		hw,lcdkit-iglobal-hist-black-weight = <51>;
		hw,lcdkit-iglobal-hist-white-weight = <51>;
		hw,lcdkit-iglobal-hist-zero-cut-ratio = <486>;
		hw,lcdkit-iglobal-hist-slope-cut-ratio = <410>;
		hw,lcdkit-imax-lcd-luminance = <500>;
		hw,lcdkit-imin-lcd-luminance = <3>;
		hw,lcdkit-cfg-name = "/product/etc/display/effect/algorithm/hdr_engine.xml";
		hw,lcdkit-effect-support-mode = <65537>;
		hw,lcdkit-bl-support-mode = <1>;
		hw,lcdkit-bl-enhance = <10000>;
		hw,lcdkit-bl-normal = <8000>;
		hw,lcdkit-delay-af-rst-off = <5>;
		hw,lcdkit-h-back-porch = <16>;
		hw,lcdkit-h-front-porch = <170>;
		hw,lcdkit-h-pulse-width = <6>;
		hw,lcdkit-v-back-porch = <54>;
		hw,lcdkit-v-pulse-width = <9>;
		hw,lcdkit-v-front-porch = <112>;
		hw,lcdkit-h-sync-skew = <0>;
		hw,lcdkit-non-check-ldi-porch = <1>;
		hw,lcdkit-lcd-type = <2>;
		hw,lcdkit-panel-pt-test-support = <1>;
		hw,lcdkit-mipi-clk-config-support = <1>;
		hw,lcdkit-panel-hkadc-support = <0>;
		hw,lcdkit-bias-power-ctrl-mode = <4>;
		hw,lcdkit-bl-gpio-ctrl-mode = <1>;
		hw,lcdkit-bl-gpio-suspend-disable = <1>;
		hw,lcdkit-iovcc-power-ctrl-mode = <1>;
		hw,lcdkit-vci-power-ctrl-mode = <16>;
		hw,lcdkit-vbat-power-ctrl-mode = <0>;
		hw,lcdkit-id0-gpio = <36>;
		hw,lcdkit-id1-gpio = <37>;
		hw,lcdkit-reset-gpio = <39>;
		hw,lcdkit-te-gpio = <15>;
		hw,lcdkit-vsp-gpio = <35>;
		hw,lcdkit-vsn-gpio = <45>;
		hw,lcdkit-iovcc-gpio = <0>;
		hw,lcdkit-vci-gpio = <0>;
		hw,lcdkit-bl-gpio = <209>;
		hw,lcdkit-vbat-gpio = <0>;
		hw,lcdkit-iovcc-on-is-need-reset = <0>;
		hw,lcdkit-vsn-on-is-need-reset = <1>;
		hw,lcdkit-lcdanalog-vcc = <3100000>;
		hw,lcdkit-lcdio-vcc = <1850000>;
		hw,lcdkit-lcd-bias = <5500000>;
		hw,lcdkit-lcd-vsp = <5500000>;
		hw,lcdkit-lcd-vsn = <5500000>;
		hw,lcdkit-lcd-rst-first-high = <6>;
		hw,lcdkit-lcd-rst-low = <1>;
		hw,lcdkit-lcd-rst-second-high = <15>;
		hw,lcdkit-delay-af-vci-on = <0>;
		hw,lcdkit-delay-af-iovcc-on = <11>;
		hw,lcdkit-delay-af-vbat-on = <0>;
		hw,lcdkit-delay-af-bias-on = <0>;
		hw,lcdkit-delay-af-vsp-on = <2>;
		hw,lcdkit-delay-af-vsn-on = <12>;
		hw,lcdkit-delay-af-lp11 = <5>;
		hw,lcdkit-delay-af-tp-reset = <0>;
		hw,lcdkit-tp-reset-before-lcd-reset = <1>;
		hw,lcdkit-delay-af-vsn-off = <5>;
		hw,lcdkit-delay-af-vsp-off = <5>;
		hw,lcdkit-delay-af-bias-off = <0>;
		hw,lcdkit-delay-af-vbat-off = <0>;
		hw,lcdkit-delay-af-iovcc-off = <3>;
		hw,lcdkit-delay-af-vci-off = <0>;
		hw,lcdkit-ulps-flag = <0>;
		hw_tps65132,lcdkit-bias-type = <0x06>;
		hw_tps65132,lcdkit-bias-vpos-reg = <0x00>;
		hw_tps65132,lcdkit-bias-vneg-reg = <0x01>;
		hw_tps65132,lcdkit-bias-vpos-val = <0x0f>;
		hw_tps65132,lcdkit-bias-vneg-val = <0x0f>;
		hw_tps65132,lcdkit-bias-vpos-mask = <0x1f>;
		hw_tps65132,lcdkit-bias-vneg-mask = <0x1f>;
		hw_tps65132,lcdkit-bias-state-reg = <0x03>;
		hw_tps65132,lcdkit-bias-state-val = <0x43>;
		hw_tps65132,lcdkit-bias-state-mask = <0x43>;
		hw_rt4801h,lcdkit-bias-type = <0x0c>;
		hw_rt4801h,lcdkit-bias-vpos-reg = <0x00>;
		hw_rt4801h,lcdkit-bias-vneg-reg = <0x01>;
		hw_rt4801h,lcdkit-bias-vpos-val = <0x0f>;
		hw_rt4801h,lcdkit-bias-vneg-val = <0x0f>;
		hw_rt4801h,lcdkit-bias-vpos-mask = <0x1f>;
		hw_rt4801h,lcdkit-bias-vneg-mask = <0x1f>;
		hw_rt4801h,lcdkit-bias-state-reg = <0x03>;
		hw_rt4801h,lcdkit-bias-state-val = <0x03>;
		hw_rt4801h,lcdkit-bias-state-mask = <0x43>;
		hw_lv52134a,lcdkit-bias-type = <0x04>;
		hw_lv52134a,lcdkit-bias-vpos-reg = <0x00>;
		hw_lv52134a,lcdkit-bias-vneg-reg = <0x01>;
		hw_lv52134a,lcdkit-bias-vpos-val = <0x0f>;
		hw_lv52134a,lcdkit-bias-vneg-val = <0x0f>;
		hw_lv52134a,lcdkit-bias-vpos-mask = <0x1f>;
		hw_lv52134a,lcdkit-bias-vneg-mask = <0x1f>;
		hw_lv52134a,lcdkit-bias-state-reg = <0x00>;
		hw_lv52134a,lcdkit-bias-state-val = <0x00>;
		hw_lv52134a,lcdkit-bias-state-mask = <0x00>;
    };
};