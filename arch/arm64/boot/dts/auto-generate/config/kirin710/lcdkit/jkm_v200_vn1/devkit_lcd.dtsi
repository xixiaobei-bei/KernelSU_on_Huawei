/*---------------------------------------------------------------------------
 * This file is autogenerated file using huawei LCD parser. Please do not edit it.
 * Update input XML file to add a new entry or update variable in this file
 * Parser location: vendor/huawei/chipset_common/devkit/lcdkit/tools 
 *---------------------------------------------------------------------------*/


/include/ "jkm_v200_vn1_auo_otm1901a_5p2_1080p_video_default_1.dtsi"
/include/ "jkm_v200_vn1_boe_nt36682a_6p5_1080p_video.dtsi"
/include/ "jkm_v200_vn1_boe_td4320_6p5_1080p_video.dtsi"
/include/ "jkm_v200_vn1_ebbg_nt36682a_6p5_1080p_video.dtsi"
/include/ "jkm_v200_vn1_ofilm_td4320_6p5_1080p_video.dtsi"
/include/ "jkm_v200_vn1_ofilm_td4330_6p5_1080p_cmd.dtsi"
/include/ "jkm_v200_vn1_tm_nt36682a_6p5_1080p_video.dtsi"
/include/ "jkm_v200_vn1_tm_td4320_6p5_1080p_video.dtsi"