/*---------------------------------------------------------------------------
 * This file is autogenerated file using huawei LCD parser. Please do not edit it.
 * Update input XML file to add a new entry or update variable in this file
 * Parser location: vendor/huawei/chipset_common/devkit/lcdkit/tools 
 *---------------------------------------------------------------------------*/


/include/ "jdn2_v2_auo_otm1901a_5p2_1080p_video_default_1.dtsi"
/include/ "jdn2_v2_boe_v2_nt51021_8p0_1200p_video.dtsi"
/include/ "jdn2_v2_truly_v2_nt51021_8p0_1200p_video.dtsi"