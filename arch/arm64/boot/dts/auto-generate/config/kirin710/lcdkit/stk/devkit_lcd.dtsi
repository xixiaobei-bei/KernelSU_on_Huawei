/*---------------------------------------------------------------------------
 * This file is autogenerated file using huawei LCD parser. Please do not edit it.
 * Update input XML file to add a new entry or update variable in this file
 * Parser location: vendor/huawei/chipset_common/devkit/lcdkit/tools 
 *---------------------------------------------------------------------------*/


/include/ "stk_auo_otm1901a_5p2_1080p_video_default_1.dtsi"
/include/ "stk_boe_nt36682a_6p59_1080p_video.dtsi"
/include/ "stk_boe_td4320_6p59_1080p_video.dtsi"
/include/ "stk_inx_nt36682a_6p59_1080p_video.dtsi"
/include/ "stk_tcl_nt36682a_6p59_1080p_video.dtsi"
/include/ "stk_tm_nt36682a_6p5_1080p_video.dtsi"
/include/ "stk_tm_td4321_6p59_1080p_video.dtsi"