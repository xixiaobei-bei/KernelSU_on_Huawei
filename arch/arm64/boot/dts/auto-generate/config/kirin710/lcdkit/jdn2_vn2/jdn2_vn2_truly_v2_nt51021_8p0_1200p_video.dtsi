/* Copyright (c) 2013, The Linux Foundation. All rights reserved.
 *
 * This program is free software; you can redistribute it and/or modify
 * it under the terms of the GNU General Public License version 2 and
 * only version 2 as published by the Free Software Foundation.
 *
 * This program is distributed in the hope that it will be useful,
 * but WITHOUT ANY WARRANTY; without even the implied warranty of
 * MERCHANTABILITY or FITNESS FOR A PARTICULAR PURPOSE.  See the
 * GNU General Public License for more details.
 */

/*-------------------------------------------------------------------------
 * This file is autogenerated file using gcdb parser. Please do not edit it.
 * Update input XML file to add a new entry or update variable in this file
 * VERSION = 1.1
 *-----------------------------------------------------------------------*/
&huawei_lcd_config {
	dsi_jdn2_vn2_truly_v2_nt51021_8p0_1200p_video: lcdkit_jdn2_vn2_truly_v2_nt51021_8p0_1200p_video {
		compatible = "truly_v2_nt51021_8p0_1200p_video";
		hw,lcdkit-panel-name = "TRULY_NT51021 V2 8P0 VIDEO TFT 1200 x 1920";
		hw,lcdkit-panel-type = <0x1>;
		hw,lcdkit-panel-xres = <1200>;
		hw,lcdkit-panel-yres = <1920>;
		hw,lcdkit-panel-width = <108>;
		hw,lcdkit-panel-height = <173>;
		hw,lcdkit-panel-on-command = <0x15 0x01 0x00 0x00 0x0A 0x00 0x02 0x8F 0xA5
				0x15 0x01 0x00 0x00 0x1E 0x01 0x02 0x01 0x00
				0x15 0x01 0x00 0x00 0x00 0x00 0x02 0x8F 0xA5
				0x15 0x01 0x00 0x00 0x00 0x00 0x02 0x83 0xAA
				0x15 0x01 0x00 0x00 0x00 0x00 0x02 0x84 0x11
				0x15 0x01 0x00 0x00 0x00 0x00 0x02 0xA9 0x4B
				0x15 0x01 0x00 0x00 0x0a 0x00 0x02 0x83 0xbb
				0x15 0x01 0x00 0x00 0x0a 0x00 0x02 0x84 0x22
				0x15 0x01 0x00 0x00 0x0a 0x00 0x02 0x90 0x00
				0x15 0x01 0x00 0x00 0x0a 0x00 0x02 0xA1 0xff
				0x15 0x01 0x00 0x00 0x0a 0x00 0x02 0xA2 0xfa
				0x15 0x01 0x00 0x00 0x0a 0x00 0x02 0xA3 0xf7
				0x15 0x01 0x00 0x00 0x0a 0x00 0x02 0xA4 0xf2
				0x15 0x01 0x00 0x00 0x0a 0x00 0x02 0xA5 0xeb
				0x15 0x01 0x00 0x00 0x0a 0x00 0x02 0xA6 0xe2
				0x15 0x01 0x00 0x00 0x0a 0x00 0x02 0xA7 0xdc
				0x15 0x01 0x00 0x00 0x0a 0x00 0x02 0xA8 0xd7
				0x15 0x01 0x00 0x00 0x0a 0x00 0x02 0xA9 0xd1
				0x15 0x01 0x00 0x00 0x0a 0x00 0x02 0xAA 0xcc
				0x15 0x01 0x00 0x00 0x0a 0x00 0x02 0xB4 0x48
				0x15 0x01 0x00 0x00 0x0a 0x00 0x02 0xB5 0x5f
				0x15 0x01 0x00 0x00 0x0a 0x00 0x02 0xB6 0x42
				0x15 0x01 0x00 0x00 0x0a 0x00 0x02 0xAD 0x03
				0x15 0x01 0x00 0x00 0x0a 0x00 0x02 0x9A 0x10
				0x15 0x01 0x00 0x00 0x0a 0x00 0x02 0x94 0x18
				0x15 0x01 0x00 0x00 0x0a 0x00 0x02 0x95 0x00
				0x15 0x01 0x00 0x00 0x0a 0x00 0x02 0x99 0x00
				0x15 0x01 0x00 0x00 0x0a 0x00 0x02 0x96 0x00
				0x15 0x01 0x00 0x00 0x0a 0x00 0x02 0x83 0x00
				0x15 0x01 0x00 0x00 0x0a 0x00 0x02 0x84 0x00
				0x15 0x01 0x00 0x00 0x0a 0x00 0x02 0x9F 0xfe
				0x15 0x01 0x00 0x00 0x00 0x00 0x02 0x8B 0x04
				0x15 0x01 0x00 0x00 0x00 0x00 0x02 0x96 0x07
				0x15 0x01 0x00 0x00 0x00 0x00 0x02 0x97 0x80
				0x05 0x01 0x00 0x00 0x0f 0x01 0x02 0x11 0x00>;
		hw,lcdkit-panel-on-command-state = "dsi_lp_mode";
		hw,lcdkit-panel-off-command = <0x15 0x01 0x00 0x00 0x46 0x01 0x02 0x10 0x00>;
		hw,lcdkit-panel-off-command-state = "dsi_hs_mode";
		hw,lcdkit-panel-backlight-command = <0x23 0x01 0x00 0x00 0x00 0x00 0x02 0x9F 0x00>;
		hw,lcdkit-panel-backlight-command-state = "dsi_lp_mode";
		hw,lcdkit-panel-cabc-off-command = <0x23 0x01 0x00 0x00 0x00 0x00 0x02 0x83 0xBB
				0x23 0x01 0x00 0x00 0x00 0x00 0x02 0x84 0x22
				0x23 0x01 0x00 0x00 0x00 0x00 0x02 0x90 0xC0>;
		hw,lcdkit-panel-cabc-off-command-state = "dsi_hs_mode";
		hw,lcdkit-panel-cabc-ui-command = <0x23 0x01 0x00 0x00 0x00 0x00 0x02 0x83 0xBB
				0x23 0x01 0x00 0x00 0x00 0x00 0x02 0x84 0x22
				0x23 0x01 0x00 0x00 0x00 0x00 0x02 0x90 0x00>;
		hw,lcdkit-panel-cabc-ui-command-state = "dsi_hs_mode";
		hw,lcdkit-panel-cabc-still-command = <0x23 0x01 0x00 0x00 0x00 0x00 0x02 0x83 0xBB
				0x23 0x01 0x00 0x00 0x00 0x00 0x02 0x84 0x22
				0x23 0x01 0x00 0x00 0x00 0x00 0x02 0x90 0x40>;
		hw,lcdkit-panel-cabc-still-command-state = "dsi_hs_mode";
		hw,lcdkit-panel-cabc-moving-command = <0x23 0x01 0x00 0x00 0x00 0x00 0x02 0x83 0xBB
				0x23 0x01 0x00 0x00 0x00 0x00 0x02 0x84 0x22
				0x23 0x01 0x00 0x00 0x00 0x00 0x02 0x90 0x00>;
		hw,lcdkit-panel-cabc-moving-command-state = "dsi_hs_mode";
		hw,lcdkit-panel-cabc-support = <1>;
		hw,lcdkit-panel-se-support = <0>;
		hw,lcdkit-panel-btb-support = <0>;
		hw,lcdkit-panel-ce-support = <0>;
		hw,lcdkit-panel-inversion-support = <0>;
		hw,lcdkit-panel-scan-support = <0>;
		hw,lcdkit-panel-display-region-command = <>;
		hw,lcdkit-panel-display-region-command-state = "dsi_lp_mode";
		hw,lcdkit-panel-display-region-support = <0>;
		hw,lcdkit-panel-checksum-support = <0>;
		hw,lcdkit-panel-esd-support = <0>;
		hw,lcdkit-panel-mipi-check-support = <0>;
		hw,lcdkit-panel-check-reg-support = <0>;
		hw,lcdkit-panel-brightness-color-uniform-support = <0>;
		hw,lcdkit-panel-dynamic-gamma-support = <0>;
		hw,lcdkit-panel-mipi-detect-command = <>;
		hw,lcdkit-panel-mipi-detect-value = <>;
		hw,lcdkit-panel-mipi-detect-mask = <>;
		hw,lcdkit-panel-mipi-detect-command-state = "dsi_lp_mode";
		hw,lcdkit-panel-mipi-detect-support = <0>;
		hw,lcdkit-panel-dynamic-sram-check-support = <0>;
		hw,lcdkit-panel-fps-updt-support = <0>;
		hw,lcdkit-panel-dis-on-cmds-delay-margin-support = <1>;
		hw,lcdkit-panel-ts-resume-ctrl-mode = <0>;
		hw,lcdkit-panel-dis-on-cmds-delay-margin-time = <100>;
		hw,lcdkit-panel-lptohs-mipi-check-support = <0>;
		hw,lcdkit-panel-acl-ctrl-support = <0>;
		hw,lcdkit-panel-hbm-ctrl-support = <0>;
		hw,lcdkit-panel-vr-support = <0>;
		hw,lcdkit-panel-current-detect-support = <0>;
		hw,lcdkit-panel-lv-detect-support = <0>;
		hw,lcdkit-panel-orientation = <1>;
		hw,lcdkit-panel-bpp = <0>;
		hw,lcdkit-panel-bgrfmt = <0>;
		hw,lcdkit-panel-bl-type = <4>;
		hw,lcdkit-panel-blmin = <75>;
		hw,lcdkit-panel-blmax = <7100>;
		hw,lcdkit-panel-idle2-lcd-reset-low = <0>;
		hw,lcdkit-panel-bl-def = <4000>;
		hw,lcdkit-panel-bl-maxnit = <530>;
		hw,lcdkit-panel-bl-v200 = <0>;
		hw,lcdkit-panel-bl-otm = <0>;
		hw,lcdkit-panel-getblmaxnit-type = <0>;
		hw,lcdkit-panel-cmd-type = <8>;
		hw,lcdkit-panel-ifbctype = <0>;
		hw,lcdkit-panel-frc-enable = <0>;
		hw,lcdkit-panel-esd-skip-mipi-check = <1>;
		hw,lcdkit-panel-pxl-clk = <160>;
		hw,lcdkit-panel-pxl-clk-div = <1>;
		hw,lcdkit-panel-tp-resume-nosync = <0>;
		hw,lcdkit-panel-dirt-updt-support = <0>;
		hw,lcdkit-is-hostprocessing = <0>;
		hw,lcdkit-host-info-all-in-ddic = <0>;
		hw,lcdkit-panel-dsi-upt-support = <1>;
		hw,lcdkit-panel-vsyn-ctr-type = <0>;
		hw,lcdkit-panel-bl-pwm-preci-no-convert = <0>;
		hw,lcdkit-panel-bl-pwm-preci-type = <2>;
		hw,lcdkit-panel-bl-ic-ctrl-type = <8>;
		hw,lcdkit-panel-bl-pwm-out-div-value = <0>;
		hw,lcdkit-panel-step-support = <1>;
		hw,lcdkit-panel-xcc-set-in-isr-support = <1>;
		hw,lcdkit-ldi-hsync-plr = <0>;
		hw,lcdkit-ldi-vsync-plr = <0>;
		hw,lcdkit-ldi-pixel-clk-plr = <0>;
		hw,lcdkit-ldi-data-en-plr = <0>;
		hw,lcdkit-ldi-dpi-a-overlap-size = <0>;
		hw,lcdkit-ldi-dpi-b-overlap-size = <0>;
		hw,lcdkit-sbl-stren-limit = <128>;
		hw,lcdkit-sbl-cal-a = <60>;
		hw,lcdkit-sbl-cal-b = <95>;
		hw,lcdkit-sbl-cal-c = <5>;
		hw,lcdkit-sbl-cal-d = <1>;
		hw,lcdkit-sbl-tf-ctl = <5>;
		hw,lcdkit-sbl-bl-min = <480>;
		hw,lcdkit-sbl-bl-max = <4096>;
		hw,lcdkit-sbl-bl-scale = <0xff>;
		hw,lcdkit-sbl-am-light-min = <14>;
		hw,lcdkit-sbl-filter-a = <1738>;
		hw,lcdkit-sbl-filter-b = <6>;
		hw,lcdkit-sbl-logo-left = <0>;
		hw,lcdkit-sbl-logo-top = <0>;
		hw,lcdkit-sbl-variance-intensity-space = <145>;
		hw,lcdkit-sbl-slope-max = <54>;
		hw,lcdkit-sbl-slope-min = <160>;
		hw,lcdkit-mipi-lane-nums = <3>;
		hw,lcdkit-mipi-color-mode = <5>;
		hw,lcdkit-mipi-vc = <0>;
		hw,lcdkit-mipi-dsi-bit-clk = <480>;
		hw,lcdkit-mipi-burst-mode = <2>;
		hw,lcdkit-mipi-max-esc-clk = <10>;
		hw,lcdkit-mipi-dsi-bit-clk-val-a = <500>;
		hw,lcdkit-mipi-dsi-bit-clk-val-b = <480>;
		hw,lcdkit-mipi-dsi-bit-clk-val-c = <0>;
		hw,lcdkit-mipi-dsi-bit-clk-val-d = <0>;
		hw,lcdkit-mipi-dsi-bit-clk-val-e = <0>;
		hw,lcdkit-mipi-dsi-bit-clk-upt = <480>;
		hw,lcdkit-mipi-rg-vcm-adjust = <5>;
		hw,lcdkit-mipi-rg-lptx-adjust = <0>;
		hw,lcdkit-mipi-rg-sri-adjust = <0>;
		hw,lcdkit-mipi-rg-vcm-clk-adjust = <0>;
		hw,lcdkit-mipi-rg-vcm-data-adjust = <0>;
		hw,lcdkit-mipi-non-continue-enable = <0>;
		hw,lcdkit-mipi-clk-post-adjust = <30>;
		hw,lcdkit-mipi-lp11_flag = <0>;
		hw,lcdkit-mipi-phy_update = <0>;
		hw,lcdkit-mipi-clk-pre-adjust = <0>;
		hw,lcdkit-mipi-clk-t-hs-prepare-adjust = <0>;
		hw,lcdkit-mipi-clk-t-lpx-adjust = <0>;
		hw,lcdkit-mipi-clk-t-hs-trail-adjust = <0>;
		hw,lcdkit-mipi-clk-t-hs-exit-adjust = <0>;
		hw,lcdkit-mipi-clk-t-hs-zero-adjust = <0>;
		hw,lcdkit-mipi-data-t-hs-trail-adjust = <0>;
		hw,lcdkit-mipi-phy-mode = <0>;
		hw,lcdkit-mipi-txoff-rxulps-enable = <0>;
		hw,lcdkit-dirt-left-align = <2>;
		hw,lcdkit-dirt-right-align = <2>;
		hw,lcdkit-dirt-top-align = <2>;
		hw,lcdkit-dirt-bott-align = <2>;
		hw,lcdkit-dirt-width-align = <2>;
		hw,lcdkit-dirt-height-align = <2>;
		hw,lcdkit-dirt-width-min = <2>;
		hw,lcdkit-dirt-height-min = <2>;
		hw,lcdkit-dirt-top-start = <0xffff>;
		hw,lcdkit-dirt-bott-start = <0xffff>;
		hw,lcdkit-gpios = <&gpio24 5 0>,<&gpio24 6 0>,<&gpio26 1 0>,<&gpio18 3 0>;
		lcdio-vcc-supply = <&ldo31>;
		lcdanalog-vcc-supply = <&ldo17>;
		pinctrl-0 = <&gpio036_pmx_func &gpio037_pmx_func &gpio209_pmx_func &gpio147_pmx_func &gpio036_cfg_func &gpio037_cfg_func &gpio209_cfg_func &gpio147_cfg_func>;
		pinctrl-1 = <&gpio036_pmx_idle &gpio037_pmx_idle &gpio209_pmx_idle &gpio147_pmx_idle &gpio036_cfg_idle &gpio037_cfg_idle &gpio209_cfg_idle &gpio147_cfg_idle>;
		pinctrl-names = "default","idle";
		status = "disabled";
		hw,lcdkit-sbl-support = <1>;
		hw,lcdkit-gamma-support = <1>;
		hw,lcdkit-gmp-support = <1>;
		hw,lcdkit-color-temp-support = <1>;
		hw,lcdkit-color-temp-rectify-support = <0>;
		hw,lcdkit-comform-mode-support = <1>;
		hw,lcdkit-cinema-mode-support = <0>;
		hw,lcdkit-prefix-sharp-two-d-support = <1>;
		hw,lcdkit-xcc-support = <1>;
		hw,lcdkit-prefix-ce-support = <0>;
		hw,lcdkit-prefix-sharp-one-d-support = <0>;
		hw,lcdkit-acm-support = <0>;
		hw,lcdkit-smart-color-mode-support = <0>;
		hw,lcdkit-acm-ce-support = <0>;
		hw,lcdkit-acm-valid-num = <7>;
		hw,lcdkit-r_hh0 = <0x7f>;
		hw,lcdkit-r_lh0 = <0x3ff>;
		hw,lcdkit-r_hh1 = <0xc2>;
		hw,lcdkit-r_lh1 = <0x80>;
		hw,lcdkit-r_hh2 = <0x1c0>;
		hw,lcdkit-r_lh2 = <0xc3>;
		hw,lcdkit-r_hh3 = <0x1fe>;
		hw,lcdkit-r_lh3 = <0x1c1>;
		hw,lcdkit-r_hh4 = <0x2fd>;
		hw,lcdkit-r_lh4 = <0x1ff>;
		hw,lcdkit-r_hh5 = <0x33f>;
		hw,lcdkit-r_lh5 = <0x2fe>;
		hw,lcdkit-r_hh6 = <0x37f>;
		hw,lcdkit-r_lh6 = <0x340>;
		hw,lcdkit-r_video_hh0 = <0x7f>;
		hw,lcdkit-r_video_lh0 = <0xe>;
		hw,lcdkit-r_video_hh1 = <0xbe>;
		hw,lcdkit-r_video_lh1 = <0x80>;
		hw,lcdkit-r_video_hh2 = <0xff>;
		hw,lcdkit-r_video_lh2 = <0xbf>;
		hw,lcdkit-r_video_hh3 = <0x1c0>;
		hw,lcdkit-r_video_lh3 = <0x100>;
		hw,lcdkit-r_video_hh4 = <0x27f>;
		hw,lcdkit-r_video_lh4 = <0x1c1>;
		hw,lcdkit-r_video_hh5 = <0x323>;
		hw,lcdkit-r_video_lh5 = <0x280>;
		hw,lcdkit-r_video_hh6 = <0x381>;
		hw,lcdkit-r_video_lh6 = <0x324>;
		hw,lcdkit-color-temp-rectify-r = <32768>;
		hw,lcdkit-color-temp-rectify-g = <32768>;
		hw,lcdkit-color-temp-rectify-b = <32768>;
		hw,lcdkit-hiace-support = <0>;
		hw,lcdkit-panel-effect-support = <0>;
		hw,lcdkit-arsr1p-sharpness-support = <0>;
		hw,lcdkit-iglobal-hist-black-pos = <16>;
		hw,lcdkit-iglobal-hist-white-pos = <240>;
		hw,lcdkit-iglobal-hist-black-weight = <51>;
		hw,lcdkit-iglobal-hist-white-weight = <51>;
		hw,lcdkit-iglobal-hist-zero-cut-ratio = <486>;
		hw,lcdkit-iglobal-hist-slope-cut-ratio = <410>;
		hw,lcdkit-imax-lcd-luminance = <500>;
		hw,lcdkit-imin-lcd-luminance = <3>;
		hw,lcdkit-cfg-name = "/product/etc/display/effect/algorithm/hdr_engine.xml";
		hw,lcdkit-effect-support-mode = <65537>;
		hw,lcdkit-bl-support-mode = <0>;
		hw,lcdkit-bl-enhance = <0>;
		hw,lcdkit-bl-normal = <0>;
		hw,lcdkit-delay-af-rst-off = <5>;
		hw,lcdkit-h-back-porch = <36>;
		hw,lcdkit-h-front-porch = <62>;
		hw,lcdkit-h-pulse-width = <2>;
		hw,lcdkit-v-back-porch = <24>;
		hw,lcdkit-v-pulse-width = <22>;
		hw,lcdkit-v-front-porch = <104>;
		hw,lcdkit-h-sync-skew = <0>;
		hw,lcdkit-lcd-type = <1>;
		hw,lcdkit-panel-pt-test-support = <0>;
		hw,lcdkit-mipi-clk-config-support = <0>;
		hw,lcdkit-panel-hkadc-support = <0>;
		hw,lcdkit-bias-power-ctrl-mode = <16>;
		hw,lcdkit-bl-power-ctrl-mode = <0>;
		hw,lcdkit-bl-gpio-ctrl-mode = <1>;
		hw,lcdkit-bl-gpio-suspend-disable = <0>;
		hw,lcdkit-iovcc-power-ctrl-mode = <1>;
		hw,lcdkit-vci-power-ctrl-mode = <16>;
		hw,lcdkit-vbat-power-ctrl-mode = <2>;
		hw,lcdkit-id0-gpio = <198>;
		hw,lcdkit-id1-gpio = <197>;
		hw,lcdkit-reset-gpio = <0>;
		hw,lcdkit-te-gpio = <15>;
		hw,lcdkit-vsp-gpio = <35>;
		hw,lcdkit-vsn-gpio = <45>;
		hw,lcdkit-iovcc-gpio = <0>;
		hw,lcdkit-vci-gpio = <0>;
		hw,lcdkit-bl-gpio = <209>;
		hw,lcdkit-vbat-gpio = <147>;
		hw,lcdkit-iovcc-on-is-need-reset = <0>;
		hw,lcdkit-vsn-on-is-need-reset = <0>;
		hw,lcdkit-lcdanalog-vcc = <3100000>;
		hw,lcdkit-lcdio-vcc = <3100000>;
		hw,lcdkit-lcd-bias = <5500000>;
		hw,lcdkit-lcd-vsp = <5500000>;
		hw,lcdkit-lcd-vsn = <5500000>;
		hw,lcdkit-lcd-rst-first-high = <0>;
		hw,lcdkit-lcd-rst-low = <0>;
		hw,lcdkit-lcd-rst-second-high = <0>;
		hw,lcdkit-delay-af-vci-on = <0>;
		hw,lcdkit-delay-af-iovcc-on = <0>;
		hw,lcdkit-delay-af-vbat-on = <31>;
		hw,lcdkit-delay-af-bias-on = <0>;
		hw,lcdkit-delay-af-vsp-on = <5>;
		hw,lcdkit-delay-af-vsn-on = <5>;
		hw,lcdkit-delay-af-lp11 = <5>;
		hw,lcdkit-delay-af-tp-reset = <0>;
		hw,lcdkit-tp-reset-before-lcd-reset = <0>;
		hw,lcdkit-delay-af-vsn-off = <5>;
		hw,lcdkit-delay-af-vsp-off = <5>;
		hw,lcdkit-delay-af-bias-off = <0>;
		hw,lcdkit-delay-af-vbat-off = <0>;
		hw,lcdkit-delay-af-iovcc-off = <500>;
		hw,lcdkit-delay-af-vci-off = <0>;
		hw,lcdkit-ulps-flag = <0>;
		hw_lm36923,lcdkit-bl-ic-level = <2047>;
		hw_lm36923,lcdkit-bl-ic-ctrl-mode = <0>;
		hw_lm36923,lcdkit-bl-ic-type = <0>;
		hw_lm36923,lcdkit-bl-ic-before-init-delay = <0>;
		hw_lm36923,lcdkit-bl-ic-init-delay = <0>;
		hw_lm36923,lcdkit-bl-ic-ovp-check = <1>;
		hw_lm36923,lcdkit-bl-ic-fake-lcd-ovp-check = <0>;
		hw_lm36923,lcdkit-bl-ic-init-cmd = <0x02 0x11 0x85 0xff
						0x01 0x13 0x7a 0xff
						0x01 0x10 0x0f 0x0f
						0x02 0x12 0xa3 0xff
						0x01 0x15 0x00 0xff
						0x01 0x16 0x00 0xff
						0x01 0x1e 0x04 0x0f>;
		hw_lm36923,lcdkit-bl-ic-num-of-init-cmd = <0x07>;
		hw_lm36923,lcdkit-bl-ic-bl-lsb-reg-cmd = <0x03 0x18 0x02 0x07>;
		hw_lm36923,lcdkit-bl-ic-bl-msb-reg-cmd = <0x08 0x19 0x66 0xff>;
		hw_lm36923,lcdkit-bl-ic-bl-enable-cmd = <0x01 0x10 0x0f 0x0f>;
		hw_lm36923,lcdkit-bl-ic-bl-disable-cmd = <0x01 0x10 0x00 0x00>;
		hw_lm36923,lcdkit-bl-ic-disable-device-cmd = <0x01 0x10 0x00 0x00>;
		hw_lm36923,lcdkit-bl-ic-fault-flag-cmd = <0x01 0x1f 0x00 0xff>;
		hw_lm36923,lcdkit-bl-ic-bias-disable-cmd = <0x01 0x00 0x00 0x00>;
		hw_lm36923,lcdkit-bl-ic-pull-down-vsp-cmd = <0x00 0x00 0x00 0x00>;
		hw_lm36923,lcdkit-bl-ic-pull-down-vsn-cmd = <0x00 0x00 0x00 0x00>;
		hw_lm36923,lcdkit-bl-ic-sec-enable-cmd = <0x00 0x00 0x00 0x00>;
		hw_lm36923,lcdkit-bl-ic-pull-down-boost-cmd = <0x00 0x00 0x00 0x00>;
		hw_lm36923,lcdkit-bl-ic-bias-enable-cmd = <0x01 0x00 0x00 0x00>;
		hw_lm36923,lcdkit-bl-ic-led-open-short-test = <1>;
		hw_lm36923,lcdkit-bl-ic-num-of-led = <3>;
		hw_lm36923,lcdkit-bl-ic-brt-ctrl-cmd = <0x01 0x11 0x00 0xff>;
		hw_lm36923,lcdkit-bl-ic-fault-ctrl-cmd = <0x01 0x1e 0x00 0xff>;
		hw_lm36923,lcdkit-bl-ic-hidden-reg-surpport = <0>;
		hw_lm36923,lcdkit-bl-ic-sec-reg-enable-cmd = <0x00 0x00 0x00 0x00>;
		hw_lm36923,lcdkit-bl-ic-sec-reg-disable-cmd = <0x00 0x00 0x00 0x00>;
		hw_lm36923,lcdkit-bl-ic-hidden-reg-cmd = <0x00 0x00 0x00 0x00>;
		hw_lm36923,lcdkit-bl-ic-hidden-reg-val-mask = <0>;
		hw_lm36923,lcdkit-bl-ic-suspend-disbright-support = <0>;
		hw_lm36923,lcdkit-bl-ic-bl-wq-support = <0>;
		hw_lm36923,lcdkit-bl-ic-bl-enahnce-support = <0>;
		hw_lm36923,lcdkit-bl-ic-pull-down-boost-support = <0>;
		hw_lm36923,lcdkit-bl-ic-pull-down-boost-delay = <0>;
		hw_lm36923,lcdkit-bl-ic-bl-lowpower-delay = <0>;
		hw_lm36923,lcdkit-bl-ic-bl-normal-level = <0>;
		hw_lm36923,lcdkit-bl-ic-bl-enhance-level = <0>;
		hw_lm36923,lcdkit-bl-ic-bl-enhance-hrdtimer-time = <0>;
		hw_lm36923,lcdkit-bl-ic-bl-normal-ovp-cmd = <0x00 0x00 0x00 0x00>;
		hw_lm36923,lcdkit-bl-ic-bl-normal-cur-ramp-cmd = <0x00 0x00 0x00 0x00>;
		hw_lm36923,lcdkit-bl-ic-bl-normal-boost-cur-cmd = <0x00 0x00 0x00 0x00>;
		hw_lm36923,lcdkit-bl-ic-bl-normal-sink-cmd = <0x00 0x00 0x00 0x00>;
		hw_lm36923,lcdkit-bl-ic-bl-enhance-ovp-cmd = <0x00 0x00 0x00 0x00>;
		hw_lm36923,lcdkit-bl-ic-bl-enhance-cur-ramp-cmd = <0x00 0x00 0x00 0x00>;
		hw_lm36923,lcdkit-bl-ic-bl-enhance-boost-cur-cmd = <0x00 0x00 0x00 0x00>;
		hw_lm36923,lcdkit-bl-ic-bl-enhance-sink-cmd = <0x00 0x00 0x00 0x00>;
		hw_lm36923,lcdkit-bl-ovp-bit = <0>;
		hw_lm36923,lcdkit-bl-ocp-bit = <0>;
		hw_lm36923,lcdkit-bl-tsd-bit = <0>;
		hw_mp3313,lcdkit-bl-ic-level = <2047>;
		hw_mp3313,lcdkit-bl-ic-ctrl-mode = <0>;
		hw_mp3313,lcdkit-bl-ic-type = <0>;
		hw_mp3313,lcdkit-bl-ic-before-init-delay = <0>;
		hw_mp3313,lcdkit-bl-ic-init-delay = <0>;
		hw_mp3313,lcdkit-bl-ic-ovp-check = <1>;
		hw_mp3313,lcdkit-bl-ic-fake-lcd-ovp-check = <0>;
		hw_mp3313,lcdkit-bl-ic-init-cmd = <0x01 0x11 0x82 0xff
						0x01 0x13 0x7a 0xff
						0x01 0x15 0x00 0xff
						0x01 0x16 0x00 0xff
						0x01 0x1e 0x4a 0xff
						0x01 0x10 0x0F 0x0f>;
		hw_mp3313,lcdkit-bl-ic-num-of-init-cmd = <0x06>;
		hw_mp3313,lcdkit-bl-ic-bl-lsb-reg-cmd = <0x03 0x18 0x02 0x07>;
		hw_mp3313,lcdkit-bl-ic-bl-msb-reg-cmd = <0x08 0x19 0x66 0xff>;
		hw_mp3313,lcdkit-bl-ic-bl-enable-cmd = <0x01 0x10 0x0f 0x0f>;
		hw_mp3313,lcdkit-bl-ic-bl-disable-cmd = <0x01 0x10 0x00 0xff>;
		hw_mp3313,lcdkit-bl-ic-disable-device-cmd = <0x01 0x10 0x00 0xff>;
		hw_mp3313,lcdkit-bl-ic-fault-flag-cmd = <0x01 0x1f 0x00 0xff>;
		hw_mp3313,lcdkit-bl-ic-bias-disable-cmd = <0x01 0x00 0x00 0x00>;
		hw_mp3313,lcdkit-bl-ic-pull-down-vsp-cmd = <0x00 0x00 0x00 0x00>;
		hw_mp3313,lcdkit-bl-ic-pull-down-vsn-cmd = <0x00 0x00 0x00 0x00>;
		hw_mp3313,lcdkit-bl-ic-sec-enable-cmd = <0x00 0x00 0x00 0x00>;
		hw_mp3313,lcdkit-bl-ic-pull-down-boost-cmd = <0x00 0x00 0x00 0x00>;
		hw_mp3313,lcdkit-bl-ic-bias-enable-cmd = <0x01 0x00 0x00 0x00>;
		hw_mp3313,lcdkit-bl-ic-led-open-short-test = <0>;
		hw_mp3313,lcdkit-bl-ic-num-of-led = <3>;
		hw_mp3313,lcdkit-bl-ic-brt-ctrl-cmd = <0x01 0x11 0x00 0xff>;
		hw_mp3313,lcdkit-bl-ic-fault-ctrl-cmd = <0x01 0x1e 0x00 0xff>;
		hw_mp3313,lcdkit-bl-ic-hidden-reg-surpport = <0>;
		hw_mp3313,lcdkit-bl-ic-sec-reg-enable-cmd = <0x00 0x00 0x00 0x00>;
		hw_mp3313,lcdkit-bl-ic-sec-reg-disable-cmd = <0x00 0x00 0x00 0x00>;
		hw_mp3313,lcdkit-bl-ic-hidden-reg-cmd = <0x00 0x00 0x00 0x00>;
		hw_mp3313,lcdkit-bl-ic-hidden-reg-val-mask = <0>;
		hw_mp3313,lcdkit-bl-ic-suspend-disbright-support = <0>;
		hw_mp3313,lcdkit-bl-ic-bl-wq-support = <0>;
		hw_mp3313,lcdkit-bl-ic-bl-enahnce-support = <0>;
		hw_mp3313,lcdkit-bl-ic-pull-down-boost-support = <0>;
		hw_mp3313,lcdkit-bl-ic-pull-down-boost-delay = <0>;
		hw_mp3313,lcdkit-bl-ic-bl-lowpower-delay = <0>;
		hw_mp3313,lcdkit-bl-ic-bl-normal-level = <0>;
		hw_mp3313,lcdkit-bl-ic-bl-enhance-level = <0>;
		hw_mp3313,lcdkit-bl-ic-bl-enhance-hrdtimer-time = <0>;
		hw_mp3313,lcdkit-bl-ic-bl-normal-ovp-cmd = <0x00 0x00 0x00 0x00>;
		hw_mp3313,lcdkit-bl-ic-bl-normal-cur-ramp-cmd = <0x00 0x00 0x00 0x00>;
		hw_mp3313,lcdkit-bl-ic-bl-normal-boost-cur-cmd = <0x00 0x00 0x00 0x00>;
		hw_mp3313,lcdkit-bl-ic-bl-normal-sink-cmd = <0x00 0x00 0x00 0x00>;
		hw_mp3313,lcdkit-bl-ic-bl-enhance-ovp-cmd = <0x00 0x00 0x00 0x00>;
		hw_mp3313,lcdkit-bl-ic-bl-enhance-cur-ramp-cmd = <0x00 0x00 0x00 0x00>;
		hw_mp3313,lcdkit-bl-ic-bl-enhance-boost-cur-cmd = <0x00 0x00 0x00 0x00>;
		hw_mp3313,lcdkit-bl-ic-bl-enhance-sink-cmd = <0x00 0x00 0x00 0x00>;
		hw_mp3313,lcdkit-bl-ovp-bit = <0>;
		hw_mp3313,lcdkit-bl-ocp-bit = <0>;
		hw_mp3313,lcdkit-bl-tsd-bit = <0>;
		hw_ktz8864,lcdkit-bl-ic-level = <2047>;
		hw_ktz8864,lcdkit-bl-ic-ctrl-mode = <0>;
		hw_ktz8864,lcdkit-bl-ic-type = <0>;
		hw_ktz8864,lcdkit-bl-ic-before-init-delay = <0>;
		hw_ktz8864,lcdkit-bl-ic-init-delay = <0>;
		hw_ktz8864,lcdkit-bl-ic-ovp-check = <0>;
		hw_ktz8864,lcdkit-bl-ic-fake-lcd-ovp-check = <0>;
		hw_ktz8864,lcdkit-bl-ic-init-cmd = <0x01 0x02 0x60 0xff
						0x01 0x03 0x82 0xff
						0x01 0x06 0x00 0xff
						0x01 0x07 0x00 0xff
						0x01 0x09 0x19 0xff
						0x01 0x0a 0x11 0xff
						0x01 0x0b 0x00 0xff
						0x01 0x0c 0x24 0xff
						0x01 0x0d 0x1E 0xff
						0x01 0x0e 0x1E 0xff
						0x01 0x10 0x46 0xff
						0x01 0x11 0x75 0xff
						0x01 0x08 0x17 0xff>;
		hw_ktz8864,lcdkit-bl-ic-num-of-init-cmd = <0x0D>;
		hw_ktz8864,lcdkit-bl-ic-bl-lsb-reg-cmd = <0x03 0x04 0x00 0x07>;
		hw_ktz8864,lcdkit-bl-ic-bl-msb-reg-cmd = <0x08 0x05 0x00 0xff>;
		hw_ktz8864,lcdkit-bl-ic-bl-enable-cmd = <0x01 0x08 0x17 0xff>;
		hw_ktz8864,lcdkit-bl-ic-bl-disable-cmd = <0x01 0x08 0x00 0xff>;
		hw_ktz8864,lcdkit-bl-ic-disable-device-cmd = <0x01 0x08 0x80 0xff>;
		hw_ktz8864,lcdkit-bl-ic-fault-flag-cmd = <0x00 0x0f 0x00 0xff>;
		hw_ktz8864,lcdkit-bl-ic-bias-disable-cmd = <0x02 0x09 0x00 0xff>;
		hw_ktz8864,lcdkit-bl-ic-pull-down-vsp-cmd = <0x00 0x00 0x00 0x00>;
		hw_ktz8864,lcdkit-bl-ic-pull-down-vsn-cmd = <0x00 0x00 0x00 0x00>;
		hw_ktz8864,lcdkit-bl-ic-sec-enable-cmd = <0x00 0x00 0x00 0x00>;
		hw_ktz8864,lcdkit-bl-ic-pull-down-boost-cmd = <0x00 0x00 0x00 0x00>;
		hw_ktz8864,lcdkit-bl-ic-bias-enable-cmd = <0x02 0x09 0x00 0x60>;
		hw_ktz8864,lcdkit-bl-ic-led-open-short-test = <0>;
		hw_ktz8864,lcdkit-bl-ic-num-of-led = <3>;
		hw_ktz8864,lcdkit-bl-ic-brt-ctrl-cmd = <0x00 0x00 0x00 0x00>;
		hw_ktz8864,lcdkit-bl-ic-fault-ctrl-cmd = <0x00 0x00 0x00 0x00>;
		hw_ktz8864,lcdkit-bl-ic-hidden-reg-surpport = <0>;
		hw_ktz8864,lcdkit-bl-ic-sec-reg-enable-cmd = <0x01 0x50 0x08 0xff>;
		hw_ktz8864,lcdkit-bl-ic-sec-reg-disable-cmd = <0x01 0x50 0x00 0xff>;
		hw_ktz8864,lcdkit-bl-ic-hidden-reg-cmd = <0x00 0x6a 0x00 0xff>;
		hw_ktz8864,lcdkit-bl-ic-hidden-reg-val-mask = <0x30>;
		hw_ktz8864,lcdkit-bl-ic-suspend-disbright-support = <1>;
		hw_ktz8864,lcdkit-bl-ic-bl-wq-support = <0>;
		hw_ktz8864,lcdkit-bl-ic-bl-enahnce-support = <0>;
		hw_ktz8864,lcdkit-bl-ic-pull-down-boost-support = <0>;
		hw_ktz8864,lcdkit-bl-ic-pull-down-boost-delay = <0>;
		hw_ktz8864,lcdkit-bl-ic-bl-lowpower-delay = <6>;
		hw_ktz8864,lcdkit-bl-ic-bl-normal-level = <1709>;
		hw_ktz8864,lcdkit-bl-ic-bl-enhance-level = <1869>;
		hw_ktz8864,lcdkit-bl-ic-bl-enhance-hrdtimer-time = <60>;
		hw_ktz8864,lcdkit-bl-ic-bl-normal-ovp-cmd = <0x01 0x02 0x60 0xff>;
		hw_ktz8864,lcdkit-bl-ic-bl-normal-cur-ramp-cmd = <0x01 0x03 0x82 0xff>;
		hw_ktz8864,lcdkit-bl-ic-bl-normal-boost-cur-cmd = <0x01 0x11 0x75 0xff>;
		hw_ktz8864,lcdkit-bl-ic-bl-normal-sink-cmd = <0x01 0x08 0x17 0xff>;
		hw_ktz8864,lcdkit-bl-ic-bl-enhance-ovp-cmd = <0x01 0x02 0x60 0xff>;
		hw_ktz8864,lcdkit-bl-ic-bl-enhance-cur-ramp-cmd = <0x01 0x03 0xad 0xff>;
		hw_ktz8864,lcdkit-bl-ic-bl-enhance-boost-cur-cmd = <0x01 0x11 0x76 0xff>;
		hw_ktz8864,lcdkit-bl-ic-bl-enhance-sink-cmd = <0x01 0x08 0x17 0xff>;
		hw_ktz8864,lcdkit-bl-ovp-bit = <0>;
		hw_ktz8864,lcdkit-bl-ocp-bit = <0>;
		hw_ktz8864,lcdkit-bl-tsd-bit = <0>;
		hw_lm36274,lcdkit-bl-ic-level = <2047>;
		hw_lm36274,lcdkit-bl-ic-ctrl-mode = <0>;
		hw_lm36274,lcdkit-bl-ic-type = <0>;
		hw_lm36274,lcdkit-bl-ic-before-init-delay = <0>;
		hw_lm36274,lcdkit-bl-ic-init-delay = <0>;
		hw_lm36274,lcdkit-bl-ic-ovp-check = <0>;
		hw_lm36274,lcdkit-bl-ic-fake-lcd-ovp-check = <0>;
		hw_lm36274,lcdkit-bl-ic-init-cmd = <0x01 0x02 0x60 0xff
						0x01 0x03 0x85 0xff
						0x01 0x06 0x00 0xff
						0x01 0x07 0x00 0xff
						0x01 0x09 0x19 0xff
						0x01 0x0a 0x11 0xff
						0x01 0x0b 0x00 0xff
						0x01 0x0c 0x24 0xff
						0x01 0x0d 0x1E 0xff
						0x01 0x0e 0x1E 0xff
						0x01 0x10 0x46 0xff
						0x01 0x11 0x75 0xff
						0x01 0x08 0x17 0xff>;
		hw_lm36274,lcdkit-bl-ic-num-of-init-cmd = <0x0D>;
		hw_lm36274,lcdkit-bl-ic-bl-lsb-reg-cmd = <0x03 0x04 0x00 0x07>;
		hw_lm36274,lcdkit-bl-ic-bl-msb-reg-cmd = <0x08 0x05 0x00 0xff>;
		hw_lm36274,lcdkit-bl-ic-bl-enable-cmd = <0x01 0x08 0x17 0xff>;
		hw_lm36274,lcdkit-bl-ic-bl-disable-cmd = <0x01 0x08 0x00 0xff>;
		hw_lm36274,lcdkit-bl-ic-disable-device-cmd = <0x01 0x08 0x80 0xff>;
		hw_lm36274,lcdkit-bl-ic-fault-flag-cmd = <0x00 0x0f 0x00 0xff>;
		hw_lm36274,lcdkit-bl-ic-bias-disable-cmd = <0x02 0x09 0x00 0xff>;
		hw_lm36274,lcdkit-bl-ic-pull-down-vsp-cmd = <0x00 0x00 0x00 0x00>;
		hw_lm36274,lcdkit-bl-ic-pull-down-vsn-cmd = <0x00 0x00 0x00 0x00>;
		hw_lm36274,lcdkit-bl-ic-sec-enable-cmd = <0x00 0x00 0x00 0x00>;
		hw_lm36274,lcdkit-bl-ic-pull-down-boost-cmd = <0x00 0x00 0x00 0x00>;
		hw_lm36274,lcdkit-bl-ic-bias-enable-cmd = <0x02 0x09 0x00 0xe0>;
		hw_lm36274,lcdkit-bl-ic-led-open-short-test = <0>;
		hw_lm36274,lcdkit-bl-ic-num-of-led = <3>;
		hw_lm36274,lcdkit-bl-ic-brt-ctrl-cmd = <0x00 0x00 0x00 0x00>;
		hw_lm36274,lcdkit-bl-ic-fault-ctrl-cmd = <0x00 0x00 0x00 0x00>;
		hw_lm36274,lcdkit-bl-ic-hidden-reg-surpport = <0>;
		hw_lm36274,lcdkit-bl-ic-sec-reg-enable-cmd = <0x01 0x50 0x08 0xff>;
		hw_lm36274,lcdkit-bl-ic-sec-reg-disable-cmd = <0x01 0x50 0x00 0xff>;
		hw_lm36274,lcdkit-bl-ic-hidden-reg-cmd = <0x00 0x6a 0x00 0xff>;
		hw_lm36274,lcdkit-bl-ic-hidden-reg-val-mask = <0x30>;
		hw_lm36274,lcdkit-bl-ic-suspend-disbright-support = <1>;
		hw_lm36274,lcdkit-bl-ic-bl-wq-support = <0>;
		hw_lm36274,lcdkit-bl-ic-bl-enahnce-support = <0>;
		hw_lm36274,lcdkit-bl-ic-pull-down-boost-support = <0>;
		hw_lm36274,lcdkit-bl-ic-pull-down-boost-delay = <0>;
		hw_lm36274,lcdkit-bl-ic-bl-lowpower-delay = <6>;
		hw_lm36274,lcdkit-bl-ic-bl-normal-level = <1709>;
		hw_lm36274,lcdkit-bl-ic-bl-enhance-level = <1869>;
		hw_lm36274,lcdkit-bl-ic-bl-enhance-hrdtimer-time = <60>;
		hw_lm36274,lcdkit-bl-ic-bl-normal-ovp-cmd = <0x01 0x02 0x60 0xff>;
		hw_lm36274,lcdkit-bl-ic-bl-normal-cur-ramp-cmd = <0x01 0x03 0x85 0xff>;
		hw_lm36274,lcdkit-bl-ic-bl-normal-boost-cur-cmd = <0x01 0x11 0x75 0xff>;
		hw_lm36274,lcdkit-bl-ic-bl-normal-sink-cmd = <0x01 0x08 0x17 0xff>;
		hw_lm36274,lcdkit-bl-ic-bl-enhance-ovp-cmd = <0x01 0x02 0x60 0xff>;
		hw_lm36274,lcdkit-bl-ic-bl-enhance-cur-ramp-cmd = <0x01 0x03 0xad 0xff>;
		hw_lm36274,lcdkit-bl-ic-bl-enhance-boost-cur-cmd = <0x01 0x11 0x76 0xff>;
		hw_lm36274,lcdkit-bl-ic-bl-enhance-sink-cmd = <0x01 0x08 0x17 0xff>;
		hw_lm36274,lcdkit-bl-ovp-bit = <0>;
		hw_lm36274,lcdkit-bl-ocp-bit = <0>;
		hw_lm36274,lcdkit-bl-tsd-bit = <0>;
    };
};