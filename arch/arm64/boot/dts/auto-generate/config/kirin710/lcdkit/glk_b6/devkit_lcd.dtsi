/*---------------------------------------------------------------------------
 * This file is autogenerated file using huawei LCD parser. Please do not edit it.
 * Update input XML file to add a new entry or update variable in this file
 * Parser location: vendor/huawei/chipset_common/devkit/lcdkit/tools 
 *---------------------------------------------------------------------------*/


/include/ "glk_b6_auo_td4320_6p4_1080p_video.dtsi"
/include/ "glk_b6_boe_nt36682a_6p4_1080p_video.dtsi"
/include/ "glk_b6_boe_td4320_6p4_1080p_video.dtsi"
/include/ "glk_b6_ctc_nt36682a_6p4_1080p_video.dtsi"
/include/ "glk_b6_tm_td4320_6p4_1080p_video.dtsi"