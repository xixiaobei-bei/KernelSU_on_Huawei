/*---------------------------------------------------------------------------
 * This file is autogenerated file using huawei LCD parser. Please do not edit it.
 * Update input XML file to add a new entry or update variable in this file
 * Parser location: vendor/huawei/chipset_common/devkit/lcdkit/tools 
 *---------------------------------------------------------------------------*/


/include/ "marp_boe_nt36682a_6p15_1080p_video.dtsi"
/include/ "marp_boe_td4320_6p15_1080p_video.dtsi"
/include/ "marp_cmi_nt36682a_6p15_1080p_video.dtsi"
/include/ "marp_jdi_td4320_6p15_1080p_video.dtsi"
/include/ "marp_tm_nt36682a_6p15_1080p_video.dtsi"
/include/ "marp_tm_td4320_6p15_1080p_video.dtsi"
/include/ "marp_tm_td4330_6p15_1080p_video.dtsi"