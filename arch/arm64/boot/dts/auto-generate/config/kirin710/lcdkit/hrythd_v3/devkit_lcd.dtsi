/*---------------------------------------------------------------------------
 * This file is autogenerated file using huawei LCD parser. Please do not edit it.
 * Update input XML file to add a new entry or update variable in this file
 * Parser location: vendor/huawei/chipset_common/devkit/lcdkit/tools 
 *---------------------------------------------------------------------------*/


/include/ "hrythd_v3_auo_nt36682a_6p21_1080p_video.dtsi"
/include/ "hrythd_v3_auo_otm1901a_5p2_1080p_video_default_1.dtsi"
/include/ "hrythd_v3_boe_nt36682a_6p21_1080p_video.dtsi"
/include/ "hrythd_v3_boe_td4320_6p21_1080p_video.dtsi"
/include/ "hrythd_v3_mutto_td4320_6p21_1080p_video.dtsi"
/include/ "hrythd_v3_tm_nt36682a_6p21_1080p_video.dtsi"
/include/ "hrythd_v3_tm_td4320_6p21_1080p_video.dtsi"
/include/ "hrythd_v3_tm_td4330_6p21_1080p_cmd.dtsi"