/* DO NOT EDIT - Automatically generated by python */
/ {
		nvtatl_3320_68k_4400:nvtatl_3320_68k_4400 {
			fcc = <3320>;
			default_rbatt_mohm = <100>;
			identify_type = "id_volt";
			id_identify_min = <1759>;
			id_identify_max = <2281>;
			id_voltage_min = <1956>;
			id_voltage_max = <2135>;
			vbat_max = <4400>;
			temp_para = 
						"-32767","0","-1","0","4100","0",
						"0","5","-1","332","4400","0",
						"5","10","-1","996","4400","3",
						"10","45","-1","-1","4400","3",
						"45","50","-1","1162","4100","3",
						"50","32767","-1","0","4100","0";
			vbat_para = 
						"-32767","3400","-1","820","0",
						"3400","32767","-1","-1","0";
			segment_para = 
						"-32767","4150","3320","4208","50",
						"4150","4450","2324","4400","0";
			batt_brand = "nvtatl";
			fcc_temp = <3339 3341 3344 3363 3355 3328>;
			fcc_sf_x = <0 100 200 300 400 500 600 700 800 1000 1500>;
			fcc_sf_y = <100 96 94 92 90 88 87 84 81 75 50>;
			fcc_sf_cols = <11>;
			pc_sf_rows = <1>;
			pc_sf_cols = <1>;
			pc_sf_row_entries = <0>;
			pc_sf_percent = <100>;
			pc_sf_sf = <100>;
			rbatt_sf_rows = <28>;
			rbatt_sf_cols = <6>;
			rbatt_sf_percent = <100 95 90 85 80 75 70 65 60 55 50 45 40 35 30 25 20 15 10 9 8 7 6 5 4 3 2 1>;
			rbatt_sf_sf = <
			               2162 1248 513 144 117 105
			               2161 1248 513 144 117 105
			               1995 1225 507 144 117 107
			               1859 1179 497 148 119 108
			               1773 1142 493 153 123 110
			               1735 1146 510 160 127 112
			               1571 1061 524 170 133 115
			               1555 1006 488 180 139 119
			               1558 999 458 190 150 128
			               1537 984 436 146 121 110
			               1554 981 429 139 117 108
			               1597 1005 436 143 118 108
			               1645 1062 443 148 124 111
			               1712 1126 473 154 130 117
			               1784 1174 515 158 133 118
			               1875 1301 572 150 120 109
			               1990 1419 637 145 118 109
			               2144 1543 717 147 118 109
			               2541 1433 678 161 131 110
			               2889 1341 621 155 127 120
			               3183 1493 659 158 132 122
			               3455 1652 708 160 130 120
			               3743 1829 761 158 133 116
			               4097 1979 836 158 129 116
			               4457 2115 883 163 130 118
			               4849 2289 976 170 133 122
			               5416 2631 1114 197 141 127
			               5919 2334 1416 376 170 139
			              >;
			pc_temp_ocv_rows = <29>;
			pc_temp_ocv_cols = <6>;
			pc_temp_ocv_percent = <100 95 90 85 80 75 70 65 60 55 50 45 40 35 30 25 20 15 10 9 8 7 6 5 4 3 2 1>;
			pc_temp_ocv_ocv = <
			                   4376 4373 4371 4365 4361 4355
			                   4285 4295 4303 4306 4303 4297
			                   4220 4234 4244 4249 4245 4241
			                   4162 4175 4187 4192 4189 4184
			                   4109 4120 4133 4137 4134 4130
			                   4062 4075 4085 4085 4082 4078
			                   3972 4004 4030 4036 4034 4030
			                   3929 3948 3971 3987 3987 3986
			                   3894 3909 3925 3945 3947 3946
			                   3854 3870 3882 3890 3891 3890
			                   3829 3835 3847 3856 3857 3856
			                   3811 3812 3822 3831 3832 3831
			                   3795 3799 3801 3811 3812 3810
			                   3782 3788 3789 3793 3795 3793
			                   3767 3778 3779 3778 3777 3774
			                   3753 3763 3769 3760 3753 3742
			                   3737 3746 3752 3739 3732 3720
			                   3721 3721 3723 3712 3706 3693
			                   3701 3697 3694 3690 3683 3671
			                   3695 3693 3691 3688 3682 3670
			                   3687 3689 3689 3686 3680 3668
			                   3678 3685 3685 3683 3677 3665
			                   3668 3678 3678 3673 3671 3656
			                   3650 3661 3662 3647 3650 3633
			                   3618 3627 3627 3602 3609 3592
			                   3571 3575 3574 3543 3555 3540
			                   3504 3503 3502 3464 3485 3471
			                   3404 3402 3398 3356 3384 3369
			                   3200 3200 3200 3200 3200 3200
			                  >;
		};
};
