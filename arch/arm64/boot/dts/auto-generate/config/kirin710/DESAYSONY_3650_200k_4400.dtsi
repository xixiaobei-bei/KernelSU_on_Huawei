/* DO NOT EDIT - Automatically generated by python */
/ {
		DESAYSONY_3650_200k_4400:DESAYSONY_3650_200k_4400 {
			fcc = <3650>;
			default_rbatt_mohm = <100>;
			identify_type = "id_volt";
			id_identify_min = <2786>;
			id_identify_max = <3312>;
			id_voltage_min = <2941>;
			id_voltage_max = <3167>;
			vbat_max = <4400>;
			temp_para = 
						"-32767","0","-1","0","4100","0",
						"0","5","-1","365","4400","0",
						"5","10","-1","1095","4400","3",
						"10","45","-1","-1","4400","3",
						"45","50","-1","1277","4100","3",
						"50","32767","-1","0","4100","0";
			vbat_para = 
						"-32767","3400","-1","820","0",
						"3400","32767","-1","-1","0";
			segment_para = 
						"-32767","4150","3650","4208","50",
						"4150","4450","2555","4400","0";
			batt_brand = "DESAYSONY";
			fcc_temp = <3769 3749 3760 3809 3786 3763>;
			fcc_sf_x = <0 100 200 300 400 500 600 700 800 1000 1500>;
			fcc_sf_y = <100 96 94 92 90 88 87 84 81 75 50>;
			fcc_sf_cols = <11>;
			pc_sf_rows = <1>;
			pc_sf_cols = <1>;
			pc_sf_row_entries = <0>;
			pc_sf_percent = <100>;
			pc_sf_sf = <100>;
			rbatt_sf_rows = <28>;
			rbatt_sf_cols = <6>;
			rbatt_sf_percent = <100 95 90 85 80 75 70 65 60 55 50 45 40 35 30 25 20 15 10 9 8 7 6 5 4 3 2 1>;
			rbatt_sf_sf = <
			               1223 695 378 160 141 140
			               1223 695 378 160 141 140
			               1237 714 390 163 143 140
			               1231 719 400 168 145 141
			               1226 723 411 172 148 142
			               1226 722 420 180 152 144
			               1216 713 427 189 157 147
			               1217 706 412 198 165 151
			               1219 711 399 194 169 155
			               1226 717 392 174 156 147
			               1246 725 394 164 146 141
			               1257 740 402 165 146 140
			               1299 764 411 169 148 142
			               1366 803 423 175 153 145
			               1451 855 444 178 152 145
			               1570 923 469 174 148 141
			               1753 1011 496 173 150 144
			               2072 1174 544 175 151 145
			               2589 1218 509 178 156 150
			               2857 1318 518 180 156 151
			               3332 1459 552 185 158 154
			               4034 1676 586 188 160 155
			               5109 1947 639 191 162 155
			               7055 2349 704 190 161 151
			               11830 2900 794 192 162 156
			               21659 3922 993 200 166 157
			               31923 6257 1342 210 172 159
			               42188 12366 2030 226 185 166
			              >;
			pc_temp_ocv_rows = <29>;
			pc_temp_ocv_cols = <6>;
			pc_temp_ocv_percent = <100 95 90 85 80 75 70 65 60 55 50 45 40 35 30 25 20 15 10 9 8 7 6 5 4 3 2 1>;
			pc_temp_ocv_ocv = <
			                   4387 4385 4383 4381 4379 4375
			                   4300 4305 4308 4309 4303 4299
			                   4233 4241 4245 4248 4241 4238
			                   4167 4179 4185 4188 4182 4178
			                   4105 4119 4127 4130 4125 4122
			                   4047 4060 4071 4076 4072 4069
			                   3992 4004 4019 4026 4023 4020
			                   3942 3952 3965 3979 3977 3976
			                   3896 3908 3917 3931 3932 3932
			                   3856 3870 3877 3885 3886 3885
			                   3826 3836 3844 3850 3850 3849
			                   3794 3809 3818 3824 3824 3823
			                   3771 3787 3797 3804 3804 3802
			                   3753 3771 3780 3787 3788 3785
			                   3737 3757 3767 3772 3769 3763
			                   3721 3741 3753 3753 3746 3735
			                   3702 3719 3731 3732 3725 3712
			                   3678 3687 3699 3703 3697 3685
			                   3644 3649 3659 3670 3665 3654
			                   3630 3641 3652 3665 3661 3650
			                   3616 3632 3647 3659 3655 3646
			                   3600 3622 3639 3651 3648 3639
			                   3580 3609 3630 3640 3637 3629
			                   3547 3591 3614 3616 3612 3603
			                   3494 3559 3583 3573 3570 3561
			                   3422 3502 3531 3516 3515 3508
			                   3348 3424 3457 3444 3444 3439
			                   3274 3316 3356 3353 3347 3345
			                   3200 3200 3200 3200 3200 3200
			                  >;
		};
};
