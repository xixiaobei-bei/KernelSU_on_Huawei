/* DO NOT EDIT - Automatically generated by python */
/ {
		scudliwinon_3900_68k_4400:scudliwinon_3900_68k_4400 {
			fcc = <3900>;
			default_rbatt_mohm = <100>;
			identify_type = "id_volt";
			id_identify_min = <1759>;
			id_identify_max = <2281>;
			id_voltage_min = <1956>;
			id_voltage_max = <2135>;
			vbat_max = <4400>;
			temp_para = 
						"-32767","0","-1","0","4100","0",
						"0","5","-1","390","4400","0",
						"5","10","-1","1170","4400","3",
						"10","45","-1","-1","4400","3",
						"45","50","-1","1365","4100","3",
						"50","32767","-1","0","4100","0";
			vbat_para = 
						"-32767","3400","-1","820","0",
						"3400","32767","-1","-1","0";
			segment_para = 
						"-32767","4150","3900","4208","50",
						"4150","4450","2730","4400","0";
			batt_brand = "scudliwinon";
			fcc_temp = <4073 4074 4073 4100 4077 4032>;
			fcc_sf_x = <0 100 200 300 400 500 600 700 800 1000 1500>;
			fcc_sf_y = <100 96 94 92 90 88 87 84 81 75 50>;
			fcc_sf_cols = <11>;
			pc_sf_rows = <1>;
			pc_sf_cols = <1>;
			pc_sf_row_entries = <0>;
			pc_sf_percent = <100>;
			pc_sf_sf = <100>;
			rbatt_sf_rows = <28>;
			rbatt_sf_cols = <6>;
			rbatt_sf_percent = <100 95 90 85 80 75 70 65 60 55 50 45 40 35 30 25 20 15 10 9 8 7 6 5 4 3 2 1>;
			rbatt_sf_sf = <
			               1630 724 328 143 131 121
			               1625 723 328 143 131 122
			               1502 718 325 144 131 122
			               1407 705 325 146 133 123
			               1326 704 331 147 133 125
			               1310 725 342 152 136 126
			               1200 703 368 160 139 127
			               1169 640 338 165 141 130
			               1172 652 332 176 152 135
			               1170 645 311 165 149 136
			               1186 653 305 146 132 124
			               1226 675 307 144 131 124
			               1281 718 312 146 132 125
			               1359 784 322 150 135 128
			               1454 878 344 152 138 127
			               1561 1016 383 148 134 125
			               1686 1200 440 147 133 128
			               1860 1398 527 150 135 128
			               2878 1215 438 152 136 131
			               3120 1338 459 153 138 133
			               3457 1500 482 158 140 136
			               3921 1689 507 164 144 139
			               4391 1892 551 167 145 138
			               5011 2141 596 168 144 135
			               5649 2513 632 182 150 145
			               6070 2849 678 198 164 156
			               6003 3202 756 224 180 157
			               3434 1883 899 281 195 175
			              >;
			pc_temp_ocv_rows = <29>;
			pc_temp_ocv_cols = <6>;
			pc_temp_ocv_percent = <100 95 90 85 80 75 70 65 60 55 50 45 40 35 30 25 20 15 10 9 8 7 6 5 4 3 2 1>;
			pc_temp_ocv_ocv = <
			                   4404 4401 4398 4392 4387 4380
			                   4301 4315 4325 4327 4320 4313
			                   4227 4249 4262 4265 4259 4253
			                   4168 4188 4202 4204 4199 4194
			                   4107 4132 4147 4147 4142 4136
			                   4062 4082 4094 4093 4087 4082
			                   3979 4017 4040 4042 4036 4032
			                   3925 3943 3969 3985 3988 3986
			                   3887 3907 3928 3946 3946 3943
			                   3851 3868 3885 3897 3898 3896
			                   3824 3835 3850 3855 3854 3852
			                   3807 3812 3823 3828 3827 3826
			                   3794 3798 3803 3807 3806 3805
			                   3782 3788 3789 3791 3790 3788
			                   3768 3777 3781 3778 3775 3767
			                   3752 3765 3772 3762 3755 3743
			                   3736 3745 3754 3743 3735 3721
			                   3720 3722 3725 3714 3708 3694
			                   3696 3696 3699 3690 3682 3669
			                   3690 3691 3696 3689 3681 3668
			                   3683 3685 3693 3687 3679 3667
			                   3675 3679 3689 3685 3677 3665
			                   3667 3670 3684 3678 3672 3659
			                   3646 3656 3671 3655 3655 3640
			                   3614 3626 3638 3612 3617 3602
			                   3570 3574 3583 3552 3564 3551
			                   3502 3501 3509 3475 3494 3481
			                   3426 3415 3400 3366 3389 3379
			                   3200 3200 3200 3200 3200 3200
			                  >;
		};
};
