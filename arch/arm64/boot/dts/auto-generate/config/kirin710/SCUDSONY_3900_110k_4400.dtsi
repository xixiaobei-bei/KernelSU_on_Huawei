/* DO NOT EDIT - Automatically generated by python */
/ {
		SCUDSONY_3900_110k_4400:SCUDSONY_3900_110k_4400 {
			fcc = <3900>;
			default_rbatt_mohm = <100>;
			identify_type = "id_volt";
			id_identify_min = <2281>;
			id_identify_max = <2786>;
			id_voltage_min = <2426>;
			id_voltage_max = <2631>;
			vbat_max = <4400>;
			temp_para = 
						"-32767","0","-1","0","4100","0",
						"0","5","-1","390","4400","0",
						"5","10","-1","1170","4400","3",
						"10","45","-1","-1","4400","3",
						"45","50","-1","1365","4100","3",
						"50","32767","-1","0","4100","0";
			vbat_para = 
						"-32767","3400","-1","820","0",
						"3400","32767","-1","-1","0";
			segment_para = 
						"-32767","4150","3900","4208","50",
						"4150","4450","2730","4400","0";
			batt_brand = "SCUDSONY";
			fcc_temp = <3981 3986 4000 4058 4043 4028>;
			fcc_sf_x = <0 100 200 300 400 500 600 700 800 1000 1500>;
			fcc_sf_y = <100 96 94 92 90 88 87 84 81 75 50>;
			fcc_sf_cols = <11>;
			pc_sf_rows = <1>;
			pc_sf_cols = <1>;
			pc_sf_row_entries = <0>;
			pc_sf_percent = <100>;
			pc_sf_sf = <100>;
			rbatt_sf_rows = <28>;
			rbatt_sf_cols = <6>;
			rbatt_sf_percent = <100 95 90 85 80 75 70 65 60 55 50 45 40 35 30 25 20 15 10 9 8 7 6 5 4 3 2 1>;
			rbatt_sf_sf = <
			               1387 673 343 134 106 98
			               1387 673 343 134 106 98
			               1383 688 353 137 106 96
			               1356 693 360 140 108 99
			               1352 694 366 145 111 100
			               1353 708 373 151 114 100
			               1306 684 379 158 118 103
			               1297 660 366 164 125 108
			               1287 660 352 157 126 112
			               1292 658 345 139 112 102
			               1320 664 347 135 106 97
			               1369 681 353 137 107 97
			               1431 719 362 140 110 98
			               1491 771 380 145 114 102
			               1572 830 406 147 113 101
			               1688 907 439 143 110 99
			               1881 1022 481 141 111 102
			               2299 1256 565 143 112 102
			               4275 1456 515 139 110 101
			               5069 1598 548 142 113 102
			               6122 1922 614 147 114 102
			               7446 2322 699 151 115 102
			               9892 2884 839 156 117 104
			               16119 3780 1022 153 115 103
			               31361 5407 1258 154 115 106
			               57304 8906 1663 201 127 138
			               102067 20134 2505 298 214 155
			               163630 40545 5027 170 150 116
			              >;
			pc_temp_ocv_rows = <29>;
			pc_temp_ocv_cols = <6>;
			pc_temp_ocv_percent = <100 95 90 85 80 75 70 65 60 55 50 45 40 35 30 25 20 15 10 9 8 7 6 5 4 3 2 1>;
			pc_temp_ocv_ocv = <
			                   4384 4382 4380 4379 4370 4363
			                   4285 4298 4302 4307 4300 4293
			                   4213 4233 4239 4246 4239 4232
			                   4143 4170 4177 4186 4180 4173
			                   4085 4108 4118 4128 4123 4117
			                   4033 4056 4063 4074 4070 4064
			                   3966 3997 4011 4024 4021 4015
			                   3916 3941 3958 3976 3975 3971
			                   3872 3897 3910 3927 3929 3927
			                   3834 3858 3870 3882 3882 3880
			                   3805 3824 3836 3848 3847 3844
			                   3783 3797 3810 3823 3823 3819
			                   3764 3777 3788 3803 3803 3798
			                   3742 3761 3773 3786 3787 3782
			                   3720 3746 3760 3770 3768 3760
			                   3699 3729 3745 3751 3745 3732
			                   3681 3705 3722 3729 3723 3709
			                   3655 3672 3688 3699 3695 3681
			                   3612 3633 3645 3668 3663 3649
			                   3599 3618 3636 3663 3658 3645
			                   3583 3606 3627 3657 3653 3640
			                   3557 3593 3617 3650 3646 3634
			                   3538 3576 3605 3640 3637 3623
			                   3509 3552 3589 3621 3614 3601
			                   3473 3522 3561 3582 3574 3561
			                   3438 3477 3514 3531 3521 3509
			                   3364 3412 3442 3468 3456 3444
			                   3276 3311 3336 3365 3359 3347
			                   3200 3200 3200 3200 3200 3200
			                  >;
		};
};
