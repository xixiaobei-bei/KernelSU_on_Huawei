/* DO NOT EDIT - Automatically generated by python */
/ {
		swdmurata_3900_39k_4400:swdmurata_3900_39k_4400 {
			fcc = <3900>;
			default_rbatt_mohm = <100>;
			identify_type = "id_volt";
			id_identify_min = <1235>;
			id_identify_max = <1759>;
			id_voltage_min = <1420>;
			id_voltage_max = <1562>;
			vbat_max = <4400>;
			temp_para = 
						"-32767","0","-1","0","4100","0",
						"0","5","-1","390","4400","0",
						"5","10","-1","1170","4400","3",
						"10","45","-1","-1","4400","3",
						"45","50","-1","1365","4100","3",
						"50","32767","-1","0","4100","0";
			vbat_para = 
						"-32767","3400","-1","820","0",
						"3400","32767","-1","-1","0";
			segment_para = 
						"-32767","4150","3900","4208","50",
						"4150","4450","2730","4400","0";
			batt_brand = "swdmurata";
			fcc_temp = <3978 4003 4025 4075 4042 4016>;
			fcc_sf_x = <0 100 200 300 400 500 600 700 800 1000 1500>;
			fcc_sf_y = <100 96 94 92 90 88 87 84 81 75 50>;
			fcc_sf_cols = <11>;
			pc_sf_rows = <1>;
			pc_sf_cols = <1>;
			pc_sf_row_entries = <0>;
			pc_sf_percent = <100>;
			pc_sf_sf = <100>;
			rbatt_sf_rows = <28>;
			rbatt_sf_cols = <6>;
			rbatt_sf_percent = <100 95 90 85 80 75 70 65 60 55 50 45 40 35 30 25 20 15 10 9 8 7 6 5 4 3 2 1>;
			rbatt_sf_sf = <
			               1184 681 355 130 98 86
			               1184 682 355 130 99 86
			               1193 685 360 132 101 88
			               1179 689 366 136 103 89
			               1180 684 374 140 105 90
			               1168 703 381 148 109 93
			               1133 680 383 157 114 95
			               1160 679 372 166 123 100
			               1159 677 365 162 127 104
			               1168 677 363 145 114 96
			               1177 670 366 135 102 90
			               1195 703 372 135 102 90
			               1218 723 380 139 104 91
			               1278 760 393 145 109 95
			               1352 787 413 149 109 94
			               1449 838 437 144 105 90
			               1605 943 468 145 106 94
			               1904 1108 524 145 108 94
			               2673 1250 510 155 115 98
			               2944 1323 546 161 114 102
			               3401 1485 573 165 116 102
			               3925 1751 610 172 121 100
			               5018 2111 666 178 123 106
			               6549 2492 720 178 125 105
			               9608 3337 816 185 130 114
			               18222 4726 947 198 137 119
			               36668 5527 1208 226 149 118
			               63166 10329 1972 309 177 140
			              >;
			pc_temp_ocv_rows = <29>;
			pc_temp_ocv_cols = <6>;
			pc_temp_ocv_percent = <100 95 90 85 80 75 70 65 60 55 50 45 40 35 30 25 20 15 10 9 8 7 6 5 4 3 2 1>;
			pc_temp_ocv_ocv = <
			                   4385 4384 4382 4381 4372 4367
			                   4299 4305 4311 4313 4304 4299
			                   4234 4241 4249 4252 4243 4238
			                   4167 4179 4187 4191 4183 4179
			                   4109 4116 4129 4133 4126 4122
			                   4049 4058 4073 4079 4073 4069
			                   3992 4002 4018 4028 4024 4020
			                   3942 3952 3964 3981 3979 3976
			                   3897 3906 3917 3933 3934 3932
			                   3859 3869 3877 3887 3887 3885
			                   3824 3835 3845 3852 3850 3848
			                   3797 3807 3819 3826 3825 3823
			                   3774 3786 3797 3806 3805 3802
			                   3756 3769 3780 3789 3789 3785
			                   3740 3754 3766 3773 3770 3763
			                   3722 3737 3751 3754 3747 3735
			                   3704 3713 3729 3733 3725 3713
			                   3678 3681 3695 3703 3698 3685
			                   3646 3651 3660 3671 3665 3653
			                   3634 3641 3653 3665 3660 3649
			                   3621 3630 3647 3659 3655 3645
			                   3607 3617 3639 3651 3648 3638
			                   3591 3602 3629 3639 3637 3627
			                   3569 3584 3614 3612 3613 3601
			                   3534 3555 3585 3569 3572 3561
			                   3488 3506 3532 3513 3519 3509
			                   3419 3435 3460 3436 3450 3441
			                   3324 3336 3351 3345 3351 3347
			                   3200 3200 3200 3200 3200 3200
			                  >;
		};
};
