/* DO NOT EDIT - Automatically generated by python */
/ {
		desaysony_3650_68k_4400:desaysony_3650_68k_4400 {
			fcc = <3650>;
			default_rbatt_mohm = <100>;
			identify_type = "id_volt";
			id_identify_min = <1759>;
			id_identify_max = <2281>;
			id_voltage_min = <1956>;
			id_voltage_max = <2135>;
			vbat_max = <4400>;
			temp_para = 
						"-32767","0","-1","0","4100","0",
						"0","5","-1","365","4400","0",
						"5","10","-1","1095","4400","3",
						"10","45","-1","-1","4400","3",
						"45","50","-1","1277","4100","3",
						"50","32767","-1","0","4100","0";
			vbat_para = 
						"-32767","3400","-1","820","0",
						"3400","32767","-1","-1","0";
			segment_para = 
						"-32767","4150","3650","4208","50",
						"4150","4450","2555","4400","0";
			batt_brand = "desaysony";
			fcc_temp = <3609 3620 3641 3684 3672 3656>;
			fcc_sf_x = <0 100 200 300 400 500 600 700 800 1000 1500>;
			fcc_sf_y = <100 96 94 92 90 88 87 84 81 75 50>;
			fcc_sf_cols = <11>;
			pc_sf_rows = <1>;
			pc_sf_cols = <1>;
			pc_sf_row_entries = <0>;
			pc_sf_percent = <100>;
			pc_sf_sf = <100>;
			rbatt_sf_rows = <28>;
			rbatt_sf_cols = <6>;
			rbatt_sf_percent = <100 95 90 85 80 75 70 65 60 55 50 45 40 35 30 25 20 15 10 9 8 7 6 5 4 3 2 1>;
			rbatt_sf_sf = <
			               1407 701 343 141 111 101
			               1407 701 343 141 111 101
			               1419 720 353 145 114 102
			               1399 721 365 149 116 103
			               1400 734 369 155 118 104
			               1374 749 389 161 122 106
			               1360 709 384 169 127 109
			               1348 709 371 176 134 114
			               1334 714 358 161 132 115
			               1344 715 352 143 114 102
			               1369 718 348 141 112 102
			               1424 736 351 143 113 102
			               1492 773 358 147 116 104
			               1558 818 373 153 121 108
			               1639 873 395 153 120 105
			               1754 938 424 148 114 103
			               1906 1027 451 147 116 105
			               2186 1228 504 148 116 106
			               3708 1741 671 150 118 107
			               4103 1778 572 150 119 109
			               4781 1652 557 151 119 108
			               6056 1876 610 154 121 108
			               8096 2276 669 155 122 109
			               11635 2966 782 154 119 114
			               20619 4043 950 156 119 152
			               37741 6038 1212 170 121 110
			               60657 11957 1723 341 172 130
			               104332 27588 3055 474 325 203
			              >;
			pc_temp_ocv_rows = <29>;
			pc_temp_ocv_cols = <6>;
			pc_temp_ocv_percent = <100 95 90 85 80 75 70 65 60 55 50 45 40 35 30 25 20 15 10 9 8 7 6 5 4 3 2 1>;
			pc_temp_ocv_ocv = <
			                   4350 4349 4348 4341 4335 4328
			                   4259 4272 4277 4277 4272 4266
			                   4190 4208 4216 4218 4213 4208
			                   4125 4146 4158 4160 4156 4152
			                   4069 4092 4100 4106 4102 4098
			                   4010 4043 4050 4055 4052 4048
			                   3957 3980 3998 4007 4005 4002
			                   3909 3931 3947 3961 3962 3960
			                   3865 3889 3902 3913 3916 3915
			                   3831 3851 3864 3870 3871 3869
			                   3801 3818 3833 3841 3841 3839
			                   3779 3793 3807 3818 3818 3816
			                   3761 3775 3788 3799 3799 3797
			                   3742 3760 3773 3783 3784 3781
			                   3722 3746 3760 3767 3765 3758
			                   3704 3730 3746 3747 3741 3729
			                   3683 3704 3723 3726 3721 3709
			                   3658 3673 3688 3697 3693 3681
			                   3616 3632 3645 3664 3661 3651
			                   3607 3624 3638 3660 3657 3646
			                   3596 3615 3632 3654 3651 3641
			                   3577 3602 3625 3646 3644 3635
			                   3556 3585 3613 3634 3632 3623
			                   3529 3566 3594 3608 3606 3597
			                   3493 3537 3563 3565 3564 3558
			                   3448 3481 3512 3509 3510 3504
			                   3391 3408 3440 3446 3441 3438
			                   3302 3322 3347 3363 3355 3349
			                   3200 3200 3200 3200 3200 3200
			                  >;
		};
};
