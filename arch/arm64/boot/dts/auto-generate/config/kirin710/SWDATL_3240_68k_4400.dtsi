/* DO NOT EDIT - Automatically generated by python */
/ {
		SWDATL_3240_68k_4400:SWDATL_3240_68k_4400 {
			fcc = <3240>;
			default_rbatt_mohm = <100>;
			identify_type = "id_volt";
			id_identify_min = <1759>;
			id_identify_max = <2281>;
			id_voltage_min = <1956>;
			id_voltage_max = <2135>;
			vbat_max = <4400>;
			temp_para = 
						"-32767","0","-1","0","4100","0",
						"0","5","-1","324","4400","0",
						"5","10","-1","972","4400","3",
						"10","45","-1","-1","4400","3",
						"45","50","-1","1134","4100","3",
						"50","32767","-1","0","4100","0";
			vbat_para = 
						"-32767","3400","-1","820","0",
						"3400","32767","-1","-1","0";
			segment_para = 
						"-32767","4150","3240","4208","50",
						"4150","4450","2268","4400","0";
			batt_brand = "SWDATL";
			fcc_temp = <3233 3239 3236 3253 3244 3217>;
			fcc_sf_x = <0 100 200 300 400 500 600 700 800 1000 1500>;
			fcc_sf_y = <100 96 94 92 90 88 87 84 81 75 50>;
			fcc_sf_cols = <11>;
			pc_sf_rows = <1>;
			pc_sf_cols = <1>;
			pc_sf_row_entries = <0>;
			pc_sf_percent = <100>;
			pc_sf_sf = <100>;
			rbatt_sf_rows = <28>;
			rbatt_sf_cols = <6>;
			rbatt_sf_percent = <100 95 90 85 80 75 70 65 60 55 50 45 40 35 30 25 20 15 10 9 8 7 6 5 4 3 2 1>;
			rbatt_sf_sf = <
			               2024 918 425 130 106 96
			               2024 918 425 130 106 96
			               1886 899 416 130 106 96
			               1733 884 404 132 108 97
			               1704 853 408 135 110 99
			               1646 888 412 140 113 100
			               1512 841 437 149 118 103
			               1498 786 403 159 124 107
			               1477 793 380 173 137 115
			               1469 777 365 135 112 100
			               1491 778 360 126 106 97
			               1538 792 361 128 107 98
			               1593 830 365 133 109 100
			               1657 882 383 137 114 103
			               1731 944 409 139 117 103
			               1822 1022 441 133 107 98
			               1948 1115 477 132 107 98
			               2139 1259 532 135 107 99
			               2502 1485 634 138 110 99
			               3194 1270 498 138 113 103
			               3718 1417 521 138 110 104
			               4221 1606 552 137 112 104
			               4774 1825 606 142 113 102
			               5411 2084 701 141 111 100
			               6288 2470 752 141 110 100
			               7358 2899 830 146 112 102
			               9029 3709 1046 152 116 102
			               14189 5638 1593 202 124 105
			              >;
			pc_temp_ocv_rows = <29>;
			pc_temp_ocv_cols = <6>;
			pc_temp_ocv_percent = <100 95 90 85 80 75 70 65 60 55 50 45 40 35 30 25 20 15 10 9 8 7 6 5 4 3 2 1>;
			pc_temp_ocv_ocv = <
			                   4388 4387 4384 4376 4371 4364
			                   4298 4314 4317 4317 4313 4306
			                   4232 4250 4256 4259 4255 4249
			                   4162 4192 4197 4201 4197 4192
			                   4120 4132 4143 4145 4142 4137
			                   4066 4089 4091 4091 4088 4083
			                   3981 4023 4040 4042 4039 4034
			                   3935 3957 3976 3992 3992 3990
			                   3892 3918 3928 3949 3950 3947
			                   3855 3878 3887 3893 3893 3892
			                   3830 3844 3853 3858 3858 3857
			                   3813 3818 3826 3832 3832 3831
			                   3798 3801 3804 3811 3811 3810
			                   3785 3790 3790 3793 3794 3792
			                   3772 3779 3780 3777 3777 3771
			                   3757 3767 3770 3759 3752 3741
			                   3739 3748 3752 3740 3732 3719
			                   3721 3722 3723 3713 3705 3692
			                   3699 3698 3694 3688 3681 3671
			                   3689 3691 3690 3686 3680 3668
			                   3680 3685 3687 3684 3678 3666
			                   3669 3678 3682 3681 3675 3663
			                   3654 3666 3672 3673 3668 3655
			                   3629 3646 3656 3652 3649 3632
			                   3593 3617 3624 3611 3610 3593
			                   3540 3566 3571 3557 3558 3542
			                   3472 3493 3499 3483 3490 3474
			                   3374 3387 3394 3378 3390 3376
			                   3200 3200 3200 3200 3200 3200
			                  >;
		};
};
