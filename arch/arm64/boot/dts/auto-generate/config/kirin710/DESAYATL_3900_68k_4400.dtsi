/* DO NOT EDIT - Automatically generated by python */
/ {
		DESAYATL_3900_68k_4400:DESAYATL_3900_68k_4400 {
			fcc = <3900>;
			default_rbatt_mohm = <100>;
			identify_type = "id_volt";
			id_identify_min = <1759>;
			id_identify_max = <2281>;
			id_voltage_min = <1956>;
			id_voltage_max = <2135>;
			vbat_max = <4400>;
			temp_para = 
						"-32767","0","-1","0","4100","0",
						"0","5","-1","390","4400","0",
						"5","10","-1","1170","4400","3",
						"10","45","-1","-1","4400","3",
						"45","50","-1","1365","4100","3",
						"50","32767","-1","0","4100","0";
			vbat_para = 
						"-32767","3400","-1","820","0",
						"3400","32767","-1","-1","0";
			segment_para = 
						"-32767","4150","3900","4208","50",
						"4150","4450","2730","4400","0";
			batt_brand = "DESAYATL";
			fcc_temp = <3911 3916 3919 3961 3940 3903>;
			fcc_sf_x = <0 100 200 300 400 500 600 700 800 1000 1500>;
			fcc_sf_y = <100 96 94 92 90 88 87 84 81 75 50>;
			fcc_sf_cols = <11>;
			pc_sf_rows = <1>;
			pc_sf_cols = <1>;
			pc_sf_row_entries = <0>;
			pc_sf_percent = <100>;
			pc_sf_sf = <100>;
			rbatt_sf_rows = <28>;
			rbatt_sf_cols = <6>;
			rbatt_sf_percent = <100 95 90 85 80 75 70 65 60 55 50 45 40 35 30 25 20 15 10 9 8 7 6 5 4 3 2 1>;
			rbatt_sf_sf = <
			               1870 1132 476 127 102 95
			               1870 1132 476 127 102 95
			               1713 1098 472 129 103 95
			               1588 1054 464 131 105 97
			               1540 1020 456 137 108 98
			               1482 1026 478 144 112 100
			               1362 918 480 152 117 103
			               1346 874 444 160 123 107
			               1321 860 426 161 130 114
			               1314 842 407 130 109 98
			               1336 844 402 123 102 95
			               1374 876 411 126 105 97
			               1425 921 432 132 109 100
			               1474 979 469 136 115 104
			               1540 1045 513 139 116 105
			               1617 1122 572 133 107 98
			               1726 1209 639 129 105 99
			               1860 1296 725 130 106 98
			               2232 1306 716 132 108 98
			               2760 1244 618 130 107 103
			               3057 1376 664 131 108 103
			               3279 1510 726 134 110 101
			               3498 1678 816 134 108 102
			               3728 1822 897 130 105 99
			               4022 1961 979 134 109 99
			               4303 2151 1070 138 107 102
			               4706 2438 1201 143 111 103
			               5283 2830 1438 222 121 108
			              >;
			pc_temp_ocv_rows = <29>;
			pc_temp_ocv_cols = <6>;
			pc_temp_ocv_percent = <100 95 90 85 80 75 70 65 60 55 50 45 40 35 30 25 20 15 10 9 8 7 6 5 4 3 2 1>;
			pc_temp_ocv_ocv = <
			                   4388 4386 4384 4378 4371 4366
			                   4287 4299 4308 4317 4311 4307
			                   4215 4233 4245 4259 4253 4250
			                   4151 4172 4187 4201 4196 4194
			                   4107 4116 4133 4145 4140 4139
			                   4052 4075 4086 4092 4087 4086
			                   3972 3998 4031 4043 4039 4037
			                   3930 3945 3971 3992 3991 3992
			                   3889 3905 3925 3948 3950 3951
			                   3854 3865 3880 3894 3896 3895
			                   3830 3833 3845 3859 3859 3860
			                   3813 3814 3818 3833 3834 3834
			                   3799 3801 3800 3812 3812 3812
			                   3784 3790 3789 3793 3795 3794
			                   3770 3780 3779 3777 3777 3774
			                   3753 3767 3769 3759 3753 3740
			                   3741 3750 3751 3738 3731 3718
			                   3724 3725 3724 3712 3706 3692
			                   3701 3700 3693 3689 3682 3669
			                   3693 3694 3688 3687 3680 3667
			                   3688 3690 3684 3685 3679 3666
			                   3680 3685 3679 3682 3676 3662
			                   3668 3679 3672 3673 3669 3655
			                   3648 3662 3656 3646 3649 3631
			                   3619 3630 3624 3604 3610 3590
			                   3571 3579 3576 3546 3557 3539
			                   3504 3512 3506 3469 3488 3471
			                   3401 3410 3407 3354 3387 3372
			                   3200 3200 3200 3200 3200 3200
			                  >;
		};
};
