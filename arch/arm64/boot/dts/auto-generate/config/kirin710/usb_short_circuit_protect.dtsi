	&usb_short_circuit_protect {
		compatible = "huawei,usb_short_circuit_protect";
		gpio_usb_short_circuit_protect = <&gpio6 4 0>;
		uscp_threshold_tusb = <40>;
		open_mosfet_temp = <20>;
		close_mosfet_temp = <10>;
		interval_switch_temp = <15>;
		status = "disable";
	};
