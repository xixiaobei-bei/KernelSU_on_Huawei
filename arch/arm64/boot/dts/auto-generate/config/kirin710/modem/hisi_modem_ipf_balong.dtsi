/*
 * Hisilicon Ltd Balong SOC
 */

/include/ "skeleton.dtsi"

/{
	ipf_app:ipf1@ff038000 {
		#address-cells = <2>;
		#size-cells = <2>;
		compatible = "hisilicon,ipf_balong_app";
		reg = <0x0 0xff038000 0x0 0x8000>;
		clocks = <&clk_gate_ipf>;
		clock-names = "ipf_clk";
		interrupts = <0 222 4>;
		rst_crg = <0xFFF35000 0x84 0x88 0x8c 0x2000000>;
		status = "ok";
	};
};
