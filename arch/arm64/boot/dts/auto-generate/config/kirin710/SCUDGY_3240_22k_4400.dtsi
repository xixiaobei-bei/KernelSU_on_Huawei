/* DO NOT EDIT - Automatically generated by python */
/ {
		SCUDGY_3240_22k_4400:SCUDGY_3240_22k_4400 {
			fcc = <3240>;
			default_rbatt_mohm = <100>;
			identify_type = "id_volt";
			id_identify_min = <751>;
			id_identify_max = <1235>;
			id_voltage_min = <939>;
			id_voltage_max = <1059>;
			vbat_max = <4400>;
			temp_para = 
						"-32767","0","-1","0","4100","0",
						"0","5","-1","324","4400","0",
						"5","10","-1","972","4400","3",
						"10","45","-1","-1","4400","3",
						"45","50","-1","1134","4100","3",
						"50","32767","-1","0","4100","0";
			vbat_para = 
						"-32767","3400","-1","820","0",
						"3400","32767","-1","-1","0";
			segment_para = 
						"-32767","4150","3240","4208","50",
						"4150","4450","2268","4400","0";
			batt_brand = "SCUDGY";
			fcc_temp = <3259 3264 3261 3266 3262 3238>;
			fcc_sf_x = <0 100 200 300 400 500 600 700 800 1000 1500>;
			fcc_sf_y = <100 96 94 92 90 88 87 84 81 75 50>;
			fcc_sf_cols = <11>;
			pc_sf_rows = <1>;
			pc_sf_cols = <1>;
			pc_sf_row_entries = <0>;
			pc_sf_percent = <100>;
			pc_sf_sf = <100>;
			rbatt_sf_rows = <28>;
			rbatt_sf_cols = <6>;
			rbatt_sf_percent = <100 95 90 85 80 75 70 65 60 55 50 45 40 35 30 25 20 15 10 9 8 7 6 5 4 3 2 1>;
			rbatt_sf_sf = <
			               1423 560 287 120 105 100
			               1423 560 287 120 105 100
			               1411 559 288 121 106 100
			               1347 562 288 123 106 101
			               1348 560 301 126 109 102
			               1353 587 312 131 112 103
			               1192 602 350 144 117 105
			               1187 507 303 152 123 110
			               1190 520 286 160 134 118
			               1188 512 274 124 109 102
			               1206 509 268 119 106 101
			               1249 514 269 121 106 101
			               1305 526 272 125 109 104
			               1378 552 281 130 113 106
			               1474 587 289 129 115 107
			               1598 638 302 124 107 102
			               1759 708 317 123 106 102
			               1964 820 341 124 107 103
			               2190 771 331 125 110 103
			               2432 798 337 125 111 108
			               2676 852 347 127 111 108
			               2926 920 362 128 110 107
			               3150 994 389 130 112 106
			               3479 1100 405 126 107 101
			               3757 1140 407 129 109 105
			               4187 1218 428 132 112 106
			               4669 1400 482 148 117 107
			               5398 1699 616 337 192 158
			              >;
			pc_temp_ocv_rows = <29>;
			pc_temp_ocv_cols = <6>;
			pc_temp_ocv_percent = <100 95 90 85 80 75 70 65 60 55 50 45 40 35 30 25 20 15 10 9 8 7 6 5 4 3 2 1>;
			pc_temp_ocv_ocv = <
			                   4392 4389 4386 4377 4372 4365
			                   4308 4319 4321 4321 4315 4308
			                   4243 4257 4262 4262 4257 4251
			                   4176 4200 4204 4204 4200 4194
			                   4128 4143 4151 4149 4144 4138
			                   4083 4097 4098 4095 4090 4085
			                   3981 4038 4053 4051 4041 4036
			                   3933 3953 3969 3989 3993 3990
			                   3894 3919 3927 3947 3948 3945
			                   3857 3882 3888 3892 3891 3889
			                   3828 3849 3855 3858 3857 3855
			                   3811 3822 3829 3832 3831 3829
			                   3798 3801 3808 3812 3810 3808
			                   3786 3788 3791 3794 3793 3790
			                   3774 3778 3779 3776 3774 3768
			                   3760 3766 3768 3757 3749 3737
			                   3743 3749 3751 3737 3728 3716
			                   3727 3726 3727 3712 3704 3690
			                   3703 3704 3700 3689 3681 3669
			                   3697 3700 3698 3688 3680 3668
			                   3690 3696 3696 3686 3678 3666
			                   3680 3692 3693 3682 3675 3662
			                   3665 3683 3687 3672 3667 3652
			                   3643 3664 3668 3645 3643 3625
			                   3609 3629 3629 3600 3601 3585
			                   3562 3578 3576 3543 3549 3533
			                   3498 3510 3505 3466 3479 3465
			                   3399 3413 3405 3359 3379 3369
			                   3200 3200 3200 3200 3200 3200
			                  >;
		};
};
