/*
 * Hisilicon Ltd. kirinxxx SoC
 *
 * Copyright (C) 2013 Hisilicon Technologies CO., Ltd.
 *
 * This program is free software; you can redistribute it and/or modify
 * it under the terms of the GNU General Public License version 2 as
 * publishhed by the Free Software Foundation.
 */

/*secs_clk_rate: clk of cc
 *       325000000: high freq
 *       181000000: low freq
*/
/{
	hisi_secs: secs_power_ctrl {
		compatible = "hisilicon,secs_power_ctrl";
		secs_clk_rate = <325000000 181000000 163000000>;
		secs-atfd-power-ctrl;
		secs-clk-freq-adapt;
	};
};
