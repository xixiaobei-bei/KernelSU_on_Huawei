## drivers/echub/keyboard/Kconfig
```kconfig
#
# Keyboard F7 hotkey mute led
#

config HUAWEI_ECHUB_MUTELED
	bool "Keyboard mute led"
	depends on HUAWEI_ECHUB
	default n
	help
	  This driver provides support for Keyboard F7 hotkey mute led
	  via I2c. This driver only used by OS.
```

## drivers/echub/power/Kconfig
```kconfig
#
# echub power moudule
#

config HUAWEI_ECHUB_PMSYNC
        bool "ec state sync"
        depends on HUAWEI_ECHUB
        default n
        help
          This driver provides support for ec state sync(suspend / resume)
          via GPIO.

config HUAWEI_ECHUB_LID
        bool "ec lid func"
        depends on HUAWEI_ECHUB
        default n
        help
          This driver provides support for Lid function
          via GPIO.

config HUAWEI_ECHUB_LID_TEST
        bool "lid production test"
        depends on HUAWEI_ECHUB
        default n
        help
          This config provides support for Lid production test.
```

## drivers/emcom/Kconfig
```kconfig
menuconfig HUAWEI_EMCOM
    bool "Huawei emcom feature support"
    default n
    help
    Say yes here to support emcom feature

if HUAWEI_EMCOM
source "drivers/emcom/argo/Kconfig"
source "drivers/emcom/xengine/Kconfig"
source "drivers/emcom/smartcare/Kconfig"
source "drivers/emcom/nweval/Kconfig"
source "drivers/emcom/opmp/Kconfig"
source "drivers/emcom/nstack/Kconfig"
endif # if HUAWEI_EMCOM
```

## drivers/emcom/nstack/Kconfig
```kconfig
menuconfig HW_EMCOM_NSTACK
	bool "Huawei Emcom Nstack"
	depends on HUAWEI_EMCOM
	default n

if HW_EMCOM_NSTACK
source "drivers/emcom/nstack/fi/Kconfig"
endif # if HW_EMCOM_NSTACK
```

## drivers/emcom/nstack/fi/Kconfig
```kconfig
config HW_NSTACK_FI
	bool "Huawei NSTACK FI"
	depends on HW_EMCOM_NSTACK
	default n
```

## drivers/emcom/smartcare/Kconfig
```kconfig
menuconfig HW_NETWORK_MEASUREMENT
	bool "Huawei Network Measurement System"
	depends on HUAWEI_EMCOM
	default n

if HW_NETWORK_MEASUREMENT
source "drivers/emcom/smartcare/fi/Kconfig"
endif # if HW_NETWORK_MEASUREMENT
```

## drivers/gpu/arm/bifrost-r18p0-01rel0/platform/hisilicon/Kconfig
```kconfig
#
# Copyright (c) Huawei Technologies Co., Ltd. 2014-2019. All rights reserved.
# Description: This file describe HISI GPU hardware related features
# Author: Huawei Technologies Co., Ltd.
# Create: 2014-2-24
#
# This program is free software and is provided to you under the terms of the
# GNU General Public License version 2 as published by the Free Software
# Foundation, and any use by you of this program is subject to the terms
# of such GNU licence.
#
# A copy of the licence is included with the program, and can also be obtained
# from Free Software Foundation, Inc., 51 Franklin Street, Fifth Floor,
# Boston, MA  02110-1301, USA.
#
#

config MALI_PM_DEMAND
	bool "Switch power policy"
	depends on MALI_MIDGARD && MALI_EXPERT
	default n
	help
	  switch policy for different platform, fpga or chip

config REPORT_VSYNC
	bool "Enabel REPORT_VSYNC"
	depends on MALI_MIDGARD && MALI_EXPERT
	default y
	help
	  Enable REPORT_VSYNC

config MALI_IDLE_AUTO_CLK_DIV
	bool "Idle auto clock divide"
	depends on MALI_MIDGARD && MALI_EXPERT
	default y
	help
	  when GPU in IDLE state, auto decrease the clock rate

config MALI_GPU_DRM_HI3660
	bool "Enable gpu drm feature for hi3660"
	depends on MALI_MIDGARD && MALI_EXPERT
	default n
	help
	  enable mali gpu drm feature

config HISI_HW_VOTE_GPU_FREQ
	bool "Enable hardware vote gpu freq feature"
	depends on PM_DEVFREQ && HISI_HW_VOTE
	default n
	help
	  enable hardware vote gpu freq feature

config HISI_GPU_CORE_HOTPLUG
	bool "Enable gpu core hotplug if high temperature scenario"
	depends on MALI_MIDGARD && MALI_EXPERT
	default n
	help
	  enable some cores shutdown if the thermal need reduce gpu power consumption

config MALI_LAST_BUFFER
	bool "Last buffer"
	depends on MALI_MIDGARD && MALI_EXPERT && MALI_PLATFORM_HISILICON && HISI_LB
	default n
	help
	  Select  this option to enable last buffer support.

config HISI_GPU_AI_FENCE_INFO
	bool "GPU AI frequency schedule fence info"
	default n
	help
	  Open function for GPU AI frequency schedule.

# source hisilicon platform base driver Kconfig.
source "drivers/gpu/arm/bifrost-r18p0-01rel0/platform/hisilicon/base/Kconfig"
```

## drivers/gpu/arm/bifrost-r18p0-01rel0/platform/hisilicon/base/Kconfig
```kconfig
#
# Copyright (c) Huawei Technologies Co., Ltd. 2014-2019. All rights reserved.
# Description: This file describe HISI GPU hardware related features
# Author: Huawei Technologies Co., Ltd.
# Create: 2014-2-24
#
# This program is free software and is provided to you under the terms of the
# GNU General Public License version 2 as published by the Free Software
# Foundation, and any use by you of this program is subject to the terms
# of such GNU licence.
#
# A copy of the licence is included with the program, and can also be obtained
# from Free Software Foundation, Inc., 51 Franklin Street, Fifth Floor,
# Boston, MA  02110-1301, USA.
#
#

# source hisilicon memory group manager Kconfig.
source "drivers/gpu/arm/bifrost-r18p0-01rel0/platform/hisilicon/base/mgm/Kconfig"
```

## drivers/gpu/arm/bifrost-r18p0-01rel0/platform/hisilicon/base/mgm/Kconfig
```kconfig
#
# Copyright (c) Huawei Technologies Co., Ltd. 2014-2019. All rights reserved.
# Description: This file describe HISI GPU hardware related features
# Author: Huawei Technologies Co., Ltd.
# Create: 2014-2-24
#
# This program is free software and is provided to you under the terms of the
# GNU General Public License version 2 as published by the Free Software
# Foundation, and any use by you of this program is subject to the terms
# of such GNU licence.
#
# This program is distributed in the hope that it will be useful,
# but WITHOUT ANY WARRANTY; without even the implied warranty of
# MERCHANTABILITY or FITNESS FOR A PARTICULAR PURPOSE. See the
# GNU General Public License for more details.
#
# You should have received a copy of the GNU General Public License
# along with this program; if not, you can access it online at
# http://www.gnu.org/licenses/gpl-2.0.html.
#
# SPDX-License-Identifier: GPL-2.0
#
#

config MALI_MEMORY_GROUP_MANAGER
	tristate "MALI_MEMORY_GROUP_MANAGER"
	help
	  This option enables an hisi implementation of a memory group manager
	  for allocation and release of pages for memory pools managed by Mali GPU
	  device drivers.
```

## drivers/gpu/arm/r28p0-01eac0/platform/hisilicon/Kconfig
```kconfig
#
# Copyright (c) Huawei Technologies Co., Ltd. 2014-2021. All rights reserved.
# Description: This file describe GPU hardware related features
# Create: 2014-2-24
#
# This program is free software and is provided to you under the terms of the
# GNU General Public License version 2 as published by the Free Software
# Foundation, and any use by you of this program is subject to the terms
# of such GNU licence.
#
# A copy of the licence is included with the program, and can also be obtained
# from Free Software Foundation, Inc., 51 Franklin Street, Fifth Floor,
# Boston, MA  02110-1301, USA.
#
#

config MALI_PM_DEMAND
	bool "Switch power policy"
	depends on MALI_MIDGARD && MALI_EXPERT
	default n
	help
	  switch policy for different platform, fpga or chip

config REPORT_VSYNC
	bool "Enabel REPORT_VSYNC"
	depends on MALI_MIDGARD && MALI_EXPERT
	default y
	help
	  Enable REPORT_VSYNC

config HW_VOTE_GPU_FREQ
	bool "Enable hardware vote gpu freq feature"
	depends on PM_DEVFREQ && HW_VOTE
	default n
	help
	  enable hardware vote gpu freq feature

config MALI_GPU_BUG_ON
	bool "Bug on for gpu steadiness"
	depends on MALI_MIDGARD && MALI_EXPERT
	default n
	help
	  Open bug on in mali driver for gpu steadiness.

config MALI_PLATFORM_HISILICON
	bool "Hisilicon"
	depends on MALI_MIDGARD && MALI_EXPERT
	default n

config MALI_MIDGARD_RT_PM
	bool "Enable Runtime power management"
	depends on MALI_MIDGARD
	depends on PM_RUNTIME || PM
	default n
	help
	  Choose this option to enable runtime power management in the Mali Midgard DDK.

config GPU_CORE_HOTPLUG
	bool "Enable gpu core hotplug if high temperature scenario"
	depends on MALI_MIDGARD && MALI_EXPERT
	default n
	help
	  enable some cores shutdown if the thermal need reduce gpu power consumption

config GPU_SHADER_PRESENT_CFG
	bool "Enable shader present configuration"
	depends on MALI_MIDGARD && MALI_EXPERT
	default n
	help
	  enable shader present configuration

config MALI_GPU_CL_BOOST
	bool "Enable mali GPU CL Boost"
	depends on MALI_MIDGARD && MALI_EXPERT
	default n
	help
	  enable MALI GPU CL boost.

config GPU_AI_FENCE_INFO
	bool "GPU AI frequency schedule fence info"
	default n
	help
	  Open function for GPU AI frequency schedule.

config GPU_DPM_PCR
	bool "GPU dpm pcr function"
	depends on DPM_HWMON
	default n
	help
	  enable dpm pcr function

config GPU_THROTTLE_DEVFREQ
	bool "Enable gpu throttlel devfreq"
	default y
	help
	  enable gpu throttlel devfreq for user

config GPU_VIRTUAL_DEVFREQ
	bool "Enable gpu virtual devfreq"
	default n
	help
	  enable gpu virtual devfreq if low load scenario

# source hisilicon platform base driver Kconfig.
source "drivers/gpu/arm/r28p0-01eac0/platform/hisilicon/base/Kconfig"
```

## drivers/gpu/arm/valhall-r21p0-01rel0/platform/hisilicon/Kconfig
```kconfig
#
# Copyright (c) Huawei Technologies Co., Ltd. 2014-2019. All rights reserved.
# Description: This file describe HISI GPU hardware related features
# Author: Huawei Technologies Co., Ltd.
# Create: 2014-2-24
#
# This program is free software and is provided to you under the terms of the
# GNU General Public License version 2 as published by the Free Software
# Foundation, and any use by you of this program is subject to the terms
# of such GNU licence.
#
# A copy of the licence is included with the program, and can also be obtained
# from Free Software Foundation, Inc., 51 Franklin Street, Fifth Floor,
# Boston, MA  02110-1301, USA.
#
#

config MALI_PM_DEMAND
	bool "Switch power policy"
	depends on MALI_MIDGARD && MALI_EXPERT
	default n
	help
	  switch policy for different platform, fpga or chip

config REPORT_VSYNC
	bool "Enabel REPORT_VSYNC"
	depends on MALI_MIDGARD && MALI_EXPERT
	default y
	help
	  Enable REPORT_VSYNC

config HISI_HW_VOTE_GPU_FREQ
	bool "Enable hardware vote gpu freq feature"
	depends on PM_DEVFREQ && HISI_HW_VOTE
	default n
	help
	  enable hardware vote gpu freq feature

config MALI_GPU_BUG_ON
	bool "Bug on for gpu steadiness"
	depends on MALI_MIDGARD && MALI_EXPERT
	default n
	help
	  Open bug on in mali driver for gpu steadiness.

config MALI_PLATFORM_HISILICON
	bool "Hisilicon"
	depends on MALI_MIDGARD && MALI_EXPERT
	default n

config MALI_MIDGARD_RT_PM
	bool "Enable Runtime power management"
	depends on MALI_MIDGARD
	depends on PM_RUNTIME || PM
	default n
	help
	  Choose this option to enable runtime power management in the Mali Midgard DDK.

config HISI_GPU_CORE_HOTPLUG
	bool "Enable gpu core hotplug if high temperature scenario"
	depends on MALI_MIDGARD && MALI_EXPERT
	default n
	help
	  enable some cores shutdown if the thermal need reduce gpu power consumption

config HISI_GPU_SHADER_PRESENT_CFG
	bool "Enable shader present configuration"
	depends on MALI_MIDGARD && MALI_EXPERT
	default n
	help
	  enable shader present configuration

config MALI_HISI_CL_BOOST
	bool "Enable HISI mali GPU CL Boost"
	depends on MALI_MIDGARD && MALI_EXPERT
	default n
	help
	  enable MALI GPU CL boost.

config HISI_GPU_AI_FENCE_INFO
	bool "GPU AI frequency schedule fence info"
	default n
	help
	  Open function for GPU AI frequency schedule.
```

## drivers/gpu/drm/hisi/Kconfig
```kconfig
config DRM_HISI
	tristate "HISI DRM"
	depends on DRM
	depends on OF && COMMON_CLK
	depends on MMU
	select REGULATOR
	select DRM_KMS_HELPER
	select DRM_GEM_CMA_HELPER
	select DRM_KMS_CMA_HELPER
	select DRM_PANEL
	select SHMEM
	select TMPFS
	select SYNC_FILE
	select PM_OPP
	default n
	help
	  DRM/KMS driver for hisi/kirin.

config DRM_HISI_DPE
	bool "Enable dss dpe support in HISI DRM driver"
	depends on DRM_HISI
	select DRM_PANEL
	select DRM_MIPI_DSI
	default n
	help
	  Choose this option if you have a need for dpe support.

config DRM_HISI_DSI
	bool "Enable mipi dsi support in HISI DRM driver"
	depends on DRM_HISI_DPE
	default n
	help
	  Choose this option if you have a need for dsi encoder support.

config DRM_HISI_DP
	bool "Enable display port support in HISI DRM driver"
	depends on DRM_HISI_DPE
	default n
	help
	  Choose this option if you have a need for display port connector
	  support.

config DRM_HISI_LCD
	bool "Enable lcd support in HISI DRM driver"
	depends on DRM_HISI
	depends on DRM_HISI_DSI
	default n
	help
	  Choose this option if you have a need for lcd support.

config DRM_HISI_BL
	bool "Enable backlight support in HISI DRM driver"
	depends on DRM_HISI_LCD
	default n
	help
	  Choose this option if you have a need for backlight support.

config DRM_DSS_IOMMU
	bool "Enable dss iommu"
	depends on DRM_HISI_DPE
	default n
	help
      Choose this option if you have a need dss iommu support.

config HISI_DSS_V510
	bool "dss v510"
	depends on DRM_HISI_DPE
	default n
	help
	  This driver supports HISI V510 dss

config HISI_DSS_V600
	bool "dss v600"
	depends on DRM_HISI_DPE
	default n
	help
	  This driver supports HISI V600 dss

config DRM_HISI_DEBUG
	bool "Enable debug in HISI DRM driver"
	depends on DRM_HISI
	default n
	help
      Choose the option if you have a need debugfs support

config DRM_SMMU_V3
	tristate "HISI DRM smmu v3 support"
	depends on DRM
	default n
	help
	  This framebuffer driver supports smmu v3.

source "drivers/gpu/drm/hisi/heap/Kconfig"
```

## drivers/gpu/drm/hisi/heap/Kconfig
```kconfig
config DRM_GEM_HEAP
	bool "Enable heap memory manager feature"
	depends on DRM_DSS_IOMMU
	default n
	help
	  DRM GEM Heap feature

config DRM_GEM_TRACE
        bool "Enable DRM Heap GEM trace"
        depends on DRM_GEM_HEAP
        default n
        help
          DRM GEM Tracer
```

## drivers/hid/i2c-hid/Kconfig
```kconfig
menu "I2C HID support"
	depends on I2C

config I2C_HID
	tristate "HID over I2C transport layer"
	default n
	depends on I2C && INPUT
	select HID
	---help---
	  Say Y here if you use a keyboard, a touchpad, a touchscreen, or any
	  other HID based devices which is connected to your computer via I2C.

	  If unsure, say N.

	  This support is also available as a module.  If so, the module
	  will be called i2c-hid.

config HUAWEI_ARMPC_I2C_HID
	bool "HUAWEI armpc hid driver"
	default n
	depends on I2C_HID
	---help---
	  Say Y here if you use a keyboard or a clickpad (Synopsys and ELAN) HID
	  based devices which is connected to your computer via I2C.

	  If unsure, say N.

endmenu
```
