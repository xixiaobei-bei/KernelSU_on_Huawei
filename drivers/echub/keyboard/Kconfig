## drivers/hisi/Kconfig
```kconfig
menu "Hisilicon platform"

menuconfig HISILICON_PLATFORM
	bool "Hisilicon platform support"
	default n
	help
	  Say yes here to support the hisilicon platform

if HISILICON_PLATFORM

source "drivers/hisi/adc/Kconfig"
source "drivers/hisi/cmdline/Kconfig"
source "drivers/hisi/mailbox/Kconfig"
source "drivers/hisi/mntn/Kconfig"
source "drivers/hisi/lpnv/Kconfig"
source "drivers/hisi/factory_svfd/Kconfig"
source "drivers/hisi/noc/Kconfig"
source "drivers/hisi/syscounter/Kconfig"
source "drivers/hisi/soundtrigger/Kconfig"
source "drivers/hisi/memory_dump/Kconfig"
source "drivers/hisi/drmdriver/Kconfig"
source "drivers/hisi/efuse/Kconfig"
source "drivers/hisi/security_info/Kconfig"
source "drivers/hisi/da_separate/Kconfig"
source "drivers/hisi/da_combine/Kconfig"
source "drivers/hisi/da_combine_dsp/Kconfig"
source "drivers/hisi/slimbus/Kconfig"
source "drivers/hisi/hifi_dsp/Kconfig"
source "drivers/hisi/hifi_mailbox/Kconfig"
source "drivers/hisi/ddrc/Kconfig"
source "drivers/hisi/hisi_lb/Kconfig"
source "drivers/hisi/tzdriver/Kconfig"
source "drivers/hisi/hisee/Kconfig"
source "drivers/hisi/mspc/Kconfig"
source "drivers/hisi/hieps/Kconfig"
source "drivers/hisi/load_image/Kconfig"
source "drivers/hisi/perfhub/Kconfig"
source "drivers/hisi/jpu/Kconfig"
source "drivers/hisi/l3cache/Kconfig"
source "drivers/hisi/pm/Kconfig"
source "drivers/hisi/hisi_lmk/Kconfig"
source "drivers/hisi/hw_vote/Kconfig"
source "drivers/hisi/gpufreq/Kconfig"
source "drivers/hisi/onsys_avs/Kconfig"
source "drivers/hisi/modem_decoupl/Kconfig"
if HISI_INC_MODEM_CONFIG
-source "drivers/hisi/modem/Kconfig"
endif
source "drivers/hisi/ivp/Kconfig"
source "drivers/hisi/hisi_page_tracker/Kconfig"
source "drivers/hisi/timekeeper/Kconfig"
source "drivers/hisi/max_power/Kconfig"
source "drivers/hisi/hhee/Kconfig"
source "drivers/hisi/bl2_log/Kconfig"
source "drivers/hisi/file_encry/Kconfig"
source "drivers/hisi/lpcpu_pmu_dump/Kconfig"
source "drivers/hisi/dieid/Kconfig"
source "drivers/hisi/kernel_harden_test/Kconfig"
source "drivers/hisi/harden/Kconfig"
source "drivers/hisi/secs_power_ctrl/Kconfig"
source "drivers/hisi/ipp/Kconfig"
source "drivers/hisi/isp/Kconfig"
source "drivers/hisi/accurate_delay/Kconfig"
source "drivers/hisi/perf_ctrl/Kconfig"
source "drivers/hisi/drg/Kconfig"
source "drivers/hisi/hisi_dummy_ko/Kconfig"
source "drivers/hisi/rpmb/Kconfig"
source "drivers/hisi/ivp/Kconfig"
source "drivers/hisi/timekeeper/Kconfig"
source "drivers/hisi/perfhub/Kconfig"
source "drivers/hisi/ics/Kconfig"
source "drivers/hisi/hitest/Kconfig"
source "drivers/hisi/cci_extra/Kconfig"
source "drivers/hisi/irq_affinity/Kconfig"
source "drivers/hisi/bl31_log/Kconfig"
source "drivers/hisi/usb_phy_chip/Kconfig"
source "drivers/hisi/bus_monitor/Kconfig"
source "drivers/hisi/hsdt_trace/Kconfig"
source "drivers/hisi/soc_mad/Kconfig"
source "drivers/hisi/tlb_conflict/Kconfig"
source "drivers/hisi/hisi_ap_ready/Kconfig"
source "drivers/hisi/bl31_hibernate/Kconfig"
source "drivers/hisi/hi1103_eeprom/Kconfig"
source "drivers/hisi/dpm/Kconfig"
source "drivers/hisi/thee/Kconfig"

endif #HISILICON_PLATFORM

endmenu
```

## drivers/hisi/accurate_delay/Kconfig
```kconfig
config ACCURATE_DELAY
	bool "Accurate Delay Lib"
	default n
	help
	Say yes here if you want to use Accurate Delay lib
```

## drivers/hisi/adc/Kconfig
```kconfig
config LPM_HKADC
	bool "LPM ADC support"
	depends on HISI_MAILBOX
	default n
	help
	  Say yes here to support the LPM ADC device

config HKADC_DEBUG
	tristate "ADC DEBUG"
	help
	  Say yes here to support this lock
```

## drivers/hisi/arpp/Kconfig
```kconfig
# SPDX-License-Identifier: GPL-2.0
#
# ARPP device configuration
#

menu "Hisilicon ARPP"

config HISI_ARPP
	bool "Hisilicon ARPP Drivers"
	default n
	help
		ARPP drivers

config HISI_ARPP_V100
	bool "Hisilicon ARPP Drivers for V100"
	depends on HISI_ARPP
	default n
	help
		ARPP drivers for V100
endmenu
```

## drivers/hisi/bl2_log/Kconfig
```kconfig
menu "ATF BL2 LOG"

config ATF_KERNEL_BL2_LOG
	bool "ATF kernel dump bl2 log support"
	default n
	help
	  Say yes here to support dump bl2 log in kernel

endmenu
```

## drivers/hisi/bl31_hibernate/Kconfig
```kconfig
config HISI_BL31_HIBERNATE
	bool "Hisilicon BL31 S4 Hibernate feature support"
	default n
	depends on HIBERNATION
	help
	---help---
	  This module supports the safe configuration or saving and recovery of
	  data for bl31 modules. Bl31 implements the saving and recovery
	  mechanism of S4 state, which is used by bl31 module.
	  If unsure, say N.
config HISI_BL31_HIBERNATE_TEST
	bool "Hisilicon BL31 S4 Hibernate test support"
	default n
	depends on HISI_BL31_HIBERNATE
	help
	---help---
	  This module is designed to test bl31 hibernate feature.
	  If unsure, say N.
```

## drivers/hisi/bl31_log/Kconfig
```kconfig
config ATF_KERNEL_BL31_LOG
	bool "atf kernel dump bl31 log support"
	default n
	help
	  Say yes here to support dump bl31 log in kernel
```

## drivers/hisi/bus_monitor/Kconfig
```kconfig
config BUS_MONITOR_TEST
	bool "bus monitor test"
	default n
	help
	test CPU Bus Perf Monitor
config BUS_MONITOR
	bool "bus monitor"
	default n
	help
	CPU Bus Perf Monitor
```

## drivers/hisi/cci_extra/Kconfig
```kconfig
config LPCPU_CCI_EXTRA
	bool "CCI Extra Configuration Driver"
	default n
	select ARM_CCI
	help
	CCI Extra Configuration Driver support

config LPCPU_CCI_EXTRA_PMU
	bool "CCI Extra PMU Driver"
	depends on LPCPU_CCI_EXTRA
	default n
	select ARM_CCI
	help
	CCI Extra PMU support
```

## drivers/hisi/da_combine/Kconfig
```kconfig
config DA_COMBINE_V3_CODEC
	tristate "Support DA_combine_v3 Codec IC"
	default n
	help
          Enables the DA_COMBINE_V3 core driver.

config HAC_SUPPORT
	bool "Support HAC for DA_combine_v3 Codec"
	depends on DA_COMBINE_V3_CODEC
	default n
	help
          Enables hac for DA_COMBINE_V3 Codec.

config RCV_TDD_SUPPORT
	bool "Support RCV TDD for DA_combine_v3 Codec"
	depends on DA_COMBINE_V3_CODEC
	default n
	help
          Enables rcv tdd for DA_COMBINE_V3 Codec.
```

## drivers/hisi/da_combine_dsp/Kconfig
```kconfig
config CODEC_DSP_MISC
     tristate "codec dsp misc device support"
     default n
     ---help---
	codec dsp misc driver
```
