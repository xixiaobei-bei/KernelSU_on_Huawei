## drivers/hwpower/cc_battery/battery_temp/Kconfig
```kconfig
#
# Huawei battery temperature configuration
#

config HUAWEI_BATTERY_TEMP
	bool "battery temperature"
	default n
	help
	  Say Y here to enable battery temperature support.
	  Support battery temperature management.
	  Compatible with coul driver.

config HUAWEI_MULTI_BATT_TEMP
	bool "multi battery temperature"
	default n
	depends on HUAWEI_BATTERY_TEMP
	help
	  Say Y here to enable multi battery temperature module.
	  This module monitor multi battery temperature,
	  and mixed multi battery temperature.
	  Should register to HUAWEI_BATTERY_TEMP module.

config HUAWEI_MULTI_BTB_TEMP
	bool "multi btb temperature"
	default n
	depends on HUAWEI_BATTERY_TEMP
	help
	  Say Y here to enable multi btb temperature module.
	  This module monitor multi btb temperature,
	  and mixed multi btb temperature.
	  Should register to HUAWEI_BATTERY_TEMP module.
```

## drivers/hwpower/cc_battery/battery_ui_capacity/Kconfig
```kconfig
#
# huawei battery ui capacity driver
#

config HUAWEI_BATTERY_UI_CAPACTIY
	bool "huawei battery ui capacity driver"
	default n
	help
	  Say Y here to enable battery ui capacity driver.
	  It provides basic capacity processing algorithm and
	  informs capacity change through power supply.In addition,
	  it provides interface to obtain current capacity.
```

## drivers/hwpower/cc_common_module/Kconfig
```kconfig
#
# huawei power common drivers
#

source "drivers/hwpower/cc_common_module/power_debug/Kconfig"
source "drivers/hwpower/cc_common_module/power_devices_info/Kconfig"
source "drivers/hwpower/cc_common_module/power_firmware/Kconfig"
source "drivers/hwpower/cc_common_module/power_supply/Kconfig"
source "drivers/hwpower/cc_common_module/power_thermalzone/Kconfig"
```

## drivers/hwpower/cc_common_module/power_devices_info/Kconfig
```kconfig
#
# huawei power devices info drivers
#

config HUAWEI_POWER_DEVICES_INFO
	bool "huawei power devices information"
	default n
	help
	  Say Y here to enable power devices information driver.
	  This driver is used to statistics charging related device information.
```

## drivers/hwpower/cc_common_module/power_firmware/Kconfig
```kconfig
#
# huawei power firmware drivers
#

config HUAWEI_POWER_FIRMWARE
	bool "huawei power firmware module"
	default n
	help
	  Say Y here to enable power firmware driver.
```

## drivers/hwpower/cc_common_module/power_supply/Kconfig
```kconfig
#
# huawei power supply drivers
#

config HUAWEI_POWER_SUPPLY
	bool "huawei power supply"
	depends on POWER_SUPPLY
	default n
	help
	  Say Y here to enable power supply drivers.
```

## drivers/hwpower/cc_coul/Kconfig
```kconfig
#
# huawei coul drivers
#

config HUAWEI_COUL
	bool "huawei coul"
	default n
	help
	  Say Y here to enable huawei coul driver.
	  This driver provides a unified interface to the coul.
```

## drivers/hwpower/cc_hardware_channel/Kconfig
```kconfig
#
# huawei hardware channel drivers
#

source "drivers/hwpower/cc_hardware_channel/wired_channel_switch/Kconfig"
source "drivers/hwpower/cc_hardware_channel/vbus_channel/Kconfig"
```

## drivers/hwpower/cc_hardware_ic/Kconfig
```kconfig
#
# huawei hardware ic drivers
#

source "drivers/hwpower/cc_hardware_ic/buck_boost/Kconfig"
source "drivers/hwpower/cc_hardware_ic/charge_pump/Kconfig"
source "drivers/hwpower/cc_hardware_ic/load_switch/Kconfig"
source "drivers/hwpower/cc_hardware_ic/switch_capacitor/Kconfig"
source "drivers/hwpower/cc_hardware_ic/boost_5v/Kconfig"
source "drivers/hwpower/cc_hardware_ic/wireless_charge_ic/Kconfig"
source "drivers/hwpower/cc_hardware_ic/charge_adc_monitor/Kconfig"
source "drivers/hwpower/cc_hardware_ic/fuel_gauge/Kconfig"
source "drivers/hwpower/cc_hardware_ic/protocol_ic/Kconfig"
```

## drivers/hwpower/cc_hardware_ic/buck_boost/Kconfig
```kconfig
#
# huawei buck boost drivers
#

config BUCKBOOST
	bool "buck boost"
	default n
	help
	  Say Y here to enable buck_boost driver.
	  This driver provides a unified interface to buck_boost.
	  This driver is in logic layer.
	  Currently supported device_check and set_vol etc.

config BUCKBOOST_TPS63810
	bool "buck boost tps63810"
	depends on BUCKBOOST
	default n
	help
	  Say Y here to enable buckboost tps63810 driver.
	  Currently supported chips as below:
	  ti: tps63810.
	  rt: rt6160.
	  rt6160 and tps63810 are compatible in device function and pin.

config BUCKBOOST_MAX77813
	bool "buck boost max77813"
	depends on BUCKBOOST
	default n
	help
	  Say Y here to enable buckboost max77813 driver.
```

## drivers/hwpower/cc_hardware_ic/charge_adc_monitor/Kconfig
```kconfig
#
# huawei adc monitor for direct charge drivers
#

config CHARGE_ADC_MONITOR
	bool "adc_monitor"
	depends on DIRECT_CHARGER
	default n
	help
	  Say Y here to enable adc monitor driver.
	  This driver provides a unified interface for adc monitor.
	  Support device:
	  ina231
	  opa2333p

config INA231_FOR_CHARGE
	bool "ina231_for_direct_charge"
	depends on CHARGE_ADC_MONITOR
	default n
	help
	  Say Y here to enable ina231 driver.
	  Ina231 is a current-shunt and power monitor.
	  This driver monitors vbus and ibus for direct_charge.
	  This driver works with i2c interface that features 16 programmable addresses.

config OPA2333P_FOR_CHARGE
	bool "opa2333p_for_direct_charge"
	depends on CHARGE_ADC_MONITOR
	default n
	help
	  Say Y here to enable opa2333p driver.
	  The opa2333p is a cmos operational amplifier.
	  The opa2333p is optimized for low-voltage.
	  This driver works for direct_charge.
```

## drivers/hwpower/cc_hardware_ic/charge_pump/Kconfig
```kconfig
#
# charge_pump drivers
#

config CHARGE_PUMP
	bool "charge pump"
	default n
	help
	  Say Y here to enable charge pump driver.
	  This driver provides a unified interface to charge pump.
	  This driver is in logic layer.

config CHARGE_PUMP_HL1506
	bool "charge pump hl1506"
	depends on CHARGE_PUMP
	default n
	help
	  Say Y here to enable hl1506 driver.
	  The hl1506 is an soc for wireless charge-pump converter.
	  It is fully compliant with the latest Qi receiver to make
	  the input current to be half the current delivered to the output.

config CHARGE_PUMP_SY6510
	bool "charge pump sy6510"
	depends on CHARGE_PUMP
	default n
	help
	  Say Y here to enable sy6510 driver.
	  The sy6510 is an soc for wireless charge-pump converter.
	  It is fully compliant with the latest Qi receiver to make
	  the input current to be half the current delivered to the output.

config CHARGE_PUMP_PCA9488
	bool "charge pump pca9488"
	depends on CHARGE_PUMP
	default n
	help
	  Say Y here to enable pca9488 driver.
	  The PCA9488 is a highly-integrated switched-capacitor converter
	  with a dual-input, targeted to provide a doubled output current
	  for a fast charging application.
	  It is fully compliant with the latest Qi receiver to make
	  the input current to be half the current delivered to the output.

config CHARGE_PUMP_HL1512
	bool "charge pump hl1512"
	depends on CHARGE_PUMP
	default n
	help
	  Say Y here to enable hl1512 driver.
	  The hl1512 is an soc for wireless charge-pump converter.
	  It is fully compliant with the latest Qi receiver to make
	  the input current to be half the current delivered to the output.

config CHARGE_PUMP_SC8502
	bool "charge pump sc8502"
	depends on CHARGE_PUMP
	default n
	help
	  Say Y here to enable sc8502 driver.
	  The sc8502 is an soc for wireless charge-pump converter.
	  It is fully compliant with the latest Qi receiver to make
	  the input current to be half the current delivered to the output.
```

## drivers/hwpower/cc_hardware_ic/fuel_gauge/Kconfig
```kconfig
#
# fuel gauge ic drivers
#

config FUEL_GAUGE
	bool "fuel gauge"
	default n
	help
	  Say Y here to enable fuel gauge.
	  This driver provides a unified interface to the coul.
	  Currently supported coul as below.
	  bq27z561
	  rt9426

config RT9426_FUEL_GAUGE
	bool "rt9426 fuel gauge"
	depends on FUEL_GAUGE
	default n
	help
	  Say Y here to enable rt9426 fuel gauge driver.
	  this driver provides some interfaces to the coul.
	  also support a few high accuracy battery elements.
	  for example current and voltage.

config BQ27Z561_FUEL_GAUGE
	bool "bq27z561 fuel gauge"
	depends on FUEL_GAUGE
	default n
	help
	  Say Y here to enable bq27z561 fuel gauge driver.
	  this driver provides some interfaces to the coul.
	  also support a few high accuracy battery elements.
	  for example current and voltage.

config BQ40Z50_FUEL_GAUGE
	bool "bq40z50 fuel gauge"
	depends on FUEL_GAUGE
	default n
	help
	  Say Y here to enable bq40z50 fuel gauge driver.
	  this driver provides some interfaces to the coul.
	  also support a few high accuracy battery elements.
	  for example current and voltage.
```

## drivers/hwpower/cc_hardware_ic/load_switch/Kconfig
```kconfig
#
# huawei load switch for direct charge drivers
#

config LOADSWITCH
	bool "load_switch"
	depends on DIRECT_CHARGER
	default n
	help
	  Say Y here to enable load switch driver.
	  This driver provides a unified interface for load switch.
	  Support device:
	  rt9748

config RT9748
	bool "rt9748_for_direct_charge"
	depends on LOADSWITCH
	default n
	help
	  Say Y here to enable rt9748 driver.
	  RT9748 is a 6-A smart load switch battery charger, which integrates an
	  internal load switch with charge pump control and 4-path constant current
	  and constant voltage regulation, a 5-way hardware protection, and a 10-channel
	  12-bit ADC converter.
```

## drivers/hwpower/cc_hardware_ic/protocol_ic/Kconfig
```kconfig
#
# protocol ic drivers
#

config PROTOCOL_IC_SC200X
	bool "sc200x protocol ic"
	depends on ADAPTER_PROTOCOL
	default n
	help
	  Say Y here to enable sc200x protocol ic driver.
	  the sc200x protocol ic is used to communicate between a master device
	  and a single device over a singe wire bus. it is support SCP/FCP
	  fast charging protocol and type protocol.
	  This driver is to be used to configure, contorl and read status of
	  a slave device.
```

## drivers/hwpower/cc_hardware_ic/switch_capacitor/Kconfig
```kconfig
#
# huawei switch capacitor for direct charge drivers
#

config SWITCHCAP
	bool "switch_capacitor"
	depends on DIRECT_CHARGER
	default n
	help
	  Say Y here to enable switch capacitor driver.
	  This driver provides a unified interface for switch capacitor.
	  Support device:
	  bq25970
	  ltc7820
	  rt9759

config BQ25970
	bool "bq25970_for_direct_charge"
	depends on SWITCHCAP
	default n
	help
	  Say Y here to enable bq25970 driver.
	  BQ25970 is a 97% efficient, 8-A battery charging solution using a
	  switched cap architecture.
	  This architecture and the integrated FETs are optimized to enable
	  a 50% duty cycle.

config RT9759
	bool "rt9759_for_direct_charge"
	depends on SWITCHCAP
	default n
	help
	  Say Y here to enable rt9759 driver.
	  rt9759 is a high effiency and high charge current charger. The
	  efficiency is up to 97.8% when VBAT = 4.2V, IBAT = 2.5A and the
	  maximum charge current is up to 8A.

config LTC7820
	bool "ltc7820_for_direct_charge"
	depends on SWITCHCAP
	default n
	help
	  Say Y here to enable ltc7820 driver.
	  LTC7820 is a fixed ratio high voltage high power switched capacitor
	  and charge pump controller.
	  This device achieves a 2:1 step-down ratio form an input voltage as
	  high as 72v.

config SC8545
	  bool "sc8545_for_direct_charge"
	  depends on SWITCHCAP
	  default n
	  help
	  Say Y here to enable sc8545 driver.
	  sc8545 is a fixed ratio high voltage high power switched capacitor
	  and low voltage loadswtich ic.

config SM5450
	bool "sm5450_for_direct_charge"
	depends on SWITCHCAP
	default n
	help
	  Say Y here to enable sm5450 driver.
	  sm5450 is a fixed ratio high voltage high power switched capacitor
	  and low voltage loadswtich ic.

config AW32280
	bool "aw32280_for_direct_charge"
	depends on SWITCHCAP
	default n
	help
	  Say Y here to enable aw32280 driver.
	  aw32280 is a fixed ratio high voltage high power switched capacitor
	  and low voltage loadswtich ic.
```

## drivers/hwpower/cc_hardware_ic/wireless_charge_ic/Kconfig
```kconfig
#
# wireless charge ic driver
#

config WIRELESS_CPS7181
	bool "wireless cps7181"
	depends on WIRELESS_CHARGER
	default n
	help
	  Say Y here to enable cps7181 driver.
	  The cps7181 is an soc for magnetic induction
	  based wireless power receiver. it is fully compliant
	  with latest WPC Qi specification of BPP and EPP
	  and also supports various proprietary fast charging
	  protocols used by major smart phone OEM.

config WIRELESS_CPS4029
	bool "wireless cps4029"
	depends on WIRELESS_CHARGER
	default n
	help
	  Say Y here to enable cps4029 driver.
	  The cps4029 is an soc for magnetic induction
	  based wireless power receiver. it is fully compliant
	  with latest WPC Qi specification of BPP and EPP
	  and also supports various proprietary fast charging
	  protocols used by major smart phone OEM.

config WIRELESS_CPS4057
	bool "wireless cps4057"
	depends on WIRELESS_CHARGER
	default n
	help
	  Say Y here to enable cps4057 driver.
	  The cps4057 is an soc for magnetic induction
	  based wireless power receiver. it is fully compliant
	  with latest WPC Qi specification of BPP and EPP
	  and also supports various proprietary fast charging
	  protocols used by major smart phone OEM.

config WIRELESS_STWLC88
	bool "wireless stwlc88"
	depends on WIRELESS_CHARGER
	default n
	help
	  Say Y here to enable stwlc88 driver.
	  The stwlc68 is an soc for magnetic induction
	  based wireless power receiver. it is fully compliant
	  with latest WPC Qi specification of BPP and EPP
	  and also supports various proprietary fast charging
	  protocols used by major smart phone OEM.

config WIRELESS_MT5735
	bool "wireless mt5735"
	depends on WIRELESS_CHARGER
	default n
	help
	  Say Y here to enable mt5735 driver.
	  The mt5735 is an soc for magnetic induction
	  based wireless power receiver. it is fully compliant
	  with latest WPC Qi specification of BPP and EPP
	  and also supports various proprietary fast charging
	  protocols used by major smart phone OEM.
```

## drivers/hwpower/cc_hardware_monitor/Kconfig
```kconfig
#
# huawei hardware monitor drivers
#

source "drivers/hwpower/cc_hardware_monitor/vbus_monitor/Kconfig"
source "drivers/hwpower/cc_hardware_monitor/lga_check/Kconfig"
source "drivers/hwpower/cc_hardware_monitor/water_detect/Kconfig"
source "drivers/hwpower/cc_hardware_monitor/soc_control/Kconfig"
source "drivers/hwpower/cc_hardware_monitor/bat_heating/Kconfig"
source "drivers/hwpower/cc_hardware_monitor/temp_control/Kconfig"
source "drivers/hwpower/cc_hardware_monitor/acr_detect/Kconfig"
source "drivers/hwpower/cc_hardware_monitor/btb_check/Kconfig"
source "drivers/hwpower/cc_hardware_monitor/soc_decimal/Kconfig"
source "drivers/hwpower/cc_hardware_monitor/cpu_buck/Kconfig"
source "drivers/hwpower/cc_hardware_monitor/ffc_control/Kconfig"
source "drivers/hwpower/cc_hardware_monitor/smpl/Kconfig"
source "drivers/hwpower/cc_hardware_monitor/uscp/Kconfig"
source "drivers/hwpower/cc_hardware_monitor/water_check/Kconfig"
```

## drivers/hwpower/cc_hardware_monitor/acr_detect/Kconfig
```kconfig
#
# acr abnormal monitor drivers
#

config HUAWEI_BATT_ACR_DETECT
	bool "huawei batt acr detect"
	default n
	help
	  Say Y here to enable acr abnormal monitor driver.
```

## drivers/hwpower/cc_hardware_monitor/btb_check/Kconfig
```kconfig
#
# btb abnormal monitor drivers
#

config HUAWEI_BTB_CHECK
	bool "btb abnormal monitor"
	default n
	help
	  Say Y here to enable btb abnormal monitor driver.
```

## drivers/hwpower/cc_hardware_monitor/ffc_control/Kconfig
```kconfig
#
# ffc control drivers
#

config HUAWEI_FFC_CONTROL
	bool "huawei ffc control"
	default n
	help
	  Say Y here to enable ffc control driver.
	  This module monitor charge cut-off voltage,
	  including increasing cut-off voltage and vbat safety strategy.
```
