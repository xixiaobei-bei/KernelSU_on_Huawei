## drivers/hwpower/cc_hardware_monitor/lga_check/Kconfig
```kconfig
#
# lga board abnormal monitor drivers
#

config HUAWEI_LGA_CHECK
	bool "lga board abnormal monitor"
	default n
	help
	  Say Y here to enable lga board abnormal monitor driver.
```

## drivers/hwpower/cc_hardware_monitor/ship_mode/Kconfig
```kconfig
# SPDX-License-Identifier: GPL-2.0
#
# ship mode drivers
#

config HUAWEI_SHIP_MODE
	bool "ship mode"
	default n
	help
	  Say Y here to enable ship mode driver.
	  Ship mode: isolating battery from vsys loads during phone
	  shipping/storage to prevent battery discharge by system leakage.
```

## drivers/hwpower/cc_hardware_monitor/soc_decimal/Kconfig
```kconfig
#
# calculate soc with decimal drivers
#

config HUAWEI_SOC_DECIMAL
	bool "soc with decimal"
	default n
	help
	  Say Y here to enable soc with decimal driver.
	  We know that the stage of capacity is calculated by
	  integrating the electric current of the electricity meter.
	  At present, we calculate the soc with decimal by software.
```
