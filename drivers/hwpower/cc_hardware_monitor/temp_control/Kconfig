## drivers/hwpower/cc_hardware_monitor/temp_control/Kconfig
```kconfig
#
# huawei temperature control drivers
#

config HUAWEI_TEMP_CONTROL
	bool "huawei temperature control"
	default n
	help
	  Say Y here to enable huawei temperature control driver.
```

## drivers/hwpower/cc_hardware_monitor/uscp/Kconfig
```kconfig
#
# usb port short circuit monitor drivers
#

config HUAWEI_USB_SHORT_CIRCUIT_PROTECT
	bool "huawei usb short circuit protect"
	default n
	help
	  Say Y here to enable usb port short circuit monitor driver.
	  We will cutoff charging path by set charger into hiz mode and
	  open mos switch when usb port short circuit happend.
```

## drivers/hwpower/cc_hardware_monitor/vbus_monitor/Kconfig
```kconfig
#
# vbus monitor drivers
#

config HUAWEI_VBUS_MONITOR
	bool "vbus monitor"
	default n
	help
	  Say Y here to enable vbus monitor driver.
```

## drivers/hwpower/cc_isolation/Kconfig
```kconfig
#
# huawei power isolation drivers
#

config HUAWEI_POWER_EMBEDDED_ISOLATION
	bool "huawei power isolation module"
	default n
	help
	  Say Y here to enable power isolation driver.
```

## drivers/hwpower/cc_protocol/Kconfig
```kconfig
source "drivers/hwpower/cc_protocol/adapter_protocol/Kconfig"
source "drivers/hwpower/cc_protocol/wireless_protocol/Kconfig"
```

## drivers/hwpower/cc_protocol/adapter_protocol/Kconfig
```kconfig
#
# huawei adapter protocol drivers
#

config ADAPTER_PROTOCOL
	bool "adapter protocol"
	default n
	help
	  Say Y here to enable adapter protocol driver.
	  This driver provides a unified interface to the adapter protocol.
	  Currently supported adapter protocols as below:
	  Huawei FCP protocol.
	  Huawei SCP protocol.

config ADAPTER_PROTOCOL_FCP
	bool "huawei adapter protocol with fcp"
	depends on ADAPTER_PROTOCOL
	default n
	help
	  Say Y here to enable adapter fcp protocol driver.
	  The fast adapter protocol is used to communicate between a master
	  device and a single device over a singe wire bus. the protocol is
	  meant to be used to configure, control and read the status of
	  a slave device.

config ADAPTER_PROTOCOL_SCP
	bool "huawei adapter protocol with scp"
	depends on ADAPTER_PROTOCOL
	default n
	help
	  Say Y here to enable adapter scp protocol driver.
	  The smart adapter protocol is used to communicate between a master
	  device and a single device over a singe wire bus. the protocol is
	  meant to be used to configure, control and read the status of
	  a slave device.

config ADAPTER_PROTOCOL_PD
	bool "huawei adapter protocol with pd"
	depends on ADAPTER_PROTOCOL
	default n
	help
	  Say Y here to enable adapter pd protocol driver.
	  The pd adapter protocol is used to communicate between a master
	  device and a single device over a cc bus. the protocol is
	  meant to be used to configure, control and read the status of
	  a slave device.

config ADAPTER_PROTOCOL_UVDM
	bool "huawei adapter protocol with uvdm"
	depends on ADAPTER_PROTOCOL
	default n
	help
	  Say Y here to enable adapter uvdm protocol driver.
	  The uvdm adapter protocol is used to communicate between a master
	  device and a single device over a cc bus. the protocol is
	  meant to be used to configure, control and read the status of
	  a slave device.
```

## drivers/hwpower/cc_protocol/wireless_protocol/Kconfig
```kconfig
#
# huawei wireless protocol drivers
#

config WIRELESS_PROTOCOL
	bool "wireless protocol"
	default n
	help
	  Say Y here to enable wireless protocol driver.
	  This driver provides a unified interface to the wireless protocol.
	  Currently supported wireless protocols as below:
	  QI/WPC protocol.

config WIRELESS_PROTOCOL_QI
	bool "wireless protocol with qi"
	depends on WIRELESS_PROTOCOL
	default n
	help
	  Say Y here to enable wireless qi protocol driver.
	  Qi (pronounced “chee”) is the world’s de facto wireless charging
	  standard for providing 5-15 watts of power to small personal
	  electronics. Though it is primarily used to charge smartphones,
	  the standard can also apply and easily be used to provide power
	  for a growing number of consumer devices.
	  With more than 3,700 Qi-Certified products on the market today,
	  Qi delivers a positive and safe wireless charging experience.
	  The Wireless Power Consortium and its 650+ member companies are
	  committed to continuing to grow this market by delivering
	  differentiated and affordable products.
```

## drivers/hwsensors/hall/Kconfig
```kconfig
#
# huawei hall interface
#

config HUAWEI_HALL_INTERFACE
	bool "hall interface"
	default n
	help
	  Say Y here to enable hall interface.
```

## drivers/hwxcollie/Kconfig
```kconfig
config HW_XCOLLIE
	depends on HW_LOGGER
	bool "Huawei kernel xcollie driver"
	default n
	---help---
	  This feature support to kernel xcollie
```

## drivers/hwzerohung/Kconfig
```kconfig
config HW_ZEROHUNG
	depends on HW_LOGGER
	bool "Huawei zero hung driver"
	default n
	---help---
	  This feature support to catch hung log

config HW_CGROUP_INFO
	depends on CGROUPS
	depends on CGROUP_FREEZER
	bool "Huawei cgroup info for dfr"
	default n
	---help---
	  This feature support to catch freezer cgroup hung

config HW_FREEZEDETECTOR
	depends on HW_LOGGER
	bool "Huawei zero hung send with hievent"
	default n
	---help---
	  This feature support to send hung log with hievent
```

## drivers/iommu/hisi/Kconfig
```kconfig
# Hisilicon IOMMU support

config HISI_IODOMAIN_API
	bool

config HISI_IOMMU
	bool "Hisilicon IOMMU Support"
	select IOMMU_API
	select HISI_IODOMAIN_API
	help
	  Hisilicon IOMMU Support.

config HISI_IOMMU_LPAE
	bool "Hisilicon IOMMU LPAE Support"
	select IOMMU_API
	depends on HISI_IOMMU
	help
	  Hisilicon IOMMU Support.

config HISI_IOMMU_BYPASS
	bool "Hisilicon IOMMU Bypass Support"
	select IOMMU_API
	depends on HISI_IOMMU
	help
	  Hisilicon IOMMU Bypass Support.

config HISI_IOMMU_LEGACY
	bool "Hisilicon IOMMU SECOND LEVEL PAGE TABLE Support"
	select IOMMU_API
	depends on HISI_IOMMU && !HISI_IOMMU_LPAE
	help
	  Hisilicon IOMMU Support.

config HISI_IOMMU_TEST
	bool "Hisilicon IOMMU TEST Support"
	depends on HISI_IOMMU_LPAE
	select IOMMU_API
	help
	  Hisilicon IOMMU Support.

config HISI_IOMMU_IOVA_DEBUG
        bool "Hisilicon IOMMU IOVA DEBUG Support"
	depends on HISI_IOMMU
	default n
	help
	  Hisilicon IOMMU IOVA DEBUG Support

config HISI_SVM
	tristate "HISI SVM driver"
	select MMU_NOTIFIER
	---help---
	  This option enables support for the hisi svm features base on the ARM
	  smmu v3 hardware. Select this option if you want to use devices by ssid
	  and asid interface.

config HISI_SMMUV310
	bool "HISI SMMUV310 Support"
	depends on HISI_SVM
	default n
	help
	  HISI SMMUV310 Support
```

## drivers/iomt_host/Kconfig
```kconfig
#
# huawei mmc/ufs host device state stat config
#

config HUAWEI_DSM_IOMT_HOST
	bool "Huawei dsm iomt host"
	default n
	help
	  enable host state stat feature.

config HUAWEI_DSM_IOMT_EMMC_HOST
	bool "Huawei dsm iomt emmc host"
	depends on MMC != n && HUAWEI_DSM_IOMT_HOST != n
	default n
	help
	  enable emmc host state stat feature.
```

## drivers/media/huawei/camera/hisp/hisp310/Kconfig
```kconfig
comment "HISI ISP"

choice
	prompt "HISP Version"
	default HUAWEI_CAMERA_USE_HISP310
	depends on HUAWEI_CAMERA
	help
        Select ISP version.

config HUAWEI_CAMERA_USE_HISP310
	bool "HISP310"
	depends on HUAWEI_CAMERA

endchoice
```

## drivers/media/huawei/camera/laser/vi53xx/vi5300/Kconfig
```kconfig
config VI5300
	tristate "VI5300 I2C DEVICE"
	depends on I2C && SYSFS
	help
	  Using I2C
```

## drivers/media/huawei/swingcam/Kconfig
```kconfig
config CONTEXTHUB_SWING_CAM
	bool "swing cam driver"
	depends on INPUTHUB_20&&HUAWEI_CAMERA
	default n
	help
	Swing driver support camera.
```

## drivers/mfd/hisi_hi6562_pmic_mipi/Kconfig
```kconfig
config HISI_HI6562_PMIC_MIPI
	tristate "platform pmu62 pmic mipi"
	depends on OF
	help
	  This driver supports platform pmu62 power to control TOF cameras.
```

## drivers/pci/dwc/Kconfig
```kconfig
menu "DesignWare PCI Core Support"

config PCIE_DW
	bool

config PCIE_DW_HOST
        bool
	depends on PCI
	depends on PCI_MSI_IRQ_DOMAIN
        select PCIE_DW

config PCIE_DW_EP
	bool
	depends on PCI_ENDPOINT
	select PCIE_DW

config PCI_DRA7XX
	bool "TI DRA7xx PCIe controller"
	depends on SOC_DRA7XX || COMPILE_TEST
	depends on (PCI && PCI_MSI_IRQ_DOMAIN) || PCI_ENDPOINT
	depends on OF && HAS_IOMEM && TI_PIPE3
	help
	 Enables support for the PCIe controller in the DRA7xx SoC. There
	 are two instances of PCIe controller in DRA7xx. This controller can
	 work either as EP or RC. In order to enable host-specific features
	 PCI_DRA7XX_HOST must be selected and in order to enable device-
	 specific features PCI_DRA7XX_EP must be selected. This uses
	 the DesignWare core.

if PCI_DRA7XX

config PCI_DRA7XX_HOST
	bool "PCI DRA7xx Host Mode"
	depends on PCI
	depends on PCI_MSI_IRQ_DOMAIN
	select PCIE_DW_HOST
	default y
	help
	 Enables support for the PCIe controller in the DRA7xx SoC to work in
	 host mode.

config PCI_DRA7XX_EP
	bool "PCI DRA7xx Endpoint Mode"
	depends on PCI_ENDPOINT
	select PCIE_DW_EP
	help
	 Enables support for the PCIe controller in the DRA7xx SoC to work in
	 endpoint mode.

endif

config PCIE_DW_PLAT
	bool "Platform bus based DesignWare PCIe Controller"
	depends on PCI
	depends on PCI_MSI_IRQ_DOMAIN
	select PCIE_DW_HOST
	---help---
	 This selects the DesignWare PCIe controller support. Select this if
	 you have a PCIe controller on Platform bus.

	 If you have a controller with this interface, say Y or M here.

	 If unsure, say N.

config PCI_EXYNOS
	bool "Samsung Exynos PCIe controller"
	depends on PCI
	depends on SOC_EXYNOS5440
	depends on PCI_MSI_IRQ_DOMAIN
	select PCIEPORTBUS
	select PCIE_DW_HOST

config PCI_IMX6
	bool "Freescale i.MX6 PCIe controller"
	depends on PCI
	depends on SOC_IMX6Q
	depends on PCI_MSI_IRQ_DOMAIN
	select PCIEPORTBUS
	select PCIE_DW_HOST

config PCIE_SPEAR13XX
	bool "STMicroelectronics SPEAr PCIe controller"
	depends on PCI
	depends on ARCH_SPEAR13XX
	depends on PCI_MSI_IRQ_DOMAIN
	select PCIEPORTBUS
	select PCIE_DW_HOST
	help
	  Say Y here if you want PCIe support on SPEAr13XX SoCs.

config PCI_KEYSTONE
	bool "TI Keystone PCIe controller"
	depends on PCI
	depends on ARCH_KEYSTONE
	depends on PCI_MSI_IRQ_DOMAIN
	select PCIEPORTBUS
	select PCIE_DW_HOST
	help
	  Say Y here if you want to enable PCI controller support on Keystone
	  SoCs. The PCI controller on Keystone is based on DesignWare hardware
	  and therefore the driver re-uses the DesignWare core functions to
	  implement the driver.

config PCI_LAYERSCAPE
	bool "Freescale Layerscape PCIe controller"
	depends on PCI
	depends on OF && (ARM || ARCH_LAYERSCAPE)
	depends on PCI_MSI_IRQ_DOMAIN
	select MFD_SYSCON
	select PCIE_DW_HOST
	help
	  Say Y here if you want PCIe controller support on Layerscape SoCs.

config PCI_HISI
	depends on OF && ARM64
	bool "HiSilicon Hip05 and Hip06 SoCs PCIe controllers"
	depends on PCI
	depends on PCI_MSI_IRQ_DOMAIN
	select PCIEPORTBUS
	select PCIE_DW_HOST
	select PCI_HOST_COMMON
	help
	  Say Y here if you want PCIe controller support on HiSilicon
	  Hip05 and Hip06 SoCs

config PCIE_QCOM
	bool "Qualcomm PCIe controller"
	depends on PCI
	depends on ARCH_QCOM && OF
	depends on PCI_MSI_IRQ_DOMAIN
	select PCIEPORTBUS
	select PCIE_DW_HOST
	help
	  Say Y here to enable PCIe controller support on Qualcomm SoCs. The
	  PCIe controller uses the DesignWare core plus Qualcomm-specific
	  hardware wrappers.

config PCIE_ARMADA_8K
	bool "Marvell Armada-8K PCIe controller"
	depends on PCI
	depends on ARCH_MVEBU
	depends on PCI_MSI_IRQ_DOMAIN
	select PCIEPORTBUS
	select PCIE_DW_HOST
	help
	  Say Y here if you want to enable PCIe controller support on
	  Armada-8K SoCs. The PCIe controller on Armada-8K is based on
	  DesignWare hardware and therefore the driver re-uses the
	  DesignWare core functions to implement the driver.

config PCIE_ARTPEC6
	bool "Axis ARTPEC-6 PCIe controller"
	depends on PCI
	depends on MACH_ARTPEC6
	depends on PCI_MSI_IRQ_DOMAIN
	select PCIEPORTBUS
	select PCIE_DW_HOST
	help
	  Say Y here to enable PCIe controller support on Axis ARTPEC-6
	  SoCs.  This PCIe controller uses the DesignWare core.

config PCIE_KPORT
	bool "Kport PCIe controller"
	depends on PCI
	depends on PCI_MSI_IRQ_DOMAIN
	select PCIEPORTBUS
	select PCIE_DW_HOST
	help
	  Say Y here to enable PCIe controller support on Kport SoCs.
	  The PCIe controller uses DesignWare core.

config PCIE_KPORT_V1
	bool "Kport PCIe V1"
	depends on PCIE_KPORT
	help
	  Say Y here to enable Kport PCIe V1.

config PCIE_KPORT_TEST
	tristate "kport PCIe test"
	depends on PCIE_KPORT
	help
	  Say Y here if you want to use testcases for PCIe controller on kport SoC

config PCIE_KPORT_SLT
	tristate "kport PCIe SLT"
	depends on PCIE_KPORT
	help
	  Say Y here if you want to use SLT Func for PCIe on kport SoC

config PCIE_KPORT_SLT_DEVICE
	tristate "kport PCIe SLT test with device"
	depends on PCIE_KPORT_SLT
	help
	  Say Y here if you want to use SLT Func for kport PCIe with device

config PCIE_KIRIN_SLT_HI110X
	tristate "kport PCIe SLT connected with wifi"
	depends on PCIE_KPORT_SLT
	help
	  Say Y here if you want to use SLT Func for kport PCIe with device wifi

config PCIE_KPORT_MNTN
	tristate "kport PCIe mntn log"
	depends on PCIE_KPORT
	help
	  Say Y here if you want PCIe controller support on kport SoC

config PCIE_KPORT_FEB
	tristate "kport PCIe RC-Feb"
	select PCIE_KPORT

config PCIE_KPORT_MAR
	tristate "kport PCIe RC-Mar"
	select PCIE_KPORT

config PCIE_KPORT_APR
	tristate "kport PCIe RC-Apr"
	select PCIE_KPORT
	select PCIE_KPORT_CPLTIMEOUT_INT

config PCIE_KPORT_MAY
	tristate "kport PCIe RC-May"
	select PCIE_KPORT
	select PCIE_KPORT_CPLTIMEOUT_INT

config PCIE_KPORT_SEP
	tristate "kport PCIe RC-Sep"
	select PCIE_KPORT
	select PCIE_KPORT_CPLTIMEOUT_INT

config PCIE_KPORT_BURB
	tristate "kport PCIe RC-Burb"
	select PCIE_KPORT
	select PCIE_KPORT_CPLTIMEOUT_INT

config PCIE_KPORT_JUN
	tristate "kport PCIe RC-Jun"
	select PCIE_KPORT
	select PCIE_KPORT_CPLTIMEOUT_INT

config PCIE_KPORT_CPLTIMEOUT_INT
	bool
	depends on PCIE_KPORT
	help
	  Say Y here to add cpltimeout interrupt on kport SoC

config PCIE_KPORT_IDLE
	bool "kport PCIe L1ss idle"
	depends on PCIE_KPORT
	help
	  Say Y here to enable pcie L1ss idle on kport SOC

config KIRIN_PCIE_L1SS_IDLE_SLEEP
	bool "kport PCIe L1ss idle timeout&wake interrupts"
	depends on PCIE_KPORT_IDLE
	help
	  Say Y here to add L1ss idle timeout&wake interrupts on kport SOC

config PCIE_KPORT_NOC_DBG
	tristate "pcie_kport NOC DEBUG"
	select PCIE_KPORT
	help
	  Say Y here to dump kport pcie host info when PCIe NOC happen

config KIRIN_PCIE_NOC_DBG
	tristate "kport NOC DEBUG"
	select PCIE_KPORT
	help
	  Say Y here if you want dump pcie host info when PCIe NOC happen

config PCIE_KPORT_PHY
	tristate "kport PCIe PHY"
	select PCIE_KPORT
	help
	  Say Y here if you want select kport pcie phy

config PCIE_KPORT_PHY_XW
	tristate "kport PCIe PHY-XW"
	select PCIE_KPORT
	help
	  Say Y here if you want select kport pcie phy-xw

config PCIE_KPORT_DBI_SPLT
	tristate "kport PCIe dbi splt"
	select PCIE_KPORT
	help
	  Say Y here if need support PCIe dbi ep memory split

config PCIE_KPORT_PC
	bool "kport Phoenix PC use this"
	default n

endmenu
```
