## drivers/huawei_platform/sensor/pos_optocoupler/Kconfig
```kconfig
#
# pos_optocoupler driver configuration
#
config POS_OPTOCOUPLER
	bool "huawei pos_optocoupler driver"
	default n
	help
	Say yes here to support for pos optocoupler.
```

## drivers/huawei_platform/thermal/ntc_thermal/Kconfig
```kconfig
config HISI_EXT_NTC
	bool "huawei watch ntc"
	default n
	help
	  Say Y here to enable watch ntc thermal driver.
	  This driver works only on smartwatch.
```

## drivers/huawei_platform/touch_key/Kconfig
```kconfig
#
# touch key driver configuration
#
menuconfig HW_PLAY_KEY
	bool "huawei play key driver"
	default n
	help
	Say yes here to support for touch key.
```

## drivers/huawei_platform/usb/hw_pogopin/Kconfig
```kconfig
#
# huawei pogopin drivers
#

config POGO_PIN
	bool "huawei pogopin support"
	default n
	help
	  Say Y here to enable pogopin driver.
```

## drivers/huawei_platform/usb/otg_gpio_id/Kconfig
```kconfig
#
# huawei gpio based for otgid drivers
#

config OTG_GPIO_ID
	bool "OTG_GPIO_ID support"
	default n
	depends on GPIOLIB
	help
	  Say Y here to enable gpio based switch for otgid driver.
```

## drivers/huawei_platform/usb/otg_gpio_switch/Kconfig
```kconfig
#
# huawei gpio switch for otgid drivers
#

config SWITCH_OTGID_GPIO
	bool "SWITCH_OTGID_GPIO support"
	default n
	help
	  Say Y here to enable gpio switch for otgid driver.
```

## drivers/huawei_platform/usb/pd/Kconfig
```kconfig
source "drivers/huawei_platform/usb/pd/richtek/Kconfig"
source "drivers/huawei_platform/usb/pd/develop/Kconfig"

config TYPEC_CAP_CUSTOM_SRC2
        bool "Support Double 22/10k Pullup Function"
        default n
        help
          Say Y to enable
```

## drivers/huawei_platform/usb/pd/develop/Kconfig
```kconfig
#
# TypeC Port Controller Device Configuration
#

config HW_TCPC_CLASS
	bool "Huawei typec Port Controller Device Class"
	default n
	help
	  Say Y to enable
	  Typec Port
	  Controller Device
	  Class

config HW_USB_POWER_DELIVERY
	bool "Support Huawei USB power delivery Function"
	depends on HW_TCPC_CLASS
	default n
	help
	  Say Y to enable
	  USB
	  Power Delivery
	  support

config HW_TCPC_RT1711H
	bool "RT1711H TypeC port Controller Driver"
	depends on HW_TCPC_CLASS
	default n
	help
	  Say Y to enable
	  Richtek RT1711H
	  TypeC port Controller
	  Driver

config HW_USB_PD_VBUS_STABLE_TOUT
	int "Huawei PD VBUS Stable Timeout"
	depends on HW_USB_POWER_DELIVERY
	range 0 1000
	default 125
	help
	  Setup a timeout value (ms)
	  for
	  VBUS change
	  stable

config HW_DUAL_ROLE_USB_INTF
	bool "Generic huawei DUAL ROLE sysfs interface"
	depends on HW_TCPC_CLASS
	default n
	help
	  A generic sysfs interface to track and change the state of
	  dual role usb phys. The usb phy drivers can register to
	  this interface to expose it capabilities to the userspace
	  and thereby allowing userspace to change the port mode.
```

## drivers/huawei_platform/usb/superswitch/Kconfig
```kconfig
config SUPERSWITCH
	tristate "superswitch support"
	default n
	help
	  Say Y here to enable superswitch support.

config SUPERSWITCH_FSC
	tristate "fsc superswitch support"
	depends on SUPERSWITCH
	help
	  Say Y here to enable fsc superswitch support.
```

## drivers/huawei_platform/usb/usb_extra_modem/Kconfig
```kconfig
config USB_EXTRA_MODEM
	bool "huawei usb extra modem driver"
	default n
	help
	  Enable this option to support extra modem by usb.
```

## drivers/huawei_platform/vibrator/ext_vibrator/Kconfig
```kconfig
#
#vibator ext_vibrator driver configuration
#
config HISI_EXT_VIBRATOR
	bool "Led classdev ext_vibrator hisi driver"
	depends on LEDS_TRIGGERS && LEDS_TRIGGER_TRANSIENT
	default n
	help
	  Say Y to enable support for the Hisilicon EXT vibrator driver.

	  To compile this driver as a module, choose M here: the module will be
	  called hisi ext vibrator driver.
```

## drivers/huawei_platform/wakeup/Kconfig
```kconfig
#
# wakeup report configuration
#

config WAKEUP
    tristate "Wakeup"
    default n
    help
      add this to support wakeup
```

## drivers/hwbootfail/Kconfig
```kconfig
#
# huawei device state monitor configuration
#

config BOOT_DETECTOR
	bool "Boot Detector"
	default n
	help
	  If you say yes here you get support for huawei Boot Detector solution.

config BOOT_DETECTOR_HISI
	bool "Boot Detector for hisi"
	default n
	help
	  If you say yes here you get support for huawei Boot Detector solution on hisi.

config BOOT_DETECTOR_QCOM
	bool "Boot Detector for qcom"
	default n
	help
	  If you say yes here you get support for huawei Boot Detector solution on qcom.

config BOOT_DETECTOR_MTK
	bool "Boot Detector for mtk"
	default n
	help
	  If you say yes here you get support for huawei Boot Detector solution on mtk.

config BOOT_DETECTOR_MTK_4G
	bool "Boot Detector for mtk-4g"
	default n
	help
	  If you say yes here you get support for huawei Boot Detector solution on mtk-4g.

config BOOT_DETECTOR_HONGHU
	bool "Boot Detector for honghu"
	default n
	help
	  If you say yes here you get support for huawei Boot Detector solution on honghu.

config BOOT_RECOVERY
    bool "use Boot Recovery"
    default n
    help
      If you say yes here you get support for huawei Boot Recovery solution

config BOOT_DETECTOR_DBG
        bool "Boot Detector debug"
        default n
        help
          If you say yes here you get support for huawei Boot Detector debug.
```

## drivers/hwgtm/Kconfig
```kconfig
#
# huawei global task manager
#

menuconfig HUAWEI_GLOBAL_TASK_MANAGER
	bool "Huawei global task manager"
	default n
	help
	  Support for huawei global task manager.
```

## drivers/hwmemcheck/Kconfig
```kconfig
config HW_MEMCHECK
	depends on HW_LOGGER
	bool "Huawei memory checker driver"
	default n
	---help---
	  This feature support to memory leak check
```

## drivers/hwnet/Kconfig
```kconfig
source "drivers/hwnet/ipv4/Kconfig"
source "drivers/hwnet/booster/Kconfig"
source "drivers/hwnet/chr/Kconfig"
source "drivers/hwnet/hw_dpi_mark/Kconfig"
```

## drivers/hwnet/booster/Kconfig
```kconfig
config HW_BOOSTER
    tristate "Network-related optimization acceleration features."
    default n
    help
      Provide network acceleration, business quality assessment
      and other functions.
config HW_PACKET_FILTER_BYPASS
    tristate "huawei iptables and bpf interception detection and bypass module"
    default n
    help
      Detect whether the network packet of foreground uid is dropped by netfilter
      or bpf, and then try to recovery it.
config HW_NETWORK_QOE
    tristate "Network-Qoe optimization features."
    default n
    help
      Provide network Qoe feature.
config HW_NETWORK_SLICE
    tristate "network slice management features."
    default n
    help
      Provide ip report and route selection feature.
config HW_ICMP_PING_DETECT
    tristate "icmp ping detect features."
    default n
    help
      Provide icmp ping detect feature.
config TCP_CONG_ALGO_CTRL
    tristate "Dynamic control tcp congestion algorithms"
    default n
    help
      Detect network state and uid state to change tcp congestion algorithm
config HW_PACKET_TRACKER
    tristate "CONFIG HW PACKET TRACKER."
    default n
    help
      Tracking data transport time in kernel and report chr if detect slow.
config APP_ACCELERATOR
    tristate "app accelertor"
    default n
    help
      app accelertor
config HW_STEADY_SPEED_STATS
    tristate "steady speed statistics"
    default n
    help
      count the steady speed for specific uid.
config STREAM_DETECT
    tristate "stream detect features."
    default n
    help
      Provide stream anomaly detection feature.
```

## drivers/hwnet/hw_dual_connection/Kconfig
```kconfig
config HW_DC_MODULE
	tristate "kernel huawei custom packet dual connection for wlan"
	default n
	help
		This module adds support dual connection feature.
```

## drivers/hwnet/ipv4/Kconfig
```kconfig
config HW_WIFIPRO
	bool "Huawei wifipro tcp monitor support"
	default n

config HW_WIFIPRO_PROC
	bool "Huawei wifipro proc support"
	depends on HW_WIFIPRO
	default n

config WIFI_DELAY_STATISTIC
	bool "wifi delay statistic"
	default n

config HW_SNIFFER
	bool "hw sniffer"
	default n

config HW_CHR_TCP_SMALL_WIN_PROC
	bool "Huawei tcp small window monitor proc support"
	depends on HW_CHR_TCP_SMALL_WIN_MONITOR
	default n

config HW_WIFI_TEMP
	bool "Huawei wifi temperature upload"
	default n
```

## drivers/hwnet/waudio/Kconfig
```kconfig
config HW_WAUDIO_MODULE
	tristate "kernel huawei custom packet wifi audio for wlan"
	default n
	help
		This module adds support wifi audio feature.
```

## drivers/hwpower/Kconfig
```kconfig
#
# huawei power common drivers
#

source "drivers/hwpower/cc_isolation/Kconfig"
source "drivers/hwpower/cc_common_module/Kconfig"
source "drivers/hwpower/cc_protocol/Kconfig"
source "drivers/hwpower/cc_coul/Kconfig"
source "drivers/hwpower/cc_hardware_ic/Kconfig"
source "drivers/hwpower/cc_hardware_monitor/Kconfig"
source "drivers/hwpower/cc_hardware_channel/Kconfig"
source "drivers/hwpower/cc_battery/Kconfig"
source "drivers/hwpower/cc_charger/Kconfig"
```

## drivers/hwpower/cc_battery/Kconfig
```kconfig
#
# huawei battery drivers
#

config HUAWEI_BATTERY_CORE
	bool "huawei battery core driver"
	default n
	help
	  Say Y here to enable battery core driver.
	  This driver updates the basic informations of battery
	  through battery model and coul interface, and provides
	  interface for application layer through power supply.

config HUAWEI_MIXED_BATT
	bool "huawei mixed battery power supply"
	help
	  Say Y here to enable support for battery
	  power supply. this module cooperate with multi
	  sub battery power supply for third party
	  fuelguage IC to monitor battery status.

source "drivers/hwpower/cc_battery/battery_model/Kconfig"
source "drivers/hwpower/cc_battery/battery_fault/Kconfig"
source "drivers/hwpower/cc_battery/battery_ui_capacity/Kconfig"
source "drivers/hwpower/cc_battery/battery_soh/Kconfig"
source "drivers/hwpower/cc_battery/battery_temp/Kconfig"
source "drivers/hwpower/cc_battery/battery_type_identify/Kconfig"
```

## drivers/hwpower/cc_battery/battery_fault/Kconfig
```kconfig
#
# huawei battery fault driver
#

config HUAWEI_BATTERY_FAULT
	bool "huawei battery fault driver"
	default n
	help
	  Say Y here to enable battery fault driver.
	  This driver detects battery low voltage and other abnormalities,
	  report corresponding DMD, and provides external interface to
	  obtain current battery abnormal state.
```

## drivers/hwpower/cc_battery/battery_model/Kconfig
```kconfig
#
# huawei battery model driver
#

config HUAWEI_BATTERY_MODEL
	bool "huawei battery model driver"
	default n
	help
	  Say Y here to enable battery model driver.
	  This driver provides a unified interface to battery model,
	  such as: battery name, rated capacity, etc.
	  It shields battery model differences between platforms.
```
