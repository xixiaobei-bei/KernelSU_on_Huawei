## drivers/huawei_platform/emcom/nstack/Kconfig
```kconfig
menuconfig HW_EMCOM_NSTACK
	bool "Huawei Emcom Nstack"
	depends on HUAWEI_EMCOM
	default n

if HW_EMCOM_NSTACK
source "drivers/huawei_platform/emcom/nstack/fi/Kconfig"
endif # if HW_EMCOM_NSTACK
```

## drivers/huawei_platform/hwdps/Kconfig
```kconfig
config HWDPS
	bool "hwdps System"
	default n
	help
	Huawei Application Authentication System
```

## drivers/huawei_platform/hwsdp/Kconfig
```kconfig
config HWSDP
	bool "HWSDP System"
	default y
	help
	Huawei Sensitive Data Protection Module
```

## drivers/huawei_platform/multichip_skytone/Kconfig
```kconfig
menuconfig MULTICHIP_SKYTONE
	bool "huawei mcskytone driver support"
	default n
	help
		Say yes here to support the mcskytone function
```

## drivers/huawei_platform/net/Kconfig
```kconfig
source "drivers/huawei_platform/net/ipv4/Kconfig"
source "drivers/huawei_platform/net/hw_netfilter/Kconfig"
source "drivers/huawei_platform/net/netbooster/Kconfig"
source "drivers/huawei_platform/net/himos/Kconfig"
source "drivers/huawei_platform/net/bastet/Kconfig"
```

## drivers/huawei_platform/net/ipv4/Kconfig
```kconfig
config HW_WIFI
	bool "Huawei wifi tcp monitor support"
	default n

config HW_WIFI_MSS
    bool "Huawei WLAN MIMO SISO switch support"
    default n

config HW_WIFI_RSSI
    bool "Huawei TAS RSSI report support"
    default n

config HUAWEI_MSS_AUTO_CHANGE
        bool "Huawei MSS auto change function support"
        default n

config HW_SYN_LINEAR_RETRY
        bool "Huawei tcp syn sent linear retry support"
        default n

config HW_GET_EXT_SIG_ULDELAY
	bool "Huawei wifi add uplink delay parameter support"
	default n

config HW_WIFI_EXT
	bool "Huawei wifi ext support"
	default n
```

## drivers/huawei_platform/nfc/st21nfc/Kconfig
```kconfig
#
# Near Field Communication (NFC) devices
#
config NFC_ST21NFC
	tristate "ST21NFC NFC driver"
	depends on I2C
	select CRC_CCITT
	default n
	---help---
	  Say yes if you want PN547/PN548 Near Field Communication driver.
	  This is for i2c connected version. If unsure, say N here.

	  To compile this driver as a module, choose m here. The module will
	  be called ST21NFC.
```

## drivers/huawei_platform/pmeminfo/Kconfig
```kconfig
menu "Huawei memory info dump"

config TOPN_MEMINFO_DUMP
	bool "Memory info dump for TopN"
	default n
	help
	   Dump process info and memory info for TopN

endmenu
```

## drivers/huawei_platform/power/Kconfig
```kconfig
source "drivers/huawei_platform/power/charger/Kconfig"
source "drivers/huawei_platform/power/hardware_ic/Kconfig"
source "drivers/huawei_platform/power/hardware_channel/Kconfig"
source "drivers/huawei_platform/power/battery/Kconfig"
source "drivers/huawei_platform/power/hw_kstate/Kconfig"
source "drivers/huawei_platform/power/pid_socket/Kconfig"
source "drivers/huawei_platform/power/wifi_filter/Kconfig"
```

## drivers/huawei_platform/power/battery/Kconfig
```kconfig
source "drivers/huawei_platform/power/battery/battery_ct/Kconfig"
source "drivers/huawei_platform/power/battery/battery_voltage/Kconfig"
source "drivers/huawei_platform/power/battery/battery_temp_fitting/Kconfig"
source "drivers/huawei_platform/power/battery/battery_capacity/Kconfig"
```

## drivers/huawei_platform/power/battery/battery_capacity/Kconfig
```kconfig
#
# Huawei battery capacity configuration
#

config HUAWEI_BATTERY_CAPACITY
	bool "huawei battery capacity"
	default n
	help
	  Say Y here to enable huawei battery capacity support.
	  Support series battery capacity.
	  Compatible with hisi coul driver.
	  Depend on "huawei-battery" power supply.

config HUAWEI_SERIES_BATT_CAP
	bool "huawei series battery capacity"
	default n
	help
	  Say Y here to enable series battery capacity module.
	  This module monitor dual battery capacity,
	  and mixed two battery SOC to huawei battery module.
	  Should register "huawei-battery" power supply.
```

## drivers/huawei_platform/power/battery/battery_ct/Kconfig
```kconfig
menu "Battery certification support"

menuconfig HUAWEI_BATTERY_INFORMATION
	bool
	prompt "Certificate battery by information of IC."
	default n

source "drivers/huawei_platform/power/battery/battery_ct/maxim/Kconfig"
source "drivers/huawei_platform/power/battery/battery_ct/nxp/Kconfig"
source "drivers/huawei_platform/power/battery/battery_ct/onewire/Kconfig"

endmenu
```

## drivers/huawei_platform/power/battery/battery_ct/infineon/Kconfig
```kconfig
#
# IC SLE test drivers
#

config HUAWEI_BATTCT_SLE95250
	bool
	prompt "Support sle95250 as certification IC."
	depends on HUAWEI_BATTERY_INFORMATION
	default n
	help
	  Say Y here to enable sle95250 ic driver
```

## drivers/huawei_platform/power/battery/battery_ct/maxim/Kconfig
```kconfig
config CERTIFICATION_IC_DS28EL15
	bool
	prompt "Support MAXIM ds28el15 as certification IC."
	depends on HUAWEI_BATTERY_INFORMATION
	default n
	help
	  It needs a onewire physical controller to work.
	  Currently, only ONEWIRE_PHY_PL061_GPIO supports it.
	  Now, if you open this, please open ONEWIRE_PHY_PL061_GPIO.
	  Otherwise, this driver will be failed to probe.

config CERTIFICATION_IC_DS28E16
	bool
	prompt "Support ds28e16 as certification IC."
	depends on HUAWEI_BATTERY_INFORMATION
	default n
	help
	  It needs a onewire physical controller to work.
	  Currently, only ONEWIRE_PHY_PL061_GPIO supports it.
	  Now, if you open this, please open ONEWIRE_PHY_PL061_GPIO.
	  Otherwise, this driver will be failed to probe.
```

## drivers/huawei_platform/power/battery/battery_ct/nxp/Kconfig
```kconfig
config CERTIFICATION_IC_A1007
	bool
	prompt "Support NXP A1007 as certification IC."
	depends on HUAWEI_BATTERY_INFORMATION
	default n
	help
	  It needs a onewire physical controller to work.
	  Currently, only ONEWIRE_PHY_PL061_GPIO_V2 supports it.
	  Now, if you open this, please open ONEWIRE_PHY_PL061_GPIO_V2.
	  Otherwise, this driver will be failed to probe.
```

## drivers/huawei_platform/power/battery/battery_ct/onewire/Kconfig
```kconfig
config ONEWIRE_PHY_PL061_GPIO
	bool
	prompt "MAXIM onewire physical controller: pl061(GPIO)."
	depends on HUAWEI_BATTERY_INFORMATION
	depends on GPIO_PL061
	default n
	help
	  It's an onewire physical controller.
	  It supports ds28el15 & ds28el16.
	  ALL physical controller will be add to a list.
	  IC will go through the list and find its own physical controller.

config ONEWIRE_PHY_PL061_GPIO_V2
	bool
	prompt "NXP onewire physical controller : pl061(GPIO)."
	depends on HUAWEI_BATTERY_INFORMATION
	depends on GPIO_PL061
	default n
	help
	  It's an onewire physical controller.
	  It supports A1007 now.
	  ALL physical controller will be add to a list.
	  IC will go through the list and find its own physical controller.
```

## drivers/huawei_platform/power/battery/battery_ct/richtek/Kconfig
```kconfig
config CERTIFICATION_IC_RICHTEK
	bool
	prompt "Support richtek as certification IC."
	depends on HUAWEI_BATTERY_INFORMATION
	default n
	help
		It needs a onewire physical controller to work.
```

## drivers/huawei_platform/power/battery/battery_soh/Kconfig
```kconfig
config HUAWEI_BATTERY_SOH
	bool "huawei battery soh"
	default n
	help
	  Say Y here to enable battery aging health driver.
	  This driver is an adaptation layer. It provides
	  channels for modules in the native layer to retrieve
	  relevant data from kernel.
```

## drivers/huawei_platform/power/battery/battery_temp_fitting/Kconfig
```kconfig
#
# battery temperature fitting drivers
#

config HUAWEI_BATTERY_TEMP_FITTING
	bool "huawei battery temperature fitting"
	default n
	help
	  Say Y here to enable battery temperature fitting feature.
	  battery_temperature_fitting gives another optional battery
	  temperature value as an alternative in case the one from
	  sensor measurement not available.
```

## drivers/huawei_platform/power/charger/Kconfig
```kconfig
source "drivers/huawei_platform/power/charger/charger_ap/Kconfig"
source "drivers/huawei_platform/power/charger/watch_charger/Kconfig"
source "drivers/huawei_platform/power/charger/speaker_charger/Kconfig"

config HUAWEI_CHARGER
	bool "huawei charger"
	default n
```

## drivers/huawei_platform/power/charger/charger_ap/Kconfig
```kconfig
source "drivers/huawei_platform/power/charger/charger_ap/direct_charger/Kconfig"
source "drivers/huawei_platform/power/charger/charger_ap/wireless_charger/Kconfig"
source "drivers/huawei_platform/power/charger/charger_ap/uvdm_charger/Kconfig"

config HUAWEI_CHARGER_AP
	bool "huawei charger ap"
	default n
config DIRECT_CHARGER
	bool "direct charger"
	default n
config WIRELESS_CHARGER
	bool "wireless charger"
	default n
config SERIES_BATT
	bool "series batt charger"
	default n
config BATTERY_BALANCE
	bool "battery balance"
	default n
```

## drivers/huawei_platform/power/charger/charger_ap/direct_charger/Kconfig
```kconfig
#
# huawei direct charger drivers
#

source "drivers/huawei_platform/power/charger/charger_ap/direct_charger/switchcap/Kconfig"
```
