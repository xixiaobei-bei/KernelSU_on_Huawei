## drivers/huawei_platform/power/charger/charger_ap/direct_charger/switchcap/multi_switchcap/Kconfig
```kconfig
#
# huawei multi_switchcap drivers
#

config MULTI_SWITCHCAP
	bool "multi_switchcap"
	default n
	help
	  Say Y here to enable multi_sc driver.
	  This driver provides a unified interface for multi switchcap
	  Support device:
	  Multi_hl1506

config MULTI_HL1506
	bool "multi_hl1506"
	default n
	depends on MULTI_SWITCHCAP
	help
	  Say Y here to enable hl1506 driver.
	  HL1506 is 98% Efficient Power Stage for 20W Output
	  This device is a switched capacitor Architecture Optimized
	  for 50% Duty Cycle.

config OVP_FOR_SWITCHCAP
	bool "ovp_for_switchcap"
	default n
	depends on MULTI_SWITCHCAP
	help
	  Say Y here to enable fpf2283 driver.
	  Fpf2283 works with switchcap.
	  Operate over an input voltage range of 2.8V to 28V.
	  This device is to prevent current inrush.
```

## drivers/huawei_platform/power/charger/charger_ap/uvdm_charger/Kconfig
```kconfig
#
# huawei uvdm charger drivers
#

config UVDM_CHARGER
	bool "uvdm charger"
	default n
	help
	  Say Y here to enable uvdm charger driver.
	  This driver works with switchcap.
	  This driver works after the cover connect.
	  This driver communicates with uvdm protocol.
```

## drivers/huawei_platform/power/charger/charger_ap/wireless_charger/Kconfig
```kconfig
#
# wireless charger driver
#

config WIRELESS_IDTP9221
	bool "wireless idt9221"
	default n
	help
	  Say Y here to enable idt9221 driver.
	  The idt9221 is an soc for magnetic induction
	  based wireless power receiver. it is fully compliant
	  with latest WPC Qi specification of BPP and EPP
	  and also supports various proprietary fast charging
	  protocols used by major smart phone OEM.

config WIRELESS_STWLC68
	bool "wireless stwlc68"
	default n
	help
	  Say Y here to enable stwlc68 driver.
	  The stwlc68 is an soc for magnetic induction
	  based wireless power receiver. It is fully compliant
	  with latest WPC Qi specification of BPP and EPP
	  and also supports various proprietary fast charging
	  protocols used by major smart phone OEM.
```

## drivers/huawei_platform/power/charger/charger_protocol/Kconfig
```kconfig
#
# huawei charger protocol drivers
#

config CHARGER_PROTOCOL
	bool "charger protocol"
	default n
	help
	  Say Y here to enable charger protocol driver.
	  This driver provides a unified interface to the charger protocol.
	  Currently supported charger protocols as below:
	  Huawei FCP protocol.
	  Huawei SCP protocol.

config CHARGER_PROTOCOL_FCP
	bool "huawei charger protocol with fcp"
	depends on CHARGER_PROTOCOL
	default n
	help
	  Say Y here to enable charger fcp protocol driver.
	  The fast charger protocol is used to communicate between a master
	  device and a single device over a singe wire bus. the protocol is
	  meant to be used to configure, control and read the status of
	  a slave device.

config CHARGER_PROTOCOL_SCP
	bool "huawei charger protocol with scp"
	depends on CHARGER_PROTOCOL
	default n
	help
	  Say Y here to enable charger scp protocol driver.
```

## drivers/huawei_platform/power/charger/speaker_charger/Kconfig
```kconfig
config HUAWEI_SPEAKER_CHARGER
	bool "huawei speaker charger"
	depends on DIRECT_CHARGER
	default n
	help
	  Say Y here to enable huawei speaker charger.
```

## drivers/huawei_platform/power/charger/watch_charger/Kconfig
```kconfig
#
# huawei watch charger drivers
#

config HUAWEI_WATCH_CHARGER
	bool "watch charger"
	default n
	help
	  Say Y here to enable watch charger driver.
	  This driver works only on smartwatch.
```

## drivers/huawei_platform/power/common_module/Kconfig
```kconfig
source "drivers/huawei_platform/power/common_module/power_thermalzone/Kconfig"
source "drivers/huawei_platform/power/common_module/power_debug/Kconfig"
```

## drivers/huawei_platform/power/common_module/power_mesg/Kconfig
```kconfig
#
# huawei power message drivers
#

config HUAWEI_POWER_MESG_INTERFACE
	bool
	prompt "Huawei power message interface."
	default n
	help
	  Say Y here to enable power message driver.
	  It's for asking and getting HMAC from user space.
```

## drivers/huawei_platform/power/hardware_buckboost/Kconfig
```kconfig
source "drivers/huawei_platform/power/hardware_buckboost/boost_5v/Kconfig"
source "drivers/huawei_platform/power/hardware_buckboost/buck_boost/Kconfig"
```

## drivers/huawei_platform/power/hardware_ic/Kconfig
```kconfig
source "drivers/huawei_platform/power/hardware_ic/charger_ic/Kconfig"
source "drivers/huawei_platform/power/hardware_ic/boost_5v/Kconfig"
source "drivers/huawei_platform/power/hardware_ic/buck_boost/Kconfig"
source "drivers/huawei_platform/power/hardware_ic/charge_pump/Kconfig"
source "drivers/huawei_platform/power/hardware_ic/wireless_charge_ic/Kconfig"
```

## drivers/huawei_platform/power/hardware_ic/charger_ic/Kconfig
```kconfig
#
# charger ic drivers
#

config BQ2560X_CHARGER
	bool "bq2560x charger"
	default n
	help
	  Say Y here to enable bq2560x charger driver.

config BQ25892_CHARGER
	bool "bq25892 charger"
	default n
	help
	  Say Y here to enable bq25892 charger driver.

config RT9466_CHARGER
	bool "rt9466 charger"
	default n
	help
	  Say Y here to enable rt9466 charger driver.

config HL7019_CHARGER
	bool "hl7019 charger"
	default n
	help
	  Say Y here to enable hl7019 charger driver.

config RT9471_CHARGER
	bool "rt9471 charger"
	default n
	help
	  Say Y here to enable rt9471 charger driver.

config BQ25882_CHARGER
	bool "bq25882 charger"
	default n
	help
	  Say Y here to enable bq25882 charger driver.

config BD99954_CHARGER
	bool "bd99954 charger"
	default n
	help
	  Say Y here to enable bd99954 charger driver.

config BQ25713_CHARGER
	bool "bq25713 charger"
	default n
	help
	  Say Y here to enable bq25713 charger driver.
```

## drivers/huawei_platform/power/hardware_ic/load_switch/Kconfig
```kconfig
config DUAL_LOADSWITCH
	bool "dual_load_switch"
	depends on DIRECT_CHARGER
	default n
	help
	  Say Y here to enable dual load switch driver.
	  This driver provides a unified interface for dual load swtich.
	  Support device:
	  dual_rt9748
	  dual_fpf2283

config DUAL_LOADSWITCH_FPF2283
	bool "dual_loadwitch_fpf2283"
	depends on DUAL_LOADSWITCH
	default n
	help
	  Say Y here to enable dual fpf2283 driver.
```

## drivers/huawei_platform/power/hardware_ic/wireless_charge_ic/Kconfig
```kconfig
#
# wireless charge ic driver
#

config WIRELESS_STWLC68
	bool "wireless stwlc68"
	depends on WIRELESS_CHARGER
	default n
	help
	  Say Y here to enable stwlc68 driver.
	  The stwlc68 is an soc for magnetic induction
	  based wireless power receiver. it is fully compliant
	  with latest WPC Qi specification of BPP and EPP
	  and also supports various proprietary fast charging
	  protocols used by major smart phone OEM.

config WIRELESS_IDTP9415
	bool "wireless idt9415"
	depends on WIRELESS_CHARGER
	default n
	help
	  Say Y here to enable idtp9415 driver.
	  The idtp9415 is an soc for magnetic induction
	  based wireless power receiver. it is fully compliant
	  with latest WPC Qi specification of BPP and EPP
	  and also supports various proprietary fast charging
	  protocols used by major smart phone OEM.

config WIRELESS_NU1619
	bool "wireless nu1619"
	depends on WIRELESS_CHARGER
	default n
	help
	  Say Y here to enable nu1619 driver.
	  The nu1619 is an soc for magnetic induction
	  based wireless power receiver. it is fully compliant
	  with latest WPC Qi specification of BPP and EPP
	  and also supports various proprietary fast charging
	  protocols used by major smart phone OEM.
```

## drivers/huawei_platform/power/hardware_monitor/Kconfig
```kconfig
source "drivers/huawei_platform/power/hardware_monitor/smpl/Kconfig"
source "drivers/huawei_platform/power/hardware_monitor/cpu_buck/Kconfig"
source "drivers/huawei_platform/power/hardware_monitor/lga_check/Kconfig"
source "drivers/huawei_platform/power/hardware_monitor/acr_detect/Kconfig"
source "drivers/huawei_platform/power/hardware_monitor/uscp/Kconfig"
source "drivers/huawei_platform/power/hardware_monitor/water_check/Kconfig"
source "drivers/huawei_platform/power/hardware_monitor/soc_control/Kconfig"
```

## drivers/huawei_platform/power/hardware_monitor/bat_heating/Kconfig
```kconfig
#
# battery heating control drivers
#

config HUAWEI_BAT_HEATING
	bool "battery heating control"
	default n
	help
	  Say Y here to enable battery heating control driver.
	  We know that, batteries cannot be charged at low temperatures,
	  but we can heat them in a special way to achieve the goal of charging
	  at low temperatures.
```

## drivers/huawei_platform/power/hardware_monitor/cpu_buck/Kconfig
```kconfig
#
# cpu_buck error monitor drivers
#

config HUAWEI_CPU_BUCK
	bool "huawei cpu_buck"
	default n
	help
	  Say Y here to enable cpu_buck error monitor driver.
	  This driver provides a unified interface to cpu_buck.
	  This driver is in logic layer.
	  Currently supported device as below:
	  lp8758
	  hi6422v100
	  hi6422v200

config HUAWEI_LP8758
	bool "cpu_buck lp8758"
	depends on HUAWEI_CPU_BUCK
	default n
	help
	  Say Y here to enable cpu_buck lp8758 driver.
	  The LP8758 is designed to meet the power management
	  requirements of the latest application processors
	  in mobile phones and similar portable applications.
	  The device contains four step-down DC/DC converter cores,
	  which are bundled together in a single 4-phase buck converter.
	  The device is controlled by an I2C-compatible serial interface.

config HI6422V100
	bool "cpu_buck hi6422v100"
	depends on HUAWEI_CPU_BUCK
	default n
	help
	  Say Y here to enable cpu_buck hi6422v100 driver.

config HI6422V200
	bool "cpu_buck hi6422v200"
	depends on HUAWEI_CPU_BUCK
	default n
	help
	  Say Y here to enable cpu_buck hi6422v200 driver.
```

## drivers/huawei_platform/power/hardware_monitor/smpl/Kconfig
```kconfig
#
# smpl error monitor drivers
#

config HUAWEI_SMPL
	bool "huawei smpl"
	default n
	help
	  Say Y here to enable smpl error monitor driver.
```

## drivers/huawei_platform/power/hardware_monitor/uscp/Kconfig
```kconfig
#
# usb port short circuit monitor drivers
#

config HUAWEI_USB_SHORT_CIRCUIT_PROTECT
	bool "huawei usb short circuit protect"
	default n
	help
	  Say Y here to enable usb port short circuit monitor driver.
	  We will cutoff charging path by set charger into hiz mode and
	  open mos switch when usb port short circuit happend.
	  This control by AP.

config HUAWEI_USB_SHORT_CIRCUIT_PROTECT_SENSORHUB
	bool "huawei sensorhub usb short circuit protect"
	depends on INPUTHUB
	default n
	help
	  Say Y here to enable usb port short circuit monitor driver.
	  This control by INPUTHUB.
```

## drivers/huawei_platform/power/hardware_monitor/water_check/Kconfig
```kconfig
#
# water check monitor drivers
#

config HUAWEI_WATER_CHECK
	bool "huawei water check"
	default n
	help
	  Say Y here to enable water check monitor driver.
	  Currently supported monitor position as below:
	  The position of sim card
	  The position of ear hole
	  The position of key button
```

## drivers/huawei_platform/power/hardware_monitor/water_detect/Kconfig
```kconfig
#
# water detect monitor drivers
#

config HUAWEI_WATER_DETECT
	bool "huawei water detect"
	default n
	help
	  Say Y here to enable water detect monitor driver.
	  Currently supported monitor chip as below:
	  fsa9685
	  scharger v300
	  scharger v600
	  fsa4480
```

## drivers/huawei_platform/power/wireless/Kconfig
```kconfig
source "drivers/huawei_platform/power/wireless/wireless_protocol/Kconfig"
source "drivers/huawei_platform/power/wireless/wireless_alignment_detect/Kconfig"
```

## drivers/huawei_platform/power/wireless/wireless_alignment_detect/Kconfig
```kconfig
#
# huawei wireless alignment detect drivers
#

config WIRELESS_ALIGNMENT_DETECT
	bool "wireless alignment detect"
	default n
	help
	  Say Y here to enable wireless alignment detect driver.
```

## drivers/huawei_platform/rmeminspect/Kconfig
```kconfig
#
#meminspect config driver configuration
#
config MEM_INSPECT
        tristate "rmeminspect driver"
        default n
        help
        Say yes here to support for dram inspection driver.
```

## drivers/huawei_platform/sensor/ext_inputhub/Kconfig
```kconfig
menuconfig EXT_INPUTHUB
	bool "External InputHub feature support"
	default n
	help
	Say yes here to support external sensorhub feature.
```
