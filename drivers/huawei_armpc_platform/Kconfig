## drivers/huawei_armpc_platform/Kconfig
```kconfig
menu "Huawei Armpc Platform Drivers"

menuconfig HUAWEI_ARMPC_PLATFORM
       bool "Huawei armpc platform drivers support"
       default n
       help
       Say yes here to support the huawei armpc platform

source "drivers/huawei_armpc_platform/sensor/Kconfig"
source "drivers/huawei_armpc_platform/usbhub/Kconfig"
source "drivers/huawei_armpc_platform/pcie_misc/Kconfig"
endmenu
```

## drivers/huawei_armpc_platform/pcie_misc/Kconfig
```kconfig
#sensor unification for differ platform
menuconfig HUAWEI_ARMPC_PCIE_MISC
	bool "huawei armpc PCIE device misc control"
	default n
	help
	Say yes here to support pcie device misc control for huawei arm PC.
```

## drivers/huawei_armpc_platform/sensor/Kconfig
```kconfig
#sensor unification for differ platform
menuconfig HUAWEI_ARMPC_SENSORS_INPUT_INFO
	bool "huawei armpc sensor input info"
	default n
	help
	Say yes here to support the huawei armpc sensor input information.

source "drivers/huawei_armpc_platform/sensor/fingerprint/Kconfig"
```

## drivers/huawei_armpc_platform/sensor/fingerprint/Kconfig
```kconfig
#
# fingerprint configuration
#
menuconfig ARMPC_FINGERPRINT
	bool "armpc_fingerprint"
	default n
	help
	Say yes here to support for fingerprint.
```

## drivers/huawei_armpc_platform/usbhub/Kconfig
```kconfig
#sensor unification for differ platform
menuconfig HUAWEI_ARMPC_USB_HUB
	bool "huawei armpc usb hub device"
	default n
	help
	Say yes here to support usb hub for Kirin PC.
```

## drivers/huawei_platform/audio/Kconfig
```kconfig
menu "Audio configuration"
config HUAWEI_AUDIO
        bool "Audio support"
        default n
        select REGMAP_I2C
        help
          Enable support for audio
if HUAWEI_AUDIO
source "drivers/huawei_platform/audio/ana_hs_extern_ops/Kconfig"
source "drivers/huawei_platform/audio/invert_hs/Kconfig"
source "drivers/huawei_platform/audio/anc_hs_module/Kconfig"
source "drivers/huawei_platform/audio/ak4376/Kconfig"
source "drivers/huawei_platform/audio/hifi_vir_dai/Kconfig"
source "drivers/huawei_platform/audio/usb_analog_hs_module/Kconfig"
source "drivers/huawei_platform/audio/dig_hs_module/Kconfig"
source "drivers/huawei_platform/audio/usb_audio_power/Kconfig"
source "drivers/huawei_platform/audio/usb_audio_common/Kconfig"
source "drivers/huawei_platform/audio/usb_audio_power_v600/Kconfig"
source "drivers/huawei_platform/audio/usb_headset_core/Kconfig"
source "drivers/huawei_platform/audio/high_resistance_hs_det/Kconfig"
source "drivers/huawei_platform/audio/tf_agent/Kconfig"
source "drivers/huawei_platform/audio/virtual_voice_proxy/Kconfig"
source "drivers/huawei_platform/audio/codec_check/Kconfig"
source "drivers/huawei_platform/audio/adc/Kconfig"
endif # if HUAWEI_AUDIO
endmenu
```

## drivers/huawei_platform/audio/adc/Kconfig
```kconfig
#
#adc config driver configuration
#
menuconfig SND_SOC_ES7210
	bool "es7210 config driver"
	default n
	help
	Say yes here to support for es7210 config driver.

menuconfig SND_SOC_ES7243E
        bool "es7243e config driver"
        default n
        help
        Say yes here to support for es7243e config driver.
```

## drivers/huawei_platform/audio/ana_hs_extern_ops/Kconfig
```kconfig
config ANA_HS_EXTERN_OPS
	tristate "Support for ana hs extern ops"
	default n
	---help---
	 Say Y here if you want to support invert headset
```

## drivers/huawei_platform/audio/codec_check/Kconfig
```kconfig
config CODEC_CHECK
	tristate "Support for codec reg check in call"
	default n
	---help---
	 Say Y here if you want to support codec reg check in call
```

## drivers/huawei_platform/audio/dig_hs_module/Kconfig
```kconfig
menuconfig DIG_HS_MODULE
	bool "USB digital headset drivers support"
	default n
	help
	Say yes here to support the USB digital headset module

if DIG_HS_MODULE
config DIG_HS
	tristate "Support for DIG_HS"
	default n
	---help---
	 Say Y here if you want to support DIG_HS
config DIG_HS_POWER
	tristate "Support for digital headset with DIG_HS_POWER"
	default n
	---help---
	 Say Y here if you want to support digital headset with DIG_HS_POWER
config DIG_HS_POWER_V600
	tristate "Support for digital headset with DIG_HS_POWER_V600"
	default n
	---help---
	 Say Y here if you want to support digital headset with DIG_HS_POWER_V600
config DIG_HS_CORE
	tristate "Support for digital headset with DIG_HS_CORE"
	default n
	---help---
	 Say Y here if you want to support digital headset with DIG_HS_CORE
endif #DIG_HS_MODULE
```

## drivers/huawei_platform/audio/dig_hs_module/dig_hs_core/Kconfig
```kconfig
config DIG_HS_CORE
	tristate "Support for digital headset core"
	default n
	---help---
	 Say Y here if you want to support digital headset core
```

## drivers/huawei_platform/audio/dig_hs_module/dig_hs_power/Kconfig
```kconfig
config DIG_HS_POWER
	tristate "Support for digital headset power consumption control"
	default n
	---help---
	 Say Y here if you want to support digital headset power consumption control
```

## drivers/huawei_platform/audio/dig_hs_module/dig_hs_power_v600/Kconfig
```kconfig
config DIG_HS_POWER_V600
	tristate "Support for digital headset power consumption v600 control"
	default n
	---help---
	 Say Y here if you want to support digital headset power consumption v600 control
```

## drivers/huawei_platform/audio/hwcxext_codec/Kconfig
```kconfig
menuconfig HWCXEXT_CODEC_MODULE
	bool "hwcxext codec drivers support"
	default n
	help
	Say yes here to support the hwcxext codec module

if HWCXEXT_CODEC_MODULE
config HWCXEXT_CODEC_INTERFACE
	tristate "Support for HWCXEXT_CODEC_INTERFACE"
	default n
	---help---
	 Say Y here if you want to support HWCXEXT_CODEC_INTERFACE
config HWCXEXT_CODEC_V1
	tristate "Support for hwcxext codec v1"
	default n
	---help---
	 Say Y here if you want to support hwcxext codec v1
config HWCXEXT_MBHC
	tristate "Support for hwcxext mbhc"
	default n
	---help---
	 Say Y here if you want to support hwcxext mbhc
config HWCXEXT_I2C_OPS
	tristate "Support for hwcxext i2c ops"
	default n
	---help---
	 Say Y here if you want to support hwcxext i2c ops
endif #HWCXEXT_CODEC_MODULE
```

## drivers/huawei_platform/audio/hwevext_adc/Kconfig
```kconfig
config HWEVEXT_EXTERN_ADC
	tristate "hwevext adc driver"
	default n
	help
		Say Y to enable hwevext adc driver support
```

## drivers/huawei_platform/audio/hwevext_codec/Kconfig
```kconfig
menuconfig HWEVEXT_CODEC_MODULE
	bool "hwevext codec drivers support"
	default n
	help
	Say yes here to support the hwevext codec module

if HWEVEXT_CODEC_MODULE
config HWEVEXT_CODEC_INTERFACE
	tristate "Support for HWEVEXT_CODEC_INTERFACE"
	default n
	---help---
	 Say Y here if you want to support HWEVEXT_CODEC_INTERFACE
config HWEVEXT_CODEC_V1
	tristate "Support for hwevext codec v1"
	default n
	---help---
	 Say Y here if you want to support hwevext codec v1
config HWEVEXT_MBHC
	tristate "Support for hwevext mbhc"
	default n
	---help---
	 Say Y here if you want to support hwevext mbhc
config HWEVEXT_I2C_OPS
	tristate "Support for hwevext i2c ops"
	default n
	---help---
	 Say Y here if you want to support hwevext i2c ops
endif #HWEVEXT_CODEC_MODULE
```

## drivers/huawei_platform/audio/tf_agent/Kconfig
```kconfig
# tfagent driver configuration

config TF_AGENT
	tristate "tfagent driver"
	default n
	help
		Say Y to enable tfagent driver support
```

## drivers/huawei_platform/audio/virtual_voice_proxy/Kconfig
```kconfig
# virtual voice proxy driver configuration

config VIRTUAL_VOICE_PROXY
	tristate "virtual voice proxy drivers support"
	default n
	help
	 Say Y here if you to support the virtual voice proxy drivers

config VIRTUAL_VOICE_PROXY_EXTDEV
	tristate "Support for virtual voice proxy extend devices"
	default n
	help
	 Say Y here if you want to support  virtual voice proxy extend devices
```

## drivers/huawei_platform/card_tray/card_tray_detect/Kconfig
```kconfig
menuconfig CARD_TRAY_GPIO_DETECT
    bool "card_tray_gpio_detect support"
    default n
```

## drivers/huawei_platform/connectivity/bcm/syna/Kconfig
```kconfig
#
# Copyright (C) 2022, Broadcom.
#
#      Unless you and Broadcom execute a separate written software license
# agreement governing use of this software, this software is licensed to you
# under the terms of the GNU General Public License version 2 (the "GPL"),
# available at http://www.broadcom.com/licenses/GPLv2.php, with the
# following added to such license:
#
#      As a special exception, the copyright holders of this software give you
# permission to link this software with independent modules, and to copy and
# distribute the resulting executable under terms of your choice, provided that
# you also meet, for each linked independent module, the terms and conditions of
# the license of that module.  An independent module is a module which is not
# derived from this software.  The special exception does not apply to any
# modifications of the software.
#
#
# <<Broadcom-WL-IPTag/Open:>>
#

config BCMDHD
	tristate "Broadcom FullMAC wireless cards support"
	---help---
	  This module adds support for wireless adapters based on
	  Broadcom FullMAC chipset.

	  If you choose to build a module, it'll be called dhd. Say M if
	  unsure.

config BCMDHD_SDIO
	bool "SDIO bus interface support"
	depends on BCMDHD && MMC

config BCMDHD_PCIE
	bool "PCIe bus interface support"
	depends on BCMDHD && PCI && !BCMDHD_SDIO

config BCM4354
	bool "BCM4354 support"
	depends on BCMDHD
	default n

config BCM4356
	bool "BCM4356 support"
	depends on BCMDHD
	default n

config BCM4359
	bool "BCM4359 support"
	depends on BCMDHD
	default n

config BCM4362
	bool "BCM4362 support"
	depends on BCMDHD
	default n

config BCM4375
	bool "BCM4375 support"
	depends on BCMDHD
	default n

config BCM43752
	bool "BCM43752 support"
	depends on BCMDHD
	default n

config DHD_OF_SUPPORT
	bool "Use in-drive platform device"
	depends on BCMDHD
	default n


config BROADCOM_WIFI_RESERVED_MEM
	bool "BROADCOM Reserved memory for wifi device"
	depends on BCMDHD
	---help---
	  This is a configuration for Broadcom WLAN driver.

config BCMDHD_WEXT
	bool "Enable WEXT support"
	depends on BCMDHD && CFG80211 = n
	select WIRELESS_EXT
	select WEXT_PRIV
	help
	  Enables WEXT support

config DHD_USE_SCHED_SCAN
	bool "Use CFG80211 sched scan"
	depends on BCMDHD && CFG80211
	default n
	---help---
	  Use CFG80211 sched scan


config WL_NAN
	bool "NAN Feature"
	depends on BCMDHD
	default n
	---help---
	  This is a configuration for NAN Feature.

config BCMDHD_PREALLOC_PKTIDMAP
	bool "BROADCOM PCIE specific memory reserved for PKTIDMAP"
	depends on BROADCOM_WIFI_RESERVED_MEM && BCMDHD_PCIE
	---help---
	  Preallocated memory support for PCIE interface in Broadcom
	  WLAN driver.

config BCMDHD_PREALLOC_MEMDUMP
	bool "BROADCOM PCIE specific memory reserved for MEMDUMP"
	depends on BROADCOM_WIFI_RESERVED_MEM
	---help---
	  Preallocated memory support for dongle memory dump

config BCMDHD_OOB_HOST_WAKE
        bool "Use the external WLAN_HOST_WAKE pin"
        depends on BCMDHD
        ---help---
          Use the external GPIO pin to wake up host
```

## drivers/huawei_platform/connectivity/bt_driver_hi1135/Kconfig
```kconfig
menuconfig BT_HCI_DRIVER_HI1135
	bool "Bt hci driver is sdio"
	default n
	help
	Say yes here to indicate bt hci driver is sdio.
```

## drivers/huawei_platform/connectivity/unicore/Kconfig
```kconfig
config AIROHA_GPS
	bool "Airoha GPS Support"
	default y
	help
		Airoha GPS Support
```

## drivers/huawei_platform/devdetect/Kconfig
```kconfig
# detect devices

menuconfig HUAWEI_HW_DEV_DCT
    bool "HUAWEI DEVICE DETECT"
    default n
    help
      Say yes if you want i2c device detect driver.
      This is for i2c connected version. If unsure, say N here.
```
