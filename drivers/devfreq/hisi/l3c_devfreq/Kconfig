## drivers/devfreq/hisi/l3c_devfreq/Kconfig
```kconfig
config L3C_DEVFREQ
	tristate "L3 cache DEVFREQ Driver"
	depends on ARCH_HISI && PM_DEVFREQ && (ARM_DSU_PMU || NAMSTO_PMU)
	select PM_OPP
	help
	  This enables the l3c devfreq driver.

config HW_VOTE_L3C_FREQ
	bool "Enable hardware vote l3c dvfs feature"
	depends on L3C_DEVFREQ && HW_VOTE
	default n
	help
	  enable hardware vote l3c dvfs feature

config L3C_DEVFREQ_DEBUG
	tristate "L3C DEVFREQ SYSFS DEBUG"
	depends on L3C_DEVFREQ
	default n
	help
	  l3c devfreq driver sysfs debug
```

## drivers/devfreq/hisi/mem_lat/Kconfig
```kconfig
config ARM_MEMLAT_MON
        tristate "ARM CPU Memory Latency monitor hardware"
        help
          The PMU present on these ARM cores allow for the use of counters to
          monitor the memory latency characteristics of an ARM CPU workload.
          This driver uses these counters to implement the APIs needed by
          the mem_latency devfreq governor.

config DEVFREQ_GOV_MEMLAT
        tristate "HW monitor based governor for device BW"
        depends on ARM_MEMLAT_MON
        help
          HW monitor based governor for device to DDR bandwidth voting.
          This governor sets the CPU BW vote based on stats obtained from memalat
          monitor if it determines that a workload is memory latency bound. Since
          this uses target specific counters it can conflict with existing profiling
          tools.

config DEVFREQ_DEVBW
        bool "DEVFREQ device for device BW/FREQ voting"
        select DEVFREQ_GOV_PERFORMANCE
        select DEVFREQ_GOV_MEMLAT
        select ARM_MEMLAT_MON
        default n
        help
          Different devfreq governors use this devfreq device to make CPU to
          DDR bandwidth votes. This driver provides a SoC topology
          agnostic interface to so that some of the devfreq governors can be
          shared across SoCs.
```

## drivers/devfreq/hisi/npu_devfreq/Kconfig
```kconfig
config DEVFREQ_GOV_NPU_PM_QOS
	tristate "NPU PM QOS"
	depends on ARCH_HISI && PM_DEVFREQ
	select PM_OPP
	select DEVFREQ
```

## drivers/devkit/audiokit/Kconfig
```kconfig
#
# Audiokit configuration
#
config AUDIOKIT
bool "Audio Kit"
default n
help
 choose y to open Audio Kit
if AUDIOKIT
source "drivers/devkit/audiokit/dsm_audio/Kconfig"
source "drivers/devkit/audiokit/boxid/Kconfig"
source "drivers/devkit/audiokit/smartpakit/Kconfig"
endif
```

## drivers/devkit/audiokit/adsp_misc/Kconfig
```kconfig
config HUAWEI_ADSP_MISC
    bool "audio dsp driver for ipi adapter"
    default n

config ADSP_HUAWEI_SHARED_MEM
    bool "mtk shared mem between ap and adsp for huawei params"
    depends on HUAWEI_ADSP_MISC
    default n
```

## drivers/devkit/audiokit/ana_hs_kit/Kconfig
```kconfig
menuconfig HUAWEI_ANA_HS_KIT_AUDIO
	bool "analog headset drivers support"
	default n
	help
	Say yes here to support the  analog headset module

if HUAWEI_ANA_HS_KIT_AUDIO
config ANA_HS
	tristate "Support for analog headset"
	default n
	---help---
	 Say Y here if you want to support analog headset
config ANA_HS_CORE
	tristate "Support for analog headset core"
	default n
	---help---
	 Say Y here if you want to support analog headset core
config INVERT_HS_CORE
	tristate "Support for invert headset"
	default n
	---help---
	 Say Y here if you want to support invert headset
endif #HUAWEI_ANA_HS_KIT_AUDIO
```

## drivers/devkit/audiokit/ana_hs_kit/ana_hs_core/Kconfig
```kconfig
config ANA_HS_CORE
	tristate "Support for analog headset core"
	default n
	---help---
	 Say Y here if you want to support analog headset core
```

## drivers/devkit/audiokit/ana_hs_kit/invert_hs_core/Kconfig
```kconfig
config INVERT_HS_CORE
	tristate "Support for invert headset"
	default n
	---help---
	 Say Y here if you want to support invert headset
```

## drivers/devkit/audiokit/boxid/Kconfig
```kconfig
menuconfig HUAWEI_DEVICEBOX_AUDIO
	tristate "device boxid driver"
	default n
	help
		Say Y to enable device boxid driver support
```

## drivers/devkit/lcdkit/lcdkit3.0/kernel/qcom/src/Kconfig
```kconfig
#
# lcdkit qcom driver configuration
#
menuconfig LCD_KIT_QCOM
	bool "lcd kit 3.0 qcom driver"
	default n
	help
	   If you say yes here you get support for lcd kit qcom driver.
```

## drivers/devkit/tpkit/3_0/panel/Kconfig
```kconfig
#
# huawei touchscreen driver configuration
#


source "drivers/devkit/tpkit/3_0/panel/synaptics/Kconfig"
source "drivers/devkit/tpkit/3_0/panel/gt1x/Kconfig"
source "drivers/devkit/tpkit/3_0/panel/samsung/Kconfig"
source "drivers/devkit/tpkit/3_0/panel/synaptics_tcm/Kconfig"
source "drivers/devkit/tpkit/3_0/panel/gt8x/Kconfig"
source "drivers/devkit/tpkit/3_0/panel/focaltech/Kconfig"
source "drivers/devkit/tpkit/3_0/panel/novatek/Kconfig"
source "drivers/devkit/tpkit/3_0/panel/parade/Kconfig"
source "drivers/devkit/tpkit/3_0/panel/atmel/Kconfig"
source "drivers/devkit/tpkit/3_0/panel/st/Kconfig"
source "drivers/devkit/tpkit/3_0/panel/elan/Kconfig"
source "drivers/devkit/tpkit/3_0/panel/mstar/Kconfig"
source "drivers/devkit/tpkit/3_0/panel/gtx8_brl/Kconfig"
source "drivers/devkit/tpkit/3_0/panel/himax_64/Kconfig"
source "drivers/devkit/tpkit/3_0/panel/ilitek/Kconfig"
source "drivers/devkit/tpkit/3_0/panel/chipone/Kconfig"
```

## drivers/devkit/tpkit/3_0/panel/chipone/Kconfig
```kconfig
#
# huawei touchscreen driver configuration
#

menuconfig CHIPONE_TS_KIT_3_0
	tristate "TS_KIT_3_0 chipone drivers"
	default n
	help
	  If you say yes here you get support for huawei touchscreen.
```

## drivers/devkit/tpkit/3_0/panel/gtx8_brl/Kconfig
```kconfig
#
# huawei touchscreen driver configuration
#

menuconfig GOODIX_GTX8_BRL_TS_KIT_3_0
	bool "TS_KIT GTX8 BRL 3.0 drivers"
	default n
	help
	  If you say yes here you get support for huawei touchscreen.
```

## drivers/devkit/tpkit/3_0/panel/himax_64/Kconfig
```kconfig
#
# huawei touchscreen driver configuration
#

menuconfig HIMAX_TS_KIT_3_0
	bool "huawei ts kit himax_64 drivers"
	default n
	help
	  If you say yes here you get support for huawei touchscreen.
```

## drivers/devkit/tpkit/3_0/panel/ilitek/Kconfig
```kconfig
#
# huawei touchscreen driver configuration
#

menuconfig ILITEK_TS_KIT_3_0
	bool "TS_KIT ilitek 3_0 drivers"
	default n
	help
	If you say yes here you get support for huawei touchscreen.
```

## drivers/devkit/tpkit/3_0/panel/mstar/Kconfig
```kconfig
#
# huawei touchscreen driver configuration
#

menuconfig MSTAR_TS_KIT_3_0
	bool "TS_KIT_3_0 mstar drivers"
	default n
	help
	  If you say yes here you get support for huawei touchscreen.
```

## drivers/devkit/tpkit/hostprocessing/Kconfig
```kconfig
#
# huawei hostprocessing ts driver configuration
#

menuconfig JDI_HOST_TS_KIT
	tristate "JDI_HOST ts drivers"
	default n
	help
	  If you say yes here you get support for jdi hostprocessing ts touchscreen.

menuconfig HUAWEI_SHB_THP
        tristate "HUAWEI thp2.0 architecture"
        default n
        help
          If you say yes here you get support for core capacity hostprocessing touchscreen.

menuconfig HUAWEI_THP
	tristate "HUAWEI thp core drivers"
	default n
	help
	  If you say yes here you get support for core capacity hostprocessing touchscreen.

menuconfig HUAWEI_THP_NOVATECH
	tristate "Novatech thp drivers"
	default n
	help
	  If you say yes here you get support for novatech hostprocessing touchscreen.

menuconfig HUAWEI_THP_HIMAX
	tristate "Himax thp drivers"
	default n
	help
	  If you say yes here you get support for himax hostprocessing touchscreen

menuconfig HUAWEI_THP_SYNAPTICS
	tristate "Synaptics thp drivers"
	default n
	help
	  If you say yes here you get support for Synaptics hostprocessing touchscreen.

menuconfig HUAWEI_THP_GOODIX
	tristate "Goodix thp drivers"
	default n
	help
	  If you say yes here you get support for Synaptics hostprocessing touchscreen.

menuconfig HUAWEI_THP_SOLOMON
	tristate "Solomon thp drivers"
	default n
	help
	  If you say yes here you get support for Synaptics hostprocessing touchscreen.

menuconfig HUAWEI_THP_FOCALTECH
	tristate "Focaltech thp drivers"
	default n
	help
	  If you say yes here you get support for Focaltech hostprocessing touchscreen.

menuconfig HUAWEI_THP_ILITEK
	tristate "Ilitek thp drivers"
	default n
	help
	  If you say yes here you get support for Ilitek hostprocessing touchscreen.

menuconfig HUAWEI_THP_ST
	tristate "ST thp drivers"
	default n
	help
	  If you say yes here you get support for ST hostprocessing touchscreen.
```

## drivers/devkit/tpkit/mcu/Kconfig
```kconfig
#
# huawei touchscreen driver configuration
#
menuconfig MCU_TS
	tristate "huawei  ts kit mcu drivers"
	default n
	help
	  If you say yes here you get support for huawei touchscreen.
```

## drivers/devkit/tpkit/panel/omnivision_tcm/Kconfig
```kconfig
#
# Omnivision TCM touchscreen driver configuration
#

menuconfig OMNIVISION_TCM_TS_KIT
	tristate "OMNIVISION TCM touchscreen"
	default n
	help
	  Say Y here if you have a OMNIVISION TCM touchscreen connected
	  to your system.

	  If unsure, say N.
```

## drivers/devkit/tpkit/panel/zinitix/Kconfig
```kconfig
#
# huawei touchscreen driver configuration
#

menuconfig ZINITIX_TS_KIT
	tristate "TS_KIT zinitix drivers"
	default n
	help
	  If you say yes here you get support for huawei touchscreen.
```

## drivers/devkit/tpkit/panel_driver/Kconfig
```kconfig
#
# huawei touchscreen driver configuration
#
source "drivers/devkit/tpkit/panel_driver/rotary_crown/Kconfig"
```

## drivers/devkit/tpkit/panel_driver/rotary_crown/Kconfig
```kconfig
menuconfig HUAWEI_ROTARY_CROWN
	bool "huawei rotary crown driver"
	default n
	help
	Say yes here to support the huawei rotary crown driver.
```

## drivers/dubai/Kconfig
```kconfig
menu "Huawei Device Usage Big-data Analytics Initiative Support"

config HUAWEI_DUBAI
	bool "Huawei Device Usage Big-data Analytics Initiative Support"
	default n
	help
	  This driver provides DUBAI feature

config HUAWEI_DUBAI_TASK_CPU_POWER
	bool "Huawei DUBAI Task CPU Power"
	default n
	depends on HUAWEI_DUBAI && (CPU_FREQ_POWER_STAT || ARCH_MSM)
	help
	  Get task cpu power

config HUAWEI_DUBAI_RGB_STATS
	bool "Huawei DUBAI Rgb Stats"
	default n
	depends on HUAWEI_DUBAI && FB
	help
	  Get Rgb Stats

endmenu
```

## drivers/echub/Kconfig
```kconfig
#
# Huawei echub driver configuration
#

config HUAWEI_ECHUB
	bool "huawei echub drvier"
	depends on I2C
	default n
	help
	  echub handle all EC chipset status and messages required by OS,it's agent of EC in the Linux Kernel.

config HUAWEI_ECHUB_I2C
	bool "huawei echub i2c drvier"
	depends on HUAWEI_ECHUB
	default n
	help
	  echub i2c drvier handle all EC chipset data read/write.

config HUAWEI_ECHUB_DEBUG_FS
	bool "huawei echub debug"
	depends on HUAWEI_ECHUB
	default n
	help
	  enable echub debug fs

source drivers/echub/keyboard/Kconfig
source drivers/echub/power/Kconfig
source drivers/echub/battery/Kconfig
```

## drivers/echub/battery/Kconfig
```kconfig
#
# echub battery moudule
#

config HUAWEI_ECHUB_BATTERY
        bool "echub battery"
        depends on HUAWEI_ECHUB
        default n
        help
          This driver provides support for echub battery
```
