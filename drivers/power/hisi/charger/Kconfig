## drivers/power/hisi/charger/Kconfig
```kconfig
config SCHARGER
	bool "pmic charger"
	default n
config SCHARGER_V200
	bool "schargerV200"
	default n
config SCHARGER_V300
	bool "schargerV300"
	default n
config SCHARGER_V600
	bool "schargerV600"
	default n
config CHARGER_SYS_WDG
	bool "pmic charger sys watchdog"
	default n
config CHARGER_WDG
	bool "hisi charger watchdog"
	default n
```

## drivers/power/hisi/coul/Kconfig
```kconfig
config COUL_DRV
        bool "pmic coul"
        default n
config COUL_PMIC6X21V500
        bool "pmic6421v500 coul"
        default n
config COUL_PMIC6X21V600
	bool "pmic6421v600 coul"
	default n
config COUL_PMIC6X55V100
        bool "pmic6555v100 coul"
        default n
config COUL_PMIC6X55V200
        bool "pmic6555v200 coul"
        default n
config COUL_PMIC6X21V700
	bool "pmic6421v700 coul"
	default n
config COUL_PMIC6X21V800
	bool "pmic6421V800 coul"
	default n
config COUL_PMIC6X55V300
	bool "pmic6555V300 coul"
	default n
config COUL_PMIC6X55V500
	bool "pmic6555V500 coul"
	default n
config COUL_PMIC6X21V900
	bool "pmic6421v900 coul"
	default n
config COUL_TEST
        bool "coul test"
        default n
config COUL_POLAR
        bool "coul polar"
        default n
```

## drivers/power/hisi/eis/Kconfig
```kconfig
config BATT_EIS
	bool "batt eis"
	default n
	help
	  Electrochemical Impedance Spectroscopy.

if BATT_EIS
config BATT_EIS_FREQ
	bool "batt eis freq"
	default n
	help
	  batt eis frequency domain method.

config BATT_EIS_TIME
	bool "batt eis time"
	default n
	help
	   batt eis time domain method.

config BATT_EIS_WAVELET
	bool "batt eis wavelet"
	default n
	help
	  batt eis wavelet method.

config BATT_EIS_VERBOSE_DEBUG
	bool "batt eis verbose debug"
	default n
	help
	  batt eis verbose debug
endif

source drivers/power/hisi/eis/pmic/Kconfig
```

## drivers/power/hisi/eis/pmic/Kconfig
```kconfig
config BATT_EIS_PMIC
	bool "batt eis hardware in pmic"
	default n
	depends on BATT_EIS
	help
	  hardware in pmic for eis.
```

## drivers/power/hisi/soh/Kconfig
```kconfig
config BATT_SOH
        bool "batt soh"
        default n

config BATT_SOH_PMIC
        bool "batt soh pmic driver"
        default n

config BATT_SOH_HI6531
        bool "batt soh hi6531 driver"
        default n
config BATT_SOH_CHARGER
        bool "batt soh charger driver"
        default n
```

## drivers/storage_rofa/Kconfig
```kconfig
#
# Huawei storage_rofa drivers configuration
#

config HUAWEI_STORAGE_ROFA
       bool "Huawei storage readonly First Aid module"
       default n
       help
         Huawei storage readonly boot solution.

         If unsure, say N.

config HUAWEI_STORAGE_ROCHK
       bool "Huawei storage readonly check module"
       default n
       ---help---
         Huawei storage readonly check misc device.

config HUAWEI_DYNAMIC_BRD
       bool "Huawei dynamic create ramdisk"
       default n
       depends on BLK_DEV_RAM
       help
         Create a given size ramdisk dynamicly.

         If unsure, say N.

config HUAWEI_STORAGE_ROW
       bool "Huawei redirection on write DM"
       default n
       depends on MD
       ---help---
         This device-mapper target is virtually a ROW target. This
         target is setup by reading a string table.

config STORAGE_ROW_SKIP_PART
       bool "Skip DFX partition for storage ROW"
       default n
       depends on HUAWEI_STORAGE_ROFA
       ---help---
         HUAWEI_STORAGE_ROW operates on the whole disk. This function would disable
	 ROW on some specific partitions.

         If unsure, say N.
```

## drivers/swapfile/Kconfig
```kconfig
#
# Huawei swapfile driver configuration
#

config HUAWEI_SWAPFILE
	bool "huawei swapfile driver"
	depends on HIBERNATION
	default n
	help
	  swapfile driver supports swapfile's dynamic mount and umount for hibernate.

config HUAWEI_HIBERNATE_SWAP_PROTECT
	bool "huawei hibernate swap protect"
	depends on HIBERNATION
	default n
	help
	  the hibernation swap should not be used as a normal swap partition when the swap partition
	  is set at UFS. If you do not know, saw N.
```

## drivers/task_mem_stat/Kconfig
```kconfig
config HW_TASK_MEM_STAT
	bool "Huawei memory stats for every kernel task"
	default n
	help
	  Huawei memory stats for every kernel task, support Slab/Shmem/PageTable.
```

## drivers/thermal/hisi/Kconfig
```kconfig
config IPA_THERMAL
	tristate "Temperature sensor on ARM SoC based on THERMAL_TSENSOR interface"
	depends on THERMAL_TSENSOR
	depends on CPU_FREQ
	depends on OF
	select THERMAL_POWER_ACTOR_CPU
	help
	  Support for the thermal sensor driver in the Linux thermal
	  framework.

config THERMAL_TSENSOR
	tristate "Thermal sensor driver"
	default n
	help
	  Enable this to plug the thermal sensor driver into the Linux
	  thermal framework

config THERMAL_PERIPHERAL
	tristate "Peripheral thermal driver"
	default n
	help
	  Enable this to plug the peripheral thermal sensor driver into the Linux
	  thermal framework

config THERMAL_PERIPHERAL_HIGHRESTEMP
	bool "High resolution thermal format for peripheral thermal driver"
	depends on THERMAL_PERIPHERAL
	default n
	help
	  Enable this to use hi-resolution temperature format for PERIPHERAL thermal.

config THERMAL_CONTEXTHUB
	bool "Contexthub thermal driver"
	default n
	help
	  Enable Contexthub Thermal

config THERMAL_SPM
	bool "Sustainable performance mode"
	depends on IPA_THERMAL
	default n
	help
	  Enable sustainable performance mode

config THERMAL_HOTPLUG
	bool "Thermal hotplug support"
	depends on HOTPLUG_CPU
	depends on IPA_THERMAL
	default n
	help
	  Enable thermal hotplug

config THERMAL_GPU_HOTPLUG
	bool "Thermal gpu hotplug support"
	depends on IPA_THERMAL
	depends on HISI_GPU_CORE_HOTPLUG
	default n
	help
	  Enable gpu thermal hotplug

config GPU_HOTPLUG_EMULATION
	bool "Thermal gpu hotplug emulation support"
	depends on THERMAL_GPU_HOTPLUG
	default n
	help
	  Enable thermal gpu hotplug emulation

config THERMAL_NPU_HOTPLUG
	bool "Thermal npu hotplug support"
	depends on IPA_THERMAL
	default n
	help
	  Enable npu thermal hotplug

config NPU_HOTPLUG_EMULATION
	bool "Thermal npu hotplug emulation support"
	depends on THERMAL_NPU_HOTPLUG
	default n
	help
	  Enable thermal npu hotplug emulation

config HOTPLUG_EMULATION
	bool "Thermal hotplug emulation support"
	depends on THERMAL_HOTPLUG
	default n
	help
	  Enable thermal hotplug emulation

config THERMAL_TRIP
	bool "Trip point for thermal zone"
	depends on THERMAL_TSENSOR
	depends on THERMAL_PERIPHERAL
	depends on BCI_BATTERY
	default n
	help
	  Enable trip point for thermal zone

config THERMAL_SHELL
	bool "Shell temp calculation"
	depends on THERMAL_PERIPHERAL
	depends on COUL_DRV
	default n
	help
	  Enable shell temp calculation
config SHELL_TEMP_DEBUG
	bool "Shell temp debug configuration"
	depends on THERMAL_SHELL
	default n
	help
	  Enable debug node for shell temp calculation

config THERMAL_AMBIENT
	bool "Ambient temp calculation"
	depends on THERMAL_PERIPHERAL
	depends on COUL_DRV
	default n
	help
	  Enable ambient temp calculation

config THERMAL_NPU
	bool "Npu thermal contral"
	depends on THERMAL_GOV_STEP_WISE
	depends on THERMAL_TSENSOR
	default n
	help
		Enable npu thermal contral

config HKADC_MODEM
	bool "Hkadc modem temp"
	default n
	help
	  Enable hkadc modem temp

config ITS
	bool "ITS driver"
	default n
	help
	  Enable this to enable ITS driver

config ITS_DEBUG
	bool "ITS driver debug message"
	depends on ITS
	default n
	help
	  Enable this to print debug power message for ITS driver

config ITS_IPA
	bool "IPA using ITS/DPM power data"
	depends on IPA_THERMAL
	depends on ITS
	depends on DPM_HWMON
	default n
	help
	  Use ITS/DPM power during IPA calculate power.

source "drivers/thermal/hisi/hw_dpm/Kconfig"
```

## drivers/thermal/hisi/hw_dpm/Kconfig
```kconfig
config DPM_HWMON
	bool "dpm hwmon driver config"
	default n
	help
	  Driver for kernel dpm
config DPM_HWMON_V1
	bool "dpm hwmon first version config"
	depends on DPM_HWMON
	default n
	help
	  First version for kernel dpm
config DPM_HWMON_V2
	bool "dpm hwmon second version config"
	depends on DPM_HWMON
	default n
	help
	  Second version for kernel dpm
config DPM_HWMON_DEBUG
	bool "dpm hwmon driver for fitting debug"
	depends on DPM_HWMON
	default n
	help
	  Driver for kernel dpm debug
config MODEM_DPM
	bool "modem dpm hwmon config"
	depends on DPM_HWMON
	default n
	help
	  Driver for modem dpm
```

## drivers/usb/dwc3/hisi/Kconfig
```kconfig
config USB_DWC3_CHIP
	tristate "Platforms"
	default USB_DWC3
	select CHIP_USB_HELPER
	select CHIP_USB_REG_CFG
	help
	  Support of USB2/3 functionality in platforms,
	  Say 'Y' or 'M' here if you have one such device.

if USB_DWC3_CHIP

config USB_DWC3_NOV
       tristate "Platforms NOV USB"
       default n
       help
         Support of USB2 functionality in platforms,
         Say 'Y' or 'M' here if you have one such device.

config USB_DWC3_OCT
       tristate "Platforms OCT USB"
       default n
       help
         Support of USB2 functionality in platforms,
         Say 'Y' or 'M' here if you have one such device.

config USB_DWC3_SEP
       tristate "Platforms SEP USB"
       default n
       help
         Support of USB2 functionality in platforms,
         Say 'Y' or 'M' here if you have one such device.

config USB_DWC3_AUG
       tristate "Platforms AUG USB"
       default n
       help
         Support of USB2 functionality in platforms,
         Say 'Y' or 'M' here if you have one such device.

config USB_DWC3_APR
	tristate "Platforms APR USB"
	select CHIP_USB_XHCI_HUB_PORT_DIS
	default n
	select CHIP_USB_REG_CFG
	help
	  Support of USB2/3/3.1 functionality in platforms,
	  Say 'Y' or 'M' here if you have one such device.

config USB_DWC3_MAR
	tristate "Platforms MAR USB"
	select CHIP_USB_XHCI_HUB_PORT_DIS
	default n
	select CHIP_USB_REG_CFG
	help
	  Support of USB2/3/3.1 functionality in platforms,
	  Say 'Y' or 'M' here if you have one such device.

config USB_DWC3_FEB
	tristate "Platforms FEB USB"
	select CHIP_USB_XHCI_HUB_PORT_DIS
	default n
	select CHIP_USB_REG_CFG
	help
	  Support of USB2/3 functionality in platforms,
	  Say 'Y' or 'M' here if you have one such device.

config USB_DWC3_NYET_ABNORMAL
	bool "Enable workaround for receiving NYET bug on dwc3 feb"
	default n
	help
	  There is a Bug that receiving NYET in control transfer
	  can cause controller abnormal on dwc3 feb.

config CONTEXTHUB_PD
	bool "Sensor CONTEXTHUB PD driver"
	default n
	help
	  Say yes here if you want to use contexthub pd function

if CONTEXTHUB_PD
config CHIP_COMBOPHY
	tristate "Platforms MAR USB"
	default n
	help
	  Support of USB2/3/3.1 functionality in platforms,
	  Say 'Y' or 'M' here if you have one such device.
endif # CONTEXTHUB_PD

config CHIP_USB_NEW_FRAME
       tristate "USB new hardware config frame for Platforms"
       default n
       help
         Support for new usb phy and controller config frame for USB
         Say 'Y' or 'M' here if you have one such device.

endif # USB_DWC3_CHIP
```

## drivers/usb/dwc3/hisi/hisi_usb_vbus/Kconfig
```kconfig
config USB_DWC3_VBUS_PLT
	tristate "Hisilicon Platforms USB VBUS usb platform drv intf"
	depends on HISI_PMIC
	default n
	help
	  Use platform bus register usb insert/pull-out interrupt.

config USB_DWC3_VBUS_SPMI
	tristate "Hisilicon Platforms USB VBUS usb spmi drv intf"
	depends on HISI_SPMI
	default n
	help
	  Use spmi bus register usb insert/pull-out interrupt.
```

## drivers/usb/hisi-usb-vbus/Kconfig
```kconfig
config USB_VBUS_SPMI
	tristate "Hisilicon Platforms USB VBUS usb spmi drv intf"
	depends on HISI_SPMI
	default n
	help
	  Use spmi bus register usb insert/pull-out interrupt.
```

## drivers/usb/hisi-usb/Kconfig
```kconfig
#
# USB drivers for platforms
#
config CHIP_USB_REG_CFG
	tristate "Register config for USB module"
	depends on (ARCH_HISI && ARM64) || COMPILE_TEST
	select MFD_SYSCON
	help
	  Enable this to support the register config for HISILICON USB.

	  To compile this driver as a module, choose M here.

config CHIP_USB_HELPER
	tristate "Helper functions for USB module"
	depends on (ARCH_HISI && ARM64) || COMPILE_TEST
	help
	  Enable this to support the helper functions for HISILICON USB.

	  To compile this driver as a module, choose M here.

config CHIP_USB_MISC_CTRL
	tristate "Misc Ctrl for USB module"
	depends on (ARCH_HISI && ARM64) || COMPILE_TEST
	select CHIP_USB_REG_CFG
	select CHIP_USB_HELPER
	help
	  Enable this to support the misc ctrl for  USB.

	  To compile this driver as a module, choose M here.

config CHIP_USB_LOG
	bool "Chip USB Log"
	depends on ARCH_HISI
	---help---
	  This option adds support for USB Log.

config CHIP_USB_DEBUG_MODULE
	bool "USB Debug MODULE"
	---help---
	This option adds support for Usb Driver Debug MODULE.
```

## drivers/usb/hiusbc/Kconfig
```kconfig
config USB_HIUSBC
	bool "Hisilicon USB Controller Driver"
	help
	  Say Y to enable Hisilicon USB Controller Driver
```

## drivers/vcodec/hi_vcodec/Kconfig
```kconfig
menu "VCODEC DRIVER Configuration"

config VCODEC_PLATFORM_HIVCODECV200
        tristate "v200 Vcodec configs"
        default n

config VCODEC_PLATFORM_HIVCODECV210
        tristate "v210 Vcodec configs"
        default n

config VCODEC_PLATFORM_HIVCODECV300
        tristate "v300 Vcodec configs"
        default n

config VCODEC_PLATFORM_HIVCODECV310
       tristate "v310 Vcodec configs"
       default n

config VCODEC_PLATFORM_HIVCODECV500
        tristate "v500 Vcodec configs"
        default n

config VCODEC_PLATFORM_HIVCODECV520
        tristate "v520 Vcodec configs"
        default n

config VCODEC_PLATFORM_HIVCODECV600
        tristate "v600 Vcodec configs"
        default n

config VCODEC_DPM_ENABLE
        bool "dpm hwmon second version config"
        depends on DPM_HWMON
        default n
        help
            Second version for kernel dpm

source "drivers/vcodec/hi_vcodec/vdec_hivna/Kconfig"
source "drivers/vcodec/hi_vcodec/venc_hivna/drv/venc/Kconfig"

endmenu
```

## drivers/vcodec/hi_vcodec/vdec_hivna/Kconfig
```kconfig
menu "video vdec support"
config HI_VCODEC_VDEC_HIVNA
    tristate "video decoder support"
    default n
    help
      This is the decoder driver

config VDEC_TVP_SUPPORT
    bool "Vdec vfmw tvp support"
    depends on HI_VCODEC_VDEC_HIVNA
    default n
endmenu
```

## drivers/video/fbdev/dkmd/Kconfig
```kconfig
config DKMD_ENABLE
	bool "DKMD driver support"
	default n
	help
	  This feature driver supports dkmd driver.

# source "drivers/video/fbdev/dkmd/dpu/cetus/Kconfig"
# source "drivers/video/fbdev/dkmd/connector/Kconfig"
# source "drivers/video/fbdev/dkmd/cmdlist/Kconfig"
# source "drivers/video/fbdev/dkmd/dksm/Kconfig"
```

## drivers/video/fbdev/dkmd/cmdlist/Kconfig
```kconfig
config DKMD_CMDLIST_ENABLE
	bool "DKMD support cmdlist driver"
	default n
	depends on DMA_CMA
	depends on DKMD_DKSM
	help
	  This feature driver supports DKMD config by cmdlist.
```

## drivers/video/fbdev/dkmd/connector/Kconfig
```kconfig
config DKMD_DPU_CONNECTOR
	bool "Enable connector support in dpu driver"
	default n
	depends on DKMD_DKSM
	select DKMD_DPU_MIPI_DSI
	select DKMD_DPU_PANEL
	select DKMD_DPU_DP
	help
	  Choose this option if need connector support.

config DKMD_DPU_MIPI_DSI
	bool "Enable DSI support in dpu driver"
	default n
	depends on DKMD_DPU_COMPOSER
	help
	  Choose this option if need mipi dsi driver support.

config DKMD_DPU_PANEL
	bool "Enable panel support in dpu driver"
	default n
	depends on DKMD_DPU_MIPI_DSI
	help
	  Choose this option if need panel driver support.

config DKMD_DPU_DP
	bool "Enable dp support in dpu driver"
	default n
	depends on DKMD_DPU_COMPOSER
	help
	  Choose this option if need dp driver support.
```

## drivers/video/fbdev/dkmd/dksm/Kconfig
```kconfig
config DKMD_DKSM
	bool "DKMD dksm driver support"
	default n
	help
	  This feature supports dksm driver.
```
