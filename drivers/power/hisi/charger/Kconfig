## drivers/video/fbdev/dkmd/dpu/cetus/Kconfig
```kconfig
config DKMD_DPU_ENABLE
	bool "DKMD dpu driver support"
	default n
	depends on DKMD_ENABLE
	select DKMD_DKSM
	select DKMD_CMDLIST_ENABLE
	select DKMD_DPU_DEVICE
	select DKMD_DPU_COMMON
	help
	  This feature driver supports dpu cetus driver.

config DKMD_DPU_DEVICE
	tristate "DKMD FB Framebuffer support"
	default n
	depends on FB
	select FB_CFB_FILLRECT
	select FB_SYS_FOPS
	select FB_CFB_COPYAREA
	select FB_CFB_IMAGEBLIT
	help
	  This framebuffer driver supports Dkmd FB.

config DKMD_DPU_COMPOSER
	bool "DKMD driver support composer device"
	default n
	depends on DKMD_DPU_DEVICE
	help
	  This feature driver supports dpu composer device driver.

config DKMD_DPU_RES_MGR
	bool "DKMD driver support resource manager"
	default n
	help
	  This feature driver supports dpu resource manager driver.

config DKMD_DPU_COMMON
	bool "DKMD driver support common utils"
	default n
	help
	  This feature driver supports dpu common utils driver.
```

## drivers/video/fbdev/hisi/Kconfig
```kconfig
config HISI_FB_FAKE
	tristate "HISI Framebuffer Fake support"
	depends on FB
	select FB_CFB_FILLRECT
	select FB_SYS_FOPS
	select FB_CFB_COPYAREA
	select FB_CFB_IMAGEBLIT
	select REGMAP
	help
	  This framebuffer driver supports HISI FB Fake.

config HISI_FB_970
	tristate "HISI FB 970 Framebuffer support"
	depends on FB
	select FB_CFB_FILLRECT
	select FB_SYS_FOPS
	select FB_CFB_COPYAREA
	select FB_CFB_IMAGEBLIT
	select REGMAP
	help
	  This framebuffer driver supports HISI970 FB.

config HISI_FB_V501
	tristate "HISI FB V501 Framebuffer support"
	depends on FB
	select FB_CFB_FILLRECT
	select FB_SYS_FOPS
	select FB_CFB_COPYAREA
	select FB_CFB_IMAGEBLIT
	select REGMAP
	help
	  This framebuffer driver supports HISI V501 FB.

config HISI_FB_V510
	tristate "HISI FB V510 Framebuffer support"
	depends on FB
	select FB_CFB_FILLRECT
	select FB_SYS_FOPS
	select FB_CFB_COPYAREA
	select FB_CFB_IMAGEBLIT
	select REGMAP
	help
	  This framebuffer driver supports HISI V510 FB.

config HISI_FB_V600
	tristate "HISI FB V600 Framebuffer support"
	depends on FB
	depends on DMA_CMA
	select FB_CFB_FILLRECT
	select FB_SYS_FOPS
	select FB_CFB_COPYAREA
	select FB_CFB_IMAGEBLIT
	select REGMAP
	help
	  This framebuffer driver supports HISI V600 FB.

config HISI_FB_V320
	tristate "HISI FB V320 Framebuffer support"
	depends on FB
	select FB_CFB_FILLRECT
	select FB_SYS_FOPS
	select FB_CFB_COPYAREA
	select FB_CFB_IMAGEBLIT
	select REGMAP
	help
	  This framebuffer driver supports HISI V320 FB.

config HISI_FB_AOD_V320
	tristate "HISI FB V320 aod support"
	depends on FB
	select FB_CFB_FILLRECT
	select FB_SYS_FOPS
	select FB_CFB_COPYAREA
	select FB_CFB_IMAGEBLIT
	select REGMAP
	select HISI_FB_V320
	help
	  This framebuffer driver supports HISI V320 aod.

config HISI_FB_V330
	tristate "HISI FB V330 Framebuffer support"
	depends on FB
	select FB_CFB_FILLRECT
	select FB_SYS_FOPS
	select FB_CFB_COPYAREA
	select FB_CFB_IMAGEBLIT
	select REGMAP
	help
	  This framebuffer driver supports HISI V330 FB.

config HISI_FB_V350
	tristate "HISI FB V350 Framebuffer support"
	depends on FB
	select FB_CFB_FILLRECT
	select FB_SYS_FOPS
	select FB_CFB_COPYAREA
	select FB_CFB_IMAGEBLIT
	select REGMAP
	help
	  This framebuffer driver supports HISI V350 FB.

config HISI_FB_ENG_DBG
	tristate "HISI FB ENG DEBUG support"
	depends on FB
	help
	  This config only used in eng version.

config FASTBOOT_DISP_ENABLE
	tristate "HISI fastboot display enable support"
	depends on FB
	help
	  Display system have already initialized in fastboot.

config HISI_DISPLAY_DFR
	tristate "HISI FB dynamic frame adaptation support"
	depends on FB
	help
	  This framebuffer driver supports dynamic frame adaptation.

config HISI_DSS_DPM
	tristate "HISI DSS DPM(digital power monitor) support"
	depends on FB
	depends on HISI_DPM_HWMON
	help
	  This framebuffer driver supports dpm function.
```

## drivers/video/fbdev/hisi/dpu/Kconfig
```kconfig
config HISI_DPU_DISP
	bool "Display driver support"
	default y
	help
	  This feature driver supports dpu driver.

config HISI_DISP_DRM
	bool "display driver support DRM"
	default n
	depends on HISI_DPU_DISP
	help
	  This feature driver supports drm driver.

config HISI_DISP_FB
	tristate "HISI Display FB Framebuffer support"
	depends on FB
	depends on HISI_DPU_DISP
	select FB_CFB_FILLRECT
	select FB_SYS_FOPS
	select FB_CFB_COPYAREA
	select FB_CFB_IMAGEBLIT
	select REGMAP
	help
	  This framebuffer driver supports HISI Display FB.

config HISI_DISP_TEST_ENABLE
	bool "Display driver support test for kunit"
	default n
	depends on HISI_DPU_DISP
	help
	  This feature driver supports display driver kunit test.

config HISI_DISP_DEBUG
	bool "enable display debug feature"
	default n
	depends on HISI_DPU_DISP
	help
	  This feature support display driver debug feature.

config HISI_DISP_ENABLE_ASSERT
	bool "enable display debug assert feature"
	default n
	depends on HISI_DPU_DISP
	help
	  This feature support display driver debug assert feature.

config HISI_DISP_ADAPTOR_ENABLE
	bool "enable display adaptor for DSS"
	default y
	depends on HISI_DPU_DISP
	help
	  This feature support display driver adaptor for DSS.

config DPP_SCENE0
	tristate "HISI Display FB Framebuffer support"
	depends on FB
	depends on HISI_DPU_DISP
	help
	  This framebuffer driver supports HISI Display FB.

config DEBUG_DPU_SCENE_1
	tristate "debug dpu fpga support scene 1"
	depends on FB
	depends on HISI_DPU_DISP
	help
	  debug dpu fpga support scene 1.

config DEBUG_DPU_SCENE_3
	tristate "debug dpu fpga support scene 3"
	depends on FB
	depends on HISI_DPU_DISP
	help
	  debug dpu fpga support scene 3.

config CMDLIST_ENABLE
	bool "display driver support cmdlist config"
	default n
	depends on FB
	depends on DMA_CMA
	help
	  This feature driver supports display config by cmdlist.
```

## drivers/video/fbdev/hisi/dpu/common/cmdlist/Kconfig
```kconfig
config CMDLIST_ENABLE
	bool "display driver support cmdlist config"
	default n
	depends on FB
	depends on DMA_CMA
	help
	  This feature driver supports display config by cmdlist.
```
