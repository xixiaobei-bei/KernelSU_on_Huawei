## drivers/hisi/npu_pm/Kconfig
```kconfig
menu "NPU PM Options"

config NPU_PM
    tristate "NPU Power Management Driver"
    depends on ARCH_HISI
    help
      This enables the npu low power driver.

config NPU_PM_DEBUG
    tristate "NPU Power Management Debug Driver"
    depends on NPU_PM
    help
      This enables the npu low power debug driver.

config NPUFREQ
    tristate "NPUFREQ Driver Based On Devfreq"
    depends on NPU_PM
    select PM_OPP
    help
      This enables the NPUFREQ Driver Based On Devfreq.
config NPU_PM_AVS_VDM
    tristate "NPU avs&svfd"
    depends on NPUFREQ
    help
      This enables the NPU avs or svfd.

config NPU_PM_AVS_NEW_TZONE
    tristate "NPU avs use new tzone feature"
    depends on NPUFREQ
    help
      This enables the NPU use new avs tzone.

config NPUFREQ_PM_QOS
    tristate "NPUFREQ PM Qos"
    depends on NPU_PM
    help
      This enables the NPUFREQ PM Qos.

config NPU_PM_SHARE_PERI_BUCK
    tristate "NPU share peri buck with other IP"
    depends on (NPU_PM && HISI_PERIDVFS)
    help
      This enables the NPU peri buck.

config NPU_PM_SMC
    tristate "NPU Power Management Driver Using SMC"
    depends on NPU_PM
    help
      This enables the npu low power smc driver.

endmenu
```

## drivers/hisi/onsys_avs/Kconfig
```kconfig
menu "Onsys AVS Options"
config ONSYS_AVS
	bool "Onsys avs enable"
	default n
	help
	  onsys avs ctrl enable.

endmenu
```

## drivers/hisi/perf_ctrl/Kconfig
```kconfig
menu "Hisilicon Performace Control"

config HISI_PERF_CTRL
        tristate "Hisilicon Performance Control Drivers"
	default n
        help
                Hisilicon Performance Control Drivers

config HISI_DDR_PERF_CTRL
        tristate "Hisilicon DDR Performance Control Function"
        depends on HISI_PERF_CTRL
        default n
        help
                Hisilicon DDR Performance Control Function

config HISI_RENDER_RT
        bool "render realted thread"
	depends on HISI_PERF_CTRL
	depends on SCHED_WALT
	depends on HISI_TASK_RAVG_SUM
	default n
        help
                Hisilicon Render Related Thread

config HISI_RENDER_RT_DEBUG
        bool "render realted thread test"
	depends on HISI_RENDER_RT
	depends on HISI_DEBUG_FS
	default n
        help
                Hisilicon Render Related Thread debug trace

endmenu
```

## drivers/hisi/perfhub/Kconfig
```kconfig
config PERFHUB
	bool "perfhub"
	default n

config FREQ_LIMIT_COUNTER
	bool "counts cpu/gpu freq limit"
	default n
	depends on IPA_THERMAL
	depends on HISI_EAS_SCHED
```

## drivers/hisi/pm/Kconfig
```kconfig
menu "S/R Options"
choice
	prompt "Select S/R Architecture"
	default SR_OLD_ARCH
	config SR_NEW_ARCH
		bool "select new sr arch"
	config SR_OLD_ARCH
		bool "select old sr arch"
endchoice

if SR_NEW_ARCH
	source "drivers/hisi/pm/new/Kconfig"
endif

if SR_OLD_ARCH
	source "drivers/hisi/pm/old/Kconfig"
endif
endmenu
```

## drivers/hisi/pm/new/Kconfig
```kconfig
menu "S/R options for new architecture"

config SR
	bool "SR adaptation"
	depends on SUSPEND
	default n
	help
	   Support suspend and resume for
if SR
	source "drivers/hisi/pm/new/main/Kconfig"
endif

config SR_DEBUG
	bool "SR debug"
	depends on SR
	default n
	help
	   debug for SR

config SR_MNTN
	bool "SR maintenance"
	depends on SR
	default n
	help
	   Support maintenance for SR

if SR_MNTN
	source "drivers/hisi/pm/new/mntn/Kconfig"
endif

endmenu
```

## drivers/hisi/pm/new/main/Kconfig
```kconfig
menu "S/R options for main function"

config SR_SYNC
	bool "The optimizes file synchronization in the SR process"
	depends on SR
	default n
	help
	  Optimizes file synchronization in the SR process

config PM_LPCTRL
	bool "ap kernel can control functions of sr in lpm3"
	depends on SR
	default n
	help
	  The ap kernel controls the sr function of lpm3

config SR_SWITCH_32K
	bool "Switch 32K clock source when the system is suspend or resume for more power saving"
	depends on PM_LPCTRL
	default n
	help
	  Switch 32K clock source
endmenu
```

## drivers/hisi/pm/new/mntn/Kconfig
```kconfig
menu "S/R maintenance options"

config SR_MNTN_AP_WAKE
	bool "SR maintenance: display ap wakeup source"
	default n
	help
	   display ap wakeup source

config SR_MNTN_SYS_WAKE
	bool "SR maintenance: display soc(lpmcu) wakeup source"
	default n
	help
	   display soc(lpmcu) wakeup source

config SR_MNTN_TICKMARK
	bool "SR maintenance: mark ticktime for some key points in SR fllow"
	default n
	help
	   mark ticktime for some key points in SR fllow

config SR_MNTN_PRECHECK
	bool "SR maintenance: check ip(such as clock, regulator) status before enter suspend"
	depends on SR_DEBUG
	default n
	help
	   check ip(such as clock, regulator) status before enter suspend

endmenu
```

## drivers/hisi/pm/old/Kconfig
```kconfig
menu "S/R options for old architecture"

config SR
	bool "Support hi3xxx suspend and resume"
	depends on SUSPEND
	default n
	help
	   support hi3xxx suspend and resume

config SR_DEBUG
	bool "Suspend-resume debug interface"
	depends on PM
	default n
	help
	suspend-resume debug for platform

config SR_DEBUG_LPREG
	bool "Suspend-resume debug mntn"
	depends on SR_DEBUG
	depends on HISI_DEBUG_FS
	default n
	help
	suspend-resume debug for platform

config SR_DEBUG_SLEEP
	bool "Suspend-resume debug sleep"
	depends on PM
	default n
	help
	suspend-resume debug sleep for platform

config SR_SYNC
	bool "Suspend optimization"
	depends on SUSPEND
	default n
	help
	  Driver for suspend optimization

config PM_SEC_GPIO
	bool "SEC GPIO"
	default n
	help
	  tell us if this platform have SEC GPIO

config PM_SEC_IO
	bool "SEC IO"
	default n
	help
	  tell us if this platform have SEC IO

config SR_TICK
	bool "Sr tick"
	depends on SUSPEND
	default n
	help
	  mark kernel sr position

config PM_FCM
	bool "FCM architecture"
	default n
	help
	  FCM architecture
config PM_LPCTRL
	bool "Ap kernel can control functions of sr in lpm3"
	depends on SUSPEND
	default n
	help
	  The ap kernel controls the sr function of lpm3

config SR_SWITCH_32K
	bool "Switch 32K clock source when the system is suspend or resume for more power saving"
	depends on PM_LPCTRL
	default n
	help
	  Switch 32K clock source

config PM_CPU_PDC_FEATURE
	bool "CPU pdc feature"
	depends on SUSPEND
	default n
	help
	  The cpu has cpu_pdc feature

config SR_PM_DEBUG
	bool "PM stub"
	depends on SUSPEND
	default n
	help
	  PM stub
endmenu
```

## drivers/hisi/rpmb/Kconfig
```kconfig
menu "RPMB support"

config VENDOR_RPMB
	bool "rpmb"
	default n
	help
	   config rpmb driver

config RPMB_MMC
	bool "rpmb mmc"
	depends on VENDOR_RPMB && ZODIAC_MMC
	default n
	help
	   config mmc rpmb driver

config RPMB_UFS
	bool "rpmb ufs"
	depends on VENDOR_RPMB && SCSI_UFS_KIRIN
	default n
	help
	   config ufs rpmb driver

config RPMB_STORAGE_INTERFACE
	bool "storage interface"
	depends on VENDOR_RPMB
	default n
	help
	   config rpmb storage interface

config RPMB_SET_MULTI_KEY
	bool "rpmb set multi key"
	depends on VENDOR_RPMB
	default n
	help
	   config rpmb set multi key

config RPMB_DEBUG_FS
	bool "rpmb debugfs"
	depends on VENDOR_RPMB && HISI_DEBUG_FS
	default n
	help
	   config rpmb debug

config RPMB_TIME_DEBUG
	bool "rpmb time debug"
	depends on VENDOR_RPMB && HISI_DEBUG_FS
	default n
	help
	   config rpmb time debug

config RPMB_KEY_ENABLE
	bool "rpmb key enable"
	depends on VENDOR_RPMB
	default n
	help
	   config rpmb key enable

config RPMB_DMD_REPORT
	bool "rpmb dmd report"
	depends on VENDOR_RPMB
	default n
	help
	   config rpmb dmd report

config RPMB_REQ_LOCK_DISABLE
	bool "rpmb req lock disable"
	depends on VENDOR_RPMB
	default n
	help
	   disable rpmb counter lock and cmd lock
endmenu
```

## drivers/hisi/security_info/Kconfig
```kconfig
config SECURITY_INFO
	bool "Support security info"
	default n
	help
	security info support
```

## drivers/hisi/slimbus/Kconfig
```kconfig
menu "slimbus driver"

config PLATFORM_SLIMBUS
     bool "slimbus device support"
     default n
     help
          slimbus driver.

endmenu
```

## drivers/hisi/soundtrigger/Kconfig
```kconfig
config SOUND_TRIGGER
	tristate "Support for sound trigger"
	default n
	---help---
	 Say Y here if you want to support sound trigger
config SND_SOC_THIRD_CODEC
	tristate "Support third codec for sound trigger"
	default n
	---help---
	Say Y here if you want to support third codec for sound trigger
```

## drivers/hisi/syscounter/Kconfig
```kconfig
config BSP_SYSCOUNTER
	bool "BSP SysCounter driver"
	depends on INPUTHUB || INPUTHUB_20 || INPUTHUB_30
	default n
	help
	Say yes here if you want to use bsp syscounter
```

## drivers/hisi/thee/Kconfig
```kconfig
config THEED
	bool "THEE support"
	depends on HAVE_ARM_SMCCC
	default n
	help
	  thee linux kernel despitch
```

## drivers/hisi/tzdriver/Kconfig
```kconfig
menu "TEE OS"

config TZDRIVER
	tristate "Secure Execution Communicator driver"
	default n
	help
	  Provides a communication interface between userspace and
	  TrustZone Operating Environment.

config HISI_SECBOOT_IMG
	bool "tzdriver split secboot img into modem and ap"
	default n
	depends on KERNEL_CLIENT
	help
	  Macro defined for splitting modem and ap img

config HISI_SECBOOT_IMG_V2
	bool "tzdriver split modem and ap for v2"
	default n
	depends on KERNEL_CLIENT
	help
	  Macro defined for splitting modem and ap img v2

config ASAN_DEBUG
	bool "hisi ASAN debug version"
	default n
	help
	  Macro defined for ASAN debug version

source  "drivers/hisi/tzdriver/auth/Kconfig"
source  "drivers/hisi/tzdriver/core/Kconfig"
source  "drivers/hisi/tzdriver/ion/Kconfig"
source  "drivers/hisi/tzdriver/tlogger/Kconfig"
source  "drivers/hisi/tzdriver/tui/Kconfig"
source  "drivers/hisi/tzdriver/agent_rpmb/Kconfig"
endmenu
```

## drivers/hisi/tzdriver/agent_rpmb/Kconfig
```kconfig
config RPMB_AGENT
	bool "Tzdriver Rpmb Agent"
	default n
	depends on TZDRIVER
	help
	  Tzdriver Rpmb Agent
```

## drivers/hisi/tzdriver/auth/Kconfig
```kconfig
# Auth Configuration
config CLIENT_AUTH
	bool "Client Application Hash Auth"
	default n
	depends on TZDRIVER
	help
	  TEEOS CA code hash auth

config ANDROID_HIDL
	bool "Android Hidl Adapt"
	default n
	depends on CLIENT_AUTH
	help
	  TEEOS hidl proc auth

config SELINUX_ADAPT
	bool "Selinux Interface Adapt"
	default n
	depends on TEECD_AUTH || CLIENT_AUTH
	help
	  Selinux Interface Adapt

config AUTH_ENHANCE
	bool "Secure Execution Auth Enhance"
	default n
	depends on CLIENT_AUTH
	help
	  TEEOS auth enhance
```

## drivers/hisi/tzdriver/core/Kconfig
```kconfig
# Framework Configuration
config CPU_AFF_NR
	int "Default Cpu Affinity"
	default 0
	depends on TZDRIVER
	help
	  Default Cpu Affinity

config DRM_ADAPT
	bool "Drm Feature Adapt"
	default n
	depends on TZDRIVER
	help
	  Drm Feature Adapt

config TA_AFFINITY
	bool "TA affinity"
	default n
	depends on TZDRIVER
	help
	  TA Cpu Affinity bind range, consistent with CONFIG_MAX_NUM_NODES in TEE

config TA_AFFINITY_CPU_NUMS
	int "TA affinity max support cpus"
	default 8
	depends on TA_AFFINITY
	help
	  consistent with CONFIG_MAX_NUM_NODES in TEE

config TEECD_AUTH
	bool "Teec Daemon Path Hash Auth"
	default n
	depends on TZDRIVER
	help
	  TEEOS TEECD path hash auth

config TEE_AUDIT
	bool "Audit TA"
	default n
	depends on AUTH_ENHANCE
	help
	  Audit TA in case of evil TA

config KERNEL_CLIENT
	bool "Kernel Client Interface"
	default n
	depends on TZDRIVER
	help
	  Kernel Client Interface

config BIG_SESSION
	bool "open more sessions"
	default n
	depends on TZDRIVER
	help
	  TEEOS open more sessions
```

## drivers/hisi/tzdriver/ion/Kconfig
```kconfig
config DYNAMIC_ION
	bool "Dynamic Ion Feature"
	default n
	depends on TZDRIVER
	help
	  TEEOS dynamic ion

config STATIC_ION
	bool "Static Ion Feature"
	default n
	depends on TZDRIVER
	help
	  TEEOS static ion
```

## drivers/hisi/tzdriver/tlogger/Kconfig
```kconfig
config RDR_MEM
	bool "Register Rdr Mem"
	default n
	depends on TZDRIVER
	help
	  Register Rdr Mem

config TEELOG
	bool "Secure Execution Log Driver"
	default n
	depends on TZDRIVER
	help
	  TEEOS log

config TEE_LOG_ACHIVE_PATH
	string "Tee log achive path"
	default "/data/log/tee/last_teemsg"
	depends on TEELOG
	help
	  Last tee msg log path

config TEE_KTRACE
	bool "TEEOS Kernel Event Log Driver"
	default n
	depends on TEELOG
	help
	  TEEOS event trace

config TEE_LOG_EXCEPTION
	bool "Log Exception Info to Imonitor"
	default n
	depends on TEELOG
	help
	  Log exception info to imonitor
```

## drivers/hisi/tzdriver/tui/Kconfig
```kconfig
config TEE_TUI
	bool "Trusted User Interface Driver"
	default n
	depends on TZDRIVER
	help
	  Trusted user interface diver

config TEE_TUI_FP
	bool "Trusted User Interface Driver For FP"
	default n
	depends on TZDRIVER
	help
	  Trusted user interface diver
```

## drivers/hisi/usb_phy_chip/Kconfig
```kconfig
config HISI_USB_PHY_CHIP
	bool "hisi usb phy chip driver"
	default n
	help
	  hisi usb phy chip driver(Hi6502)

config HISI_USB_PHY_DRIVER
	bool "hisi usb phy driver"
	default n
	help
	  hisi usb phy driver(hisi & snps phy)
config HISI_USB_PHY_EFUSE
	bool "hisi usb phy chip efuse driver"
	depends on (HISI_USB_PHY_CHIP)
	default n
	help
	  hisi usb phy chip efuse driver

config USB_PHY_CHIP_FIX_BC_DETECT
	bool "hisi usb phy chip fix bc detect problem"
	depends on (HISI_USB_PHY_CHIP)
	help
	  hisi usb phy chip fix bc detect problem
```

## drivers/hitrace/Kconfig
```kconfig
#
# huawei hitrace interface support in kernel
#

config HUAWEI_HITRACE
	bool "huawei HITRACE"
	default n
	help
	  If you say yes here you get support for huawei hitrace solution.
```
