## drivers/hisi/modem/drv/trans_report/Kconfig
```kconfig
config BALONG_TRANS_REPORT
	tristate "bsp4 for hids log"
	help
	  If this option is enabled, the kernel will include support
	  for soft fast forward.
```

## drivers/hisi/modem/drv/vcom/Kconfig
```kconfig
#
# udi adaption layer
#

comment "vcom"

config UDI_SUPPORT
tristate "support vcom"
default n
help
udi driver
```

## drivers/hisi/modem/drv/wan/Kconfig
```kconfig
#
# Balong ipf configuration
#

config wan_SUPPORT
	tristate "wan support"
	default n
	help
	  balong wan driver
```

## drivers/hisi/modem/oam/Kconfig
```kconfig
#
# Balong PAM configuration
#

config PAM_NR_MODEM_BUILD
    bool "pam nr modem build"
    default n
    help
        balong pam nr modem build config for kenel.
```

## drivers/hisi/modem/oam/lt/acore/Kconfig
```kconfig
menu "Modem Drivers"

source "chr/Kconfig"
source "debug/Kconfig"
source "diag/Kconfig"
source "list/Kconfig"
source "mode/Kconfig"
source "service/Kconfig"

endmenu
```

## drivers/hisi/modem_decoupl/Kconfig
```kconfig
config HISI_AP_CP_DECOUPL
        bool "decouple the ap && cp for kernel"
        default n
        help
           Say 'Y' if you support decoupling
           Say 'N' if you do not

config HISI_INC_MODEM_CONFIG
        bool "whether or not to include modem config for kernel"
        default n
        help
           Say 'Y' if you want to include modem config.
               so kernel modem can be compiled.
           Say 'N' if you don't want to include modem config,
               so skip modem config check in check_menuconfig.
           Suggestion is to say 'N' in kernel config and "Y' in modem.
```

## drivers/hisi/mspc/Kconfig
```kconfig
config MSPC
	depends on HISI_MAILBOX
	bool "MSP core "
	default n
	help
	  MSP core driver

config MSPC_MNTN_RESET_IRQ_SEPARATE
        depends on MSPC
        bool "mspc reset use separate interrupts."
        default n
        help
          whether mspc reset support separate interrupts feature

config MSPC_SUPPORT_DCS
        depends on MSPC
	bool "Support for Dynamic Binaries upgrade"
        default n
        help
	  whether to support dynamic binaries upgrade in Hisee
```

## drivers/hisi/noc/Kconfig
```kconfig
config HISI_NOC
	depends on HISI_BB
	bool "Support NOC"
	default n
	help
	  This driver supports XXX NOC,
	  including noc driver

config HISI_NOC_DBG
	depends on HISI_NOC && HISI_DEBUG_FS
	bool "Support NOC Dbg node"
	default n
	help
	  Support NOC Dbg node
config HISI_NOC_MODID_REGISTER
	depends on HISI_NOC
	bool "Support NOC modid register"
	default n
	help
	  Support NOC modid register
config HISI_QIC
	depends on HISI_BB
	bool "Support QIC"
	default n
	help
	  This driver supports XXX QIC
config HISI_QIC_MODID_REGISTER
        depends on HISI_QIC
        bool "Support QIC modid register"
        default n
        help
          Support QIC modid register
```

## drivers/hisi/npu/Kconfig
```kconfig
menu "NPU Drivers"

menuconfig NPU_DEVDRV
	bool "NPU support"
	default n
	help
	  Say yes here to support npu

if NPU_DEVDRV

source "drivers/hisi/npu/manager/Kconfig"
source "drivers/hisi/npu/device/Kconfig"
source "drivers/hisi/npu/platform/Kconfig"
source "drivers/hisi/npu/facility/atf/Kconfig"
source "drivers/hisi/npu/dfx/dbg/Kconfig"
source "drivers/hisi/npu/dfx/log/Kconfig"
source "drivers/hisi/npu/dfx/profiling/Kconfig"
source "drivers/hisi/npu/facility/Kconfig"

endif #NPU_DEVDRV

endmenu
```

## drivers/hisi/npu/facility/atf/Kconfig
```kconfig
menuconfig NPU_HISI_ATF_SEVICES
	tristate "NPU_HISI_ATF_SEVICES"
	default n
	help
	  Say yes here to support hisi atf sercies
```

## drivers/hisi/npu/platform/Kconfig
```kconfig
config NPU_DEVDRV_DEVPLATFORM
	tristate "DEVDRV_DEVPLATFORM"
	default y
config HISI_NPU_DEBUG
    tristate "HISI_NPU_DEBUG"
	default n
```

## drivers/hisi/npu/platform/hi3690/Kconfig
```kconfig
menuconfig PLATFORM_HI3690
	tristate "PLATFORM_HI3690"
	default n
	help
	  Say yes here to support npu hi3690 platform adapt

config PHOENIX_SUPPORT
	bool "PHOENIX support"
	depends on PLATFORM_HI3690
	default n
	help
	  Say yes here to support phoenix
```

## drivers/hisi/npu/platform/hi6280/Kconfig
```kconfig
menuconfig PLATFORM_HI6280
	tristate "PLATFORM_HI6280"
	default n
	help
	  Say yes here to support npu hi6280 platform adapt

config ORLANDO_SUPPORT
	bool "ORLANDO support"
	depends on PLATFORM_HI6280
	default n
	help
	  Say yes here to support orlando
```
