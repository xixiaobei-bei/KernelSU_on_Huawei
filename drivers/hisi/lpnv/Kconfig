## drivers/hisi/lpnv/Kconfig
```kconfig
config HISI_LPNV_SWITCH
	bool "hisilicon lpnv switch debug driver"
	depends on HISI_BB
	default n
	help
           Say 'Y' here if you want to use hisi lpnv switch debug
```

## drivers/hisi/mailbox/Kconfig
```kconfig
config HISILICON_PLATFORM_MAILBOX
	bool "HISILICON PLATFORM MAILBOX"
	default n

if HISILICON_PLATFORM_MAILBOX
source "drivers/hisi/mailbox/ipc_mailbox/Kconfig"
endif
```

## drivers/hisi/max_power/Kconfig
```kconfig
menu "lpcpu max power options"

config LPCPU_MAX_POWER
	bool "lpcpu max power"
	default n
	help
	  lpcpu max power drivers

endmenu
```

## drivers/hisi/memory_dump/Kconfig
```kconfig
config HISILICON_PLATFORM_KERNELDUMP
	bool "Support KERNELDUMP"
	default n
	help
	  This driver supports XXX KERNELDUMP,
	  including kerneldump driver.

config HISI_KERNELDUMP
	bool "Support KERNELDUMP"
	default n
	help
	  This driver supports KERNELDUMP,
	  including kerneldump driver.

config KERNELDUMP_KO_DBG
	bool "Support ko mem dump"
	depends on HISI_KERNELDUMP
	default n
	help
	  This driver supports XXX ko dump,
	  including ko dump driver.
```

## drivers/hisi/mntn/Kconfig
```kconfig
config HISILICON_PLATFORM_MAINTAIN
	bool "platform maintain module support"
	default n
	help
	  Say yes here to support the platform maintain module

config HISI_MNTN_PC
	bool "pc platform"
	default n
	help
	  Say yes here to support the pc platform

config HISILICON_PLATFORM_HISI_EASYSHELL
	bool "Support Easy Shell"
	default n
	help
	  This driver supports XXX SOC,
	  including easy shell, etc.
source "drivers/hisi/mntn/blackbox/Kconfig"
source "drivers/hisi/mntn/hisee/Kconfig"
source "drivers/hisi/mntn/bl31/Kconfig"
source "drivers/hisi/mntn/subpmu/Kconfig"


config HISI_VIRT_TO_PHYS
	bool "support converting virtual address to physical address"
	default n
	help
	  Say 'Y' here if you want to support virtual address to physical address enable.

config HISI_BOOT_TIME
	bool "support print all boot slice"
	default n
	help
	  Say 'Y' here if you want to print all boot slice.

config HISI_BB_SYSCALL
	bool "support print system call trace "
	default n
	help
	  Say 'Y' here if you want to print system call trace.

config HISI_POWER_OFF
	bool "platform power off and reset driver"
	default n
	help
	  Power off and reset support for the boards.

config HISI_FIQ
	bool "platform fiq dump driver"
	default n
	help
	   Say 'Y' here if you want to support fiq dump.

config HISI_MNTNDUMP
        bool "platform mntn dump driver"
        default n
        help
           Say 'Y' here if you want to support mntn dump.

config HISI_DEBUG_FS
	bool "platform debugfs"
	depends on DEBUG_FS
	help
		debugfs disable by self

config HISI_RECORD_SP
        bool "platform mntn record sp"
		depends on FUNCTION_TRACER
		default n
        help
           Say 'Y' here if you want to support record sp.

config HISI_HW_SP
        bool "platform hw sp"
        default n
        help
           Say 'Y' here if you want to support hw sp.

config HISI_L3CACHE_ECC
        bool "platform l3cache ecc driver"
        depends on !CPU_EDAC_ARM64
        default n
        help
           Say 'Y' here if you want to support l3cache ecc.

config HISI_L3CACHE_ECC_DEBUG
        bool "platform l3cache ecc debug"
        depends on HISI_L3CACHE_ECC
        default n
        help
           Say 'Y' here if you want to support l3cache ecc debug.

config HISI_CLANG
        bool "clang compiler auxiliary for kernel"
        default n
        help
           Say 'Y' here if you want to support clang.

config HISI_MNTN_FACTORY
        bool "debug mntn for factory test"
        depends on HISI_BB
        default n
        help
           Say 'Y' here if you want to use enable mntn factory debug

config HISI_HEALTH_GRADE
        bool "health grade driver"
        default n
        help
           Say 'Y' here if you want to use enable health grade

config HISI_MNTN_SWITCH
        bool "mntn switch debug driver"
        depends on HISI_BB
        default n
        help
           Say 'Y' here if you want to use himntn switch debug
config HISI_EARLY_PANIC
        bool "early ap panic save log buf"
        depends on HISI_BB
        default n
        help
           Say 'Y' here if you want to use enable early log buf
```

## drivers/hisi/mntn/bl31/Kconfig
```kconfig
config HISI_BL31_MNTN
    bool "bl31 mntn module support"
    default n
    help
      Say yes here to support the bl31 mntn module.
config DISABLE_DMSS_INT
    bool "DISABLE DMSS INT when acpu reset"
    default n
    help
      Support disable dmss int when acpu reset
```

## drivers/hisi/mntn/blackbox/Kconfig
```kconfig
menu "RDR - Running data recorder menu"

config HISI_BB
	bool "kernel run data recorder"
	depends on SYSFS
	default n
	help
	  This module can record some data about kernel internal info.
	  Include:
	  the task switch,
	  interrupts switch,
	  arm exception info,
	  etc ...

config HISI_BB_DEBUG
	bool "test unit for kernel run data recorder"
	depends on SYSFS && HISI_BB
	default n
	help
	  This module can test RDR function ...
	  Include:
	  dataabort,
	  etc

# need_other_module_clear
config HISI_MNTN_SP
	bool "ap core register sp record"
	depends on  HISI_LPMCU_BB
	default n
	help
	  This module can record some data about sp info.
	  Include:
	  sp,
	  etc


config HISI_LPMCU_BB
	bool "lpmcu bbox"
	depends on  HISI_BB
	default n
	help
	  This module can record some data about lpmcu info.
	  Include:
	  lpmcu exception,
	  etc

config HISI_HIFI_BB
	bool "hifi bbox"
	depends on  HISI_BB
	default n
	help
	  This module can record some data about hifi info.
	  Include:
	  hifi exception,
	  etc

# need_other_module_clear
config HISP_RDR
	bool "hisp rdr"
	depends on HISI_BB
	default n
	help
	  This module can record isp rdr info.
	  Include:
	  isp,
	  etc

config HISI_MEM_TRACE
	bool "mem trace"
	depends on HISI_BB
	default n
	help
	  This module used to record mem trace info.
	  Include:
	  mem trace,
	  etc

config HISI_DFX_CORE
	bool "dfx core"
	depends on HISI_BB
	default n
	help
	  This module can record some data to dfx partition.
	  Include:
	  dfx,
	  etc

config HISI_MNTN_ESUBTYPE
	bool "exception subtype"
	depends on HISI_BB
	default n
	help
	  This module can record exception subtype.
	  Include:
	  exception subtype,
	  etc

config HISI_BB_DIAGINFO
	bool "diaginfo"
	depends on HISI_BB
	default n
	help
	  This module used to record nonreset exception.
	  Include:
	  nonreset exception,
	  etc

config HISI_HW_DIAG
	bool "hareware diaginfo record"
	depends on HISI_BB_DIAGINFO
	default n
	help
	  This module record diaginfo to judge hardware fault.
	  Include:
	  hardware fault,
	  etc
config HISI_MNTN_GT_WATCH_SUPPORT
	bool "mntn support GT watch"
	default n
	help
	Say 'Y' here if you wat to support GT watch

config HISI_BB_SHUTDOWN_REASON
	bool "shutdown reason record"
	depends on HISI_BB
	default n
	help
	  This module used to record shutdown reason

source "drivers/hisi/mntn/blackbox/platform_ap/Kconfig"
source "drivers/hisi/hifi_dsp/Kconfig"
endmenu
```

## drivers/hisi/mntn/hisee/Kconfig
```kconfig
config HISEE_MNTN
    bool "hisee mntn module support"
    default n
    help
      Say yes here to support the hisee mntn module.

config HISEE_MNTN_TEST
    bool "hisee mntn test"
    default n
    help
      Say yes here to support the hisee mntn test.

config HISEE_NVMFORMAT_TEST
    bool "hisee nvm format"
    default n
    help
      Say yes here to support the hisee nvm format.

config MNTN_CHECKMISC
    bool "chech misc ver"
    default n
    help
      Say yes here to support checking misc version.
```

## drivers/hisi/modem/Kconfig
```kconfig
menu "Hisi Modem"
config HISI_BALONG_MODEM
	bool "Hisilicon ap+modem config"
	default n
	help
	Hisilicon ap+modem config support.

config HISI_BALONG_MODEM_HI3650
	bool "Hisilicon ap+modem config"
	default n
	help
	Hisilicon ap+modem config support.

config BALONG_OAM_PS
        tristate "support tlmsp tlps gumsp gups taf"
        default n
        help
         tlmsp tlps gumsp gups taf acore image

source "drivers/hisi/modem/drv/Kconfig"
endmenu
```

## drivers/hisi/modem/config/product/kirin980/os/acore/kirin980_extra_modem_defconfig
```kconfig
# balong modem
CONFIG_HISI_BALONG_EXTRA_MODEM=y
CONFIG_HISI_BALONG_MODEM=m
CONFIG_HISI_BALONG_MODEM_HI3650=y


#IPC
CONFIG_IPC_DRIVER=n

#ICC
CONFIG_ICC_BALONG=n
CONFIG_ICC_BALONG_TEST=n

#SEC_CALL
CONFIG_SEC_CALL=n

#modem_boot
CONFIG_MODEM_BOOT=y
CONFIG_UART_BOOT=y
CONFIG_XLOADER_DBG=y

#balong_pcie_dev
CONFIG_PCIE_MODEM_BOOT=y
CONFIG_BALONG_PCIE_DEV=y
CONFIG_BALONG_PCIE_AP_DEV=y


#pmom
CONFIG_PM_OM_BALONG=y
CONFIG_PM_OM_BALONG_TEST=n

#easy_shell
CONFIG_BALONG_EASY_SHELL=n

#IPF
CONFIG_IPF_SUPPORT=n
CONFIG_IPF_TEST=n

#MAA
# CONFIG_MAA_BALONG is not set

#PSAM
CONFIG_PSAM_SUPPORT=n

#DSP
CONFIG_DSP_BALONG=n

#HKADC
CONFIG_HKADC_BALONG=n

#nvim
CONFIG_NVIM=n
CONFIG_NVIM_TEST=n

#Loadm
CONFIG_IMAGE_LOAD=n

#OnOff
CONFIG_BALONG_ONOFF=n
CONFIG_BALONG_MODEM_ONOFF=n

# sync
CONFIG_SYNC_BALONG=n

#hwadp
CONFIG_HW_IP_BASE_ADDR=n

#rfile
CONFIG_RFILE_SUPPORT=n

#MEM
CONFIG_MEM_BALONG=n

#timer
CONFIG_HARD_TIMER=n
CONFIG_SOFT_TIMER=n
CONFIG_BBP_TIMER=n

#UDI
CONFIG_UDI_SUPPORT=n

#RESET
CONFIG_BALONG_MODEM_RESET=n

CONFIG_BALONG_MODEM_POWER_MANAGE=n
CONFIG_HIFI_RESET=n

#S_MEMORY
CONFIG_S_MEMORY=n
CONFIG_S_MEMORY_TEST=n

#SYSCTRL
CONFIG_SYSCTRL=n
CONFIG_SYSCTRL_TEST=n

# efuse
CONFIG_EFUSE_BALONG=n
CONFIG_EFUSE_BALONG_AGENT=n

#---------------------------
#dual modem
CONFIG_DUAL_MODEM=n
CONFIG_BALONG_OAM_PS=n
CONFIG_FRAME_WARN=2048


#OM
CONFIG_HISI_DUMP=n

#PMIC OCP
CONFIG_PMIC_OCP=n
#BBP
CONFIG_BBP_ACORE=n

#COLD_PATCH
CONFIG_COLD_PATCH=n

#PCIE_NIC
CONFIG_BALONG_PCIE_ETH_RC=n
```

## drivers/hisi/modem/drv/diag/Kconfig
```kconfig
#
# Balong dump configuration
#

config DIAG_SYSTEM
	tristate "hisi diag system"
	default n
	help
		balong diag for kernel
```

## drivers/hisi/modem/drv/eicc/Kconfig
```kconfig
#
# eicc driver
#
comment "eicc driver"

config EICC_DRIVER
	tristate "EICC driver"
	default n
	help
	  EICC interface

config EICC_TEST
	tristate "EICC test"
	default n
	help
	  EICC test
	  
		
```

## drivers/hisi/modem/drv/espe/Kconfig
```kconfig
config BALONG_ESPE
	tristate "smart packet process module"
	help
	  If this option is enabled, the kernel will include support
	  for soft fast forward.
```

## drivers/hisi/modem/drv/icc/Kconfig
```kconfig
#
# multicore communication driver
#

comment "multicore communication driver"

config ICC_BALONG
	tristate "support icc"
	depends on IPC_DRIVER
	default n
	help
	  ICC driver
```

## drivers/hisi/modem/drv/ipcmsg/Kconfig
```kconfig
#
# ipc msg driver
#
comment "ipc msg driver"

config IPC_MSG_DRIVER
	tristate "ipc msg driver"
	default n
	help
	  IPC_MSG interface

config IPC_MSG_TEST
	tristate "ipc msg test"
	default n
	help
	  IPC_MSG test
	  
		
```

## drivers/hisi/modem/drv/loadm/Kconfig
```kconfig
#
# ccore image load
#

comment "ccore image load driver"

config IMAGE_LOAD
	tristate "ccore image load"
	default n
	help
	  ccore image load driver

config COLD_PATCH
	tristate "ccore patch image load"
	default n
	help
	  ccore patch image load driver
```

## drivers/hisi/modem/drv/mloader/Kconfig
```kconfig
#
# ccore image load
#

comment "ccore image load driver"

config MLOADER
	tristate "ccore image load"
	default n
	help
	  ccore image load driver
```

## drivers/hisi/modem/drv/net_helper/Kconfig
```kconfig
#
# Balong net_helper configuration
#

config IPF_SUPPORT
tristate "net_helper support"
default n
    help
    balong net_helper driver
```

## drivers/hisi/modem/drv/nmi/Kconfig
```kconfig
#
# Balong nmi driver
#
config BALONG_NMI
    tristate "nmi driver"
    default n
    help
       balong nmi for tsp
```

## drivers/hisi/modem/drv/ocp/Kconfig
```kconfig
config PMIC_OCP
	bool "balong pmic ocp"
	default n
	help
	support for pmic ocp of balong
	
config PMIC_DCXO 
	bool "balong pmic dcxo"
	default n
	help
	support for pmic dcxo of balong
```

## drivers/hisi/modem/drv/pm_om/Kconfig
```kconfig
config PM_OM_BALONG
	bool "balong pm om"
	default n
	help
	support for pm om of balong

config C_SR_STRESS_TEST
	bool "ccore sr stress test"
	default n
	help
	support for ccore sr stress test
```

## drivers/hisi/modem/drv/pmom/Kconfig
```kconfig
config BALONG_PMOM
	bool "balong pmom"
	default n
	help
	support for pmom of balong
```

## drivers/hisi/modem/drv/sim_hotplug/Kconfig
```kconfig
#
#Hisilicon HISI SIM hotplug support.
#
config HISI_SIM_HOTPLUG
	bool "support sim hotplug function"
	default n
	help
	  Say 'Y' here if you want to support the SIM HOTPLUG.
```

## drivers/hisi/modem/drv/thermal/Kconfig
```kconfig
#
# thremal driver
#

comment "thermal driver"
config THERMAL_BALONG
	tristate "thermal OnOff"
	default n

	  
```
