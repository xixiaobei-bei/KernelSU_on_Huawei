## drivers/hisi/hw_vote/Kconfig
```kconfig
menu "HW Vote options"

config HW_VOTE
    tristate "Hardware Vote Driver"
    default n
    help
      This enables the Hardware Vote driver.

config HW_VOTE_DEBUG
    tristate "Hardware Vote Driver Debug"
    depends on HW_VOTE && HISI_DEBUG_FS
    default n
    help
      This enables the Hardware Vote Driver Debug.

endmenu
```

## drivers/hisi/ipp/Kconfig
```kconfig
menu "HISP IPP"

config HISPIPP
	bool "HISP IPP Drivers"
	depends on IOMMU_API
	default n
	help
		HISP IPP drivers.

config HISPIPP_V200
	bool "HISP IPP Drivers for V200"
	depends on HISPIPP
	default n
	help
		HISP IPP Drivers for V200

config HISPIPP_V210
	bool "HISP IPP Drivers for V210"
	depends on HISPIPP
	default n
	help
		HISP IPP Drivers for V210

config HISPIPP_V250
	bool "HISP IPP Drivers for V250"
	depends on HISPIPP
	default n
	help
		HISP IPP Drivers for V250

config HISPIPP_V300
	bool "HISP IPP Drivers for V300"
	depends on HISPIPP
	default n
	help
		HISP IPP Drivers for V300

config HISPIPP_V320
	bool "HISP IPP Drivers for V320"
	depends on HISPIPP
	default n
	help
		HISP IPP Drivers for V320

config HISPIPP_V350
    bool "HISP IPP Drivers for V350"
    depends on HISPIPP
    default n
    help
        HISP IPP Drivers for V350
endmenu
```

## drivers/hisi/isp/Kconfig
```kconfig
config HISI_ISP_DEBUG
	bool "hisi isp debug"
	default n
	help
		Say yes here to support hisi isp debug.

config HISI_ISP_SMMU_BYPASS_DEBUG
	bool "hisi isp smmu bypass debug"
	default n
	help
		Say yes here to support hisi isp smmu bypass debug.
```

## drivers/hisi/ivp/Kconfig
```kconfig
menu "Hisilicon IVP"

config HISI_IVP
     bool "hisilicon ivp support"
     default n
     help
          ivp driver for ivpv300.

config IVP_SMMU
	bool "Hisilicon IVP SMMU Support"
	depends on IOMMU_API
	depends on HISI_IODOMAIN_API
	help
	  Hisilicon IVP IOMMU Support.

config IVP_SMMU_V3
	bool "Hisilicon IVP SMMU_V3 Support"
	depends on IOMMU_API
	depends on HISI_IODOMAIN_API
	help
	  Hisilicon IVP IOMMU Support.
config IVP_SMMU_TEST
	bool "Hisilicon IVP SMMU TEST Support"
	depends on IVP_SMMU
	help
	  Hisilicon IVP IOMMU TEST Support.

config IVP_IVPV160
	bool "ivpv160"
	depends on HISI_IVP

config IVP_IVPV200
	bool "ivpv200"
	depends on HISI_IVP

config IVP_IVPV150
	bool "ivpv150"
	depends on HISI_IVP

config IVP_IVPV100
	bool "ivpv100"
	depends on HISI_IVP

config IVP_IVPV120
	bool "ivpv120"
	depends on HISI_IVP

config IVP_IVPV210
	bool "ivpv210"
	depends on HISI_IVP

config IVP_IVPV250
	bool "ivpv250"
	depends on HISI_IVP

config IVP_IVPV300
	bool "ivpv300"
	depends on HISI_IVP

config IVP_IVPV310
	bool "ivpv310"
	depends on HISI_IVP

endmenu
```

## drivers/hisi/ivp/vp5/Kconfig
```kconfig
menu "Hisilicon IVP vp5"

config IVP_VP5
     bool "hisilicon ivp vp5 support"
     default n
     depends on HISI_IVP 
     help
          ivp vp5 kernel driver for hi3660.
endmenu
```

## drivers/hisi/jpu/Kconfig
```kconfig
config JPU_SUPPORT
    tristate "Support for JPEG processing unit"
    default n
    help
        The decode device provides decode function for JPEG.
```

## drivers/hisi/l3cache/Kconfig
```kconfig
menu "L3Cache"
config L3CACHE_EXTENSION
	bool "l3cache extension"
	depends on HISI_LB_L3_EXTENSION
	default n
	help
	 support l3cache extension

config L3CACHE_EXTENSION_DYNAMIC
	bool "l3cache extension dynamic"
	depends on L3CACHE_EXTENSION
	default n
	help
	 support l3cache extension on/off dynamicly

config L3CACHE_EXTENSION_DEBUG
	bool "l3cache extension debug"
	depends on L3CACHE_EXTENSION
	default n
	help
	 support l3cache extension debug

config L3CACHE_SHARE
	bool "l3cache share"
	default n
	help
	 support l3cache share

config L3CACHE_SHARE_PERF
	bool "l3cache share perf"
	depends on L3CACHE_SHARE && ARM64_DSU_PCTRL_DEVFREQ
	default n
	help
	 support l3cache share perf

config L3CACHE_SHARE_DEBUG
	bool "l3cache share debug"
	depends on L3CACHE_SHARE
	default n
	help
	 support l3cache share debug

config 64BIT_CCSIDR
	bool "64bit CCSIDR"
	default n
	help
	 support 64bit CCSIDR

config L3CACHE_PARTITION_CTRL
	bool "l3cache partition control"
	default n
	help
	 support l3cache partition control

config NAMSTO
	bool "namsto"
	default n
	help
	 support namsto

config NAMSTO_FLUSH_CMO
	bool "namsto flush cmo"
	depends on NAMSTO
	default n
	help
	 support namsto flush cmo

config NONSHAREABLE
	bool "nonshareable access"
	depends on NAMSTO
	default n
	help
	 support nonshareable access mntn

config NAMSTO_DEBUG
	bool "namsto debug"
	depends on NAMSTO
	default n
	help
	 support namsto debug

config L3CACHE_LP_DEBUG
	bool "l3cache lowpower debug"
	default n
	help
	 support l3cache low power debug

endmenu
```
