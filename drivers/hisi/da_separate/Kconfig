## drivers/hisi/da_separate/Kconfig
```kconfig
config SND_SOC_DA_SEPARATE_MBHC
	tristate "Soc Smartstar Codec da separate serise support"
```

## drivers/hisi/ddrc/Kconfig
```kconfig
config HISILICON_PLATFORM_DDRC
	bool "Hisilicon platform ddr controller support"
	default n
	help
	  Say yes here to support the hisilicon platform ddr controller

config HI3650_DDRC_FLUX
	bool "Hi3650 ddr bandwith statstic "
	default n

config HI6250_DDRC_FLUX
	bool "Hi6250 ddr bandwith statstic "
	default n

config HISI_DDR_TRACKING
        tristate "Hisilicon DDR Tracking Function"
        default n
        help
                Hisilicon DDR Tracking Function

config HISI_DDRC_FLUX
	bool "Hisi ddr bandwith statstic "
	default n

config HISI_DDRC_SEC
	bool "hisi ddr secprotect"
	default n

config HISI_DDR_SUBREASON
	bool "hisi ddr subreason"
	default n

config HISI_MNTN_DMSS_OPTI
	bool "hisi dmss opti"
	default n

config HI3660_DDR_AUTO_FSGT
       bool "hi3660 ddr autofs/autogt"
       default n

config KIRIN970_DDR_AUTO_FSGT
       bool "kirin970 ddr autofs/autogt"
       default n

config DDR_AUTO_FSGT
       bool "ddr autofs/autogt"
       default n

config HISI_DDR_LACERTA
       bool "Hisi ddr lacerta platform"
       default n

config HISI_DDR_CETUS
       bool "Hisi ddr cetus platform"
       default n

config HISI_DDR_PERSEUS
       bool "Hisi ddr perseus platform"
       default n

config HISI_DDR_URSA
       bool "Hisi ddr ursa platform"
       default n

config HISI_DDR_CASSIOPEIA
       bool "Hisi ddr cassiopeia platform"
       default n

config HISI_DDR_CEPHEUS
       bool "Hisi ddr cepheus platform"
       default n

config HISI_DDR_MONOCEROS
       bool "Hisi ddr monoceros platform"
       default n

config HISI_DDR_DRACO
       bool "Hisi ddr draco platform"
       default n

config HISI_DDR_TRIONES
       bool "Hisi ddr triones platform"
       default n

config AP_CUST_2G_MEM
       bool "Cust 2G memory support"
       default n
       help
             Hisilicon 2G memory Pad, To enable this configure for Pad
	     others disable

config HISI_DDR_PERF_CTRL
        tristate "Hisilicon DDR Performance Control Function"
        depends on PERF_CTRL
        default n
        help
	  Hisilicon DDR Performance Control Function
```

## drivers/hisi/dpm/Kconfig
```kconfig
config LOWPM_STATS
	bool "lpmcu or ddr lowpower statistical info"
	default n
	help
	Driver for lpmcu or ddr lowpm info
config LOWPM_DDR_STATE
	bool "ddr lowpower state statistical info"
	depends on LOWPM_STATS
	default n
	help
	Driver for ddr lowpm state info
```

## drivers/hisi/factory_svfd/Kconfig
```kconfig
config HISI_FACTORY_SVFD
	bool "hisilicon factory svfd data debug driver"
	depends on HISI_BB
	default n
	help
           Say 'Y' here if you want to read the data of factory svfd test
```

## drivers/hisi/file_encry/Kconfig
```kconfig
config FILE_BASED_ENCRYPTO
	bool "FEB3 support"
	default n
	help
	  Say yes here to support the FBE3

config FILE_BASED_ENCRYPTO_DBG
	bool "FEB3 debug support"
	depends on FILE_BASED_ENCRYPTO
	depends on HISI_DEBUG_FS
	default n
	help
	  Say yes here to support the FBE3 debug

config FBE_MSPC_ABSENT
	bool "FEB3 not to use MSPC"
	depends on FILE_BASED_ENCRYPTO
	default n
	help
	  Say yes here FBE3 not to use MSPC

config FBE_FPGA
	bool "FEB3 FPGA mode"
	depends on FILE_BASED_ENCRYPTO
	default n
	help
	  Say yes here to adapt the FBE3 in FPGA
```

## drivers/hisi/gpufreq/Kconfig
```kconfig
menu "GPUFREQ Options"

config GPUFREQ
    tristate "GPUFREQ Driver"
    depends on ARCH_HISI && PM_DEVFREQ
    select PM_OPP
    help
      This enables the gpufreq driver.

config GPU_FHSS
    tristate "GPU Frequency-Hopping Spread Spectrum Driver"
    depends on GPUFREQ
    help
      This enables the Frequency-Hopping Spread Spectrum of GPU feature.

config GPUTOP_FREQ
    tristate "GPUTOP Driver"
    depends on GPUFREQ
    help
      This enables the GPUTOP feature.

config GPUTOP_FREQ_DEBUG
    tristate "GPUTOP Driver debug"
    depends on GPUTOP_FREQ
    help
      This enables the GPUTOP debug feature.

endmenu
```

## drivers/hisi/harden/Kconfig
```kconfig
menu "Kernel Harden"

config KERNEL_REGION_PROTECT
	bool "Secure region protect for ACPU access of kernel region"
	depends on !HISI_DDRC_KERNEL_CODE_PROTECTION
	default n
	help
	  This module is for kernel code protection within ddrc mechanism.
	  Include:
	  kernel code,
	  kernel ro data,
	  etc ...

endmenu
```

## drivers/hisi/hhee/Kconfig
```kconfig
menu "HHEE options"

config HHEE
	bool "HHEE support"
	default n
	help
	  Say yes here to support the HHEE

config HKIP_MODULE_ALLOC
	bool "HKIP overload module_alloc for hhee"
	depends on HHEE
	default n
	help
	  Say yes when overload is needed

config HHEE_DEBUG
	bool "HKIP HHEE test support"
	depends on !UBSAN && !KCOV && !KASAN
	depends on HHEE
	depends on HISI_DEBUG_FS
	default n
	help
	  Say yes here to support the HHEE debug

config UEFI_HHEE
	bool "HHEE support for UEFI boot"
	depends on HHEE
	default n
	help
	  Say yes here to support HHEE when kernel boot form UEFI

config HKIP_PRMEM
	bool "Write protect critical data not requiring high write speed."
	default y
	help
	  Selected data can be tagged/allocated in such a way that it
	  becomes read-only, with the option of allowing for modifications
	  through specific API. Run-time allocation must also use such API.
	  Saying No here will revert to basic kernel vmalloc.

config HKIP_PRMEM_BYPASS
	bool "Disable the write protection provided by prmem"
	depends on HKIP_PRMEM
	default n
	help
	  Useful for debugging or for testing existing code while it is
	  being converted to the prmem API.
	  Saying Yes here will not write protect the allocations.

config DEBUG_HKIP_PRMEM
	bool "Run self test for protected memory (prmem)"
	depends on HKIP_PRMEM
	default y
	help
	  Verifies that the protected memory interface works correctly.

config PRMEM_MAX_MEMORY
	int "Maximum phys memory in MB for prmem, in chunks of 2MB"
	depends on HKIP_PRMEM
	range 6 20
	default 6
	help
	  The system will refuse allocations requests beyond the set value.

config HKIP_PRMEM_HARDENED_USERCOPY
	bool "Detects read / write operations from userspace to prmem"
	depends on HKIP_PRMEM
	default y
	help
	  Introduces a sanity check every time a read/write operation is
	  performed from a userspace interface.
	  Saying Yes here will add a small delay on each such operation.

config HKIP_PROTECT_BPF
	bool "Harden the basic protection of the BPF filter"
	depends on BPF
	depends on HKIP_PRMEM
	default y
	help
	  Harden the basic protection of the BPF filter.

config HKIP_PROTECT_BPF_CAP
	int "Maximum BPF pool memory in MB for BPF protection"
	depends on HKIP_PROTECT_BPF
	default 2
	help
	  Limits the maximum memory available for total use by bpf.
	  Set to 0 for disabling the cap.

config HKIP_PROTECT_POWEROFF_CMD
	bool "Write protect the poweroff command string"
	default y
	depends on HKIP_PRMEM
	help
	  The poweroff command will be still programmable through /proc,
	  but it will be protected agaisnt accidental/malicious direct
	  overwrites

config HHEE_USING_IPI
	bool "HKIP HHEE Using IPI interrupt"
	depends on HHEE
	default n
	help
	  Say yes here to support using IPI not GIC

config HKIP_XOM_CODE
	bool "HKIP XOM protection of kernel code"
	depends on HHEE
	default n
	help
	  Say yes here to enable kernel XOM protection

config CFI_CHECK_CACHE_NUM
	int "Number of modules supported by the CFI mechanism"
	depends on CFI_CLANG
	depends on HKIP_PRMEM
	range 512 2048
	default 512
	help
	  You can specify the maximum number of modules supported by the
	  CFI protection mechanism. If you are unsure, the default number
	  of modules is 512.

config HKIP_CFI_HARDEN
	bool "Additional protection for CFI tables for modules"
	default y
	depends on CFI_CLANG
	depends on HKIP_PRMEM
	help
	  If you select this option, it can prevent malicious writing of CFI
	  data by attackers.

config DEBUG_CFI_HARDEN
	bool "Test the feature that use prmem API to protect the CFI data"
	depends on MODULES && CFI_CLANG
	depends on CFI_CLANG_SHADOW
	depends on HKIP_PRMEM
	default n
	help
	  Verifies that the protected CFI data works correctly.

config DEBUG_CFI_HARDEN_KO
	tristate "Test ko for test cfi harden feature"
	depends on MODULES
	help
	  Say m here to support CFI harden feature test.

config HKIP_PROTECT_CRED
	bool "Support CRED Protect Feature"
	default y
	depends on HKIP_PRMEM
	help
	  Enable write protection for instances of cred structure against
	  accidental/malicious modifications.

config HKIP_TASKS_UNITS
	int "Number of tasks supported by the CRED Protect Feature"
	default 30000
	depends on HKIP_PROTECT_CRED
	help
	  Max number of tasks supported.

endmenu
```

## drivers/hisi/hi1103_eeprom/Kconfig
```kconfig
config HISI1103_EEPROM
	bool "HISI1103 Eeprom"
	default Y
	help
		This Options Enable the Eeprom Function
```

## drivers/hisi/hieps/Kconfig
```kconfig
config HISI_HIEPS
	bool "Hisilicon hieps "
	default n
	help
	  Hisi hieps driver

config HISI_HIEPS_SMX_ATCMD
	bool "Hisilicon hieps set/get smx"
	depends on HISI_HIEPS
	default n
	help
	  Hisi hieps driver set/get smx

config HIEPS_WITHOUT_CPU
        bool "hisilicon hieps without cpu"
	depends on HISI_HIEPS
	default n
	help
	  Hisi hieps driver without cpu
```

## drivers/hisi/hifi_dsp/Kconfig
```kconfig
menu "Hifimisc driver serve HIFI dsp"

config HIFI_DSP_ONE_TRACK
     bool "hifi low power play device support"
     help
          hifi lpp device provide service for HIFI and AP, in case of HIFI ultra-low power audio play.
config HIFI_MEMORY_21M
    bool "hifi memory is 21M"
    help
         hifi memory is 21M
config HIFI_MEMORY_15M
    bool "hifi memory is 15M"
    help
         hifi memory is 15M
config DSP_VAD_WAKEUP
    bool "4mic 4ec vad wakeup"
    help
         4mic 4ec vad wakeup
config 2MIC_LP_WAKEUP
    bool "2mic lp wakeup"
    help
         2mic lp wakeup
config SOCDSP_CMA_SIZE_7M
    bool "socdsp cma size 7M"
    help
         socdsp cma size 7M
config AUDIO_DEBUG
    bool "support audio debug function"
    help
        support audio debug function
config HIFI_EXTRA_MODEM_MODE
    bool "support a+b function"
    help
        support a+b function
config HIFI_RESET_CDEV
    bool "support hifi reset cdev"
    help
        support hifi reset cdev
config HIFI_SUPPORT_VIBRATOR
    bool "support transfer vibrator data"
    help
        support transfer vibrator data
source drivers/hisi/hifi_dsp/voice_proxy/Kconfig
endmenu
```

## drivers/hisi/hifi_mailbox/mailbox/Kconfig
```kconfig
menu "Hifi mailbox driver"

config HIFI_MAILBOX
     bool "hifi mailbox driver base on ipc"
     default n
     help
          transplant modem mailbox driver.
endmenu
```

## drivers/hisi/hisee/Kconfig
```kconfig
config HISEE
	depends on HISI_MAILBOX
	bool "hisee"
	default n
	help
	  hisee driver

config HISEE_POWER_MANAGE_COUNT
	depends on HISEE
	bool "hisee power manage counter"
	default n
	help
	  hisee driver

config HISEE_APPLET_APDU_TEST_OPTIMIZATION
	depends on HISEE
	bool "hisee applet apdu test optimize"
	default n
	help
	  hisee driver used to optimize the apdu
	  test cmd.It's orginal name is CONFIG_HISEE_
	  CHIPTEST_SUPPORT_APPLET_OPTIMIZATION.

config HISEE_SUPPORT_DCS
	depends on HISEE
	bool "Support for Dynamic Binaries upgrade"
	default n
	help
	  whether to support dynamic binaries upgrade in Hisee

config HICOS_MISCIMG_PATCH
	depends on HISEE
	bool "hisee msic patch driver"
	default n
	help
	  hisee driver used to upgrade misc patch.
	  It's orginal name is CFG_HICOS_MISCIMG_PATCH, the
	  name used in cos is also named CFG_HICOS_MISCIMG_PATCH.

config MISCIMG_SECUPGRADE
	depends on HISEE
	bool "hisee misc upgrade"
	default n
	help
	  hisee driver used to upgrade misc image.

config HISEE_SUPPORT_MULTI_COS
	depends on HISEE
	bool "hisee support multi cos"
	default n
	help
	  hisee driver used to support multi cos.
	  It's orginal name is HISEE_SUPPORT_MULTI_COS.

config HISEE_NEW_COS_VERSION_HEADER
	depends on HISEE
	bool "hisee has new cos version format"
	default n
	help
	  hisee driver used to support new cos version format.

config HISEE_NEW_COSID_HEADER
	depends on HISEE_SUPPORT_MULTI_COS
	bool "hisee has new cos id format"
	default n
	help
	  hisee driver used to support new cos id format.

config HISEE_SUPPORT_8_COS
	depends on HISEE_SUPPORT_MULTI_COS
	bool "hisee can support 8 cos"
	default n
	help
	  hisee driver used to support 8 cos.

config HISEE_SUPPORT_CASDKEY
	depends on HISEE
	bool "hisee support CASD key"
	default n
	help
	  whether hisee support CASD key

config HISEE_SUPPORT_INSE_ENCRYPT
	depends on HISEE
	bool "hisee support inse encryption for bio, pin code and fingerprint."
	default n
	help
	  whether hisee support inse encryption

config HISEE_FACTORY_SECURITY_CHECK
	depends on HISEE
	bool "hisee support factory security check."
	default n
	help
	  whether hisee support factory security check

config HISEE_NFC_IRQ_SWITCH
	depends on HISEE
	bool "hisee support nfc irq switch."
	default n
	help
	  whether hisee support nfc irq switch

config HISEE_SUPPORT_OVERSEA
	depends on HISEE
	bool "hisee support oversea feature."
	default n
	help
	  whether hisee support oversea feature

config HISEE_MNTN_RESET_IRQ_SEPARATE
	depends on HISEE
	bool "hisee reset use separate interrupts."
	default n
	help
	  whether hisee reset support separate interrupts feature

config HISEE_HIGH_TEMP_PROTECT_SWITCH
	depends on HISEE
	bool "hisee support high temperature protect switch."
	default n
	help
	  whether hisee support high temperature protect switch

config HISEE_SUPPORT_ULOADER
	depends on HISEE
	bool "hisee support uloader image process."
	default n
	help
	  whether hisee support uloader image process

config SMX_PROCESS
	depends on HISEE
	bool "hisee support smx process on boot."
	default n
	help
	  whether hisee support smx process on boot

config HISEE_AT_SMX
	depends on HISEE
	bool "hisee support smx controlled by atcmdsrv."
	default n
	help
	  whether hisee support smx controlled by atcmdsrv

config HISEE_DISABLE_KEY
	depends on HISEE
	bool "hisee disable open and close key."
	default n
	help
	  whether hisee support disable open and close key
```

## drivers/hisi/hisi_ap_ready/Kconfig
```kconfig
config HISI_AP_READY
	bool "Ap init ok notice support"
	default n
	help
		Notice to 1135 kernel init end
```

## drivers/hisi/hisi_bus_monitor/Kconfig
```kconfig
config HISI_BUS_MONITOR_TEST
	bool "hisi bus monitor test"
	default n
	help
	test CPU Bus Perf Monitor
config HISI_BUS_MONITOR
	bool "hisi bus monitor"
	default n
	help
	CPU Bus Perf Monitor
```

## drivers/hisi/hisi_lb/Kconfig
```kconfig
config HISI_LB
	bool "HISI last buffer"
	help
	  Enable last buffer.

	  If unsure, say N here.

config HISI_LB_DEBUG
	bool "HISI lb debug"
	depends on HISI_LB
	help
	  Enable last buffer debug.

	  If unsure, say N here.

config HISI_LB_ENG_DEBUG
	bool "HISI lb eng debug"
	depends on HISI_LB
	help
	  Enable last buffer eng debug.

	  If unsure, say N here.

config HISI_LB_TST
	bool "HISI lb ip test"
	depends on HISI_LB
	help
	  Enable last buffer ip test
	  and need disable hisi lb debug

	  if unsure, say N here

config HISI_LB_PMU
	bool "HISI lb pmu"
	depends on HISI_LB
	help
	  Enable last buffer ip test
	  and need disable hisi lb debug

	  if unsure, say N here

config HISI_LB_GEMINI
	bool "HISI lb gemini"
	depends on HISI_LB
	help
	  Enable last buffer debug.

	  If unsure, say N here.

config HISI_LB_L3_EXTENSION
	bool "HISI lb l3 extension"
	depends on HISI_LB
	help
	  Enable last buffer debug.

	  If unsure, say N here.

config HISI_LB_ION
	bool "HISI lb ion"
	depends on HISI_LB
	help
	  Enable last buffer debug.

	  If unsure, say N here.

config HISI_LB_REMAP
	bool "HISI lb remap"
	depends on HISI_LB
	help
	  Enable last buffer remap.

	  If unsure, say N here.
```

## drivers/hisi/hsdt_trace/Kconfig
```kconfig
config HSDTTRACE
	bool "hsdttrace module support"
	default n
	help
		HSDT Trace Function
```
