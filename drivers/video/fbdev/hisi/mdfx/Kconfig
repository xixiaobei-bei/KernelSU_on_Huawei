## drivers/video/fbdev/hisi/mdfx/Kconfig
```kconfig
config HISI_MDFX
	tristate "HISI multimedia dfx"
	default n
	help
	  This is multimedia module dfx driver
```

## fs/hmdfs/Kconfig
```kconfig
config HMDFS_FS
	tristate "HMDFS"
	help
	  hmdfs

config HMDFS_ANDROID
	bool "HMDFS ANDROID PLATFORM"
	depends on HMDFS_FS && ANDROID
	default n
	help
	  hmdfs for android platform

config HMDFS_1_0
	bool "HMDFS 1.0 VERSION COMPATIBILITY"
	depends on HMDFS_ANDROID
	default n
	help
	  Enable adapter for earlier version compatibility

config HMDFS_CRYPTO
	bool "HMDFS CRYPTO"
	depends on HMDFS_FS && TLS
	default n
	help
	  Crypto for hmdfs

config HMDFS_FS_DEBUG
	bool "HMDFS Debug log print"
	default n

config HMDFS_XATTR_NOSECURITY_SUPPORT
	bool "HMDFS XATTR_NOSECURITY SUPPORT"
	depends on HMDFS_FS
	default n
	help
	  __vfs_getxattr's parameters has been modified by Android Kernel v5.4
	  For kernel with that patch, this option should be enabled.

# D2D Protocol configuration

source "fs/hmdfs/d2dp/Kconfig"

config HMDFS_D2DP_TRANSPORT
       bool "HMDFS D2D PROTOCOL SUPPORT"
       depends on HMDFS_FS && D2D_PROTOCOL
       default n
       help
         Enable experimental D2D Protocol for transport. The protocol is
         designed to achieve maximum bandwidth on local WiFi networks but may
         slightly increase latency.

config HMDFS_D2DP_TX_BINDING
       bool "HMDFS D2DP TX THREAD BINDING"
       depends on HMDFS_D2DP_TRANSPORT
       default n
       help
         Some chipsets divide CPUs into several groups depending on their
         maximum frequency. The fastest ones are 6 and 7 CPUs. This option
         enables binding for D2DP TX thread on the fastest group (6 and 7 CPUs)
         to achieve maximum transmission speed.

config HMDFS_D2DP_UDP_INCREASE_SND_BUF
       bool "HMDFS D2D UDP SEND BUFFER TUNING"
       depends on HMDFS_FS && HMDFS_D2DP_TRANSPORT
       default n
       help
         This option increases SO_SNDBUF value for D2DP connections to improve
         transmission speed.
         Say N here if your networking driver drops packets with increased
         SO_SNDBUF

config HMDFS_LOW_LATENCY
	bool "HMDFS low latency networking"
	depends on HMDFS_FS
	default n
	help
	  Enable low-latency solution for fast response networking
```

## fs/hmdfs/d2dp/Kconfig
```kconfig
config D2D_PROTOCOL
	tristate "D2D Protocol"
	depends on INET
	help
	  This enables building D2D-over-UDP Protocol. D2DP/UDP is a new fast
	  transport protocol designed for local WiFi networks with low drop
	  rate (WiFi-Direct or Soft-AP with no intermediate hops)

	  This protocol now works only in kernel space so if your application
	  does not run in kernelspace, say N here.
```

## fs/hmfs/Kconfig
```kconfig
config HMFS_FS
	tristate "HMFS filesystem support"
	depends on BLOCK
	select CRYPTO
	select CRYPTO_CRC32
	help
	  HMFS is based on Log-structured File System (LFS), which supports
	  versatile "flash-friendly" features. The design has been focused on
	  addressing the fundamental issues in LFS, which are snowball effect
	  of wandering tree and high cleaning overhead.

	  Since flash-based storages show different characteristics according to
	  the internal geometry or flash memory management schemes aka FTL, HMFS
	  and tools support various parameters not only for configuring on-disk
	  layout, but also for selecting allocation and cleaning algorithms.

	  If unsure, say N.

config HMFS_STAT_FS
	bool "HMFS Status Information"
	depends on HMFS_FS && DEBUG_FS
	default y
	help
	  /sys/kernel/debug/hmfs/ contains information about all the partitions
	  mounted as hmfs. Each file shows the whole hmfs information.

	  /sys/kernel/debug/hmfs/status includes:
	    - major filesystem information managed by hmfs currently
	    - average SIT information about whole segments
	    - current memory footprint consumed by hmfs.

config HMFS_FS_XATTR
	bool "HMFS extended attributes"
	depends on HMFS_FS
	default y
	help
	  Extended attributes are name:value pairs associated with inodes by
	  the kernel or by users (see the attr(5) manual page, or visit
	  <http://acl.bestbits.at/> for details).

	  If unsure, say N.

config HMFS_FS_POSIX_ACL
	bool "HMFS Access Control Lists"
	depends on HMFS_FS_XATTR
	select FS_POSIX_ACL
	default y
	help
	  Posix Access Control Lists (ACLs) support permissions for users and
	  groups beyond the owner/group/world scheme.

	  To learn more about Access Control Lists, visit the POSIX ACLs for
	  Linux website <http://acl.bestbits.at/>.

	  If you don't know what Access Control Lists are, say N

config HMFS_FS_SECURITY
	bool "HMFS Security Labels"
	depends on HMFS_FS_XATTR
	help
	  Security labels provide an access control facility to support Linux
	  Security Models (LSMs) accepted by AppArmor, SELinux, Smack and TOMOYO
	  Linux. This option enables an extended attribute handler for file
	  security labels in the hmfs filesystem, so that it requires enabling
	  the extended attribute support in advance.

	  If you are not using a security module, say N.

config HMFS_CHECK_FS
	bool "HMFS consistency checking feature"
	depends on HMFS_FS
	help
	  Enables BUG_ONs which check the filesystem consistency in runtime.

	  If you want to improve the performance, say N.

config HMFS_FS_ENCRYPTION
	bool "HMFS Encryption"
	depends on HMFS_FS
	depends on HMFS_FS_XATTR
	select FS_ENCRYPTION
	help
	  Enable encryption of hmfs files and directories.  This
	  feature is similar to ecryptfs, but it is more memory
	  efficient since it avoids caching the encrypted and
	  decrypted pages in the page cache.

config HMFS_IO_TRACE
	bool "HMFS IO tracer"
	depends on HMFS_FS
	depends on FUNCTION_TRACER
	help
	  HMFS IO trace is based on a function trace, which gathers process
	  information and block IO patterns in the filesystem level.

	  If unsure, say N.

config HUAWEI_HMFS_DSM
	bool "Listen hmfs kernel err"
	default n
	help
		use huawei fs log radar

config HMFS_FAULT_INJECTION
	bool "HMFS fault injection facility"
	depends on HMFS_FS
	help
	  Test HMFS to inject faults such as ENOMEM, ENOSPC, and so on.

	  If unsure, say N.
config HISI_HMFS_MTIME
	bool "reduce freq to update mtime"
	default n
	help
		reduce freq to update mtime

config HMFS_JOURNAL_APPEND
	bool "HMFS append sit and nat journal size"
	depends on HMFS_FS
	default n
	help
	  append 2 blocks for sit and nat journal

config HMFS_GRADING_SSR
	bool "HMFS grading ssr"
	depends on HMFS_FS
	default n
	help
	  use grading ssr to improve the end performance
```

## include/hwnet/Kconfig
```kconfig
source "drivers/hwnet/ipv4/Kconfig"
source "drivers/hwnet/booster/Kconfig"
source "drivers/hwnet/chr/Kconfig"
source "drivers/hwnet/hw_dpi_mark/Kconfig"
source "drivers/hwnet/hw_dual_connection/Kconfig"
source "drivers/hwnet/waudio/Kconfig"
```

## include/hwnet/booster/Kconfig
```kconfig
config HW_BOOSTER
    tristate "Network-related optimization acceleration features."
    default n
    help
      Provide network acceleration, business quality assessment
      and other functions.
config HW_PACKET_FILTER_BYPASS
    tristate "huawei iptables and bpf interception detection and bypass module"
    default n
    help
      Detect whether the network packet of foreground uid is dropped by netfilter
      or bpf, and then try to recovery it.
config HW_NETWORK_QOE
    tristate "Network-Qoe optimization features."
    default n
    help
      Provide network Qoe feature.
```

## include/hwnet/netqos_sched/Kconfig
```kconfig
config HW_NETQOS_SCHED
    bool "netqos schedule"
    default n
    help
      if set, the network will speed up or slow down according to
      business QOS
```

## kernel/cgroup_workingset/Kconfig
```kconfig
config HW_CGROUP_WORKINGSET
        bool "workingset cgroup subsystem"
        depends on CRYPTO_CRC32C
        depends on TASK_DELAY_ACCT
        help
          Provides a cgroup implementing filepage collector and prereader of workingset.
          This cgroup workingset for application, collect it touched filepages and
          preread those filepages.
```

## kernel/gcov/hisi_gcov/Kconfig
```kconfig
config HISI_KERNEL_GCOV
	bool "config hisi kernel gcov"
	depends on GCOV_KERNEL
	---help---
	This option enables hisi kernel gcov.
```

## kernel/hw_pi/Kconfig
```kconfig
config HW_FUTEX_PI
        bool "extend futex pi"
        depends on FUTEX_PI
        default n
        help
          Customize futex pi and support qos and vip_prio inheritance.
```

## kernel/hwcfs/Kconfig
```kconfig
config HW_VIP_THREAD
	bool "iaware 2.0 vip thread"
	default n
	help
	  if set, vip thread is pick first in cfs sched policy
config HW_VIP_KWORKER
	bool "iaware 6.0 vip kworker"
	default n
	help
	  if set, kworker thread is pick first in cfs sched policy
config HW_VIP_SEMAPHORE
	bool "iaware vip semaphore"
	depends on HW_VIP_THREAD
	default n
	help
	  if set, thread(has vip tsk->group_leader) with vip semaphore is pick first in cfs sched policy
```

## kernel/hwrtg/Kconfig
```kconfig
config HW_RTG_SCHED
	bool "iaware 5.0 rtg sched"
	depends on FRAME_RTG
	default n
	help
	  if set, key thread sched in rtg

config HW_RTG_SCHED_RT_THREAD_LIMIT
	bool "limit the number of RT threads"
	depends on HW_RTG_SCHED
	default n
	help
	  if set, limit the number of RT threads in AUX and Frame rtg.
```

## kernel/sched/Kconfig
```kconfig
#
# Hisi enhanced options for sched walt
#

if SCHED_WALT

config SCHED_HISI_WALT_WINDOW_SIZE_TUNABLE
	bool "Make WALT window size tunable"
	default n
	help
	  Make walt_ravg_window tunable in early param.

config SCHED_HISI_DOWNMIGRATE_LOWER_LOAD
	bool "Schedutil governor use lower load when task downmigrate"
	depends on CPU_FREQ_GOV_SCHEDUTIL
	default n
	help
	  Schedutil governor migrate cpu busy time when task migrate. This
	  option will recaculate a lower load for task downmigrate to
	  prevent little core's frequency increase too much.

config SCHED_HISI_CALC_CUM_WINDOW_DEMAND
	bool "WALT calculate cum window demand"
	depends on SCHED_HISI_USE_WALT
	default n
	help
	  This option caculates WALT's cum_window_demand, which is not used
	  currently.

config SCHED_HISI_CHECK_IRQLOAD
	bool "Scheduler check irqload when select task's cpu"
	default y
	help
	  WALT caculates an irqload for each cpu and scheduler will avoid
	  placing task on a high irqload cpu (if WALT enabled).
	  Default disabled because we haven't tested to find out which
	  threshold is the best.

config SCHED_HISI_TOP_TASK
	bool "Maintain the top task load of each cpu"
	default y
	help
	  Hisi schedutil governor may use the top task load as a guide to
	  frequency evaluation.

config SCHED_HISI_USE_WALT
	bool "Scheduler use WALT for cpu util and task util"
	default y
	help
	  This option enables calculation of WALT's task_util/cpu_util
	  signal, and sets sysctl_sched_use_walt_[cpu/task]_util to 1.

	  When enabled, you can still change the sysctl node to
	  enable or disable walt signal for debug purpose.

config SCHED_HISI_MIGRATE_SPREAD_LOAD
	bool "Spread task's load when inter-cluster migration"
	default y
	help
	  In inter-cluster migration, this option will spread task's
	  prev_window/curr_window to all cpus that the task has been
	  running on before in a window. If disabled, task's whole load
	  will move to dest cpu and that will make dest cpu's cpu load
	  very high in same cases.

config SCHED_HISI_TOP_TASK_SKIP_HISPEED_LOGIC
	bool "Let top task ignore above_hipeed_delay"
	depends on SCHED_HISI_TOP_TASK
	default y
	help
	  For schedutil governor, this option skips hispeed logic when
	  ADD_TOP_TASK event triggers freq update.

config SCHED_HISI_RUNNING_TASK_ROTATION
	bool "Rotate running tasks between clusters"
	default y
	depends on HISI_EAS_SCHED
	depends on HISI_CORE_CTRL
	depends on HISI_ED_TASK && !HISI_ED_TASK_RESET_AT_UPMIGRATION
	help
	  When there are 8 big tasks running parallelly, e.g. geekbench
	  multicore, tasks which were initially run on big cores will
	  finish its job very soon and then there will be 6 or less tasks
	  left.
	  Rotate the tasks, or in other words exchange them between
	  little cores and big cores randomly, will improve fairness and
	  parallelism.

config SCHED_HISI_PRED_LOAD
	bool "Calculate predicted load for each task"
	default y
	depends on HISI_CPU_FREQ_GOV_SCHEDUTIL
	help
	  Another signal to improve schedutil. This will help to ramp up
	  cpufreq quickly.
	  To enable this signal, say yes here and set predl_enable to 1
	  in init rc.

endif # SCHED_WALT

config SCHED_HISI_DEBUG_TRACE
	bool "Detailed trace for EAS debug"
	default n
	help
	  This option enable detailed tracepoint for EAS debug, there
	  will be more tracepoint in find best target, load balance and
	  energy diff.
```

## mm/hisi/Kconfig
```kconfig
menuconfig HISI_MM
	bool "Hisilicon MM support"
	---help---
	  This option add some hisilicon mm codes, needed by following modules.

if HISI_MM

config HISI_SLOW_PATH_COUNT
	bool "page alloc enter slow path count"
	default n
	help
	  Say 'Y' here is you want to count page alloc slow path.

endif

config HISI_PMALLOC
	bool "Protectable Memory Allocator"
	default y
	depends on MMU
	depends on HISI_MM
	select  GENERIC_ALLOCATOR
	help
	It allows to write-protect variables allocated dynamically
	ls /sys/kernel/pmalloc
```

## mm/xreclaimer/Kconfig
```kconfig
config HW_XRECLAIMER
	bool "Fast process memory reclaimer implemented by Huawei"
	depends on MMU
	help
	  Say Y here if you want to support fast process memory reclaimer
```

## net/tcp_socket/Kconfig
```kconfig
config HUAWEI_TRACK_SOCKET
	bool "track the specific tcp sockets"
	default n

config HUAWEI_TRACK_SOCKET_DEBUG
	bool "debug the tcp sockets tracking"
	default n
```

## security/check_double_free/Kconfig
```kconfig
config HW_DOUBLE_FREE_DYNAMIC_CHECK
	bool "hw double free dynamic check"
	default n
	help
	  function depends on SLUB.
	  support double free check function.
	  upload the call stack information to.
	  hisecd when double free happen.
```

## security/check_root/Kconfig
```kconfig
config HUAWEI_PROC_CHECK_ROOT
	bool "/proc/check_root support"
	default n
	help
	  Enable serveral root checks and security audit.
	  kernel root checks provides setxid syscalls audit
	  and keyfiles check.
	  security audit provides audit log functions.
```

## security/hkip_atkinfo/Kconfig
```kconfig
config HKIP_ATKINFO
	bool "Upload HKIP attack information"
	depends on HHEE || HUAWEI_HKIP
	default n
	help
	  Say yes to enable HKIP attack information to Huawei server.
	  the attacked type is included disable WXN, disable MMU,
	  modify kernel code, modify kernel page table.
	  if you not sure, choose n.

config HKIP_ATKINFO_DEBUGFS
	bool "Upload HKIP attack information debugfs"
	depends on HKIP_ATKINFO
	default n
	help
	  Say yes to support the debug fs
	  of HKIP_ATKINFO feature.
	  the debugfs is /sys/d/hkip_atkinfo.
	  if you are not sure, choose n.
```

## security/hwdps/Kconfig
```kconfig
config HWDPS
	bool "application authentication"
	default n
	help
		Say yes here to support application authentication.

config HWDPS_ENG_DEBUG
	bool "application authentication for eng debug"
	default n
	help
		Say yes here to support application authentication eng debug.
```
