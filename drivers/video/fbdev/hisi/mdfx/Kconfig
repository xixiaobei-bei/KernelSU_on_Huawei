## security/kshield/Kconfig
```kconfig
menuconfig SECURITY_KSHIELD
	bool "K-Shield"
	default n
	---help---
	  Chose this option to enable the K-Shield, which
	  can detect and block root attack at runtime.

config KSHIELD_TRACE
	bool "K-Shield Trace"
	depends on SECURITY_KSHIELD
	help
	  Chose this option to enable tracing syscall and
	  process.

choice
	prompt "Trace type"
	depends on KSHIELD_TRACE
	default KSHIELD_TRACE_BY_DIRECT

config KSHIELD_TRACE_BY_DIRECT
	bool "Instrumentation at el0_svc"
	help
	  Trace syscall and process by hooking ev0_svc().
	  This is faster than ftrace.

config KSHIELD_TRACE_BY_FTRACE
	bool "Instrumentation by ftrace"
	help
	  Trace syscall and process by ftrace.

endchoice

config KSHIELD_TEST
	bool "K-Shield Test"
	depends on SECURITY_KSHIELD
	help
	  Chose this option to support event that can be
	  used to test the module and daemon side functions.

config KSHIELD_PERMISSIVE
	bool "K-Shield Permissive"
	depends on SECURITY_KSHIELD && KSHIELD_TEST
	help
	  Chose this option to make K-Shield print kernel
	  log instead of blocking attacker.
```

## security/mdpp_ccmode/Kconfig
```kconfig
#
# Copyright (c) Huawei Technologies Co., Ltd. 2019-2019. All rights reserved.
# Description: Get ccMode from CommandLine
# Author: yangzhenyuan <yangzhenyuan@huawei.com>
# Create: 2019-11-07
#

menu "Huawei kernel mdpp ccmode"

config HUAWEI_MDPP_CCMODE
	bool "cmdline parse for ccmode"
	default y

endmenu
#a blank line must be existed
```

## security/sop/Kconfig
```kconfig
#
# Copyright (c) Huawei Technologies Co., Ltd. 2019-2020. All rights reserved.
# Description: Huawei so protect configuration
# Create: 2019-08-03
#

menu "Huawei SOP"

config HUAWEI_SOP
	bool "enables HUAWEI SOP (so protect)"
	default n
	help
	  The SOP framework is composed of a set of subsystems that
	  are needed to protect so.
config HUAWEI_SOP_ENG
	bool "Huawei SOP for engineering mode debug"
	depends on HUAWEI_SOP
	default n
	help
	  This option should only be enabled for engineering mode & debug test.
	  In engineering mode, SOP will be turnoff(default) after init,
	  tester can use supported interface to turn it on, and do debug test.

endmenu
#a blank line must be existed
```
