## sound/soc/codecs/hisi/da_combine_v3/Kconfig
```kconfig
config SND_SOC_DA_COMBINE_V3
	tristate "Soc Smartstar Codec DA combine v3 support"
```

## sound/soc/codecs/hisi/da_combine_v5/Kconfig
```kconfig
config SND_SOC_DA_COMBINE_V5
	tristate "Soc Smartstar Codec da combine v5 support"
```

## sound/soc/codecs/hisi/da_separate/Kconfig
```kconfig
source "sound/soc/codecs/hisi/da_separate/da_separate_v3/Kconfig"

config SND_SOC_CODEC_DA_SEPARATE_V5
	tristate "HI Soc Smartstar Codec da_separate_v5 support"

config SND_SOC_CODEC_DA_SEPARATE_V6B
	tristate "HI Soc Smartstar Codec da_separate_v6b support"

config SND_SOC_CODEC_DA_SEPARATE_V6L
	tristate "HI Soc Smartstar Codec da_separate_v6l support"

config SND_SOC_DA_SEPARATE_CODEC
	tristate
	default y if SND_SOC_CODEC_DA_SEPARATE_V3=y || SND_SOC_CODEC_DA_SEPARATE_V5=y || SND_SOC_CODEC_DA_SEPARATE_V6B=y || SND_SOC_CODEC_DA_SEPARATE_V6L=y
	default m if SND_SOC_CODEC_DA_SEPARATE_V3=m || SND_SOC_CODEC_DA_SEPARATE_V5=m || SND_SOC_CODEC_DA_SEPARATE_V6B=m || SND_SOC_CODEC_DA_SEPARATE_V6L=m

config SND_SOC_DA_SEPARATE_I2S
	tristate
	default y if SND_SOC_CODEC_DA_SEPARATE_V3=y || SND_SOC_CODEC_DA_SEPARATE_V5=y || SND_SOC_CODEC_DA_SEPARATE_V6B=y || SND_SOC_CODEC_DA_SEPARATE_V6L=y
	default m if SND_SOC_CODEC_DA_SEPARATE_V3=m || SND_SOC_CODEC_DA_SEPARATE_V5=m || SND_SOC_CODEC_DA_SEPARATE_V6B=m || SND_SOC_CODEC_DA_SEPARATE_V6L=m

config SND_SOC_DA_SEPARATE_UTILITY
	tristate
	default y if SND_SOC_CODEC_DA_SEPARATE_V3=y || SND_SOC_CODEC_DA_SEPARATE_V5=y || SND_SOC_CODEC_DA_SEPARATE_V6B=y || SND_SOC_CODEC_DA_SEPARATE_V6L=y
	default m if SND_SOC_CODEC_DA_SEPARATE_V3=m || SND_SOC_CODEC_DA_SEPARATE_V5=m || SND_SOC_CODEC_DA_SEPARATE_V6B=m || SND_SOC_CODEC_DA_SEPARATE_V6L=m

config SND_SOC_DA_SEPARATE_STORE
	tristate
	default y if SND_SOC_CODEC_DA_SEPARATE_V3=y || SND_SOC_CODEC_DA_SEPARATE_V5=y || SND_SOC_CODEC_DA_SEPARATE_V6B=y || SND_SOC_CODEC_DA_SEPARATE_V6L=y
	default m if SND_SOC_CODEC_DA_SEPARATE_V3=m || SND_SOC_CODEC_DA_SEPARATE_V5=m || SND_SOC_CODEC_DA_SEPARATE_V6B=m || SND_SOC_CODEC_DA_SEPARATE_V6L=m

config SND_SOC_DA_SEPARATE_CORE_PATH
	tristate
	default y if SND_SOC_CODEC_DA_SEPARATE_V3=y || SND_SOC_CODEC_DA_SEPARATE_V5=y || SND_SOC_CODEC_DA_SEPARATE_V6B=y || SND_SOC_CODEC_DA_SEPARATE_V6L=y
	default m if SND_SOC_CODEC_DA_SEPARATE_V3=m || SND_SOC_CODEC_DA_SEPARATE_V5=m || SND_SOC_CODEC_DA_SEPARATE_V6B=m || SND_SOC_CODEC_DA_SEPARATE_V6L=m

config SND_SOC_DA_SEPARATE_AUDIO_PATH
	tristate
	default y if SND_SOC_CODEC_DA_SEPARATE_V3=y || SND_SOC_CODEC_DA_SEPARATE_V5=y || SND_SOC_CODEC_DA_SEPARATE_V6B=y || SND_SOC_CODEC_DA_SEPARATE_V6L=y
	default m if SND_SOC_CODEC_DA_SEPARATE_V3=m || SND_SOC_CODEC_DA_SEPARATE_V5=m || SND_SOC_CODEC_DA_SEPARATE_V6B=m || SND_SOC_CODEC_DA_SEPARATE_V6L=m

config SND_SOC_DA_SEPARATE_ULTR_PATH
	tristate
	default y if SND_SOC_CODEC_DA_SEPARATE_V3=y || SND_SOC_CODEC_DA_SEPARATE_V5=y || SND_SOC_CODEC_DA_SEPARATE_V6B=y || SND_SOC_CODEC_DA_SEPARATE_V6L=y
	default m if SND_SOC_CODEC_DA_SEPARATE_V3=m || SND_SOC_CODEC_DA_SEPARATE_V5=m || SND_SOC_CODEC_DA_SEPARATE_V6B=m || SND_SOC_CODEC_DA_SEPARATE_V6L=m

config SND_SOC_DA_SEPARATE_VOICE_PATH
	tristate
	default y if SND_SOC_CODEC_DA_SEPARATE_V3=y || SND_SOC_CODEC_DA_SEPARATE_V5=y || SND_SOC_CODEC_DA_SEPARATE_V6B=y || SND_SOC_CODEC_DA_SEPARATE_V6L=y
	default m if SND_SOC_CODEC_DA_SEPARATE_V3=m || SND_SOC_CODEC_DA_SEPARATE_V5=m || SND_SOC_CODEC_DA_SEPARATE_V6B=m || SND_SOC_CODEC_DA_SEPARATE_V6L=m

config SND_SOC_DA_SEPARATE_SMPA_PATH
	tristate
	default y if SND_SOC_CODEC_DA_SEPARATE_V3=y || SND_SOC_CODEC_DA_SEPARATE_V5=y || SND_SOC_CODEC_DA_SEPARATE_V6B=y || SND_SOC_CODEC_DA_SEPARATE_V6L=y
	default m if SND_SOC_CODEC_DA_SEPARATE_V3=m || SND_SOC_CODEC_DA_SEPARATE_V5=m || SND_SOC_CODEC_DA_SEPARATE_V6B=m || SND_SOC_CODEC_DA_SEPARATE_V6L=m

config SND_SOC_DA_SEPARATE_THIRD_CODEC_PATH
	tristate
	default y if SND_SOC_CODEC_DA_SEPARATE_V3=y || SND_SOC_CODEC_DA_SEPARATE_V5=y || SND_SOC_CODEC_DA_SEPARATE_V6B=y || SND_SOC_CODEC_DA_SEPARATE_V6L=y
	default m if SND_SOC_CODEC_DA_SEPARATE_V3=m || SND_SOC_CODEC_DA_SEPARATE_V5=m || SND_SOC_CODEC_DA_SEPARATE_V6B=m || SND_SOC_CODEC_DA_SEPARATE_V6L=m

config SND_SOC_DA_SEPARATE_BTFM_PATH
	tristate
	default y if SND_SOC_CODEC_DA_SEPARATE_V3=y || SND_SOC_CODEC_DA_SEPARATE_V5=y || SND_SOC_CODEC_DA_SEPARATE_V6B=y || SND_SOC_CODEC_DA_SEPARATE_V6L=y
	default m if SND_SOC_CODEC_DA_SEPARATE_V3=m || SND_SOC_CODEC_DA_SEPARATE_V5=m || SND_SOC_CODEC_DA_SEPARATE_V6B=m || SND_SOC_CODEC_DA_SEPARATE_V6L=m

config SND_SOC_DA_SEPARATE_MAD_PATH
	tristate
	default y if SND_SOC_CODEC_DA_SEPARATE_V5=y || SND_SOC_CODEC_DA_SEPARATE_V6B=y || SND_SOC_CODEC_DA_SEPARATE_V6L=y
	default m if SND_SOC_CODEC_DA_SEPARATE_V5=m || SND_SOC_CODEC_DA_SEPARATE_V6B=m || SND_SOC_CODEC_DA_SEPARATE_V6L=m

config SND_SOC_DA_SEPARATE_AU_PA_PATH
	tristate
	default y if SND_SOC_CODEC_DA_SEPARATE_V6B=y || SND_SOC_CODEC_DA_SEPARATE_V6L=y
	default m if SND_SOC_CODEC_DA_SEPARATE_V6B=m || SND_SOC_CODEC_DA_SEPARATE_V6L=m
```

## sound/soc/codecs/hisi/da_separate/da_separate_v2/Kconfig
```kconfig
config SND_SOC_CODEC_DA_SEPARATE_V2
	tristate "Soc Smartstar Codec da separate v2 support"
```

## sound/soc/codecs/hisi/da_separate/da_separate_v3/Kconfig
```kconfig
config SND_SOC_CODEC_DA_SEPARATE_V3
	tristate "Soc Smartstar Codec da_separate_v3 support"
```

## sound/soc/codecs/hisi/hi6555/Kconfig
```kconfig
config SND_SOC_CODEC_HI6555V3
	tristate "HI Soc Smartstar Codec 6555v3 support"

config SND_SOC_CODEC_HI6555V5
	tristate "HI Soc Smartstar Codec 6555v5 support"

config SND_SOC_HI6555_CODEC
	tristate
	default y if SND_SOC_CODEC_HI6555V3=y || SND_SOC_CODEC_HI6555V5=y
	default m if SND_SOC_CODEC_HI6555V3=m || SND_SOC_CODEC_HI6555V5=m

config SND_SOC_HI6555_I2S
	tristate
	default y if SND_SOC_CODEC_HI6555V3=y || SND_SOC_CODEC_HI6555V5=y
	default m if SND_SOC_CODEC_HI6555V3=m || SND_SOC_CODEC_HI6555V5=m

config SND_SOC_HI6555_UTILITY
	tristate
	default y if SND_SOC_CODEC_HI6555V3=y || SND_SOC_CODEC_HI6555V5=y
	default m if SND_SOC_CODEC_HI6555V3=m || SND_SOC_CODEC_HI6555V5=m

config SND_SOC_HI6555_STORE
	tristate
	default y if SND_SOC_CODEC_HI6555V3=y || SND_SOC_CODEC_HI6555V5=y
	default m if SND_SOC_CODEC_HI6555V3=m || SND_SOC_CODEC_HI6555V5=m

config SND_SOC_HI6555_CORE_PATH
	tristate
	default y if SND_SOC_CODEC_HI6555V3=y || SND_SOC_CODEC_HI6555V5=y
	default m if SND_SOC_CODEC_HI6555V3=m || SND_SOC_CODEC_HI6555V5=m

config SND_SOC_HI6555_AUDIO_PATH
	tristate
	default y if SND_SOC_CODEC_HI6555V3=y || SND_SOC_CODEC_HI6555V5=y
	default m if SND_SOC_CODEC_HI6555V3=m || SND_SOC_CODEC_HI6555V5=m

config SND_SOC_HI6555_ULTR_PATH
	tristate
	default y if SND_SOC_CODEC_HI6555V3=y || SND_SOC_CODEC_HI6555V5=y
	default m if SND_SOC_CODEC_HI6555V3=m || SND_SOC_CODEC_HI6555V5=m

config SND_SOC_HI6555_VOICE_PATH
	tristate
	default y if SND_SOC_CODEC_HI6555V3=y || SND_SOC_CODEC_HI6555V5=y
	default m if SND_SOC_CODEC_HI6555V3=m || SND_SOC_CODEC_HI6555V5=m

config SND_SOC_HI6555_SMPA_PATH
	tristate
	default y if SND_SOC_CODEC_HI6555V3=y || SND_SOC_CODEC_HI6555V5=y
	default m if SND_SOC_CODEC_HI6555V3=m || SND_SOC_CODEC_HI6555V5=m

config SND_SOC_HI6555_THIRD_CODEC_PATH
	tristate
	default y if SND_SOC_CODEC_HI6555V3=y || SND_SOC_CODEC_HI6555V5=y
	default m if SND_SOC_CODEC_HI6555V3=m || SND_SOC_CODEC_HI6555V5=m

config SND_SOC_HI6555_BTFM_PATH
	tristate
	default y if SND_SOC_CODEC_HI6555V3=y || SND_SOC_CODEC_HI6555V5=y
	default m if SND_SOC_CODEC_HI6555V3=m || SND_SOC_CODEC_HI6555V5=m
```

## sound/soc/hisilicon/Kconfig
```kconfig
menu "SoC Audio support for CODEC"

config SND_DA_SEPARATE_MACHINE
	tristate "da separate machine sound support"
	help
	  Say y to enable sound support for da separate machine

config SND_DA_COMBINE_MACHINE
	tristate "da combine machine sound support"
	help
	  Say y to enable sound support for da combine machine

config SND_ANALOG_LESS_MACHINE
	tristate "analgo less machine sound support"
	help
	  Say y to enable sound support for analog less machine

config SND_SOC_DP_AUDIO
	tristate "SoC Audio support for DP audio"
	help
		This option enables DP audio.

config SND_AUTO_TEST
	tristate "Auto test sound support"
	help
		This option enables sound auto tesrt.

config SND_SOC_SLIMBUS_DAI
	tristate "Support SLIMBUS DAI"
	default y

source "sound/soc/hisilicon/pcm_codec/Kconfig"
endmenu
```

## sound/soc/hisilicon/pcm_codec/Kconfig
```kconfig
config SND_SOC_PCM_CODECS
	tristate "SoC Audio support for pcm codec"
	default n
```
