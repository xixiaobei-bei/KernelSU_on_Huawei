## drivers/cpufreq/hisi/Kconfig.arm
```kconfig
config LP_ENABLE_GET_VAL
	bool "Get cpufreq param"
	default n
	help
	  Get cpufreq param.

config LP_ENABLE_HPM_DATA_COLLECT
	bool "Get hpm volt param"
	depends on LP_ENABLE_GET_VAL
	default n
	help
	  Get avs hpm volt param.

config HISI_CPUFREQ_DT
	bool "Platform cpufreq-dt enable"
	depends on CPUFREQ_DT
	default n
	help
	  Customized cpufreq-dt enable.

config LPCPU_HW_VOTE_CPU_FREQ
	bool "Cpufreq-hw_vote enable"
	depends on HISI_CPUFREQ_DT && HW_VOTE
	default n
	help
	  Cpufreq-hw_vote enable.

config LPCPU_L2_DYNAMIC_RETENTION
	bool "L2 dynamic retention by freq"
	depends on LPCPU_HW_VOTE_CPU_FREQ
	default n
	help
	  L2 dynamic retention.

config LPCPU_FREQ_LINK
	bool "Cpu and devices freq link enable"
	depends on CPUFREQ_DT
	default n
	help
	  Cpu and devices freq link enable.

config CPU_FREQ_POWER_STAT
	bool "Estimation of task power consumption"
	depends on CPU_FREQ_STAT
	select CPU_FREQ_TIMES
	default n
	help
	  Keep track of amount of power each task consumes and report power per uid

config CPU_FREQ_GOV_SCHEDUTIL_OPT
	bool "Platform 'schedutil' cpufreq governor optimize"
	depends on CPU_FREQ_GOV_SCHEDUTIL
	default n
	help
	  This extends the functionality of existing schedutil governor.

config HISI_CPU_FREQ_LOCK_DETECT
	bool "Platform schedutil detect freq lock&unlock"
	depends on CPU_FREQ_GOV_SCHEDUTIL_OPT
	default n
	help
	  This extends min_sample_time when boost scene finish


config LPCPU_CPUFREQ_LOWTEMP
	bool "Low temperature cpu frequency set enable"
	depends on CPUFREQ_DT
	default n
	help
	  Low temperature cpu frequency set enable.

config LPCPU_CPUFREQ_LOWTEMP_DEBUG
	bool "Low temperature cpu frequency set debug enable"
	depends on LPCPU_CPUFREQ_LOWTEMP && HISI_DEBUG_FS
	default n
	help
	  Low temperature cpu frequency set debug enable.

config HISI_CPUFREQ_GOVERNOR_BACKUP
	bool "Backup cpufreq governor tunables"
	depends on CPU_FREQ
	default n
	help
	  Save and restore cpufreq governor tunables set by userspace.

config HISI_FREQ_STATS_COUNTING_IDLE
	bool "time in state seperate active and idle time"
	depends on CPU_FREQ_STAT && CPU_IDLE
	default n
	help
	  Account active and idle time in different frequencies.

config HISI_FREQ_IO_LIMIT
	bool "Limit IO boost Freqency"
	depends on CPU_FREQ_GOV_SCHEDUTIL_OPT
	default n
	help
	  limit maximum io-boost frequency
```

## drivers/devfreq/hisi/Kconfig
```kconfig
config DEVFREQ
	tristate "DEVFREQ Driver"
	depends on ARCH_HISI && PM_DEVFREQ
	select PM_OPP
	help
	  devfreq driver common module.

source "drivers/devfreq/hisi/ddr_devfreq/Kconfig"
source "drivers/devfreq/hisi/dsu_pctrl/Kconfig"
source "drivers/devfreq/hisi/gpu_devfreq/Kconfig"
source "drivers/devfreq/hisi/l3c_devfreq/Kconfig"
source "drivers/devfreq/hisi/mem_lat/Kconfig"
source "drivers/devfreq/hisi/npu_devfreq/Kconfig"
source "drivers/devfreq/hisi/cmfup_devfreq/Kconfig"
```

## drivers/devfreq/hisi/cmfup_devfreq/Kconfig
```kconfig
config CMFUP_DEVFREQ
	tristate "cmfup DEVFREQ Driver"
	depends on PM_DEVFREQ
	help
	   This enables the cpu max freq using policy devfreq driver.
```

## drivers/devfreq/hisi/ddr_devfreq/Kconfig
```kconfig
config HISI_DDR_DEVFREQ
	tristate "Hisilicon DDR DEVFREQ Driver"
	depends on ARCH_HISI && PM_DEVFREQ
	select PM_OPP
	select DEVFREQ_GOV_PM_QOS
	select DEVFREQ
	help
	  This enables the hisilicon DDRfreq driver.

config DEVFREQ_GOV_PM_QOS
	bool "PM QOS"
	help
	  Sets the frequency based on pm_qos throughput constraints.

config DEVFREQ_DMSS_LATENCY
	bool "PM QOS DMSS"
	depends on DEVFREQ_GOV_PM_QOS
	help
	  Sets the dmss frequency based on pm_qos throughput constraints.

config HISI_DDR_CHINTLV
	bool "Hisilicon ddr devfreq chintlv"
	default n
	help
	  Deliver register address of GLB_ADDR_INTLV to ATF.

config HISI_DDR_DEVFREQ_DEBUGFS
	bool "Hisilicon ddr devfreq debugfs"
	depends on HI3650_DDR_DEVFREQ && DEBUG_FS
	default n
	help
	  This is a testing driver for HISI ddr devfreq function.

config DDR_HW_VOTE_15BITS
	bool "Hisilicon ddr dfs hardware vote 15 bits"
	depends on HISI_DDR_DEVFREQ
	default n
	help
	  Hisilicon ddr dfs "hardware vote 15 bits" enbale.

config DDR_FREQ_BACKUP
        bool "Hisilicon ddr freq buckup vote for s4"
        depends on HISI_DDR_DEVFREQ
        default n
        help
          Hisilicon ddr dfs "ddr freq buckup vote for s4" enbale.

config HISI_MEM_PERF_SCENE_AWARE
	bool "Hisilicon memory perf scene aware"
	help
	  Provide interface to select multiple perf scenes

config DDR_DEVFREQ_DFX
	bool "DDR devfreq dfx info"
	depends on HISI_DDR_DEVFREQ
	default n
	help
	  Record and print ddr devfreq dfx info record and print.
```

## drivers/devfreq/hisi/gpu_devfreq/Kconfig
```kconfig
config DEVFREQ_GOV_GPU_SCENE_AWARE
	tristate "GPU Scene Aware"
	depends on ARCH_HISI && PM_DEVFREQ
	select PM_OPP
	select DEVFREQ

config GPU_RT_DEVFREQ
	bool "force update devfreq when gpu in runtime"
	default n
	depends on DEVFREQ_GOV_GPU_SCENE_AWARE

config GPUFREQ_GOV_POLICY_USING_DTSI
	bool "gpu governor policy using dtsi"
	default n
	depends on DEVFREQ_GOV_GPU_SCENE_AWARE
```
