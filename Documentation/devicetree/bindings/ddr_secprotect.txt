## Documentation/devicetree/bindings/ddr_secprotect.txt
```
DDR SECPROTECT

Required properties:
 - compatible : Should be "hisilicon,ddr_secprotect"
 - reg        : Should contain an entry for each value in 'reg-names'.
                Each entry should have the memory region's start address
                and the size of the region, the representation matching
                the parent node's '#address-cells' and '#size-cells' values.
 - interrupts : Interrupt; mode, number and trigger

Example:

ddr: ddr@fffc0000 {
                       #address-cells = <2>;
                       #size-cells = <2>;
                       compatible = "hisilicon,ddr_secprotect";
                       reg = <0x0 0xfffc0000 0x0 0x20000>;
                       interrupts = <0 131 4>;
                       status = "ok";
};
```

## Documentation/devicetree/bindings/leds/backlight/ktz8864.txt
```
ktz8864 bindings

Required properties:
- compatible		: Must be "ktz,ktz8864"

Optional properties:
- name			: Name of backlight device. Default is 'ktz8864'.
- ktz8864_hw_en_gpio			: GPIO to use to EN pin.
			See Documentation/devicetree/bindings/gpio/gpio.txt
- ktz8864_i2c_bus_id	: I2C bus index

Example:

	ktz,ktz8864{
		compatible = "ktz,ktz8864";
				ktz8864_support = <1>;
				reg = <0x11>;
				ktz8864_i2c_bus_id = <4>;
				ktz8864_hw_en_gpio = <10>;
				ktz8864_bl_en = <0x1F>;
				status = "disabled";
	};
```

## drivers/block/zram-s/Kconfig
```kconfig
# SPDX-License-Identifier: GPL-2.0
config ZRAM_S
	tristate "Super Compressed RAM block device support"
	depends on BLOCK && SYSFS && ZSMALLOC && CRYPTO && (ZRAM=n)
	select CRYPTO_LZO
	default n
	help
	  Creates virtual block devices called /dev/zramX (X = 0, 1, ...).
	  Pages written to these disks are compressed and stored in memory
	  itself. These disks allow very fast I/O and compression provides
	  good amounts of memory savings.

	  It has several use cases, for example: /tmp storage, use as swap
	  disks and maybe many more.

	  See Documentation/blockdev/zram.txt for more information.

config ZRAM_S_WRITEBACK
       bool "Write back incompressible or idle page to backing device"
       depends on ZRAM_S
       help
	 With incompressible page, there is no memory saving to keep it
	 in memory. Instead, write it out to backing device.
	 For this feature, admin should set up backing device via
	 /sys/block/zramX/backing_dev.

	 With /sys/block/zramX/{idle,writeback}, application could ask
	 idle page's writeback to the backing device to save in memory.

	 See Documentation/blockdev/zram.txt for more information.

config ZRAM_S_MEMORY_TRACKING
	bool "Track zRam block status"
	depends on ZRAM_S && DEBUG_FS
	help
	  With this feature, admin can track the state of allocated blocks
	  of zRAM. Admin could see the information via
	  /sys/kernel/debug/zram/zramX/block_state.

	  See Documentation/blockdev/zram.txt for more information.

config ZRAM_S_DEDUP
	bool "Memory deduplication"
	depends on ZRAM_S
	help
	  With this feature, zram could deduplicate the objects with the same
	  context. Admin could see the information via
	  /sys/block/zramX/mm_stat.
config ZRAM_S_NON_COMPRESS
	bool "zram non compress"
	depends on ZRAM_S
	help
	  With this feature, zram will not compress page that with NonCompress
          flag.
```

## drivers/block/zram/hp/Kconfig
```kconfig
# SPDX-License-Identifier: GPL-2.0
# Heterogeneous memory container backend device configuration

# Selected when system need heterogeneous memory container
config HP_CORE
	bool "Heterogeneous memory container device support"
	depends on ZRAM && HYPERHOLD && ZS_MALLOC_EXT
	default n
	---help---
	  Say Y here if you want to use the heterogeneous memory
	  as the backend device in ZRAM.
	  If unsure, say N here.
	  This module can't be compiled as a module,
	  the module is as one part of the ZRAM driver.

config HP_FILE
	bool "Heterogeneous memory file preallocate functions"
	depends on ZRAM && HYPERHOLD && ZS_MALLOC_EXT && HP_CORE
	default n
	---help---
	  Say Y here if you want to allocate a file in /data for heterogeneous memory.
	  If unsure, say N here.
	  This module can't be compiled as a module,
	  the module is as one part of the ZRAM driver.
```

## drivers/cfi/Kconfig
```kconfig
#
# CFI configuration
#

config HUAWEI_CFI_TAG
	hex "huawei cfi tag"
	default "0x0035c000"
	help
	  It configs the 4-byte value used to tag function entry.
	  Note, for ARM architecture, not all integer constants can be encoded in one instruction.
	  Refer to "Flexible second operand" in ARM Instruction Reference for more info.

config HUAWEI_CFI
	bool "HUAWEI CFI support"
	default n
	help
	  Say yes here to support the HUAWEI CFI feature
	  which adds a word to the head of a function and checks the word when jump to the function,to
	  avoid jop attack.
	  If you are unsure, say N.

config HUAWEI_CFI_DEBUG
	bool "HUAWEI CFI test support"
	default n
	help
	  Say yes here to support the HUAWEI CFI debug
	  debugfs is /proc/.
	  which give a debugfs to simulate jop attack.
	  If you are unsure, say N.
```

## drivers/char/hw_random/hisi_trng/Kconfig
```kconfig
#
# Copyright (c) Huawei Technologies Co., Ltd. 2019-2019. All rights reserved.
#
# This program is free software; you can redistribute it and/or modify
# it under the terms of the GNU General Public License version 2 as
# published by the Free Software Foundation.
#

config HW_RANDOM_HISI_TRNG
	tristate "Hisilicon Ture Random Number Generator support"
	default n
	depends on HW_RANDOM && ARCH_HISI && TZDRIVER && LOAD_IMAGE
	help
	---help---
	  This driver provides kernel-side support for the Random Number
	  Generator hardware found on dx engine.

	  To compile this driver as a module, choose M here: the
	  module will be called hisi-trng.

	  If unsure, say Y.
```

## drivers/clk/hisi/Kconfig
```kconfig
config HISI_CLK
	bool "clock driver of Soc"
	default n

config HISI_CLK_ALWAYS_ON
	bool "all clocks of Hisi Soc are always on"
	default n

config HISI_CLK_PM_MONITOR
	bool "clock pm_monitor spec"
	default n

config HISI_CLK_MAILBOX_SUPPORT
	depends on HISI_CLK
	depends on HISI_MAILBOX
	bool "clk driver support mailbox communication"
	default n

config HISI_CLK_DEBUG
	depends on DEBUG_FS
	bool "HiSilicon clock driver debug"
	default n

config HISI_CKM_MODULE
	depends on HISI_CLK
	bool "HiSilicon clk monitor driver"
	default n

config HISI_CLK_SMC_SUPPORT
	depends on HISI_CLK
	bool "HiSilicon clk SMC handler"
	default n

config HISI_PLL_LOCK_RETRY
	depends on HISI_CLK
	bool "HiSilicon clk pll lock retry"
	default n

config HISI_CLK_WAIT_DONE
	depends on HISI_CLK
	bool "HiSilicon clk wait div done"
	default n
```

## drivers/clk/hisi/debug/Kconfig
```kconfig
config HISI_CLK_DEBUG
	depends on DEBUG_FS
	bool "HiSilicon clock driver debug"
	default n
```

## drivers/clk/hisi_extreme/Kconfig
```kconfig
config HISI_CLK
	bool "clock driver of Soc"
	default n

config HISI_CLK_ALWAYS_ON
	bool "all clocks of Hisi Soc are always on"
	default n

config HISI_CLK_PM_MONITOR
	bool "clock pm_monitor spec"
	default n

config HISI_CLK_MAILBOX_SUPPORT
	depends on HISI_CLK
	depends on HISI_MAILBOX
	bool "clk driver support mailbox communication"
	default n

config HISI_CLK_DEBUG
	depends on DEBUG_FS
	bool "HiSilicon clock driver debug"
	default n

config HISI_CKM_MODULE
	depends on HISI_CLK
	bool "HiSilicon clk monitor driver"
	default n

config HISI_CLK_SMC_SUPPORT
	depends on HISI_CLK
	bool "HiSilicon clk SMC handler"
	default n

config HISI_PLL_LOCK_RETRY
	depends on HISI_CLK
	bool "HiSilicon clk pll lock retry"
	default n

config HISI_MCLK_SUPPORT
	depends on HISI_CLK_MAILBOX_SUPPORT
	bool "HiSilicon mclk support in phoe CDC"
	default n

config HISI_PLL_UNLOCK_DETECT
	depends on HISI_CLK
	bool "HiSilicon pll clk unlock detect"

config HISI_CLK_BUCK13_DVS
	bool "HiSilicon buck13 dvs feature"
	default n

config HISI_PLL_VOTE_SEC
	depends on HISI_CLK
	bool "HiSilicon clk pll vote sec"
	default n

config HISI_CLK_WAIT_DONE
	depends on HISI_CLK
	bool "HiSilicon clk wait div done"
	default n
```

## drivers/contexthub/Kconfig
```kconfig
config CONTEXTHUB
	bool "Sensor CONTEXTHUB driver"
	default n
	help
	Sensor CONTEXTHUB driver.

config CONTEXTHUB_SHMEM
	bool "Sensor CONTEXTHUB SHMEM driver"
	depends on INPUTHUB || INPUTHUB_20
	default y
	help
	Say yes here if you want to configure contexthub share memory

config CONTEXTHUB_SHELL
	bool "Sensor CONTEXTHUB SHELL DBG driver"
	depends on CONTEXTHUB
	default n
	help
	Say yes here if you want to use contexthub shell dbg function

config CONTEXTHUB_PLAYBACK
	bool "Sensor CONTEXTHUB playback driver"
	depends on CONTEXTHUB
	default n
	help
	Say yes here if you want to use contexthub playback function

config CONTEXTHUB_LOADMONITOR
	bool "Sensor CONTEXTHUB LOADMONITOR driver"
	depends on CONTEXTHUB
	default n
	help
	Say yes here if you want to use contexthub shell dbg function

config CONTEXTHUB_CHRE
	bool "Sensor CONTEXTHUB CHRE driver"
	depends on CONTEXTHUB
	default n
	help
	Say yes here if you want to use contexthub shell dbg function

config INPUTHUB_MOCK_SENSOR
	bool "mock sensor feature support"
	default n
	help
	Say yes here if you want to configure INPUTHUB_MOCK_SENSOR

config CONTEXTHUB_BOOT_STAT
	bool "sensorhub boot stat"
	depends on CONTEXTHUB
	default n
	help
	Say yes here if you want to record boot stat during sensorhub startup

config CONTEXTHUB_LOG_PATH_VAR
	bool "use sensorhub log path under /var"
	depends on CONTEXTHUB
	default n
	help
	Say yes here if you want to use log path under var directory of root path

config CONTEXTHUB_UDI
	bool "sensorhub udi"
	depends on CONTEXTHUB
	default n
	help
	Say yes here if you want to enable sensorhub udi

config CONTEXTHUB_BLE
	bool "sensorhub ble"
	depends on CONTEXTHUB
	default n
	help
	Say yes here if you want to enable sensorhub ble

config CONTEXTHUB_SH_NOCZERO
	bool "Sensor CONTEXTHUB_SH_NOCZERO"
	default n
	help
	Sensor CONTEXTHUB_SH_NOCZERO

source "drivers/contexthub/flp/Kconfig"
source "drivers/contexthub/igs/Kconfig"
source "drivers/contexthub/bsp/Kconfig"
source "drivers/contexthub/inputhub_as/Kconfig"
```

## drivers/contexthub/bsp/Kconfig
```kconfig
config INPUTHUB_30
	bool "INPUTHUB_30"
	depends on  CONTEXTHUB
	help
	support INPUTHUB_30.
```

## drivers/contexthub/flp/Kconfig
```kconfig
#
# FLP driver configuration
#

menu "SMART FLP configuration"

config SMART_SOFTTIMER
	bool "SMART SOFTTIMER support"
	depends on CONTEXTHUB
	default n
	---help---
	  Enable support for softtimer driver

config SMART_FLP
	bool "SMART FLP support"
	depends on SMART_SOFTTIMER
	default n
	---help---
	  Enable support for FLP driver

config SMART_FLP_GEOFENCE
	bool "SMART FLP GEOFENCE support"
	depends on SMART_FLP
	default n
	---help---
	  Enable support for GEOFENCE driver

config SMART_FLP_CELLFENCE
	bool "SMART FLP CELLFENCE support"
	depends on SMART_FLP
	default n
	---help---
	  Enable support for CELLFENCE driver

config SMART_FLP_WIFIFENCE
	bool "SMART_FLP_WIFIFENCE support"
	depends on SMART_FLP
	default n
	---help---
	  Enable support for WIFIFENCE driver

config SMART_FLP_BATCHING
	bool "SMART_FLP_BATCHING support"
	depends on SMART_FLP
	default n
	---help---
	  Enable support for BATCHING driver

config SMART_FLP_DIAG
	bool "SMART_FLP_DIAG support"
	depends on SMART_FLP
	default n
	---help---
	  Enable support for DIAG driver

config SMART_AR
	bool "SMART AR support"
	depends on SMART_SOFTTIMER
	default n
	---help---
	  Enable support for AR driver

config CONTEXTHUB_UNIFORM_INTERVAL
	bool "SMART CONTEXTHUB_UNIFORM_INTERVAL support"
	depends on SMART_AR
	default n
	---help---
	  Enable support for CONTEXTHUB_UNIFORM_INTERVAL driver

endmenu
```

## drivers/contexthub/igs/Kconfig
```kconfig
config CONTEXTHUB_IGS
	bool "intelligent gesture sensor driver"
	depends on INPUTHUB_20
	default n
	help
	Igs driver support aonn.

config CONTEXTHUB_IGS_DBG
	bool "intelligent gesture sensor dbg drvier"
	depends on INPUTHUB_20
	default n
	help
	Igs debug drvier support aonn.

config CONTEXTHUB_IGS_20
	bool "intelligent gesture sensor 2.0"
	default n
	help
	  intelligent gesture sensor 2.0 config
config CONTEXTHUB_IGS_TOF
	bool "intelligent gesture sensor tof"
	default n
	help
	Igs tof driver
```

## drivers/contexthub/inputhub_as/Kconfig
```kconfig
config INPUTHUB_AS
	bool "INPUTHUB_AS"
	depends on INPUTHUB_30
	default n
	help
	  support all scenario contexthub: channel buffer mechanism,
	  device detect manager, plat debug, logbuff and bus interface.

config INPUTHUB_DEBUG
	bool "INPUTHUB_DEBUG"
	depends on INPUTHUB_30
	default n
	help
	  support all scenario contexthub debug

config CONTEXTHUB_WATCH_FACTORY
	bool "Sensor CONTEXTHUB watch factory"
	depends on INPUTHUB_30
	default n
	help
	  Say yes here if you want to enable watch factory code

source "drivers/contexthub/inputhub_as/device/Kconfig"
source "drivers/contexthub/inputhub_as/sensor_channel/Kconfig"
source "drivers/contexthub/inputhub_as/fingerprint_channel/Kconfig"
```

## drivers/contexthub/inputhub_as/device/Kconfig
```kconfig
config CONTEXTHUB_DEVICE_DEMO
        bool "CONTEXTHUB_DEVICE_DEMO"
        depends on INPUTHUB_AS
        default n
        help
        support CONTEXTHUB_DEVICE_DEMO.

config CONTEXTHUB_DEVICE_CONNECTIVITY
        bool "CONTEXTHUB_DEVICE_CONNECTIVITY"
        depends on INPUTHUB_AS
        default n
        help
          support connectivity kernel driver

config CONTEXTHUB_DEVICE_GYRO
        bool "CONTEXTHUB_DEVICE_GYRO"
        depends on CONTEXTHUB_DEVICE_DEMO
        default n
        help
        Say yes here if you want to enable gyro
```

## drivers/contexthub/inputhub_as/fingerprint_channel/Kconfig
```kconfig
config FINGERPRINT_CHANNEL
	bool "FINGERPRINT_CHANNEL"
	depends on INPUTHUB_AS
	help
	support FINGERPRINT_CHANNEL.
```

## drivers/contexthub/inputhub_as/sensor_channel/Kconfig
```kconfig
config SENSOR_CHANNEL
	bool "SENSOR_CHANNEL"
	depends on INPUTHUB_AS
	help
	support SENSOR_CHANNEL.

config CTXHUB_AS_AR
	bool "CTXHUB_AS_AR"
	depends on SENSOR_CHANNEL
	default n
	help
	support ar use sensor channel report data and pass cmd to sensorhub

config CTXHUB_AS_PEDOMETER
	bool "CTXHUB_AS_PEDOMETER"
	depends on SENSOR_CHANNEL
	default n
	help
	support pedometer use sensor channel report data and pass cmd to sensorhub

config CTXHUB_AS_GYRO
	bool "CTXHUB_AS_GYRO"
	depends on SENSOR_CHANNEL
	default n
	help
	support gyro use sensor channel report data and pass cmd to sensorhub
```
